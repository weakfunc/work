[part 4 of 4: package /ETAS_Project/EcucModuleConfigurationValuess]
AUTOSAR XML (schema 4-2-2)
package /ETAS_Project/EcucModuleConfigurationValuess  (continued)
  module config Com: implementation-config-variant=VARIANT-PRE-COMPILE  (continued)
    ComConfig_0 (ComConfig)  (continued)
      LMC_0x18C_C_CANFD (ComIPdu):
        ComIPduSignalProcessing = IMMEDIATE
        ComIPduType = NORMAL
        ComIPduDirection = RECEIVE
        ComIPduCallout = ComCallOut_LMC_0x18C_C_CANFD
        ComIPduErrorNotification = ComCbk_RxTimeOut_LMC_0x18C_C_CANFD
        ComFirstTimeout = 2.2
        ComTimeout = 0.2
        ComIPduGroupRef = ComIPduGroup_Rx
        ComPduIdRef = PduCollection/LMC_0x18C_C_CANFD_PduR2Com
        ComIPduSignalRef = LMC_CRC_18C
        ComIPduSignalRef = LMC_RollingCounter_18C
        ComIPduSignalRef = LMC_TqTotalBrakeTorque
        ComIPduSignalRef = LMC_TqTotalBrakeTorque_Valid
        ComIPduSignalRef = LMC_CmpUTurnLockwhists
      5 x ComSignal, all with ComSignalInitValue=0, ComSignalEndianness=LITTLE_ENDIAN, ComUpdateBitPosition=-1, ComTransferProperty=TRIGGERED:
        LMC_CRC_18C: ComSignalType=UINT8, ComBitSize=8, ComBitPosition=0, ComNotification=Rte_COMCbk_LMC_CRC_18C, ComSystemTemplateSystemSignalRef=LMC_CRC_18C
        LMC_RollingCounter_18C: ComSignalType=UINT8, ComBitSize=4, ComBitPosition=8, ComNotification=Rte_COMCbk_LMC_RollingCounter_18C, ComSystemTemplateSystemSignalRef=LMC_RollingCounter_18C
        LMC_TqTotalBrakeTorque: ComSignalType=UINT16, ComBitSize=15, ComBitPosition=80, ComNotification=Rte_COMCbk_LMC_TqTotalBrakeTorque, ComSystemTemplateSystemSignalRef=LMC_TqTotalBrakeTorque
        LMC_TqTotalBrakeTorque_Valid: ComSignalType=BOOLEAN, ComBitSize=1, ComBitPosition=95, ComNotification=Rte_COMCbk_LMC_TqTotalBrakeTorque_Valid, ComSystemTemplateSystemSignalRef=LMC_TqTotalBrakeTorque_Valid
        LMC_CmpUTurnLockwhists: ComSignalType=UINT8, ComBitSize=3, ComBitPosition=132, ComNotification=Rte_COMCbk_LMC_CmpUTurnLockwhists, ComSystemTemplateSystemSignalRef=LMC_CmpUTurnLockwhists
      ADDC_0x83_C_CANFD (ComIPdu):
        ComIPduSignalProcessing = IMMEDIATE
        ComIPduType = NORMAL
        ComIPduDirection = RECEIVE
        ComIPduCallout = ComCallOut_HPCADAS_0x83_C_CANFD
        ComIPduErrorNotification = ComCbk_RxTimeOut_HPCADAS_0x83_C_CANFD
        ComFirstTimeout = 2.2
        ComTimeout = 0.2
        ComIPduGroupRef = ComIPduGroup_Rx
        ComPduIdRef = PduCollection/ADDC_0x83_C_CANFD_PduR2Com
        ComIPduSignalRef = ADDC_CRC_83
        ComIPduSignalRef = ADDC_ACC_AVHReq
        ComIPduSignalRef = ADDC_ACC_HoldSts
        ComIPduSignalRef = ADDC_ACCTargetTrq
        ComIPduSignalRef = ADDC_ACCTargetTrqVD
        ComIPduSignalRef = ADDC_ACCTargetTrqBrkVD
        ComIPduSignalRef = ADDC_ACCTargetTrqBrk
        ComIPduSignalRef = ADDC_MAIWarnTrqCtrlFlg
        ComIPduSignalRef = ADDC_RollingCounter_83
        ComIPduSignalRef = ADDC_ACC_FunType
        ComIPduSignalRef = ADDC_ACCMode
        ComIPduSignalRef = ADDC_Driveoff_Request
        ComIPduSignalRef = ADDC_DecToStop
        ComIPduSignalRef = ADDC_ACCAvailable
        ComIPduSignalRef = ADDC_ACCTargetAcc
        ComIPduSignalRef = ADDC_ACCTargetAccVD
        ComIPduSignalRef = ADDC_ACC_RecordingPulse
        ComIPduSignalRef = ADDC_VehicleSpeedCtlVD
        ComIPduSignalRef = ADDC_VehicleSpeedCtl
        ComIPduSignalRef = ADDC_ACC_EPBReq
        ComIPduSignalRef = ADDC_ACC_VehicleDirectCtl
        ComIPduSignalRef = ADDC_ACC_VehicleDirectCtlVD
        ComIPduSignalRef = ADDC_AEBTargetDec
        ComIPduSignalRef = ADDC_AEBDecCtrl
        ComIPduSignalRef = ADDC_AEBMode
        ComIPduSignalRef = ADDC_AEBAvailable
        ComIPduSignalRef = ADDC_ACC_VLCCtlReq
        ComIPduSignalRef = ADDC_ACC_OvrdSts
        ComIPduSignalRef = ADDC_RCTB_DecReq
        ComIPduSignalRef = ADDC_RAEB_DecReq
        ComIPduSignalRef = ADDC_MEB_DecReq
      39 x ComSignal, all with ComSignalInitValue=0, ComSignalEndianness=LITTLE_ENDIAN, ComUpdateBitPosition=-1, ComTransferProperty=TRIGGERED:
        ADDC_CRC_83: ComSignalType=UINT8, ComBitSize=8, ComBitPosition=0, ComNotification=Rte_COMCbk_ADDC_CRC_83, ComSystemTemplateSystemSignalRef=ADDC_CRC_83
        ADDC_ACC_AVHReq: ComSignalType=BOOLEAN, ComBitSize=1, ComBitPosition=62, ComNotification=Rte_COMCbk_ADDC_ACC_AVHReq, ComSystemTemplateSystemSignalRef=ADDC_ACC_AVHReq
        ADDC_ACC_HoldSts: ComSignalType=BOOLEAN, ComBitSize=1, ComBitPosition=61, ComNotification=Rte_COMCbk_ADDC_ACC_HoldSts, ComSystemTemplateSystemSignalRef=ADDC_ACC_HoldSts
        ADDC_ACCTargetTrq: ComSignalType=UINT16, ComBitSize=14, ComBitPosition=242, ComNotification=Rte_COMCbk_ADDC_ACCTargetTrq, ComSystemTemplateSystemSignalRef=ADDC_ACCTargetTrq
        ADDC_ACCTargetTrqVD: ComSignalType=BOOLEAN, ComBitSize=1, ComBitPosition=241, ComNotification=Rte_COMCbk_ADDC_ACCTargetTrqVD, ComSystemTemplateSystemSignalRef=ADDC_ACCTargetTrqVD
        ADDC_ACCTargetTrqBrkVD: ComSignalType=BOOLEAN, ComBitSize=1, ComBitPosition=240, ComNotification=Rte_COMCbk_ADDC_ACCTargetTrqBrkVD, ComSystemTemplateSystemSignalRef=ADDC_ACCTargetTrqBrkVD
        ADDC_ACCTargetTrqBrk: ComSignalType=UINT16, ComBitSize=13, ComBitPosition=227, ComNotification=Rte_COMCbk_ADDC_ACCTargetTrqBrk, ComSystemTemplateSystemSignalRef=ADDC_ACCTargetTrqBrk
        ADDC_MAIWarnTrqCtrlFlg: ComSignalType=UINT8, ComBitSize=3, ComBitPosition=224, ComNotification=Rte_COMCbk_ADDC_MAIWarnTrqCtrlFlg, ComSystemTemplateSystemSignalRef=ADDC_MAIWarnTrqCtrlFlg
        ADDC_RollingCounter_83: ComSignalType=UINT8, ComBitSize=4, ComBitPosition=8, ComNotification=Rte_COMCbk_ADDC_RollingCounter_83, ComSystemTemplateSystemSignalRef=ADDC_RollingCounter_83
        ADDC_ACC_FunType: ComSignalType=UINT8, ComBitSize=2, ComBitPosition=20, ComNotification=Rte_COMCbk_ADDC_ACC_FunType, ComSystemTemplateSystemSignalRef=ADDC_ACC_FunType
        ADDC_ACCMode: ComSignalType=UINT8, ComBitSize=3, ComBitPosition=25, ComNotification=Rte_COMCbk_ADDC_ACCMode, ComSystemTemplateSystemSignalRef=ADDC_ACCMode
        ADDC_Driveoff_Request: ComSignalType=BOOLEAN, ComBitSize=1, ComBitPosition=28, ComNotification=Rte_COMCbk_ADDC_Driveoff_Request, ComSystemTemplateSystemSignalRef=ADDC_Driveoff_Request
        ADDC_DecToStop: ComSignalType=BOOLEAN, ComBitSize=1, ComBitPosition=29, ComNotification=Rte_COMCbk_ADDC_DecToStop, ComSystemTemplateSystemSignalRef=ADDC_DecToStop
        ADDC_ACCAvailable: ComSignalType=BOOLEAN, ComBitSize=1, ComBitPosition=30, ComNotification=Rte_COMCbk_ADDC_ACCAvailable, ComSystemTemplateSystemSignalRef=ADDC_ACCAvailable
        ADDC_ACCTargetAcc: ComSignalType=UINT8, ComBitSize=8, ComBitPosition=32, ComNotification=Rte_COMCbk_ADDC_ACCTargetAcc, ComSystemTemplateSystemSignalRef=ADDC_ACCTargetAcc
        ADDC_ACCTargetAccVD: ComSignalType=BOOLEAN, ComBitSize=1, ComBitPosition=40, ComNotification=Rte_COMCbk_ADDC_ACCTargetAccVD, ComSystemTemplateSystemSignalRef=ADDC_ACCTargetAccVD
        ADDC_ACC_RecordingPulse: ComSignalType=UINT8, ComBitSize=2, ComBitPosition=42, ComNotification=Rte_COMCbk_ADDC_ACC_RecordingPulse, ComSystemTemplateSystemSignalRef=ADDC_ACC_RecordingPulse
        ADDC_VehicleSpeedCtlVD: ComSignalType=BOOLEAN, ComBitSize=1, ComBitPosition=44, ComNotification=Rte_COMCbk_ADDC_VehicleSpeedCtlVD, ComSystemTemplateSystemSignalRef=ADDC_VehicleSpeedCtlVD
        ADDC_VehicleSpeedCtl: ComSignalType=UINT16, ComBitSize=11, ComBitPosition=45, ComNotification=Rte_COMCbk_ADDC_VehicleSpeedCtl, ComSystemTemplateSystemSignalRef=ADDC_VehicleSpeedCtl
        ADDC_ACC_EPBReq: ComSignalType=UINT8, ComBitSize=2, ComBitPosition=56, ComNotification=Rte_COMCbk_ADDC_ACC_EPBReq, ComSystemTemplateSystemSignalRef=ADDC_ACC_EPBReq
        ADDC_ACC_VehicleDirectCtl: ComSignalType=UINT8, ComBitSize=2, ComBitPosition=58, ComNotification=Rte_COMCbk_ADDC_ACC_VehicleDirectCtl, ComSystemTemplateSystemSignalRef=ADDC_ACC_VehicleDirectCtl
        ADDC_ACC_VehicleDirectCtlVD: ComSignalType=BOOLEAN, ComBitSize=1, ComBitPosition=60, ComNotification=Rte_COMCbk_ADDC_ACC_VehicleDirectCtlVD, ComSystemTemplateSystemSignalRef=ADDC_ACC_VehicleDirectCtlVD
        ADDC_AEBTargetDec: ComSignalType=UINT16, ComBitSize=16, ComBitPosition=64, ComNotification=Rte_COMCbk_ADDC_AEBTargetDec, ComSystemTemplateSystemSignalRef=ADDC_AEBTargetDec
        ADDC_AEBDecCtrl: ComSignalType=BOOLEAN, ComBitSize=1, ComBitPosition=80, ComNotification=Rte_COMCbk_ADDC_AEBDecCtrl, ComSystemTemplateSystemSignalRef=ADDC_AEBDecCtrl
        ADDC_AEBMode: ComSignalType=UINT8, ComBitSize=3, ComBitPosition=91, ComNotification=Rte_COMCbk_ADDC_AEBMode, ComSystemTemplateSystemSignalRef=ADDC_AEBMode
        ADDC_AEBAvailable: ComSignalType=BOOLEAN, ComBitSize=1, ComBitPosition=94, ComNotification=Rte_COMCbk_ADDC_AEBAvailable, ComSystemTemplateSystemSignalRef=ADDC_AEBAvailable
        ADDC_ACC_VLCCtlReq: ComSignalType=BOOLEAN, ComBitSize=1, ComBitPosition=178, ComNotification=Rte_COMCbk_ADDC_ACC_VLCCtlReq, ComSystemTemplateSystemSignalRef=ADDC_ACC_VLCCtlReq
        ADDC_ACC_OvrdSts: ComSignalType=BOOLEAN, ComBitSize=1, ComBitPosition=179, ComNotification=Rte_COMCbk_ADDC_ACC_OvrdSts, ComSystemTemplateSystemSignalRef=ADDC_ACC_OvrdSts
        ADDC_RCTB_DecReq: ComSignalType=BOOLEAN, ComBitSize=1, ComBitPosition=181, ComNotification=Rte_COMCbk_ADDC_RCTB_DecReq, ComSystemTemplateSystemSignalRef=ADDC_RCTB_DecReq
        ADDC_RAEB_DecReq: ComSignalType=BOOLEAN, ComBitSize=1, ComBitPosition=193, ComNotification=Rte_COMCbk_ADDC_RAEB_DecReq, ComSystemTemplateSystemSignalRef=ADDC_RAEB_DecReq
        ADDC_MEB_DecReq: ComSignalType=BOOLEAN, ComBitSize=1, ComBitPosition=195, ComNotification=Rte_COMCbk_ADDC_MEB_DecReq, ComSystemTemplateSystemSignalRef=ADDC_MEB_DecReq
        LMC_SysSt: ComSignalType=UINT8, ComBitSize=2, ComBitPosition=176, ComNotification=Rte_COMCbk_LMC_SysSt, ComSystemTemplateSystemSignalRef=LMC_SysSt
        LMC_HSPC_ActiveSt: ComSignalType=BOOLEAN, ComBitSize=1, ComBitPosition=180, ComNotification=Rte_COMCbk_LMC_HSPC_ActiveSt, ComSystemTemplateSystemSignalRef=LMC_HSPC_ActiveSt
        LMC_FTSC_ActiveSt: ComSignalType=BOOLEAN, ComBitSize=1, ComBitPosition=181, ComNotification=Rte_COMCbk_LMC_FTSC_ActiveSt, ComSystemTemplateSystemSignalRef=LMC_FTSC_ActiveSt
        LMC_SDRM_ActiveSt: ComSignalType=BOOLEAN, ComBitSize=1, ComBitPosition=182, ComNotification=Rte_COMCbk_LMC_SDRM_ActiveSt, ComSystemTemplateSystemSignalRef=LMC_SDRM_ActiveSt
        LMC_NSPC_ActiveSt: ComSignalType=BOOLEAN, ComBitSize=1, ComBitPosition=183, ComNotification=Rte_COMCbk_LMC_NSPC_ActiveSt, ComSystemTemplateSystemSignalRef=LMC_NSPC_ActiveSt
        LMC_EAF_ActiveSt: ComSignalType=BOOLEAN, ComBitSize=1, ComBitPosition=184, ComNotification=Rte_COMCbk_LMC_EAF_ActiveSt, ComSystemTemplateSystemSignalRef=LMC_EAF_ActiveSt
        LMC_SelfCheckSt: ComSignalType=BOOLEAN, ComBitSize=1, ComBitPosition=185, ComNotification=Rte_COMCbk_LMC_SelfCheckSt, ComSystemTemplateSystemSignalRef=LMC_SelfCheckSt
        LMC_WBDC_ActiveSt: ComSignalType=UINT8, ComBitSize=2, ComBitPosition=186, ComNotification=Rte_COMCbk_LMC_WBDC_ActiveSt, ComSystemTemplateSystemSignalRef=LMC_WBDC_ActiveSt
      ADDC_0x84_C_CANFD (ComIPdu):
        ComIPduSignalProcessing = IMMEDIATE
        ComIPduType = NORMAL
        ComIPduDirection = RECEIVE
        ComIPduCallout = ComCallOut_HPCADAS_0x84_C_CANFD
        ComIPduErrorNotification = ComCbk_RxTimeOut_HPCADAS_0x84_C_CANFD
        ComFirstTimeout = 2.2
        ComTimeout = 0.2
        ComIPduGroupRef = ComIPduGroup_Rx
        ComPduIdRef = PduCollection/ADDC_0x84_C_CANFD_PduR2Com
        ComIPduSignalRef = ADDC_CRC_84
        ComIPduSignalRef = ADDC_APS_AVHReq
        ComIPduSignalRef = ADDC_APS_HoldSts
        ComIPduSignalRef = ADDC_APSTargetTrqBrkVD
        ComIPduSignalRef = ADDC_APSTargetTrqBrk
        ComIPduSignalRef = ADDC_APSTargetTrqVD
        ComIPduSignalRef = ADDC_APSTargetTrq
        ComIPduSignalRef = ADDC_safety_valid
        ComIPduSignalRef = ADDC_rearsafety_level
        ComIPduSignalRef = ADDC_frontsafety_level
        ComIPduSignalRef = ADDC_rightsafety_level
        ComIPduSignalRef = ADDC_leftsafety_level
        ComIPduSignalRef = ADDC_RollingCounter_84
        ComIPduSignalRef = ADDC_APS_EnableReq
        ComIPduSignalRef = ADDC_APS_WorkSts
        ComIPduSignalRef = ADDC_APS_PDCVehicleDirectCtlVD
        ComIPduSignalRef = ADDC_APS_VehicleSpeedCtlVD
        ComIPduSignalRef = ADDC_APS_PDC_VehicleDirectCtl
        ComIPduSignalRef = ADDC_APS_PDC_SWAngCtl
        ComIPduSignalRef = ADDC_APS_ParkingReq
        ComIPduSignalRef = ADDC_APS_EmergenceBrake
        ComIPduSignalRef = ADDC_APS_TargetAccVD
        ComIPduSignalRef = ADDC_APS_TargetAcc
        ComIPduSignalRef = ADDC_APS_VehicleSpeedCtl
        ComIPduSignalRef = ADDC_APS_DecToStop
        ComIPduSignalRef = ADDC_APS_Driveoff_Request
        ComIPduSignalRef = ADDC_APS_FuncType
        ComIPduSignalRef = ADDC_APS_Available
      28 x ComSignal, all with ComSignalInitValue=0, ComSignalEndianness=LITTLE_ENDIAN, ComUpdateBitPosition=-1, ComTransferProperty=TRIGGERED:
        ADDC_CRC_84: ComSignalType=UINT8, ComBitSize=8, ComBitPosition=0, ComNotification=Rte_COMCbk_ADDC_CRC_84, ComSystemTemplateSystemSignalRef=ADDC_CRC_84
        ADDC_APS_AVHReq: ComSignalType=BOOLEAN, ComBitSize=1, ComBitPosition=45, ComNotification=Rte_COMCbk_ADDC_APS_AVHReq, ComSystemTemplateSystemSignalRef=ADDC_APS_AVHReq
        ADDC_APS_HoldSts: ComSignalType=BOOLEAN, ComBitSize=1, ComBitPosition=44, ComNotification=Rte_COMCbk_ADDC_APS_HoldSts, ComSystemTemplateSystemSignalRef=ADDC_APS_HoldSts
        ADDC_APSTargetTrqBrkVD: ComSignalType=BOOLEAN, ComBitSize=1, ComBitPosition=125, ComNotification=Rte_COMCbk_ADDC_APSTargetTrqBrkVD, ComSystemTemplateSystemSignalRef=ADDC_APSTargetTrqBrkVD
        ADDC_APSTargetTrqBrk: ComSignalType=UINT16, ComBitSize=13, ComBitPosition=112, ComNotification=Rte_COMCbk_ADDC_APSTargetTrqBrk, ComSystemTemplateSystemSignalRef=ADDC_APSTargetTrqBrk
        ADDC_APSTargetTrqVD: ComSignalType=BOOLEAN, ComBitSize=1, ComBitPosition=111, ComNotification=Rte_COMCbk_ADDC_APSTargetTrqVD, ComSystemTemplateSystemSignalRef=ADDC_APSTargetTrqVD
        ADDC_APSTargetTrq: ComSignalType=UINT16, ComBitSize=14, ComBitPosition=97, ComNotification=Rte_COMCbk_ADDC_APSTargetTrq, ComSystemTemplateSystemSignalRef=ADDC_APSTargetTrq
        ADDC_safety_valid: ComSignalType=BOOLEAN, ComBitSize=1, ComBitPosition=96, ComNotification=Rte_COMCbk_ADDC_safety_valid, ComSystemTemplateSystemSignalRef=ADDC_safety_valid
        ADDC_rearsafety_level: ComSignalType=UINT8, ComBitSize=3, ComBitPosition=93, ComNotification=Rte_COMCbk_ADDC_rearsafety_level, ComSystemTemplateSystemSignalRef=ADDC_rearsafety_level
        ADDC_frontsafety_level: ComSignalType=UINT8, ComBitSize=3, ComBitPosition=90, ComNotification=Rte_COMCbk_ADDC_frontsafety_level, ComSystemTemplateSystemSignalRef=ADDC_frontsafety_level
        ADDC_rightsafety_level: ComSignalType=UINT8, ComBitSize=3, ComBitPosition=87, ComNotification=Rte_COMCbk_ADDC_rightsafety_level, ComSystemTemplateSystemSignalRef=ADDC_rightsafety_level
        ADDC_leftsafety_level: ComSignalType=UINT8, ComBitSize=3, ComBitPosition=84, ComNotification=Rte_COMCbk_ADDC_leftsafety_level, ComSystemTemplateSystemSignalRef=ADDC_leftsafety_level
        ADDC_RollingCounter_84: ComSignalType=UINT8, ComBitSize=4, ComBitPosition=8, ComNotification=Rte_COMCbk_ADDC_RollingCounter_84, ComSystemTemplateSystemSignalRef=ADDC_RollingCounter_84
        ADDC_APS_EnableReq: ComSignalType=BOOLEAN, ComBitSize=1, ComBitPosition=16, ComNotification=Rte_COMCbk_ADDC_APS_EnableReq, ComSystemTemplateSystemSignalRef=ADDC_APS_EnableReq
        ADDC_APS_WorkSts: ComSignalType=BOOLEAN, ComBitSize=1, ComBitPosition=17, ComNotification=Rte_COMCbk_ADDC_APS_WorkSts, ComSystemTemplateSystemSignalRef=ADDC_APS_WorkSts
        ADDC_APS_PDCVehicleDirectCtlVD: ComSignalType=BOOLEAN, ComBitSize=1, ComBitPosition=19, ComNotification=Rte_COMCbk_ADDC_APS_PDCVehicleDirectCtlVD, ComSystemTemplateSystemSignalRef=ADDC_APS_PDCVehicleDirectCtlVD
        ADDC_APS_VehicleSpeedCtlVD: ComSignalType=BOOLEAN, ComBitSize=1, ComBitPosition=20, ComNotification=Rte_COMCbk_ADDC_APS_VehicleSpeedCtlVD, ComSystemTemplateSystemSignalRef=ADDC_APS_VehicleSpeedCtlVD
        ADDC_APS_PDC_VehicleDirectCtl: ComSignalType=UINT8, ComBitSize=2, ComBitPosition=21, ComNotification=Rte_COMCbk_ADDC_APS_PDC_VehicleDirectCtl, ComSystemTemplateSystemSignalRef=ADDC_APS_PDC_VehicleDirectCtl
        ADDC_APS_PDC_SWAngCtl: ComSignalType=UINT16, ComBitSize=16, ComBitPosition=24, ComNotification=Rte_COMCbk_ADDC_APS_PDC_SWAngCtl, ComSystemTemplateSystemSignalRef=ADDC_APS_PDC_SWAngCtl
        ADDC_APS_ParkingReq: ComSignalType=UINT8, ComBitSize=2, ComBitPosition=40, ComNotification=Rte_COMCbk_ADDC_APS_ParkingReq, ComSystemTemplateSystemSignalRef=ADDC_APS_ParkingReq
        ADDC_APS_EmergenceBrake: ComSignalType=BOOLEAN, ComBitSize=1, ComBitPosition=42, ComNotification=Rte_COMCbk_ADDC_APS_EmergenceBrake, ComSystemTemplateSystemSignalRef=ADDC_APS_EmergenceBrake
        ADDC_APS_TargetAccVD: ComSignalType=BOOLEAN, ComBitSize=1, ComBitPosition=43, ComNotification=Rte_COMCbk_ADDC_APS_TargetAccVD, ComSystemTemplateSystemSignalRef=ADDC_APS_TargetAccVD
        ADDC_APS_TargetAcc: ComSignalType=UINT8, ComBitSize=8, ComBitPosition=56, ComNotification=Rte_COMCbk_ADDC_APS_TargetAcc, ComSystemTemplateSystemSignalRef=ADDC_APS_TargetAcc
        ADDC_APS_VehicleSpeedCtl: ComSignalType=UINT8, ComBitSize=6, ComBitPosition=64, ComNotification=Rte_COMCbk_ADDC_APS_VehicleSpeedCtl, ComSystemTemplateSystemSignalRef=ADDC_APS_VehicleSpeedCtl
        ADDC_APS_DecToStop: ComSignalType=BOOLEAN, ComBitSize=1, ComBitPosition=70, ComNotification=Rte_COMCbk_ADDC_APS_DecToStop, ComSystemTemplateSystemSignalRef=ADDC_APS_DecToStop
        ADDC_APS_Driveoff_Request: ComSignalType=BOOLEAN, ComBitSize=1, ComBitPosition=72, ComNotification=Rte_COMCbk_ADDC_APS_Driveoff_Request, ComSystemTemplateSystemSignalRef=ADDC_APS_Driveoff_Request
        ADDC_APS_FuncType: ComSignalType=UINT8, ComBitSize=3, ComBitPosition=73, ComNotification=Rte_COMCbk_ADDC_APS_FuncType, ComSystemTemplateSystemSignalRef=ADDC_APS_FuncType
        ADDC_APS_Available: ComSignalType=BOOLEAN, ComBitSize=1, ComBitPosition=76, ComNotification=Rte_COMCbk_ADDC_APS_Available, ComSystemTemplateSystemSignalRef=ADDC_APS_Available
      IBC_0xB1_C_CANFD (ComIPdu):
        ComIPduSignalProcessing = IMMEDIATE
        ComIPduType = NORMAL
        ComIPduDirection = RECEIVE
        ComIPduCallout = ComCallOut_IBC_0xB1_C_CANFD
        ComIPduErrorNotification = ComCbk_RxTimeOut_IBC_0xB1_C_CANFD
        ComFirstTimeout = 2.1
        ComTimeout = 0.1
        ComIPduGroupRef = ComIPduGroup_Rx
        ComPduIdRef = PduCollection/IBC_0xB1_C_CANFD_PduR2Com
        ComIPduSignalRef = IBC_CRC_B1
        ComIPduSignalRef = IBC_RollingCounter_B1
        ComIPduSignalRef = IBC_EngTorqDec_Main
        ComIPduSignalRef = IBC_EngTorqDecActive_Main
        ComIPduSignalRef = IBC_EngTorqInc_Main
        ComIPduSignalRef = IBC_EngTorqIncActive_Main
        ComIPduSignalRef = IBC_EngTorqDec_Sub
        ComIPduSignalRef = IBC_EngTorqDecActive_Sub
        ComIPduSignalRef = IBC_EngTorqInc_Sub
        ComIPduSignalRef = IBC_EngTorqIncActive_Sub
        ComIPduSignalRef = IBC_EngTorqDec_MainR
        ComIPduSignalRef = IBC_EngTorqDecActive_MainR
        ComIPduSignalRef = IBC_EngTorqInc_MainR
        ComIPduSignalRef = IBC_EngTorqIncActive_MainR
      10 x ComSignal, all with ComSignalInitValue=0, ComSignalEndianness=LITTLE_ENDIAN, ComUpdateBitPosition=-1, ComTransferProperty=TRIGGERED:
        IBC_CRC_B1: ComSignalType=UINT8, ComBitSize=8, ComBitPosition=0, ComNotification=Rte_COMCbk_IBC_CRC_B1, ComSystemTemplateSystemSignalRef=IBC_CRC_B1
        IBC_RollingCounter_B1: ComSignalType=UINT8, ComBitSize=4, ComBitPosition=8, ComNotification=Rte_COMCbk_IBC_RollingCounter_B1, ComSystemTemplateSystemSignalRef=IBC_RollingCounter_B1
        IBC_EngTorqDec_Main: ComSignalType=UINT16, ComBitSize=10, ComBitPosition=16, ComNotification=Rte_COMCbk_IBC_EngTorqDec_Main, ComSystemTemplateSystemSignalRef=IBC_EngTorqDec_Main
        IBC_EngTorqDecActive_Main: ComSignalType=BOOLEAN, ComBitSize=1, ComBitPosition=26, ComNotification=Rte_COMCbk_IBC_EngTorqDecActive_Main, ComSystemTemplateSystemSignalRef=IBC_EngTorqDecActive_Main
        IBC_EngTorqInc_Main: ComSignalType=UINT16, ComBitSize=10, ComBitPosition=32, ComNotification=Rte_COMCbk_IBC_EngTorqInc_Main, ComSystemTemplateSystemSignalRef=IBC_EngTorqInc_Main
        IBC_EngTorqIncActive_Main: ComSignalType=BOOLEAN, ComBitSize=1, ComBitPosition=42, ComNotification=Rte_COMCbk_IBC_EngTorqIncActive_Main, ComSystemTemplateSystemSignalRef=IBC_EngTorqIncActive_Main
        IBC_EngTorqDec_Sub: ComSignalType=UINT16, ComBitSize=10, ComBitPosition=48, ComNotification=Rte_COMCbk_IBC_EngTorqDec_Sub, ComSystemTemplateSystemSignalRef=IBC_EngTorqDec_Sub
        IBC_EngTorqDecActive_Sub: ComSignalType=BOOLEAN, ComBitSize=1, ComBitPosition=58, ComNotification=Rte_COMCbk_IBC_EngTorqDecActive_Sub, ComSystemTemplateSystemSignalRef=IBC_EngTorqDecActive_Sub
        IBC_EngTorqInc_Sub: ComSignalType=UINT16, ComBitSize=10, ComBitPosition=64, ComNotification=Rte_COMCbk_IBC_EngTorqInc_Sub, ComSystemTemplateSystemSignalRef=IBC_EngTorqInc_Sub
        IBC_EngTorqIncActive_Sub: ComSignalType=BOOLEAN, ComBitSize=1, ComBitPosition=74, ComNotification=Rte_COMCbk_IBC_EngTorqIncActive_Sub, ComSystemTemplateSystemSignalRef=IBC_EngTorqIncActive_Sub
      IBC_0x227_C_CANFD (ComIPdu):
        ComIPduSignalProcessing = IMMEDIATE
        ComIPduType = NORMAL
        ComIPduDirection = RECEIVE
        ComIPduCallout = ComCallOut_IBC_0x227_C_CANFD
        ComIPduErrorNotification = ComCbk_RxTimeOut_IBC_0x227_C_CANFD
        ComFirstTimeout = 2.2
        ComTimeout = 0.2
        ComIPduGroupRef = ComIPduGroup_Rx
        ComPduIdRef = PduCollection/IBC_0x227_C_CANFD_PduR2Com
        ComIPduSignalRef = IBC_CRC_227
        ComIPduSignalRef = IBC_RollingCounter_227
        ComIPduSignalRef = IBC_EPB_FailStatus
        ComIPduSignalRef = IBC_EPB_Status
        ComIPduSignalRef = IBC_EPB_DrumMode
        ComIPduSignalRef = IBC_EPB_AchievedClampForce
        ComIPduSignalRef = IBC_EPB_FailureLamp
        ComIPduSignalRef = IBC_EPB_ActuatorStateLeft
        ComIPduSignalRef = IBC_EPB_ActuatorStateRight
        ComIPduSignalRef = IBC_EPB_HostAvailabilityLeft
        ComIPduSignalRef = IBC_EPB_HostAvailabilityRight
      11 x ComSignal, all with ComSignalInitValue=0, ComSignalEndianness=LITTLE_ENDIAN, ComUpdateBitPosition=-1, ComTransferProperty=TRIGGERED:
        IBC_CRC_227: ComSignalType=UINT8, ComBitSize=8, ComBitPosition=0, ComNotification=Rte_COMCbk_IBC_CRC_227, ComSystemTemplateSystemSignalRef=IBC_CRC_227
        IBC_RollingCounter_227: ComSignalType=UINT8, ComBitSize=4, ComBitPosition=8, ComNotification=Rte_COMCbk_IBC_RollingCounter_227, ComSystemTemplateSystemSignalRef=IBC_RollingCounter_227
        IBC_EPB_FailStatus: ComSignalType=UINT8, ComBitSize=2, ComBitPosition=16, ComNotification=Rte_COMCbk_IBC_EPB_FailStatus, ComSystemTemplateSystemSignalRef=IBC_EPB_FailStatus
        IBC_EPB_Status: ComSignalType=UINT8, ComBitSize=3, ComBitPosition=18, ComNotification=Rte_COMCbk_IBC_EPB_Status, ComSystemTemplateSystemSignalRef=IBC_EPB_Status
        IBC_EPB_DrumMode: ComSignalType=BOOLEAN, ComBitSize=1, ComBitPosition=23, ComNotification=Rte_COMCbk_IBC_EPB_DrumMode, ComSystemTemplateSystemSignalRef=IBC_EPB_DrumMode
        IBC_EPB_AchievedClampForce: ComSignalType=UINT8, ComBitSize=8, ComBitPosition=24, ComNotification=Rte_COMCbk_IBC_EPB_AchievedClampForce, ComSystemTemplateSystemSignalRef=IBC_EPB_AchievedClampForce
        IBC_EPB_FailureLamp: ComSignalType=UINT8, ComBitSize=2, ComBitPosition=32, ComNotification=Rte_COMCbk_IBC_EPB_FailureLamp, ComSystemTemplateSystemSignalRef=IBC_EPB_FailureLamp
        IBC_EPB_ActuatorStateLeft: ComSignalType=UINT8, ComBitSize=2, ComBitPosition=40, ComNotification=Rte_COMCbk_IBC_EPB_ActuatorStateLeft, ComSystemTemplateSystemSignalRef=IBC_EPB_ActuatorStateLeft
        IBC_EPB_ActuatorStateRight: ComSignalType=UINT8, ComBitSize=2, ComBitPosition=48, ComNotification=Rte_COMCbk_IBC_EPB_ActuatorStateRight, ComSystemTemplateSystemSignalRef=IBC_EPB_ActuatorStateRight
        IBC_EPB_HostAvailabilityLeft: ComSignalType=UINT8, ComBitSize=2, ComBitPosition=56, ComNotification=Rte_COMCbk_IBC_EPB_HostAvailabilityLeft, ComSystemTemplateSystemSignalRef=IBC_EPB_HostAvailabilityLeft
        IBC_EPB_HostAvailabilityRight: ComSignalType=UINT8, ComBitSize=2, ComBitPosition=58, ComNotification=Rte_COMCbk_IBC_EPB_HostAvailabilityRight, ComSystemTemplateSystemSignalRef=IBC_EPB_HostAvailabilityRight
      EPS_0x18D_C_CANFD (ComIPdu):
        ComIPduSignalProcessing = IMMEDIATE
        ComIPduType = NORMAL
        ComIPduDirection = RECEIVE
        ComIPduCallout = ComCallOut_EPS_0x18D_C_CANFD
        ComIPduErrorNotification = ComCbk_RxTimeOut_EPS_0x18D_C_CANFD
        ComFirstTimeout = 2.1
        ComTimeout = 0.1
        ComIPduGroupRef = ComIPduGroup_Rx
        ComPduIdRef = PduCollection/EPS_0x18D_C_CANFD_PduR2Com
        ComIPduSignalRef = EPS_CRC_18D
        ComIPduSignalRef = EPS_RollingCounter_18D
        ComIPduSignalRef = EPS_Fault
        ComIPduSignalRef = EPS_CalibrationSts
        ComIPduSignalRef = EPS_FailureSts
        ComIPduSignalRef = EPS_SteeringAngleValidData
        ComIPduSignalRef = EPS_SteeringAngleSpeedValidData
        ComIPduSignalRef = EPS_SteerWheelAngle
        ComIPduSignalRef = EPS_SteerWheelRotSpd
        ComIPduSignalRef = EPS_SelfCheckSt
        ComIPduSignalRef = EPS_AssistanceSts
      11 x ComSignal, all with ComSignalInitValue=0, ComSignalEndianness=LITTLE_ENDIAN, ComUpdateBitPosition=-1, ComTransferProperty=TRIGGERED:
        EPS_CRC_18D: ComSignalType=UINT8, ComBitSize=8, ComBitPosition=0, ComNotification=Rte_COMCbk_EPS_CRC_18D, ComSystemTemplateSystemSignalRef=EPS_CRC_18D
        EPS_RollingCounter_18D: ComSignalType=UINT8, ComBitSize=4, ComBitPosition=8, ComNotification=Rte_COMCbk_EPS_RollingCounter_18D, ComSystemTemplateSystemSignalRef=EPS_RollingCounter_18D
        EPS_Fault: ComSignalType=BOOLEAN, ComBitSize=1, ComBitPosition=16, ComNotification=Rte_COMCbk_EPS_Fault, ComSystemTemplateSystemSignalRef=EPS_Fault
        EPS_CalibrationSts: ComSignalType=BOOLEAN, ComBitSize=1, ComBitPosition=17, ComNotification=Rte_COMCbk_EPS_CalibrationSts, ComSystemTemplateSystemSignalRef=EPS_CalibrationSts
        EPS_FailureSts: ComSignalType=BOOLEAN, ComBitSize=1, ComBitPosition=18, ComNotification=Rte_COMCbk_EPS_FailureSts, ComSystemTemplateSystemSignalRef=EPS_FailureSts
        EPS_SteeringAngleValidData: ComSignalType=BOOLEAN, ComBitSize=1, ComBitPosition=19, ComNotification=Rte_COMCbk_EPS_SteeringAngleValidData, ComSystemTemplateSystemSignalRef=EPS_SteeringAngleValidData
        EPS_SteeringAngleSpeedValidData: ComSignalType=BOOLEAN, ComBitSize=1, ComBitPosition=20, ComNotification=Rte_COMCbk_EPS_SteeringAngleSpeedValidData, ComSystemTemplateSystemSignalRef=EPS_SteeringAngleSpeedValidData
        EPS_SteerWheelAngle: ComSignalType=UINT16, ComBitSize=16, ComBitPosition=24, ComNotification=Rte_COMCbk_EPS_SteerWheelAngle, ComSystemTemplateSystemSignalRef=EPS_SteerWheelAngle
        EPS_SteerWheelRotSpd: ComSignalType=UINT8, ComBitSize=8, ComBitPosition=40, ComNotification=Rte_COMCbk_EPS_SteerWheelRotSpd, ComSystemTemplateSystemSignalRef=EPS_SteerWheelRotSpd
        EPS_SelfCheckSt: ComSignalType=BOOLEAN, ComBitSize=1, ComBitPosition=62, ComNotification=Rte_COMCbk_EPS_SelfCheckSt, ComSystemTemplateSystemSignalRef=EPS_SelfCheckSt
        EPS_AssistanceSts: ComSignalType=UINT8, ComBitSize=2, ComBitPosition=69, ComNotification=Rte_COMCbk_EPS_AssistanceSts, ComSystemTemplateSystemSignalRef=EPS_AssistanceSts
      IBC_0x136_C_CANFD (ComIPdu):
        ComIPduSignalProcessing = IMMEDIATE
        ComIPduType = NORMAL
        ComIPduDirection = RECEIVE
        ComIPduCallout = ComCallOut_IBC_0x136_C_CANFD
        ComTimeout = 0.2
        ComFirstTimeout = 2.2
        ComIPduErrorNotification = ComCbk_RxTimeOut_IBC_0x136_C_CANFD
        ComIPduGroupRef = ComIPduGroup_Rx
        ComPduIdRef = PduCollection/IBC_0x136_C_CANFD_PduR2Com
        ComIPduSignalRef = IBC_CRC_136
        ComIPduSignalRef = IBC_RollingCounter_136
        ComIPduSignalRef = IBC_ModeMinEDrvTar_FA
        ComIPduSignalRef = IBC_ModeMinEDrvTar_RA
        ComIPduSignalRef = IBC_ModeMaxEDrvTar_FA
        ComIPduSignalRef = IBC_ModeMaxEDrvTar_RA
        ComIPduSignalRef = IBC_torque_distribution_RA_Vaild
        ComIPduSignalRef = IBC_torque_distribution_RA
        ComIPduSignalRef = IBC_mTar_FA
        ComIPduSignalRef = IBC_mTar_RA
        ComIPduSignalRef = IBC_iLDC_SWInfo
        ComIPduSignalRef = IBC_Variant_Signal
        ComIPduSignalRef = IBC_nTarMax_FA
        ComIPduSignalRef = IBC_nTarMax_RA
        ComIPduSignalRef = IBC_nTarMin_FA
        ComIPduSignalRef = IBC_nTarMin_RA
      16 x ComSignal, all with ComSignalInitValue=0, ComSignalEndianness=LITTLE_ENDIAN, ComUpdateBitPosition=-1, ComTransferProperty=TRIGGERED:
        IBC_CRC_136: ComSignalType=UINT8, ComBitSize=8, ComBitPosition=0, ComNotification=Rte_COMCbk_IBC_CRC_136, ComSystemTemplateSystemSignalRef=IBC_CRC_136
        IBC_RollingCounter_136: ComSignalType=UINT8, ComBitSize=4, ComBitPosition=8, ComNotification=Rte_COMCbk_IBC_RollingCounter_136, ComSystemTemplateSystemSignalRef=IBC_RollingCounter_136
        IBC_ModeMinEDrvTar_FA: ComSignalType=UINT8, ComBitSize=2, ComBitPosition=100, ComNotification=Rte_COMCbk_IBC_ModeMinEDrvTar_FA, ComSystemTemplateSystemSignalRef=IBC_ModeMinEDrvTar_FA
        IBC_ModeMinEDrvTar_RA: ComSignalType=UINT8, ComBitSize=2, ComBitPosition=102, ComNotification=Rte_COMCbk_IBC_ModeMinEDrvTar_RA, ComSystemTemplateSystemSignalRef=IBC_ModeMinEDrvTar_RA
        IBC_ModeMaxEDrvTar_FA: ComSignalType=UINT8, ComBitSize=2, ComBitPosition=104, ComNotification=Rte_COMCbk_IBC_ModeMaxEDrvTar_FA, ComSystemTemplateSystemSignalRef=IBC_ModeMaxEDrvTar_FA
        IBC_ModeMaxEDrvTar_RA: ComSignalType=UINT8, ComBitSize=2, ComBitPosition=106, ComNotification=Rte_COMCbk_IBC_ModeMaxEDrvTar_RA, ComSystemTemplateSystemSignalRef=IBC_ModeMaxEDrvTar_RA
        IBC_torque_distribution_RA_Vaild: ComSignalType=BOOLEAN, ComBitSize=1, ComBitPosition=119, ComNotification=Rte_COMCbk_IBC_torque_distribution_RA_Vaild, ComSystemTemplateSystemSignalRef=IBC_torque_distribution_RA_Vaild
        IBC_torque_distribution_RA: ComSignalType=UINT8, ComBitSize=8, ComBitPosition=120, ComNotification=Rte_COMCbk_IBC_torque_distribution_RA, ComSystemTemplateSystemSignalRef=IBC_torque_distribution_RA
        IBC_mTar_FA: ComSignalType=UINT16, ComBitSize=16, ComBitPosition=128, ComNotification=Rte_COMCbk_IBC_mTar_FA, ComSystemTemplateSystemSignalRef=IBC_mTar_FA
        IBC_mTar_RA: ComSignalType=UINT16, ComBitSize=16, ComBitPosition=144, ComNotification=Rte_COMCbk_IBC_mTar_RA, ComSystemTemplateSystemSignalRef=IBC_mTar_RA
        IBC_iLDC_SWInfo: ComSignalType=UINT8, ComBitSize=8, ComBitPosition=160, ComNotification=Rte_COMCbk_IBC_iLDC_SWInfo, ComSystemTemplateSystemSignalRef=IBC_iLDC_SWInfo
        IBC_Variant_Signal: ComSignalType=UINT8, ComBitSize=8, ComBitPosition=168, ComNotification=Rte_COMCbk_IBC_Variant_Signal, ComSystemTemplateSystemSignalRef=IBC_Variant_Signal
        IBC_nTarMax_FA: ComSignalType=UINT16, ComBitSize=16, ComBitPosition=192, ComNotification=Rte_COMCbk_IBC_nTarMax_FA, ComSystemTemplateSystemSignalRef=IBC_nTarMax_FA
        IBC_nTarMax_RA: ComSignalType=UINT16, ComBitSize=16, ComBitPosition=208, ComNotification=Rte_COMCbk_IBC_nTarMax_RA, ComSystemTemplateSystemSignalRef=IBC_nTarMax_RA
        IBC_nTarMin_FA: ComSignalType=UINT16, ComBitSize=16, ComBitPosition=224, ComNotification=Rte_COMCbk_IBC_nTarMin_FA, ComSystemTemplateSystemSignalRef=IBC_nTarMin_FA
        IBC_nTarMin_RA: ComSignalType=UINT16, ComBitSize=16, ComBitPosition=240, ComNotification=Rte_COMCbk_IBC_nTarMin_RA, ComSystemTemplateSystemSignalRef=IBC_nTarMin_RA
      IBC_0x182_C_CANFD (ComIPdu):
        ComIPduSignalProcessing = IMMEDIATE
        ComIPduType = NORMAL
        ComIPduDirection = RECEIVE
        ComIPduCallout = ComCallOut_IBC_0x182_C_CANFD
        ComIPduErrorNotification = ComCbk_RxTimeOut_IBC_0x182_C_CANFD
        ComFirstTimeout = 2.2
        ComTimeout = 0.2
        ComIPduGroupRef = ComIPduGroup_Rx
        ComPduIdRef = PduCollection/IBC_0x182_C_CANFD_PduR2Com
        ComIPduSignalRef = IBC_CRC_182
        ComIPduSignalRef = IBC_RollingCounter_182
        ComIPduSignalRef = IBC_VehicleSpeed
        ComIPduSignalRef = IBC_VehicleSpeedVD
        ComIPduSignalRef = IBC_ABSActive
        ComIPduSignalRef = IBC_ABSFailed
        ComIPduSignalRef = IBC_TCSActive
        ComIPduSignalRef = IBC_TCSFailed
        ComIPduSignalRef = IBC_ESCFunctionStatus
        ComIPduSignalRef = IBC_BrakeForce
        ComIPduSignalRef = IBC_Vehiclestandstill
        ComIPduSignalRef = IBC_EBDFailed
        ComIPduSignalRef = IBC_EBDActive
        ComIPduSignalRef = IBC_VDCActive
        ComIPduSignalRef = IBC_VDCFailed
        ComIPduSignalRef = IBC_EDCActive
        ComIPduSignalRef = IBC_EDCFailed
        ComIPduSignalRef = IBC_SystemInitializeStatus
        ComIPduSignalRef = IBC_BTCSActive
        ComIPduSignalRef = IBC_ETCSActive
        ComIPduSignalRef = IBC_ARPActive
        ComIPduSignalRef = IBC_VCU_DrumMode
        ComIPduSignalRef = IBC_EscapeModeSts
        ComIPduSignalRef = IBC_TSAActive
        ComIPduSignalRef = IBC_TSAStatus
      25 x ComSignal, all with ComSignalInitValue=0, ComSignalEndianness=LITTLE_ENDIAN, ComUpdateBitPosition=-1, ComTransferProperty=TRIGGERED:
        IBC_CRC_182: ComSignalType=UINT8, ComBitSize=8, ComBitPosition=0, ComNotification=Rte_COMCbk_IBC_CRC_182, ComSystemTemplateSystemSignalRef=IBC_CRC_182
        IBC_RollingCounter_182: ComSignalType=UINT8, ComBitSize=4, ComBitPosition=8, ComNotification=Rte_COMCbk_IBC_RollingCounter_182, ComSystemTemplateSystemSignalRef=IBC_RollingCounter_182
        IBC_VehicleSpeed: ComSignalType=UINT16, ComBitSize=16, ComBitPosition=16, ComNotification=Rte_COMCbk_IBC_VehicleSpeed, ComSystemTemplateSystemSignalRef=IBC_VehicleSpeed
        IBC_VehicleSpeedVD: ComSignalType=BOOLEAN, ComBitSize=1, ComBitPosition=32, ComNotification=Rte_COMCbk_IBC_VehicleSpeedVD, ComSystemTemplateSystemSignalRef=IBC_VehicleSpeedVD
        IBC_ABSActive: ComSignalType=BOOLEAN, ComBitSize=1, ComBitPosition=33, ComNotification=Rte_COMCbk_IBC_ABSActive, ComSystemTemplateSystemSignalRef=IBC_ABSActive
        IBC_ABSFailed: ComSignalType=BOOLEAN, ComBitSize=1, ComBitPosition=34, ComNotification=Rte_COMCbk_IBC_ABSFailed, ComSystemTemplateSystemSignalRef=IBC_ABSFailed
        IBC_TCSActive: ComSignalType=BOOLEAN, ComBitSize=1, ComBitPosition=35, ComNotification=Rte_COMCbk_IBC_TCSActive, ComSystemTemplateSystemSignalRef=IBC_TCSActive
        IBC_TCSFailed: ComSignalType=BOOLEAN, ComBitSize=1, ComBitPosition=36, ComNotification=Rte_COMCbk_IBC_TCSFailed, ComSystemTemplateSystemSignalRef=IBC_TCSFailed
        IBC_ESCFunctionStatus: ComSignalType=BOOLEAN, ComBitSize=1, ComBitPosition=37, ComNotification=Rte_COMCbk_IBC_ESCFunctionStatus, ComSystemTemplateSystemSignalRef=IBC_ESCFunctionStatus
        IBC_BrakeForce: ComSignalType=BOOLEAN, ComBitSize=1, ComBitPosition=38, ComNotification=Rte_COMCbk_IBC_BrakeForce, ComSystemTemplateSystemSignalRef=IBC_BrakeForce
        IBC_Vehiclestandstill: ComSignalType=BOOLEAN, ComBitSize=1, ComBitPosition=39, ComNotification=Rte_COMCbk_IBC_Vehiclestandstill, ComSystemTemplateSystemSignalRef=IBC_Vehiclestandstill
        IBC_EBDFailed: ComSignalType=BOOLEAN, ComBitSize=1, ComBitPosition=40, ComNotification=Rte_COMCbk_IBC_EBDFailed, ComSystemTemplateSystemSignalRef=IBC_EBDFailed
        IBC_EBDActive: ComSignalType=BOOLEAN, ComBitSize=1, ComBitPosition=41, ComNotification=Rte_COMCbk_IBC_EBDActive, ComSystemTemplateSystemSignalRef=IBC_EBDActive
        IBC_VDCActive: ComSignalType=BOOLEAN, ComBitSize=1, ComBitPosition=42, ComNotification=Rte_COMCbk_IBC_VDCActive, ComSystemTemplateSystemSignalRef=IBC_VDCActive
        IBC_VDCFailed: ComSignalType=BOOLEAN, ComBitSize=1, ComBitPosition=43, ComNotification=Rte_COMCbk_IBC_VDCFailed, ComSystemTemplateSystemSignalRef=IBC_VDCFailed
        IBC_EDCActive: ComSignalType=BOOLEAN, ComBitSize=1, ComBitPosition=44, ComNotification=Rte_COMCbk_IBC_EDCActive, ComSystemTemplateSystemSignalRef=IBC_EDCActive
        IBC_EDCFailed: ComSignalType=BOOLEAN, ComBitSize=1, ComBitPosition=45, ComNotification=Rte_COMCbk_IBC_EDCFailed, ComSystemTemplateSystemSignalRef=IBC_EDCFailed
        IBC_SystemInitializeStatus: ComSignalType=BOOLEAN, ComBitSize=1, ComBitPosition=46, ComNotification=Rte_COMCbk_IBC_SystemInitializeStatus, ComSystemTemplateSystemSignalRef=IBC_SystemInitializeStatus
        IBC_BTCSActive: ComSignalType=BOOLEAN, ComBitSize=1, ComBitPosition=47, ComNotification=Rte_COMCbk_IBC_BTCSActive, ComSystemTemplateSystemSignalRef=IBC_BTCSActive
        IBC_ETCSActive: ComSignalType=BOOLEAN, ComBitSize=1, ComBitPosition=48, ComNotification=Rte_COMCbk_IBC_ETCSActive, ComSystemTemplateSystemSignalRef=IBC_ETCSActive
        IBC_ARPActive: ComSignalType=BOOLEAN, ComBitSize=1, ComBitPosition=49, ComNotification=Rte_COMCbk_IBC_ARPActive, ComSystemTemplateSystemSignalRef=IBC_ARPActive
        IBC_VCU_DrumMode: ComSignalType=BOOLEAN, ComBitSize=1, ComBitPosition=50, ComNotification=Rte_COMCbk_IBC_VCU_DrumMode, ComSystemTemplateSystemSignalRef=IBC_VCU_DrumMode
        IBC_EscapeModeSts: ComSignalType=BOOLEAN, ComBitSize=1, ComBitPosition=52, ComNotification=Rte_COMCbk_IBC_EscapeModeSts, ComSystemTemplateSystemSignalRef=IBC_EscapeModeSts
        IBC_TSAActive: ComSignalType=BOOLEAN, ComBitSize=1, ComBitPosition=53, ComNotification=Rte_COMCbk_IBC_TSAActive, ComSystemTemplateSystemSignalRef=IBC_TSAActive
        IBC_TSAStatus: ComSignalType=UINT8, ComBitSize=3, ComBitPosition=54, ComNotification=Rte_COMCbk_IBC_TSAStatus, ComSystemTemplateSystemSignalRef=IBC_TSAStatus
      IBC_0x183_C_CANFD (ComIPdu):
        ComIPduSignalProcessing = IMMEDIATE
        ComIPduType = NORMAL
        ComIPduDirection = RECEIVE
        ComIPduCallout = ComCallOut_IBC_0x183_C_CANFD
        ComIPduErrorNotification = ComCbk_RxTimeOut_IBC_0x183_C_CANFD
        ComFirstTimeout = 2.2
        ComTimeout = 0.2
        ComIPduGroupRef = ComIPduGroup_Rx
        ComPduIdRef = PduCollection/IBC_0x183_C_CANFD_PduR2Com
        ComIPduSignalRef = IBC_CRC_183
        ComIPduSignalRef = IBC_RollingCounter_183
        ComIPduSignalRef = IBC_RecuBrakeTorqueRequest
        ComIPduSignalRef = IBC_RecuBrakeTorqueRequest_Q
        ComIPduSignalRef = IBC_sOutputRodDriverPer_Q
        ComIPduSignalRef = IBC_BrakePedalApplied_Q
        ComIPduSignalRef = IBC_HydraTorqTgtAct_Q
        ComIPduSignalRef = IBC_HydraTorqTgtAct
        ComIPduSignalRef = IBC_BrakePedalApplied
        ComIPduSignalRef = IBC_sOutputRodDriverPer
        ComIPduSignalRef = IBC_HydraTorqAvailable
        ComIPduSignalRef = IBC_CtrlMode
        ComIPduSignalRef = IBC_QDC_HydraTorqTgt
        ComIPduSignalRef = IBC_InPutRodDriver
        ComIPduSignalRef = IBC_InPutRodDriver_Q
        ComIPduSignalRef = IBC_SystemAssistedStatus
        ComIPduSignalRef = IBC_EngTorq_VLC_Vaild
        ComIPduSignalRef = IBC_EngTorq_VLC
        ComIPduSignalRef = IBC_BrkTorq_VLC
        ComIPduSignalRef = IBC_BrkTorq_VLC_Vaild
      20 x ComSignal, all with ComSignalInitValue=0, ComSignalEndianness=LITTLE_ENDIAN, ComUpdateBitPosition=-1, ComTransferProperty=TRIGGERED:
        IBC_CRC_183: ComSignalType=UINT8, ComBitSize=8, ComBitPosition=0, ComNotification=Rte_COMCbk_IBC_CRC_183, ComSystemTemplateSystemSignalRef=IBC_CRC_183
        IBC_RollingCounter_183: ComSignalType=UINT8, ComBitSize=4, ComBitPosition=8, ComNotification=Rte_COMCbk_IBC_RollingCounter_183, ComSystemTemplateSystemSignalRef=IBC_RollingCounter_183
        IBC_RecuBrakeTorqueRequest: ComSignalType=UINT16, ComBitSize=15, ComBitPosition=16, ComNotification=Rte_COMCbk_IBC_RecuBrakeTorqueRequest, ComSystemTemplateSystemSignalRef=IBC_RecuBrakeTorqueRequest
        IBC_RecuBrakeTorqueRequest_Q: ComSignalType=UINT8, ComBitSize=2, ComBitPosition=32, ComNotification=Rte_COMCbk_IBC_RecuBrakeTorqueRequest_Q, ComSystemTemplateSystemSignalRef=IBC_RecuBrakeTorqueRequest_Q
        IBC_sOutputRodDriverPer_Q: ComSignalType=UINT8, ComBitSize=2, ComBitPosition=34, ComNotification=Rte_COMCbk_IBC_sOutputRodDriverPer_Q, ComSystemTemplateSystemSignalRef=IBC_sOutputRodDriverPer_Q
        IBC_BrakePedalApplied_Q: ComSignalType=UINT8, ComBitSize=2, ComBitPosition=36, ComNotification=Rte_COMCbk_IBC_BrakePedalApplied_Q, ComSystemTemplateSystemSignalRef=IBC_BrakePedalApplied_Q
        IBC_HydraTorqTgtAct_Q: ComSignalType=UINT8, ComBitSize=2, ComBitPosition=38, ComNotification=Rte_COMCbk_IBC_HydraTorqTgtAct_Q, ComSystemTemplateSystemSignalRef=IBC_HydraTorqTgtAct_Q
        IBC_HydraTorqTgtAct: ComSignalType=UINT16, ComBitSize=15, ComBitPosition=40, ComNotification=Rte_COMCbk_IBC_HydraTorqTgtAct, ComSystemTemplateSystemSignalRef=IBC_HydraTorqTgtAct
        IBC_BrakePedalApplied: ComSignalType=BOOLEAN, ComBitSize=1, ComBitPosition=55, ComNotification=Rte_COMCbk_IBC_BrakePedalApplied, ComSystemTemplateSystemSignalRef=IBC_BrakePedalApplied
        IBC_sOutputRodDriverPer: ComSignalType=UINT8, ComBitSize=7, ComBitPosition=56, ComNotification=Rte_COMCbk_IBC_sOutputRodDriverPer, ComSystemTemplateSystemSignalRef=IBC_sOutputRodDriverPer
        IBC_HydraTorqAvailable: ComSignalType=BOOLEAN, ComBitSize=1, ComBitPosition=63, ComNotification=Rte_COMCbk_IBC_HydraTorqAvailable, ComSystemTemplateSystemSignalRef=IBC_HydraTorqAvailable
        IBC_CtrlMode: ComSignalType=UINT8, ComBitSize=3, ComBitPosition=64, ComNotification=Rte_COMCbk_IBC_CtrlMode, ComSystemTemplateSystemSignalRef=IBC_CtrlMode
        IBC_QDC_HydraTorqTgt: ComSignalType=BOOLEAN, ComBitSize=1, ComBitPosition=67, ComNotification=Rte_COMCbk_IBC_QDC_HydraTorqTgt, ComSystemTemplateSystemSignalRef=IBC_QDC_HydraTorqTgt
        IBC_InPutRodDriver: ComSignalType=UINT16, ComBitSize=12, ComBitPosition=68, ComNotification=Rte_COMCbk_IBC_InPutRodDriver, ComSystemTemplateSystemSignalRef=IBC_InPutRodDriver
        IBC_InPutRodDriver_Q: ComSignalType=UINT8, ComBitSize=2, ComBitPosition=80, ComNotification=Rte_COMCbk_IBC_InPutRodDriver_Q, ComSystemTemplateSystemSignalRef=IBC_InPutRodDriver_Q
        IBC_SystemAssistedStatus: ComSignalType=UINT8, ComBitSize=3, ComBitPosition=82, ComNotification=Rte_COMCbk_IBC_SystemAssistedStatus, ComSystemTemplateSystemSignalRef=IBC_SystemAssistedStatus
        IBC_EngTorq_VLC_Vaild: ComSignalType=BOOLEAN, ComBitSize=1, ComBitPosition=87, ComNotification=Rte_COMCbk_IBC_EngTorq_VLC_Vaild, ComSystemTemplateSystemSignalRef=IBC_EngTorq_VLC_Vaild
        IBC_EngTorq_VLC: ComSignalType=UINT16, ComBitSize=14, ComBitPosition=88, ComNotification=Rte_COMCbk_IBC_EngTorq_VLC, ComSystemTemplateSystemSignalRef=IBC_EngTorq_VLC
        IBC_BrkTorq_VLC: ComSignalType=UINT16, ComBitSize=15, ComBitPosition=112, ComNotification=Rte_COMCbk_IBC_BrkTorq_VLC, ComSystemTemplateSystemSignalRef=IBC_BrkTorq_VLC
        IBC_BrkTorq_VLC_Vaild: ComSignalType=BOOLEAN, ComBitSize=1, ComBitPosition=127, ComNotification=Rte_COMCbk_IBC_BrkTorq_VLC_Vaild, ComSystemTemplateSystemSignalRef=IBC_BrkTorq_VLC_Vaild
      ACU_0x233_C_CANFD (ComIPdu):
        ComIPduSignalProcessing = IMMEDIATE
        ComIPduType = NORMAL
        ComIPduDirection = RECEIVE
        ComIPduCallout = ComCallOut_ACU_0x233_C_CANFD
        ComIPduErrorNotification = ComCbk_RxTimeOut_ACU_0x233_C_CANFD
        ComFirstTimeout = 6.2
        ComTimeout = 0.2
        ComIPduGroupRef = ComIPduGroup_Rx
        ComPduIdRef = PduCollection/ACU_0x233_C_CANFD_PduR2Com
        ComIPduSignalRef = ACU_CRC_233
        ComIPduSignalRef = ACU_RollingCounter_233
        ComIPduSignalRef = ACU_LateralAcce
        ComIPduSignalRef = ACU_LongitAcce
        ComIPduSignalRef = ACU_LateralAcceValid
        ComIPduSignalRef = ACU_LongitAcceValid
        ComIPduSignalRef = ACU_SensorCalSt
        ComIPduSignalRef = ACU_YawRate
        ComIPduSignalRef = ACU_YawRateValid
      9 x ComSignal, all with ComSignalInitValue=0, ComSignalEndianness=LITTLE_ENDIAN, ComUpdateBitPosition=-1, ComTransferProperty=TRIGGERED:
        ACU_CRC_233: ComSignalType=UINT8, ComBitSize=8, ComBitPosition=0, ComNotification=Rte_COMCbk_ACU_CRC_233, ComSystemTemplateSystemSignalRef=ACU_CRC_233
        ACU_RollingCounter_233: ComSignalType=UINT8, ComBitSize=4, ComBitPosition=8, ComNotification=Rte_COMCbk_ACU_RollingCounter_233, ComSystemTemplateSystemSignalRef=ACU_RollingCounter_233
        ACU_LateralAcce: ComSignalType=UINT16, ComBitSize=10, ComBitPosition=16, ComNotification=Rte_COMCbk_ACU_LateralAcce, ComSystemTemplateSystemSignalRef=ACU_LateralAcce
        ACU_LongitAcce: ComSignalType=UINT16, ComBitSize=10, ComBitPosition=26, ComNotification=Rte_COMCbk_ACU_LongitAcce, ComSystemTemplateSystemSignalRef=ACU_LongitAcce
        ACU_LateralAcceValid: ComSignalType=BOOLEAN, ComBitSize=1, ComBitPosition=36, ComNotification=Rte_COMCbk_ACU_LateralAcceValid, ComSystemTemplateSystemSignalRef=ACU_LateralAcceValid
        ACU_LongitAcceValid: ComSignalType=BOOLEAN, ComBitSize=1, ComBitPosition=37, ComNotification=Rte_COMCbk_ACU_LongitAcceValid, ComSystemTemplateSystemSignalRef=ACU_LongitAcceValid
        ACU_SensorCalSt: ComSignalType=BOOLEAN, ComBitSize=1, ComBitPosition=38, ComNotification=Rte_COMCbk_ACU_SensorCalSt, ComSystemTemplateSystemSignalRef=ACU_SensorCalSt
        ACU_YawRate: ComSignalType=UINT16, ComBitSize=14, ComBitPosition=40, ComNotification=Rte_COMCbk_ACU_YawRate, ComSystemTemplateSystemSignalRef=ACU_YawRate
        ACU_YawRateValid: ComSignalType=BOOLEAN, ComBitSize=1, ComBitPosition=54, ComNotification=Rte_COMCbk_ACU_YawRateValid, ComSystemTemplateSystemSignalRef=ACU_YawRateValid
      IBC_0x184_C_CANFD (ComIPdu):
        ComIPduSignalProcessing = IMMEDIATE
        ComIPduType = NORMAL
        ComIPduDirection = RECEIVE
        ComIPduCallout = ComCallOut_IBC_0x184_C_CANFD
        ComIPduErrorNotification = ComCbk_RxTimeOut_IBC_0x184_C_CANFD
        ComFirstTimeout = 2.1
        ComTimeout = 0.1
        ComIPduGroupRef = ComIPduGroup_Rx
        ComPduIdRef = PduCollection/IBC_0x184_C_CANFD_PduR2Com
        ComIPduSignalRef = IBC_CRC_184
        ComIPduSignalRef = IBC_RollingCounter_184
        ComIPduSignalRef = IBC_FLWheelSpeedKPH
        ComIPduSignalRef = IBC_FRWheelSpeedKPH
        ComIPduSignalRef = IBC_RLWheelSpeedKPH
        ComIPduSignalRef = IBC_RRWheelSpeedKPH
        ComIPduSignalRef = IBC_FLWheelDirection
        ComIPduSignalRef = IBC_FRWheelDirection
        ComIPduSignalRef = IBC_RLWheelDirection
        ComIPduSignalRef = IBC_RRWheelDirection
        ComIPduSignalRef = IBC_FLWheelSpeedVD
        ComIPduSignalRef = IBC_FRWheelSpeedVD
        ComIPduSignalRef = IBC_RLWheelSpeedVD
        ComIPduSignalRef = IBC_RRWheelSpeedVD
        ComIPduSignalRef = IBC_FLWheelSpeedRC
        ComIPduSignalRef = IBC_FRWheelSpeedRC
        ComIPduSignalRef = IBC_RLWheelSpeedRC
        ComIPduSignalRef = IBC_RRWheelSpeedRC
        ComIPduSignalRef = IBC_DiscTemperatureFL
        ComIPduSignalRef = IBC_DiscTemperatureFLVD
        ComIPduSignalRef = IBC_DiscTemperatureFR
        ComIPduSignalRef = IBC_DiscTemperatureFRVD
        ComIPduSignalRef = IBC_DiscTemperatureRL
        ComIPduSignalRef = IBC_DiscTemperatureRLVD
        ComIPduSignalRef = IBC_DiscTemperatureRR
        ComIPduSignalRef = IBC_DiscTemperatureRRVD
      26 x ComSignal, all with ComSignalInitValue=0, ComSignalEndianness=LITTLE_ENDIAN, ComUpdateBitPosition=-1, ComTransferProperty=TRIGGERED:
        IBC_CRC_184: ComSignalType=UINT8, ComBitSize=8, ComBitPosition=0, ComNotification=Rte_COMCbk_IBC_CRC_184, ComSystemTemplateSystemSignalRef=IBC_CRC_184
        IBC_RollingCounter_184: ComSignalType=UINT8, ComBitSize=4, ComBitPosition=8, ComNotification=Rte_COMCbk_IBC_RollingCounter_184, ComSystemTemplateSystemSignalRef=IBC_RollingCounter_184
        IBC_FLWheelSpeedKPH: ComSignalType=UINT16, ComBitSize=16, ComBitPosition=16, ComNotification=Rte_COMCbk_IBC_FLWheelSpeedKPH, ComSystemTemplateSystemSignalRef=IBC_FLWheelSpeedKPH
        IBC_FRWheelSpeedKPH: ComSignalType=UINT16, ComBitSize=16, ComBitPosition=32, ComNotification=Rte_COMCbk_IBC_FRWheelSpeedKPH, ComSystemTemplateSystemSignalRef=IBC_FRWheelSpeedKPH
        IBC_RLWheelSpeedKPH: ComSignalType=UINT16, ComBitSize=16, ComBitPosition=48, ComNotification=Rte_COMCbk_IBC_RLWheelSpeedKPH, ComSystemTemplateSystemSignalRef=IBC_RLWheelSpeedKPH
        IBC_RRWheelSpeedKPH: ComSignalType=UINT16, ComBitSize=16, ComBitPosition=64, ComNotification=Rte_COMCbk_IBC_RRWheelSpeedKPH, ComSystemTemplateSystemSignalRef=IBC_RRWheelSpeedKPH
        IBC_FLWheelDirection: ComSignalType=UINT8, ComBitSize=2, ComBitPosition=80, ComNotification=Rte_COMCbk_IBC_FLWheelDirection, ComSystemTemplateSystemSignalRef=IBC_FLWheelDirection
        IBC_FRWheelDirection: ComSignalType=UINT8, ComBitSize=2, ComBitPosition=82, ComNotification=Rte_COMCbk_IBC_FRWheelDirection, ComSystemTemplateSystemSignalRef=IBC_FRWheelDirection
        IBC_RLWheelDirection: ComSignalType=UINT8, ComBitSize=2, ComBitPosition=84, ComNotification=Rte_COMCbk_IBC_RLWheelDirection, ComSystemTemplateSystemSignalRef=IBC_RLWheelDirection
        IBC_RRWheelDirection: ComSignalType=UINT8, ComBitSize=2, ComBitPosition=86, ComNotification=Rte_COMCbk_IBC_RRWheelDirection, ComSystemTemplateSystemSignalRef=IBC_RRWheelDirection
        IBC_FLWheelSpeedVD: ComSignalType=BOOLEAN, ComBitSize=1, ComBitPosition=88, ComNotification=Rte_COMCbk_IBC_FLWheelSpeedVD, ComSystemTemplateSystemSignalRef=IBC_FLWheelSpeedVD
        IBC_FRWheelSpeedVD: ComSignalType=BOOLEAN, ComBitSize=1, ComBitPosition=89, ComNotification=Rte_COMCbk_IBC_FRWheelSpeedVD, ComSystemTemplateSystemSignalRef=IBC_FRWheelSpeedVD
        IBC_RLWheelSpeedVD: ComSignalType=BOOLEAN, ComBitSize=1, ComBitPosition=90, ComNotification=Rte_COMCbk_IBC_RLWheelSpeedVD, ComSystemTemplateSystemSignalRef=IBC_RLWheelSpeedVD
        IBC_RRWheelSpeedVD: ComSignalType=BOOLEAN, ComBitSize=1, ComBitPosition=91, ComNotification=Rte_COMCbk_IBC_RRWheelSpeedVD, ComSystemTemplateSystemSignalRef=IBC_RRWheelSpeedVD
        IBC_FLWheelSpeedRC: ComSignalType=UINT16, ComBitSize=12, ComBitPosition=92, ComNotification=Rte_COMCbk_IBC_FLWheelSpeedRC, ComSystemTemplateSystemSignalRef=IBC_FLWheelSpeedRC
        IBC_FRWheelSpeedRC: ComSignalType=UINT16, ComBitSize=12, ComBitPosition=104, ComNotification=Rte_COMCbk_IBC_FRWheelSpeedRC, ComSystemTemplateSystemSignalRef=IBC_FRWheelSpeedRC
        IBC_RLWheelSpeedRC: ComSignalType=UINT16, ComBitSize=12, ComBitPosition=116, ComNotification=Rte_COMCbk_IBC_RLWheelSpeedRC, ComSystemTemplateSystemSignalRef=IBC_RLWheelSpeedRC
        IBC_RRWheelSpeedRC: ComSignalType=UINT16, ComBitSize=12, ComBitPosition=128, ComNotification=Rte_COMCbk_IBC_RRWheelSpeedRC, ComSystemTemplateSystemSignalRef=IBC_RRWheelSpeedRC
        IBC_DiscTemperatureFL: ComSignalType=UINT8, ComBitSize=3, ComBitPosition=184, ComNotification=Rte_COMCbk_IBC_DiscTemperatureFL, ComSystemTemplateSystemSignalRef=IBC_DiscTemperatureFL
        IBC_DiscTemperatureFLVD: ComSignalType=BOOLEAN, ComBitSize=1, ComBitPosition=187, ComNotification=Rte_COMCbk_IBC_DiscTemperatureFLVD, ComSystemTemplateSystemSignalRef=IBC_DiscTemperatureFLVD
        IBC_DiscTemperatureFR: ComSignalType=UINT8, ComBitSize=3, ComBitPosition=188, ComNotification=Rte_COMCbk_IBC_DiscTemperatureFR, ComSystemTemplateSystemSignalRef=IBC_DiscTemperatureFR
        IBC_DiscTemperatureFRVD: ComSignalType=BOOLEAN, ComBitSize=1, ComBitPosition=191, ComNotification=Rte_COMCbk_IBC_DiscTemperatureFRVD, ComSystemTemplateSystemSignalRef=IBC_DiscTemperatureFRVD
        IBC_DiscTemperatureRL: ComSignalType=UINT8, ComBitSize=3, ComBitPosition=192, ComNotification=Rte_COMCbk_IBC_DiscTemperatureRL, ComSystemTemplateSystemSignalRef=IBC_DiscTemperatureRL
        IBC_DiscTemperatureRLVD: ComSignalType=BOOLEAN, ComBitSize=1, ComBitPosition=195, ComNotification=Rte_COMCbk_IBC_DiscTemperatureRLVD, ComSystemTemplateSystemSignalRef=IBC_DiscTemperatureRLVD
        IBC_DiscTemperatureRR: ComSignalType=UINT8, ComBitSize=3, ComBitPosition=196, ComNotification=Rte_COMCbk_IBC_DiscTemperatureRR, ComSystemTemplateSystemSignalRef=IBC_DiscTemperatureRR
        IBC_DiscTemperatureRRVD: ComSignalType=BOOLEAN, ComBitSize=1, ComBitPosition=199, ComNotification=Rte_COMCbk_IBC_DiscTemperatureRRVD, ComSystemTemplateSystemSignalRef=IBC_DiscTemperatureRRVD
      FSC_0x142_C_CANFD (ComIPdu):
        ComIPduSignalProcessing = IMMEDIATE
        ComIPduType = NORMAL
        ComIPduDirection = RECEIVE
        ComIPduCallout = ComCallOut_FSC_0x142_C_CANFD
        ComIPduErrorNotification = ComCbk_RxTimeOut_FSC_0x142_C_CANFD
        ComFirstTimeout = 2.2
        ComTimeout = 0.2
        ComIPduGroupRef = ComIPduGroup_Rx
        ComPduIdRef = PduCollection/FSC_0x142_C_CANFD_PduR2Com
        ComIPduSignalRef = FSC_CRC_142
        ComIPduSignalRef = FSC_RollingCounter_142
        ComIPduSignalRef = FSC_LCC_Mode
      3 x ComSignal, all with ComSignalInitValue=0, ComSignalType=UINT8, ComSignalEndianness=LITTLE_ENDIAN, ComUpdateBitPosition=-1, ComTransferProperty=TRIGGERED:
        FSC_CRC_142: ComBitSize=8, ComBitPosition=0, ComNotification=Rte_COMCbk_FSC_CRC_142, ComSystemTemplateSystemSignalRef=FSC_CRC_142
        FSC_RollingCounter_142: ComBitSize=4, ComBitPosition=8, ComNotification=Rte_COMCbk_FSC_RollingCounter_142, ComSystemTemplateSystemSignalRef=FSC_RollingCounter_142
        FSC_LCC_Mode: ComBitSize=3, ComBitPosition=40, ComNotification=Rte_COMCbk_FSC_LCC_Mode, ComSystemTemplateSystemSignalRef=FSC_LCC_Mode
      IBC_0x185_C_CANFD (ComIPdu):
        ComIPduSignalProcessing = IMMEDIATE
        ComIPduType = NORMAL
        ComIPduDirection = RECEIVE
        ComIPduCallout = ComCallOut_IBC_0x185_C_CANFD
        ComIPduErrorNotification = ComCbk_RxTimeOut_IBC_0x185_C_CANFD
        ComFirstTimeout = 2.2
        ComTimeout = 0.2
        ComIPduGroupRef = ComIPduGroup_Rx
        ComPduIdRef = PduCollection/IBC_0x185_C_CANFD_PduR2Com
        ComIPduSignalRef = IBC_CRC_185
        ComIPduSignalRef = IBC_RollingCounter_185
        ComIPduSignalRef = IBC_PlungerPressure
        ComIPduSignalRef = IBC_PlungerPressure_Q
        ComIPduSignalRef = IBC_SimulatorPressure
        ComIPduSignalRef = IBC_SimulatorPressure_Q
        ComIPduSignalRef = IBC_HMI_WarningOn
        ComIPduSignalRef = IBC_MIL_WarningOn
        ComIPduSignalRef = IBC_LongitAcceAct
        ComIPduSignalRef = IBC_LongitAcceActValid
        ComIPduSignalRef = IBC_brakeFluidWarning
        ComIPduSignalRef = IBC_SCM_Active
        ComIPduSignalRef = IBC_SCM_Failed
        ComIPduSignalRef = IBC_CDPAvailable
        ComIPduSignalRef = IBC_CDPIntervention
        ComIPduSignalRef = IBC_AEB_active
        ComIPduSignalRef = IBC_AEBdecAvailable
        ComIPduSignalRef = IBC_AVHStatus
        ComIPduSignalRef = IBC_AVHAvailable
        ComIPduSignalRef = IBC_HHCActive
        ComIPduSignalRef = IBC_HHCFailed
        ComIPduSignalRef = IBC_CDD_Available_APA
        ComIPduSignalRef = IBC_CDD_Active_APA
        ComIPduSignalRef = IBC_CDD_Available_ACC
        ComIPduSignalRef = IBC_CDD_Active_ACC
        ComIPduSignalRef = IBC_HDCStatus
        ComIPduSignalRef = IBC_HDCAvailable
        ComIPduSignalRef = IBC_CSTStatus
        ComIPduSignalRef = IBC_CSTAvailable
        ComIPduSignalRef = IBC_VLC_Available_ACC
        ComIPduSignalRef = IBC_VLC_Active_ACC
        ComIPduSignalRef = IBC_VLC_Available_APA
        ComIPduSignalRef = IBC_VLC_Active_APA
        ComIPduSignalRef = IBC_VehicleHoldStatus
        ComIPduSignalRef = IBC_DrvrBrkTqAtWhlsReqd
      35 x ComSignal, all with ComSignalInitValue=0, ComSignalEndianness=LITTLE_ENDIAN, ComUpdateBitPosition=-1, ComTransferProperty=TRIGGERED:
        IBC_CRC_185: ComSignalType=UINT8, ComBitSize=8, ComBitPosition=0, ComNotification=Rte_COMCbk_IBC_CRC_185, ComSystemTemplateSystemSignalRef=IBC_CRC_185
        IBC_RollingCounter_185: ComSignalType=UINT8, ComBitSize=4, ComBitPosition=8, ComNotification=Rte_COMCbk_IBC_RollingCounter_185, ComSystemTemplateSystemSignalRef=IBC_RollingCounter_185
        IBC_PlungerPressure: ComSignalType=UINT16, ComBitSize=11, ComBitPosition=16, ComNotification=Rte_COMCbk_IBC_PlungerPressure, ComSystemTemplateSystemSignalRef=IBC_PlungerPressure
        IBC_PlungerPressure_Q: ComSignalType=BOOLEAN, ComBitSize=1, ComBitPosition=27, ComNotification=Rte_COMCbk_IBC_PlungerPressure_Q, ComSystemTemplateSystemSignalRef=IBC_PlungerPressure_Q
        IBC_SimulatorPressure: ComSignalType=UINT16, ComBitSize=11, ComBitPosition=28, ComNotification=Rte_COMCbk_IBC_SimulatorPressure, ComSystemTemplateSystemSignalRef=IBC_SimulatorPressure
        IBC_SimulatorPressure_Q: ComSignalType=BOOLEAN, ComBitSize=1, ComBitPosition=39, ComNotification=Rte_COMCbk_IBC_SimulatorPressure_Q, ComSystemTemplateSystemSignalRef=IBC_SimulatorPressure_Q
        IBC_HMI_WarningOn: ComSignalType=UINT8, ComBitSize=2, ComBitPosition=45, ComNotification=Rte_COMCbk_IBC_HMI_WarningOn, ComSystemTemplateSystemSignalRef=IBC_HMI_WarningOn
        IBC_MIL_WarningOn: ComSignalType=BOOLEAN, ComBitSize=1, ComBitPosition=47, ComNotification=Rte_COMCbk_IBC_MIL_WarningOn, ComSystemTemplateSystemSignalRef=IBC_MIL_WarningOn
        IBC_LongitAcceAct: ComSignalType=UINT16, ComBitSize=10, ComBitPosition=48, ComNotification=Rte_COMCbk_IBC_LongitAcceAct, ComSystemTemplateSystemSignalRef=IBC_LongitAcceAct
        IBC_LongitAcceActValid: ComSignalType=BOOLEAN, ComBitSize=1, ComBitPosition=58, ComNotification=Rte_COMCbk_IBC_LongitAcceActValid, ComSystemTemplateSystemSignalRef=IBC_LongitAcceActValid
        IBC_brakeFluidWarning: ComSignalType=UINT8, ComBitSize=2, ComBitPosition=59, ComNotification=Rte_COMCbk_IBC_brakeFluidWarning, ComSystemTemplateSystemSignalRef=IBC_brakeFluidWarning
        IBC_SCM_Active: ComSignalType=BOOLEAN, ComBitSize=1, ComBitPosition=69, ComNotification=Rte_COMCbk_IBC_SCM_Active, ComSystemTemplateSystemSignalRef=IBC_SCM_Active
        IBC_SCM_Failed: ComSignalType=BOOLEAN, ComBitSize=1, ComBitPosition=70, ComNotification=Rte_COMCbk_IBC_SCM_Failed, ComSystemTemplateSystemSignalRef=IBC_SCM_Failed
        IBC_CDPAvailable: ComSignalType=BOOLEAN, ComBitSize=1, ComBitPosition=78, ComNotification=Rte_COMCbk_IBC_CDPAvailable, ComSystemTemplateSystemSignalRef=IBC_CDPAvailable
        IBC_CDPIntervention: ComSignalType=BOOLEAN, ComBitSize=1, ComBitPosition=79, ComNotification=Rte_COMCbk_IBC_CDPIntervention, ComSystemTemplateSystemSignalRef=IBC_CDPIntervention
        IBC_AEB_active: ComSignalType=BOOLEAN, ComBitSize=1, ComBitPosition=80, ComNotification=Rte_COMCbk_IBC_AEB_active, ComSystemTemplateSystemSignalRef=IBC_AEB_active
        IBC_AEBdecAvailable: ComSignalType=BOOLEAN, ComBitSize=1, ComBitPosition=81, ComNotification=Rte_COMCbk_IBC_AEBdecAvailable, ComSystemTemplateSystemSignalRef=IBC_AEBdecAvailable
        IBC_AVHStatus: ComSignalType=UINT8, ComBitSize=2, ComBitPosition=82, ComNotification=Rte_COMCbk_IBC_AVHStatus, ComSystemTemplateSystemSignalRef=IBC_AVHStatus
        IBC_AVHAvailable: ComSignalType=BOOLEAN, ComBitSize=1, ComBitPosition=84, ComNotification=Rte_COMCbk_IBC_AVHAvailable, ComSystemTemplateSystemSignalRef=IBC_AVHAvailable
        IBC_HHCActive: ComSignalType=BOOLEAN, ComBitSize=1, ComBitPosition=85, ComNotification=Rte_COMCbk_IBC_HHCActive, ComSystemTemplateSystemSignalRef=IBC_HHCActive
        IBC_HHCFailed: ComSignalType=BOOLEAN, ComBitSize=1, ComBitPosition=86, ComNotification=Rte_COMCbk_IBC_HHCFailed, ComSystemTemplateSystemSignalRef=IBC_HHCFailed
        IBC_CDD_Available_APA: ComSignalType=BOOLEAN, ComBitSize=1, ComBitPosition=87, ComNotification=Rte_COMCbk_IBC_CDD_Available_APA, ComSystemTemplateSystemSignalRef=IBC_CDD_Available_APA
        IBC_CDD_Active_APA: ComSignalType=BOOLEAN, ComBitSize=1, ComBitPosition=88, ComNotification=Rte_COMCbk_IBC_CDD_Active_APA, ComSystemTemplateSystemSignalRef=IBC_CDD_Active_APA
        IBC_CDD_Available_ACC: ComSignalType=BOOLEAN, ComBitSize=1, ComBitPosition=90, ComNotification=Rte_COMCbk_IBC_CDD_Available_ACC, ComSystemTemplateSystemSignalRef=IBC_CDD_Available_ACC
        IBC_CDD_Active_ACC: ComSignalType=BOOLEAN, ComBitSize=1, ComBitPosition=91, ComNotification=Rte_COMCbk_IBC_CDD_Active_ACC, ComSystemTemplateSystemSignalRef=IBC_CDD_Active_ACC
        IBC_HDCStatus: ComSignalType=UINT8, ComBitSize=2, ComBitPosition=94, ComNotification=Rte_COMCbk_IBC_HDCStatus, ComSystemTemplateSystemSignalRef=IBC_HDCStatus
        IBC_HDCAvailable: ComSignalType=BOOLEAN, ComBitSize=1, ComBitPosition=96, ComNotification=Rte_COMCbk_IBC_HDCAvailable, ComSystemTemplateSystemSignalRef=IBC_HDCAvailable
        IBC_CSTStatus: ComSignalType=UINT8, ComBitSize=2, ComBitPosition=97, ComNotification=Rte_COMCbk_IBC_CSTStatus, ComSystemTemplateSystemSignalRef=IBC_CSTStatus
        IBC_CSTAvailable: ComSignalType=BOOLEAN, ComBitSize=1, ComBitPosition=99, ComNotification=Rte_COMCbk_IBC_CSTAvailable, ComSystemTemplateSystemSignalRef=IBC_CSTAvailable
        IBC_VLC_Available_ACC: ComSignalType=BOOLEAN, ComBitSize=1, ComBitPosition=100, ComNotification=Rte_COMCbk_IBC_VLC_Available_ACC, ComSystemTemplateSystemSignalRef=IBC_VLC_Available_ACC
        IBC_VLC_Active_ACC: ComSignalType=BOOLEAN, ComBitSize=1, ComBitPosition=101, ComNotification=Rte_COMCbk_IBC_VLC_Active_ACC, ComSystemTemplateSystemSignalRef=IBC_VLC_Active_ACC
        IBC_VLC_Available_APA: ComSignalType=BOOLEAN, ComBitSize=1, ComBitPosition=102, ComNotification=Rte_COMCbk_IBC_VLC_Available_APA, ComSystemTemplateSystemSignalRef=IBC_VLC_Available_APA
        IBC_VLC_Active_APA: ComSignalType=BOOLEAN, ComBitSize=1, ComBitPosition=103, ComNotification=Rte_COMCbk_IBC_VLC_Active_APA, ComSystemTemplateSystemSignalRef=IBC_VLC_Active_APA
        IBC_VehicleHoldStatus: ComSignalType=UINT8, ComBitSize=2, ComBitPosition=104, ComNotification=Rte_COMCbk_IBC_VehicleHoldStatus, ComSystemTemplateSystemSignalRef=IBC_VehicleHoldStatus
        IBC_DrvrBrkTqAtWhlsReqd: ComSignalType=UINT16, ComBitSize=15, ComBitPosition=113, ComNotification=Rte_COMCbk_IBC_DrvrBrkTqAtWhlsReqd, ComSystemTemplateSystemSignalRef=IBC_DrvrBrkTqAtWhlsReqd
      ACU_0x2A3_C_CANFD (ComIPdu):
        ComIPduSignalProcessing = IMMEDIATE
        ComIPduType = NORMAL
        ComIPduDirection = RECEIVE
        ComIPduCallout = ComCallOut_ACU_0x2A3_C_CANFD
        ComIPduErrorNotification = ComCbk_RxTimeOut_ACU_0x2A3_C_CANFD
        ComFirstTimeout = 6.5
        ComTimeout = 0.5
        ComIPduGroupRef = ComIPduGroup_Rx
        ComPduIdRef = PduCollection/ACU_0x2A3_C_CANFD_PduR2Com
        ComIPduSignalRef = ACU_CRC_2A3
        ComIPduSignalRef = ACU_Trigger
        ComIPduSignalRef = ACU_RollingCounter_2A3
        ComIPduSignalRef = ACU_TotalCrashOutputSts
        ComIPduSignalRef = ACU_SelfCheckSt
        ComIPduSignalRef = ACU_FLSeatBeltRSt
        ComIPduSignalRef = ACU_FRSeatBeltRSt
      7 x ComSignal, all with ComSignalInitValue=0, ComSignalEndianness=LITTLE_ENDIAN, ComUpdateBitPosition=-1, ComTransferProperty=TRIGGERED:
        ACU_CRC_2A3: ComSignalType=UINT8, ComBitSize=8, ComBitPosition=0, ComNotification=Rte_COMCbk_ACU_CRC_2A3, ComSystemTemplateSystemSignalRef=ACU_CRC_2A3
        ACU_Trigger: ComSignalType=BOOLEAN, ComBitSize=1, ComBitPosition=88, ComNotification=Rte_COMCbk_ACU_Trigger, ComSystemTemplateSystemSignalRef=ACU_Trigger
        ACU_RollingCounter_2A3: ComSignalType=UINT8, ComBitSize=4, ComBitPosition=8, ComNotification=Rte_COMCbk_ACU_RollingCounter_2A3, ComSystemTemplateSystemSignalRef=ACU_RollingCounter_2A3
        ACU_TotalCrashOutputSts: ComSignalType=BOOLEAN, ComBitSize=1, ComBitPosition=16, ComNotification=Rte_COMCbk_ACU_TotalCrashOutputSts, ComSystemTemplateSystemSignalRef=ACU_TotalCrashOutputSts
        ACU_SelfCheckSt: ComSignalType=BOOLEAN, ComBitSize=1, ComBitPosition=28, ComNotification=Rte_COMCbk_ACU_SelfCheckSt, ComSystemTemplateSystemSignalRef=ACU_SelfCheckSt
        ACU_FLSeatBeltRSt: ComSignalType=UINT8, ComBitSize=2, ComBitPosition=30, ComNotification=Rte_COMCbk_ACU_FLSeatBeltRSt, ComSystemTemplateSystemSignalRef=ACU_FLSeatBeltRSt
        ACU_FRSeatBeltRSt: ComSignalType=UINT8, ComBitSize=2, ComBitPosition=32, ComNotification=Rte_COMCbk_ACU_FRSeatBeltRSt, ComSystemTemplateSystemSignalRef=ACU_FRSeatBeltRSt
      ICU_0x24D_C_CANFD (ComIPdu):
        ComIPduSignalProcessing = IMMEDIATE
        ComIPduType = NORMAL
        ComIPduDirection = RECEIVE
        ComIPduCallout = ComCallOut_ICU_0x24D_C_CANFD
        ComIPduErrorNotification = ComCbk_RxTimeOut_ICU_0x24D_C_CANFD
        ComFirstTimeout = 15.5
        ComTimeout = 0.5
        ComIPduGroupRef = ComIPduGroup_Rx
        ComPduIdRef = PduCollection/ICU_0x24D_C_CANFD_PduR2Com
        ComIPduSignalRef = ICU_CRC_24D
        ComIPduSignalRef = ICU_SpeedConversionCoefficient
        ComIPduSignalRef = ICU_RollingCounter_24D
        ComIPduSignalRef = ICU_CCSFunctionStatus
        ComIPduSignalRef = ICU_CruiseVehicleSpeedCtl
        ComIPduSignalRef = ICU_VehicleScreenSpeed
        ComIPduSignalRef = ICU_VehicleSpeedUnit
        ComIPduSignalRef = ICU_ACCFunctionStatus
        ComIPduSignalRef = ICU_LCCFunctionStatus
        ComIPduSignalRef = IVI_LPedalMode
      10 x ComSignal, all with ComSignalInitValue=0, ComSignalEndianness=LITTLE_ENDIAN, ComUpdateBitPosition=-1, ComTransferProperty=TRIGGERED:
        ICU_CRC_24D: ComSignalType=UINT8, ComBitSize=8, ComBitPosition=0, ComNotification=Rte_COMCbk_ICU_CRC_24D, ComSystemTemplateSystemSignalRef=ICU_CRC_24D
        ICU_SpeedConversionCoefficient: ComSignalType=UINT8, ComBitSize=2, ComBitPosition=154, ComNotification=Rte_COMCbk_ICU_SpeedConversionCoefficient, ComSystemTemplateSystemSignalRef=ICU_SpeedConversionCoefficient
        ICU_RollingCounter_24D: ComSignalType=UINT8, ComBitSize=4, ComBitPosition=8, ComNotification=Rte_COMCbk_ICU_RollingCounter_24D, ComSystemTemplateSystemSignalRef=ICU_RollingCounter_24D
        ICU_CCSFunctionStatus: ComSignalType=BOOLEAN, ComBitSize=1, ComBitPosition=39, ComNotification=Rte_COMCbk_ICU_CCSFunctionStatus, ComSystemTemplateSystemSignalRef=ICU_CCSFunctionStatus
        ICU_CruiseVehicleSpeedCtl: ComSignalType=UINT16, ComBitSize=16, ComBitPosition=64, ComNotification=Rte_COMCbk_ICU_CruiseVehicleSpeedCtl, ComSystemTemplateSystemSignalRef=ICU_CruiseVehicleSpeedCtl
        ICU_VehicleScreenSpeed: ComSignalType=UINT16, ComBitSize=9, ComBitPosition=80, ComNotification=Rte_COMCbk_ICU_VehicleScreenSpeed, ComSystemTemplateSystemSignalRef=ICU_VehicleScreenSpeed
        ICU_VehicleSpeedUnit: ComSignalType=BOOLEAN, ComBitSize=1, ComBitPosition=89, ComNotification=Rte_COMCbk_ICU_VehicleSpeedUnit, ComSystemTemplateSystemSignalRef=ICU_VehicleSpeedUnit
        ICU_ACCFunctionStatus: ComSignalType=BOOLEAN, ComBitSize=1, ComBitPosition=131, ComNotification=Rte_COMCbk_ICU_ACCFunctionStatus, ComSystemTemplateSystemSignalRef=ICU_ACCFunctionStatus
        ICU_LCCFunctionStatus: ComSignalType=BOOLEAN, ComBitSize=1, ComBitPosition=132, ComNotification=Rte_COMCbk_ICU_LCCFunctionStatus, ComSystemTemplateSystemSignalRef=ICU_LCCFunctionStatus
        IVI_LPedalMode: ComSignalType=BOOLEAN, ComBitSize=1, ComBitPosition=133, ComNotification=Rte_COMCbk_IVI_LPedalMode, ComSystemTemplateSystemSignalRef=IVI_LPedalMode
      HPCBCM_0x290_C_CANFD (ComIPdu):
        ComIPduSignalProcessing = IMMEDIATE
        ComIPduType = NORMAL
        ComIPduDirection = RECEIVE
        ComIPduCallout = ComCallOut_HPCBCM_0x290_C_CANFD
        ComIPduErrorNotification = ComCbk_RxTimeOut_HPCBCM_0x290_C_CANFD
        ComFirstTimeout = 3.0
        ComTimeout = 1.0
        ComIPduGroupRef = ComIPduGroup_Rx
        ComPduIdRef = PduCollection/HPCBCM_0x290_C_CANFD_PduR2Com
        ComIPduSignalRef = BCM_CRC_290
        ComIPduSignalRef = BCM_RRDoorSts_ID290_CCAN
        ComIPduSignalRef = BCM_RLDoorSts_ID290_CCAN
        ComIPduSignalRef = BCM_RollingCounter_290
        ComIPduSignalRef = BCM_HazardSwtSts
        ComIPduSignalRef = BCM_DrOC_PPD_Status
        ComIPduSignalRef = BCM_FLOC_PPD_Status
        ComIPduSignalRef = BCM_FROC_PPD_Status
        ComIPduSignalRef = BCM_DriverDoorSts_ID290_CCAN
        ComIPduSignalRef = BCM_DriverDoorSts_VD
        ComIPduSignalRef = BCM_FLDoorSts_ID290_CCAN
        ComIPduSignalRef = BCM_FRDoorSts_ID290_CCAN
        ComIPduSignalRef = BCM_BackDoorSts_ID290_CCAN
        ComIPduSignalRef = BCM_FrontCoverSts
        ComIPduSignalRef = BCM_HazardSwtOpenSts
        ComIPduSignalRef = BCM_BrakeFluidLevel
        ComIPduSignalRef = BCM_ON2BRelaySts_ID290_CCAN
        ComIPduSignalRef = BCM_ON2CRelaySts_ID290_CCAN
        ComIPduSignalRef = BCM_AlarmMode_C
      20 x ComSignal, all with ComSignalInitValue=0, ComSignalEndianness=LITTLE_ENDIAN, ComUpdateBitPosition=-1, ComTransferProperty=TRIGGERED:
        BCM_CRC_290: ComSignalType=UINT8, ComBitSize=8, ComBitPosition=0, ComNotification=Rte_COMCbk_BCM_CRC_290, ComSystemTemplateSystemSignalRef=BCM_CRC_290
        BCM_RRDoorSts_ID290_CCAN: ComSignalType=BOOLEAN, ComBitSize=1, ComBitPosition=49, ComNotification=Rte_COMCbk_BCM_RRDoorSts_ID290_CCAN, ComSystemTemplateSystemSignalRef=BCM_RRDoorSts_ID290_CCAN
        BCM_RLDoorSts_ID290_CCAN: ComSignalType=BOOLEAN, ComBitSize=1, ComBitPosition=48, ComNotification=Rte_COMCbk_BCM_RLDoorSts_ID290_CCAN, ComSystemTemplateSystemSignalRef=BCM_RLDoorSts_ID290_CCAN
        BCM_RollingCounter_290: ComSignalType=UINT8, ComBitSize=4, ComBitPosition=8, ComNotification=Rte_COMCbk_BCM_RollingCounter_290, ComSystemTemplateSystemSignalRef=BCM_RollingCounter_290
        BCM_HazardSwtSts: ComSignalType=BOOLEAN, ComBitSize=1, ComBitPosition=23, ComNotification=Rte_COMCbk_BCM_HazardSwtSts, ComSystemTemplateSystemSignalRef=BCM_HazardSwtSts
        BCM_DrOC_PPD_Status: ComSignalType=UINT8, ComBitSize=2, ComBitPosition=28, ComNotification=Rte_COMCbk_BCM_DrOC_PPD_Status, ComSystemTemplateSystemSignalRef=BCM_DrOC_PPD_Status
        BCM_FLOC_PPD_Status: ComSignalType=UINT8, ComBitSize=2, ComBitPosition=30, ComNotification=Rte_COMCbk_BCM_FLOC_PPD_Status, ComSystemTemplateSystemSignalRef=BCM_FLOC_PPD_Status
        BCM_FROC_PPD_Status: ComSignalType=UINT8, ComBitSize=2, ComBitPosition=32, ComNotification=Rte_COMCbk_BCM_FROC_PPD_Status, ComSystemTemplateSystemSignalRef=BCM_FROC_PPD_Status
        BCM_DriverDoorSts_ID290_CCAN: ComSignalType=BOOLEAN, ComBitSize=1, ComBitPosition=44, ComNotification=Rte_COMCbk_BCM_DriverDoorSts_ID290_CCAN, ComSystemTemplateSystemSignalRef=BCM_DriverDoorSts_ID290_CCAN
        BCM_DriverDoorSts_VD: ComSignalType=BOOLEAN, ComBitSize=1, ComBitPosition=45, ComNotification=Rte_COMCbk_BCM_DriverDoorSts_VD, ComSystemTemplateSystemSignalRef=BCM_DriverDoorSts_VD
        BCM_FLDoorSts_ID290_CCAN: ComSignalType=BOOLEAN, ComBitSize=1, ComBitPosition=46, ComNotification=Rte_COMCbk_BCM_FLDoorSts_ID290_CCAN, ComSystemTemplateSystemSignalRef=BCM_FLDoorSts_ID290_CCAN
        BCM_FRDoorSts_ID290_CCAN: ComSignalType=BOOLEAN, ComBitSize=1, ComBitPosition=47, ComNotification=Rte_COMCbk_BCM_FRDoorSts_ID290_CCAN, ComSystemTemplateSystemSignalRef=BCM_FRDoorSts_ID290_CCAN
        BCM_BackDoorSts_ID290_CCAN: ComSignalType=BOOLEAN, ComBitSize=1, ComBitPosition=50, ComNotification=Rte_COMCbk_BCM_BackDoorSts_ID290_CCAN, ComSystemTemplateSystemSignalRef=BCM_BackDoorSts_ID290_CCAN
        BCM_FrontCoverSts: ComSignalType=BOOLEAN, ComBitSize=1, ComBitPosition=51, ComNotification=Rte_COMCbk_BCM_FrontCoverSts, ComSystemTemplateSystemSignalRef=BCM_FrontCoverSts
        BCM_HazardSwtOpenSts: ComSignalType=BOOLEAN, ComBitSize=1, ComBitPosition=52, ComNotification=Rte_COMCbk_BCM_HazardSwtOpenSts, ComSystemTemplateSystemSignalRef=BCM_HazardSwtOpenSts
        BCM_BrakeFluidLevel: ComSignalType=UINT8, ComBitSize=2, ComBitPosition=53, ComNotification=Rte_COMCbk_BCM_BrakeFluidLevel, ComSystemTemplateSystemSignalRef=BCM_BrakeFluidLevel
        BCM_ON2BRelaySts_ID290_CCAN: ComSignalType=BOOLEAN, ComBitSize=1, ComBitPosition=57, ComNotification=Rte_COMCbk_BCM_ON2BRelaySts_ID290_CCAN, ComSystemTemplateSystemSignalRef=BCM_ON2BRelaySts_ID290_CCAN
        BCM_ON2CRelaySts_ID290_CCAN: ComSignalType=BOOLEAN, ComBitSize=1, ComBitPosition=58, ComNotification=Rte_COMCbk_BCM_ON2CRelaySts_ID290_CCAN, ComSystemTemplateSystemSignalRef=BCM_ON2CRelaySts_ID290_CCAN
        BCM_AlarmMode_C: ComSignalType=UINT8, ComBitSize=2, ComBitPosition=61, ComNotification=Rte_COMCbk_BCM_AlarmMode_C, ComSystemTemplateSystemSignalRef=BCM_AlarmMode_C
        LMC_LSFCActiveSt: ComSignalType=UINT8, ComBitSize=2, ComBitPosition=230, ComNotification=Rte_COMCbk_LMC_LSFCActiveSt, ComSystemTemplateSystemSignalRef=LMC_LSFCActiveSt
      IVI_0x331_C_CANFD (ComIPdu):
        ComIPduSignalProcessing = IMMEDIATE
        ComIPduType = NORMAL
        ComIPduDirection = RECEIVE
        ComIPduCallout = ComCallOut_IVI_0x331_C_CANFD
        ComIPduErrorNotification = ComCbk_RxTimeOut_IVI_0x331_C_CANFD
        ComFirstTimeout = 3.0
        ComTimeout = 1.0
        ComIPduGroupRef = ComIPduGroup_Rx
        ComPduIdRef = PduCollection/IVI_0x331_C_CANFD_PduR2Com
        ComIPduSignalRef = IVI_CRC_331
        ComIPduSignalRef = IVI_RollingCounter_331
        ComIPduSignalRef = IVI_EPBRequst
        ComIPduSignalRef = IVI_TerrainMatchMode
        ComIPduSignalRef = IVI_LPedalModeSW
        ComIPduSignalRef = IVI_AVHSw_X
        ComIPduSignalRef = IVI_ESCSw_X
        ComIPduSignalRef = IVI_HDCSw_X
        ComIPduSignalRef = IVI_CSTSw_X
        ComIPduSignalRef = IVI_AutoAllRoad
        ComIPduSignalRef = IVI_CampingMode_SW
        ComIPduSignalRef = IVI_BraPedMod
        ComIPduSignalRef = IVI_SlowspeedSmartCtrl
        ComIPduSignalRef = IVI_TrailerModeCtrl
        ComIPduSignalRef = IVI_EscapeMode_SW
        ComIPduSignalRef = IVI_PowerSavingModeReq
        ComIPduSignalRef = IVI_SelfAdaptionDriveSW
        ComIPduSignalRef = IVI_CmpUTurnStartUI
        ComIPduSignalRef = IVI_CmpUTurnLockWhlUI
        ComIPduSignalRef = IVI_CmpUTurnTarDirUI
        ComIPduSignalRef = IVI_CmpUTurnTarAngleUI
        ComIPduSignalRef = IVI_CmpUTurnReq
      22 x ComSignal, all with ComSignalInitValue=0, ComSignalEndianness=LITTLE_ENDIAN, ComUpdateBitPosition=-1, ComTransferProperty=TRIGGERED:
        IVI_CRC_331: ComSignalType=UINT8, ComBitSize=8, ComBitPosition=0, ComNotification=Rte_COMCbk_IVI_CRC_331, ComSystemTemplateSystemSignalRef=IVI_CRC_331
        IVI_RollingCounter_331: ComSignalType=UINT8, ComBitSize=4, ComBitPosition=8, ComNotification=Rte_COMCbk_IVI_RollingCounter_331, ComSystemTemplateSystemSignalRef=IVI_RollingCounter_331
        IVI_EPBRequst: ComSignalType=UINT8, ComBitSize=2, ComBitPosition=22, ComNotification=Rte_COMCbk_IVI_EPBRequst, ComSystemTemplateSystemSignalRef=IVI_EPBRequst
        IVI_TerrainMatchMode: ComSignalType=UINT8, ComBitSize=3, ComBitPosition=24, ComNotification=Rte_COMCbk_IVI_TerrainMatchMode, ComSystemTemplateSystemSignalRef=IVI_TerrainMatchMode
        IVI_LPedalModeSW: ComSignalType=UINT8, ComBitSize=1, ComBitPosition=27, ComNotification=Rte_COMCbk_IVI_LPedalModeSW, ComSystemTemplateSystemSignalRef=IVI_LPedalModeSW
        IVI_AVHSw_X: ComSignalType=UINT8, ComBitSize=2, ComBitPosition=28, ComNotification=Rte_COMCbk_IVI_AVHSw_X, ComSystemTemplateSystemSignalRef=IVI_AVHSw_X
        IVI_ESCSw_X: ComSignalType=UINT8, ComBitSize=2, ComBitPosition=30, ComNotification=Rte_COMCbk_IVI_ESCSw_X, ComSystemTemplateSystemSignalRef=IVI_ESCSw_X
        IVI_HDCSw_X: ComSignalType=UINT8, ComBitSize=2, ComBitPosition=32, ComNotification=Rte_COMCbk_IVI_HDCSw_X, ComSystemTemplateSystemSignalRef=IVI_HDCSw_X
        IVI_CSTSw_X: ComSignalType=UINT8, ComBitSize=2, ComBitPosition=34, ComNotification=Rte_COMCbk_IVI_CSTSw_X, ComSystemTemplateSystemSignalRef=IVI_CSTSw_X
        IVI_AutoAllRoad: ComSignalType=UINT8, ComBitSize=3, ComBitPosition=65, ComNotification=Rte_COMCbk_IVI_AutoAllRoad, ComSystemTemplateSystemSignalRef=IVI_AutoAllRoad
        IVI_CampingMode_SW: ComSignalType=BOOLEAN, ComBitSize=1, ComBitPosition=75, ComNotification=Rte_COMCbk_IVI_CampingMode_SW, ComSystemTemplateSystemSignalRef=IVI_CampingMode_SW
        IVI_BraPedMod: ComSignalType=UINT8, ComBitSize=2, ComBitPosition=76, ComNotification=Rte_COMCbk_IVI_BraPedMod, ComSystemTemplateSystemSignalRef=IVI_BraPedMod
        IVI_SlowspeedSmartCtrl: ComSignalType=BOOLEAN, ComBitSize=1, ComBitPosition=78, ComNotification=Rte_COMCbk_IVI_SlowspeedSmartCtrl, ComSystemTemplateSystemSignalRef=IVI_SlowspeedSmartCtrl
        IVI_TrailerModeCtrl: ComSignalType=BOOLEAN, ComBitSize=1, ComBitPosition=79, ComNotification=Rte_COMCbk_IVI_TrailerModeCtrl, ComSystemTemplateSystemSignalRef=IVI_TrailerModeCtrl
        IVI_EscapeMode_SW: ComSignalType=BOOLEAN, ComBitSize=1, ComBitPosition=81, ComNotification=Rte_COMCbk_IVI_EscapeMode_SW, ComSystemTemplateSystemSignalRef=IVI_EscapeMode_SW
        IVI_PowerSavingModeReq: ComSignalType=UINT8, ComBitSize=2, ComBitPosition=85, ComNotification=Rte_COMCbk_IVI_PowerSavingModeReq, ComSystemTemplateSystemSignalRef=IVI_PowerSavingModeReq
        IVI_SelfAdaptionDriveSW: ComSignalType=BOOLEAN, ComBitSize=1, ComBitPosition=87, ComNotification=Rte_COMCbk_IVI_SelfAdaptionDriveSW, ComSystemTemplateSystemSignalRef=IVI_SelfAdaptionDriveSW
        IVI_CmpUTurnStartUI: ComSignalType=BOOLEAN, ComBitSize=1, ComBitPosition=89, ComNotification=Rte_COMCbk_IVI_CmpUTurnStartUI, ComSystemTemplateSystemSignalRef=IVI_CmpUTurnStartUI
        IVI_CmpUTurnLockWhlUI: ComSignalType=UINT8, ComBitSize=3, ComBitPosition=90, ComNotification=Rte_COMCbk_IVI_CmpUTurnLockWhlUI, ComSystemTemplateSystemSignalRef=IVI_CmpUTurnLockWhlUI
        IVI_CmpUTurnTarDirUI: ComSignalType=UINT8, ComBitSize=2, ComBitPosition=93, ComNotification=Rte_COMCbk_IVI_CmpUTurnTarDirUI, ComSystemTemplateSystemSignalRef=IVI_CmpUTurnTarDirUI
        IVI_CmpUTurnTarAngleUI: ComSignalType=UINT16, ComBitSize=9, ComBitPosition=95, ComNotification=Rte_COMCbk_IVI_CmpUTurnTarAngleUI, ComSystemTemplateSystemSignalRef=IVI_CmpUTurnTarAngleUI
        IVI_CmpUTurnReq: ComSignalType=UINT8, ComBitSize=2, ComBitPosition=104, ComNotification=Rte_COMCbk_IVI_CmpUTurnReq, ComSystemTemplateSystemSignalRef=IVI_CmpUTurnReq
      ICU_0x332_C_CANFD (ComIPdu):
        ComIPduSignalProcessing = IMMEDIATE
        ComIPduType = NORMAL
        ComIPduDirection = RECEIVE
        ComIPduCallout = ComCallOut_ICU_0x332_C_CANFD
        ComIPduErrorNotification = ComCbk_RxTimeOut_ICU_0x332_C_CANFD
        ComFirstTimeout = 4.0
        ComTimeout = 2.0
        ComIPduGroupRef = ComIPduGroup_Rx
        ComPduIdRef = PduCollection/ICU_0x332_C_CANFD_PduR2Com
        ComIPduSignalRef = ICU_CRC_332
        ComIPduSignalRef = ICU_RollingCounter_332
        ComIPduSignalRef = ICU_AEB_SW
        ComIPduSignalRef = ICU_ISA_controlSW
        ComIPduSignalRef = ICU_SLIF_SW
        ComIPduSignalRef = ICU_SLWF_SW
      6 x ComSignal, all with ComSignalInitValue=0, ComSignalEndianness=LITTLE_ENDIAN, ComUpdateBitPosition=-1, ComTransferProperty=TRIGGERED:
        ICU_CRC_332: ComSignalType=UINT8, ComBitSize=8, ComBitPosition=0, ComNotification=Rte_COMCbk_ICU_CRC_332, ComSystemTemplateSystemSignalRef=ICU_CRC_332
        ICU_RollingCounter_332: ComSignalType=UINT8, ComBitSize=4, ComBitPosition=8, ComNotification=Rte_COMCbk_ICU_RollingCounter_332, ComSystemTemplateSystemSignalRef=ICU_RollingCounter_332
        ICU_AEB_SW: ComSignalType=BOOLEAN, ComBitSize=1, ComBitPosition=21, ComNotification=Rte_COMCbk_ICU_AEB_SW, ComSystemTemplateSystemSignalRef=ICU_AEB_SW
        ICU_ISA_controlSW: ComSignalType=BOOLEAN, ComBitSize=1, ComBitPosition=31, ComNotification=Rte_COMCbk_ICU_ISA_controlSW, ComSystemTemplateSystemSignalRef=ICU_ISA_controlSW
        ICU_SLIF_SW: ComSignalType=BOOLEAN, ComBitSize=1, ComBitPosition=32, ComNotification=Rte_COMCbk_ICU_SLIF_SW, ComSystemTemplateSystemSignalRef=ICU_SLIF_SW
        ICU_SLWF_SW: ComSignalType=BOOLEAN, ComBitSize=1, ComBitPosition=33, ComNotification=Rte_COMCbk_ICU_SLWF_SW, ComSystemTemplateSystemSignalRef=ICU_SLWF_SW
      VCU_0xB6_C_CANFD (ComIPdu):
        ComIPduSignalProcessing = IMMEDIATE
        ComIPduType = NORMAL
        ComIPduDirection = SEND
        ComIPduCallout = ComCallOut_VCU_0xB6_C_CANFD
        ComIPduGroupRef = ComIPduGroup_Tx
        ComPduIdRef = PduCollection/VCU_0xB6_C_CANFD_Com2PduR
        ComIPduSignalRef = VCU_CRC_B6
        ComIPduSignalRef = VCU_TVTest2
        ComIPduSignalRef = VCU_VPE_Test1
        ComIPduSignalRef = VCU_VPE_Test2
        ComIPduSignalRef = VCU_TVTest1
        ComIPduSignalRef = VCU_RollingCounter_B6
        ComIPduSignalRef = VCU_MDrvRequestTorque_IDB6_CCAN
        ComIPduSignalRef = VCU_MDriverRequireTorque
        ComIPduSignalRef = VCU_SDrvRequestTorque_IDB6_CCAN
        ComIPduSignalRef = VCU_SDriverRequireTorque
        ComIPduSignalRef = VCU_ThrottlePosition_IDB6_CCAN
        ComIPduSignalRef = VCU_AccPedalValid_IDB6_CCAN
        ComIPduSignalRef = VCU_BrakeSysFault_IDB6_CCAN
        ComIPduSignalRef = VCU_BrakeLightReq
        ComIPduSignalRef = VCU_BrakePedalSts
        ComIPduSignalRef = VCU_BrakePedalStsValid
        ComIPduSignalRef = VCU_GearLevelPosSts_IDB6_CCAN
        ComIPduSignalRef = VCU_GearLeverValid_IDB6_CCAN
        ComIPduSignalRef = VCU_BrakeFirstSts
        ComIPduSignalRef = VCU_DeliveryModeSts_IDB6_CCAN
        ComIPduSignalRef = VCU_MRDriverRequireTorque
        ComIPduSignalRef = VCU_MRDrvRequestTorque_IDB6_CCAN
        ComTxIPdu: ComMinimumDelayTime=0.0, ComTxIPduUnusedAreasDefault=0
          ComTxModeTrue
            ComTxMode: ComTxModeTimePeriod=0.01, ComTxModeMode=PERIODIC, ComTxModeNumberOfRepetitions=0, ComTxModeRepetitionPeriod=0, ComTxModeTimeOffset=0.0
          ComTxModeFalse
            ComTxMode: ComTxModeTimePeriod=0.01, ComTxModeMode=PERIODIC, ComTxModeNumberOfRepetitions=0, ComTxModeRepetitionPeriod=0, ComTxModeTimeOffset=0.0
      20 x ComSignal, all with ComSignalInitValue=0, ComSignalEndianness=LITTLE_ENDIAN, ComUpdateBitPosition=-1, ComTransferProperty=PENDING:
        VCU_CRC_B6: ComSignalType=UINT8, ComBitSize=8, ComBitPosition=0, ComSystemTemplateSystemSignalRef=VCU_CRC_B6
        VCU_TVTest2: ComSignalType=UINT32, ComBitSize=20, ComBitPosition=172, ComSystemTemplateSystemSignalRef=VCU_TVTest2
        VCU_VPE_Test1: ComSignalType=UINT16, ComBitSize=12, ComBitPosition=160, ComSystemTemplateSystemSignalRef=VCU_VPE_Test1
        VCU_VPE_Test2: ComSignalType=UINT8, ComBitSize=7, ComBitPosition=121, ComSystemTemplateSystemSignalRef=VCU_VPE_Test2
        VCU_TVTest1: ComSignalType=UINT16, ComBitSize=15, ComBitPosition=106, ComSystemTemplateSystemSignalRef=VCU_TVTest1
        VCU_RollingCounter_B6: ComSignalType=UINT8, ComBitSize=4, ComBitPosition=8, ComSystemTemplateSystemSignalRef=VCU_RollingCounter_B6
        VCU_MDrvRequestTorque_IDB6_CCAN: ComSignalType=UINT16, ComBitSize=16, ComBitPosition=16, ComSystemTemplateSystemSignalRef=VCU_MDrvRequestTorque_IDB6_CCAN
        VCU_MDriverRequireTorque: ComSignalType=UINT16, ComBitSize=16, ComBitPosition=32, ComSystemTemplateSystemSignalRef=VCU_MDriverRequireTorque
        VCU_SDrvRequestTorque_IDB6_CCAN: ComSignalType=UINT16, ComBitSize=16, ComBitPosition=48, ComSystemTemplateSystemSignalRef=VCU_SDrvRequestTorque_IDB6_CCAN
        VCU_SDriverRequireTorque: ComSignalType=UINT16, ComBitSize=16, ComBitPosition=64, ComSystemTemplateSystemSignalRef=VCU_SDriverRequireTorque
        VCU_ThrottlePosition_IDB6_CCAN: ComSignalType=UINT8, ComBitSize=8, ComBitPosition=88, ComSystemTemplateSystemSignalRef=VCU_ThrottlePosition_IDB6_CCAN
        VCU_AccPedalValid_IDB6_CCAN: ComSignalType=BOOLEAN, ComBitSize=1, ComBitPosition=96, ComSystemTemplateSystemSignalRef=VCU_AccPedalValid_IDB6_CCAN
        VCU_BrakeSysFault_IDB6_CCAN: ComSignalType=BOOLEAN, ComBitSize=1, ComBitPosition=97, ComSystemTemplateSystemSignalRef=VCU_BrakeSysFault_IDB6_CCAN
        VCU_BrakeLightReq: ComSignalType=BOOLEAN, ComBitSize=1, ComBitPosition=98, ComSystemTemplateSystemSignalRef=VCU_BrakeLightReq
        VCU_BrakePedalSts: ComSignalType=BOOLEAN, ComBitSize=1, ComBitPosition=99, ComSystemTemplateSystemSignalRef=VCU_BrakePedalSts
        VCU_BrakePedalStsValid: ComSignalType=BOOLEAN, ComBitSize=1, ComBitPosition=100, ComSystemTemplateSystemSignalRef=VCU_BrakePedalStsValid
        VCU_GearLevelPosSts_IDB6_CCAN: ComSignalType=UINT8, ComBitSize=2, ComBitPosition=101, ComSystemTemplateSystemSignalRef=VCU_GearLevelPosSts_IDB6_CCAN
        VCU_GearLeverValid_IDB6_CCAN: ComSignalType=BOOLEAN, ComBitSize=1, ComBitPosition=103, ComSystemTemplateSystemSignalRef=VCU_GearLeverValid_IDB6_CCAN
        VCU_BrakeFirstSts: ComSignalType=BOOLEAN, ComBitSize=1, ComBitPosition=104, ComSystemTemplateSystemSignalRef=VCU_BrakeFirstSts
        VCU_DeliveryModeSts_IDB6_CCAN: ComSignalType=BOOLEAN, ComBitSize=1, ComBitPosition=105, ComSystemTemplateSystemSignalRef=VCU_DeliveryModeSts_IDB6_CCAN
      VCU_0xB7_C_CANFD (ComIPdu):
        ComIPduSignalProcessing = IMMEDIATE
        ComIPduType = NORMAL
        ComIPduDirection = SEND
        ComIPduCallout = ComCallOut_VCU_0xB7_C_CANFD
        ComIPduGroupRef = ComIPduGroup_Tx
        ComPduIdRef = PduCollection/VCU_0xB7_C_CANFD_Com2PduR
        ComIPduSignalRef = VCU_CRC_B7
        ComIPduSignalRef = VCU_KeepWorkModeFlag
        ComIPduSignalRef = VCU_MAI_Active
        ComIPduSignalRef = VCU_MAI_Available
        ComIPduSignalRef = VCU_GetCrashStsReq
        ComIPduSignalRef = VCU_ADASPosTorqueCap_VD
        ComIPduSignalRef = VCU_ADASPosTorqueCap
        ComIPduSignalRef = VCU_RollingCounter_B7
        ComIPduSignalRef = VCU_Vehicle_Warning_IDB7_CCAN
        ComIPduSignalRef = VCU_VehicleSts_IDB7_CCAN
        ComIPduSignalRef = VCU_PowerReduceReq
        ComIPduSignalRef = VCU_ParkingReqToEPB_VD
        ComIPduSignalRef = VCU_ParkingReqToEPB
        ComIPduSignalRef = VCU_ACCAvailable
        ComIPduSignalRef = VCU_ACCActiveSts
        ComIPduSignalRef = VCU_Active_APS
        ComIPduSignalRef = VCU_Available_APS
        ComIPduSignalRef = VCU_ESCActive
        ComIPduSignalRef = VCU_ESCTorqReqAvailability_Rear
        ComIPduSignalRef = VCU_AutoHold_ibit
        ComIPduSignalRef = VCU_VehicleSpeedVD
        ComIPduSignalRef = VCU_CCSStatus
        ComIPduSignalRef = VCU_AutoDriveRequest
        ComIPduSignalRef = VCU_CCSAllow
        ComIPduSignalRef = VCU_VlcHoldSts
        ComIPduSignalRef = VCU_HoldReqSts
        ComIPduSignalRef = VCU_HoldReqStsValid
        ComIPduSignalRef = VCU_DriverAssistProhibitSts_IDB7_CCAN
        ComIPduSignalRef = VCU_SpeedLimitedSts
        ComIPduSignalRef = VCU_SpeedLimitedValue
        ComIPduSignalRef = VCU_TheoAccePedalPercent
        ComIPduSignalRef = VCU_RecuBrakeTorqueCap
        ComIPduSignalRef = VCU_RecuBrakeTorqueAct
        ComIPduSignalRef = VCU_TheoAccePedalValid
        ComIPduSignalRef = VCU_HydraTorqTgt
        ComIPduSignalRef = VCU_RecuBrakeTorqueActDrag
        ComIPduSignalRef = VCU_ESCTorqReqAvailability_Frnt
        ComIPduSignalRef = VCU_RecuBrakeTorqueCap_Q
        ComIPduSignalRef = VCU_RecuBrakeTorqueAct_Q
        ComIPduSignalRef = VCU_HydraTorqTgt_Q
        ComIPduSignalRef = VCU_RecuBrakeTorqueActDrag_Q
        ComIPduSignalRef = VCU_RecuBrakeTorqueTarget_Drag
        ComIPduSignalRef = VCU_PreventVehSlipSts
        ComIPduSignalRef = VCU_RecuBrakeTorqueTarget_Drag_Q
        ComIPduSignalRef = VCU_AllMotWhlTrqFB
        ComIPduSignalRef = VCU_AllMotWhlTrqFB_VD
        ComIPduSignalRef = VCU_LSFC_Allow
        ComIPduSignalRef = VCU_LSFC_Active
        ComIPduSignalRef = VCU_MGCUWorkMode_C
        ComIPduSignalRef = VCU_AllRoadSts
        ComIPduSignalRef = VCU_CmpUTurnAllow
        ComIPduSignalRef = VCU_CmpUTurnSts
        ComIPduSignalRef = VCU_AllowCmpUTurnStartFlag
        ComIPduSignalRef = VCU_CmpUTurnLockWhl
        ComIPduSignalRef = VCU_CmpUTurnActAngle
        ComIPduSignalRef = VCU_CmpUTurnActSpinSpd
        ComIPduSignalRef = VCU_CmpUTurnFltHMI
        ComIPduSignalRef = VCU_EscapeModeSts
        ComIPduSignalRef = VCU_MCUSWorkFailMsg
        ComIPduSignalRef = VCU_EscapeWorkFailMsg
        ComIPduSignalRef = VCU_REClutchFltMsg
        ComIPduSignalRef = VCU_BoostMode_Fail_C
        ComIPduSignalRef = VCU_BoostModeSts_C
        ComTxIPdu: ComMinimumDelayTime=0.0, ComTxIPduUnusedAreasDefault=0
          ComTxModeTrue
            ComTxMode: ComTxModeTimePeriod=0.02, ComTxModeMode=PERIODIC, ComTxModeNumberOfRepetitions=0, ComTxModeRepetitionPeriod=0, ComTxModeTimeOffset=0.0
          ComTxModeFalse
            ComTxMode: ComTxModeTimePeriod=0.02, ComTxModeMode=PERIODIC, ComTxModeNumberOfRepetitions=0, ComTxModeRepetitionPeriod=0, ComTxModeTimeOffset=0.0
      63 x ComSignal, all with ComSignalInitValue=0, ComSignalEndianness=LITTLE_ENDIAN, ComUpdateBitPosition=-1, ComTransferProperty=PENDING:
        VCU_CRC_B7: ComSignalType=UINT8, ComBitSize=8, ComBitPosition=0, ComSystemTemplateSystemSignalRef=VCU_CRC_B7
        VCU_KeepWorkModeFlag: ComSignalType=BOOLEAN, ComBitSize=1, ComBitPosition=21, ComSystemTemplateSystemSignalRef=VCU_KeepWorkModeFlag
        VCU_MAI_Active: ComSignalType=BOOLEAN, ComBitSize=1, ComBitPosition=191, ComSystemTemplateSystemSignalRef=VCU_MAI_Active
        VCU_MAI_Available: ComSignalType=BOOLEAN, ComBitSize=1, ComBitPosition=190, ComSystemTemplateSystemSignalRef=VCU_MAI_Available
        VCU_GetCrashStsReq: ComSignalType=BOOLEAN, ComBitSize=1, ComBitPosition=184, ComSystemTemplateSystemSignalRef=VCU_GetCrashStsReq
        VCU_ADASPosTorqueCap_VD: ComSignalType=BOOLEAN, ComBitSize=1, ComBitPosition=183, ComSystemTemplateSystemSignalRef=VCU_ADASPosTorqueCap_VD
        VCU_ADASPosTorqueCap: ComSignalType=UINT16, ComBitSize=14, ComBitPosition=169, ComSystemTemplateSystemSignalRef=VCU_ADASPosTorqueCap
        VCU_RollingCounter_B7: ComSignalType=UINT8, ComBitSize=4, ComBitPosition=8, ComSystemTemplateSystemSignalRef=VCU_RollingCounter_B7
        VCU_Vehicle_Warning_IDB7_CCAN: ComSignalType=UINT8, ComBitSize=2, ComBitPosition=16, ComSystemTemplateSystemSignalRef=VCU_Vehicle_Warning_IDB7_CCAN
        VCU_VehicleSts_IDB7_CCAN: ComSignalType=BOOLEAN, ComBitSize=1, ComBitPosition=18, ComSystemTemplateSystemSignalRef=VCU_VehicleSts_IDB7_CCAN
        VCU_PowerReduceReq: ComSignalType=UINT8, ComBitSize=2, ComBitPosition=19, ComSystemTemplateSystemSignalRef=VCU_PowerReduceReq
        VCU_ParkingReqToEPB_VD: ComSignalType=UINT8, ComBitSize=2, ComBitPosition=24, ComSystemTemplateSystemSignalRef=VCU_ParkingReqToEPB_VD
        VCU_ParkingReqToEPB: ComSignalType=UINT8, ComBitSize=2, ComBitPosition=26, ComSystemTemplateSystemSignalRef=VCU_ParkingReqToEPB
        VCU_ACCAvailable: ComSignalType=UINT8, ComBitSize=2, ComBitPosition=28, ComSystemTemplateSystemSignalRef=VCU_ACCAvailable
        VCU_ACCActiveSts: ComSignalType=BOOLEAN, ComBitSize=1, ComBitPosition=30, ComSystemTemplateSystemSignalRef=VCU_ACCActiveSts
        VCU_Active_APS: ComSignalType=BOOLEAN, ComBitSize=1, ComBitPosition=31, ComSystemTemplateSystemSignalRef=VCU_Active_APS
        VCU_Available_APS: ComSignalType=BOOLEAN, ComBitSize=1, ComBitPosition=32, ComSystemTemplateSystemSignalRef=VCU_Available_APS
        VCU_ESCActive: ComSignalType=BOOLEAN, ComBitSize=1, ComBitPosition=33, ComSystemTemplateSystemSignalRef=VCU_ESCActive
        VCU_ESCTorqReqAvailability_Rear: ComSignalType=BOOLEAN, ComBitSize=1, ComBitPosition=34, ComSystemTemplateSystemSignalRef=VCU_ESCTorqReqAvailability_Rear
        VCU_AutoHold_ibit: ComSignalType=BOOLEAN, ComBitSize=1, ComBitPosition=35, ComSystemTemplateSystemSignalRef=VCU_AutoHold_ibit
        VCU_VehicleSpeedVD: ComSignalType=UINT8, ComBitSize=2, ComBitPosition=36, ComSystemTemplateSystemSignalRef=VCU_VehicleSpeedVD
        VCU_CCSStatus: ComSignalType=UINT8, ComBitSize=2, ComBitPosition=38, ComSystemTemplateSystemSignalRef=VCU_CCSStatus
        VCU_AutoDriveRequest: ComSignalType=UINT8, ComBitSize=2, ComBitPosition=40, ComSystemTemplateSystemSignalRef=VCU_AutoDriveRequest
        VCU_CCSAllow: ComSignalType=BOOLEAN, ComBitSize=1, ComBitPosition=42, ComSystemTemplateSystemSignalRef=VCU_CCSAllow
        VCU_VlcHoldSts: ComSignalType=BOOLEAN, ComBitSize=1, ComBitPosition=43, ComSystemTemplateSystemSignalRef=VCU_VlcHoldSts
        VCU_HoldReqSts: ComSignalType=UINT8, ComBitSize=2, ComBitPosition=44, ComSystemTemplateSystemSignalRef=VCU_HoldReqSts
        VCU_HoldReqStsValid: ComSignalType=BOOLEAN, ComBitSize=1, ComBitPosition=79, ComSystemTemplateSystemSignalRef=VCU_HoldReqStsValid
        VCU_DriverAssistProhibitSts_IDB7_CCAN: ComSignalType=BOOLEAN, ComBitSize=1, ComBitPosition=46, ComSystemTemplateSystemSignalRef=VCU_DriverAssistProhibitSts_IDB7_CCAN
        VCU_SpeedLimitedSts: ComSignalType=BOOLEAN, ComBitSize=1, ComBitPosition=47, ComSystemTemplateSystemSignalRef=VCU_SpeedLimitedSts
        VCU_SpeedLimitedValue: ComSignalType=UINT8, ComBitSize=8, ComBitPosition=48, ComSystemTemplateSystemSignalRef=VCU_SpeedLimitedValue
        VCU_TheoAccePedalPercent: ComSignalType=UINT8, ComBitSize=8, ComBitPosition=56, ComSystemTemplateSystemSignalRef=VCU_TheoAccePedalPercent
        VCU_RecuBrakeTorqueCap: ComSignalType=UINT16, ComBitSize=15, ComBitPosition=64, ComSystemTemplateSystemSignalRef=VCU_RecuBrakeTorqueCap
        VCU_RecuBrakeTorqueAct: ComSignalType=UINT16, ComBitSize=15, ComBitPosition=80, ComSystemTemplateSystemSignalRef=VCU_RecuBrakeTorqueAct
        VCU_TheoAccePedalValid: ComSignalType=BOOLEAN, ComBitSize=1, ComBitPosition=96, ComSystemTemplateSystemSignalRef=VCU_TheoAccePedalValid
        VCU_HydraTorqTgt: ComSignalType=UINT16, ComBitSize=15, ComBitPosition=97, ComSystemTemplateSystemSignalRef=VCU_HydraTorqTgt
        VCU_RecuBrakeTorqueActDrag: ComSignalType=UINT16, ComBitSize=15, ComBitPosition=112, ComSystemTemplateSystemSignalRef=VCU_RecuBrakeTorqueActDrag
        VCU_ESCTorqReqAvailability_Frnt: ComSignalType=BOOLEAN, ComBitSize=1, ComBitPosition=127, ComSystemTemplateSystemSignalRef=VCU_ESCTorqReqAvailability_Frnt
        VCU_RecuBrakeTorqueCap_Q: ComSignalType=UINT8, ComBitSize=2, ComBitPosition=128, ComSystemTemplateSystemSignalRef=VCU_RecuBrakeTorqueCap_Q
        VCU_RecuBrakeTorqueAct_Q: ComSignalType=UINT8, ComBitSize=2, ComBitPosition=130, ComSystemTemplateSystemSignalRef=VCU_RecuBrakeTorqueAct_Q
        VCU_HydraTorqTgt_Q: ComSignalType=UINT8, ComBitSize=2, ComBitPosition=132, ComSystemTemplateSystemSignalRef=VCU_HydraTorqTgt_Q
        VCU_RecuBrakeTorqueActDrag_Q: ComSignalType=UINT8, ComBitSize=2, ComBitPosition=134, ComSystemTemplateSystemSignalRef=VCU_RecuBrakeTorqueActDrag_Q
        VCU_RecuBrakeTorqueTarget_Drag: ComSignalType=UINT16, ComBitSize=15, ComBitPosition=136, ComSystemTemplateSystemSignalRef=VCU_RecuBrakeTorqueTarget_Drag
        VCU_PreventVehSlipSts: ComSignalType=BOOLEAN, ComBitSize=1, ComBitPosition=151, ComSystemTemplateSystemSignalRef=VCU_PreventVehSlipSts
        VCU_RecuBrakeTorqueTarget_Drag_Q: ComSignalType=UINT8, ComBitSize=2, ComBitPosition=152, ComSystemTemplateSystemSignalRef=VCU_RecuBrakeTorqueTarget_Drag_Q
        VCU_AllMotWhlTrqFB: ComSignalType=UINT16, ComBitSize=14, ComBitPosition=154, ComSystemTemplateSystemSignalRef=VCU_AllMotWhlTrqFB
        VCU_AllMotWhlTrqFB_VD: ComSignalType=BOOLEAN, ComBitSize=1, ComBitPosition=168, ComSystemTemplateSystemSignalRef=VCU_AllMotWhlTrqFB_VD
        VCU_LSFC_Allow: ComSignalType=BOOLEAN, ComBitSize=1, ComBitPosition=186, ComSystemTemplateSystemSignalRef=VCU_LSFC_Allow
        VCU_LSFC_Active: ComSignalType=BOOLEAN, ComBitSize=1, ComBitPosition=187, ComSystemTemplateSystemSignalRef=VCU_LSFC_Active
        VCU_MGCUWorkMode_C: ComSignalType=UINT8, ComBitSize=2, ComBitPosition=188, ComSystemTemplateSystemSignalRef=VCU_MGCUWorkMode_C
        VCU_AllRoadSts: ComSignalType=UINT8, ComBitSize=3, ComBitPosition=221, ComSystemTemplateSystemSignalRef=VCU_AllRoadSts
        VCU_CmpUTurnAllow: ComSignalType=UINT8, ComBitSize=1, ComBitPosition=224, ComSystemTemplateSystemSignalRef=VCU_CmpUTurnAllow
        VCU_CmpUTurnSts: ComSignalType=UINT8, ComBitSize=2, ComBitPosition=225, ComSystemTemplateSystemSignalRef=VCU_CmpUTurnSts
        VCU_AllowCmpUTurnStartFlag: ComSignalType=UINT8, ComBitSize=1, ComBitPosition=227, ComSystemTemplateSystemSignalRef=VCU_AllowCmpUTurnStartFlag
        VCU_CmpUTurnLockWhl: ComSignalType=UINT8, ComBitSize=3, ComBitPosition=228, ComSystemTemplateSystemSignalRef=VCU_CmpUTurnLockWhl
        VCU_CmpUTurnActAngle: ComSignalType=UINT16, ComBitSize=9, ComBitPosition=231, ComSystemTemplateSystemSignalRef=VCU_CmpUTurnActAngle
        VCU_CmpUTurnActSpinSpd: ComSignalType=UINT8, ComBitSize=4, ComBitPosition=240, ComSystemTemplateSystemSignalRef=VCU_CmpUTurnActSpinSpd
        VCU_CmpUTurnFltHMI: ComSignalType=UINT8, ComBitSize=4, ComBitPosition=244, ComSystemTemplateSystemSignalRef=VCU_CmpUTurnFltHMI
        VCU_EscapeModeSts: ComSignalType=BOOLEAN, ComBitSize=1, ComBitPosition=207, ComSystemTemplateSystemSignalRef=VCU_EscapeModeSts
        VCU_MCUSWorkFailMsg: ComSignalType=UINT8, ComBitSize=3, ComBitPosition=208, ComSystemTemplateSystemSignalRef=VCU_MCUSWorkFailMsg
        VCU_EscapeWorkFailMsg: ComSignalType=UINT8, ComBitSize=3, ComBitPosition=211, ComSystemTemplateSystemSignalRef=VCU_EscapeWorkFailMsg
        VCU_REClutchFltMsg: ComSignalType=UINT8, ComBitSize=2, ComBitPosition=214, ComSystemTemplateSystemSignalRef=VCU_REClutchFltMsg
        VCU_BoostMode_Fail_C: ComSignalType=UINT8, ComBitSize=3, ComBitPosition=216, ComSystemTemplateSystemSignalRef=VCU_BoostMode_Fail_C
        VCU_BoostModeSts_C: ComSignalType=UINT8, ComBitSize=2, ComBitPosition=219, ComSystemTemplateSystemSignalRef=VCU_BoostModeSts_C
      VCU_0xE6_C_CANFD (ComIPdu):
        ComIPduSignalProcessing = IMMEDIATE
        ComIPduType = NORMAL
        ComIPduDirection = SEND
        ComIPduCallout = ComCallOut_VCU_0xE6_C_CANFD
        ComIPduGroupRef = ComIPduGroup_Tx
        ComPduIdRef = PduCollection/VCU_0xE6_C_CANFD_Com2PduR
        ComIPduSignalRef = DbgSignal{1..12}_FA
        ComIPduSignalRef = DbgSignal{1..12}_RA
        ComTxIPdu: ComMinimumDelayTime=0.0, ComTxIPduUnusedAreasDefault=0
          ComTxModeTrue
            ComTxMode: ComTxModeTimePeriod=0.01, ComTxModeMode=DIRECT, ComTxModeNumberOfRepetitions=0, ComTxModeRepetitionPeriod=0, ComTxModeTimeOffset=0.0
          ComTxModeFalse
            ComTxMode: ComTxModeTimePeriod=0.01, ComTxModeMode=DIRECT, ComTxModeNumberOfRepetitions=0, ComTxModeRepetitionPeriod=0, ComTxModeTimeOffset=0.0
      24 x ComSignal, all with ComSignalType=UINT16, ComSignalEndianness=LITTLE_ENDIAN, ComBitSize=16, ComUpdateBitPosition=-1, ComTransferProperty=PENDING:
        DbgSignal1_FA: ComSignalInitValue=0, ComBitPosition=0, ComSystemTemplateSystemSignalRef=DbgSignal1_FA
        DbgSignal2_FA: ComSignalInitValue=0, ComBitPosition=16, ComSystemTemplateSystemSignalRef=DbgSignal2_FA
        DbgSignal3_FA: ComSignalInitValue=3, ComBitPosition=32, ComSystemTemplateSystemSignalRef=DbgSignal3_FA
        DbgSignal4_FA: ComSignalInitValue=0, ComBitPosition=48, ComSystemTemplateSystemSignalRef=DbgSignal4_FA
        DbgSignal5_FA: ComSignalInitValue=0, ComBitPosition=64, ComSystemTemplateSystemSignalRef=DbgSignal5_FA
        DbgSignal6_FA: ComSignalInitValue=0, ComBitPosition=80, ComSystemTemplateSystemSignalRef=DbgSignal6_FA
        DbgSignal7_FA: ComSignalInitValue=0, ComBitPosition=96, ComSystemTemplateSystemSignalRef=DbgSignal7_FA
        DbgSignal8_FA: ComSignalInitValue=0, ComBitPosition=112, ComSystemTemplateSystemSignalRef=DbgSignal8_FA
        DbgSignal9_FA: ComSignalInitValue=0, ComBitPosition=128, ComSystemTemplateSystemSignalRef=DbgSignal9_FA
        DbgSignal10_FA: ComSignalInitValue=0, ComBitPosition=144, ComSystemTemplateSystemSignalRef=DbgSignal10_FA
        DbgSignal11_FA: ComSignalInitValue=0, ComBitPosition=160, ComSystemTemplateSystemSignalRef=DbgSignal11_FA
        DbgSignal12_FA: ComSignalInitValue=0, ComBitPosition=176, ComSystemTemplateSystemSignalRef=DbgSignal12_FA
        DbgSignal1_RA: ComSignalInitValue=0, ComBitPosition=192, ComSystemTemplateSystemSignalRef=DbgSignal1_RA
        DbgSignal2_RA: ComSignalInitValue=0, ComBitPosition=208, ComSystemTemplateSystemSignalRef=DbgSignal2_RA
        DbgSignal3_RA: ComSignalInitValue=0, ComBitPosition=224, ComSystemTemplateSystemSignalRef=DbgSignal3_RA
        DbgSignal4_RA: ComSignalInitValue=0, ComBitPosition=240, ComSystemTemplateSystemSignalRef=DbgSignal4_RA
        DbgSignal5_RA: ComSignalInitValue=0, ComBitPosition=256, ComSystemTemplateSystemSignalRef=DbgSignal5_RA
        DbgSignal6_RA: ComSignalInitValue=0, ComBitPosition=272, ComSystemTemplateSystemSignalRef=DbgSignal6_RA
        DbgSignal7_RA: ComSignalInitValue=0, ComBitPosition=288, ComSystemTemplateSystemSignalRef=DbgSignal7_RA
        DbgSignal8_RA: ComSignalInitValue=0, ComBitPosition=304, ComSystemTemplateSystemSignalRef=DbgSignal8_RA
        DbgSignal9_RA: ComSignalInitValue=0, ComBitPosition=320, ComSystemTemplateSystemSignalRef=DbgSignal9_RA
        DbgSignal10_RA: ComSignalInitValue=0, ComBitPosition=336, ComSystemTemplateSystemSignalRef=DbgSignal10_RA
        DbgSignal11_RA: ComSignalInitValue=0, ComBitPosition=352, ComSystemTemplateSystemSignalRef=DbgSignal11_RA
        DbgSignal12_RA: ComSignalInitValue=0, ComBitPosition=368, ComSystemTemplateSystemSignalRef=DbgSignal12_RA
      MCUM_0x135_C_CANFD (ComIPdu):
        ComIPduSignalProcessing = IMMEDIATE
        ComIPduType = NORMAL
        ComIPduDirection = SEND
        ComFirstTimeout = 0.01
        ComTimeout = 0.01
        ComIPduCallout = ComCallOut_MCUM_0x135_C_CANFD
        ComIPduGroupRef = ComIPduGroup_Tx
        ComPduIdRef = PduCollection/MCUM_0x135_C_CANFD_Com2PduR
        ComIPduSignalRef = MCUM_CRC_135
        ComIPduSignalRef = MCUM_RollingCounter_135
        ComIPduSignalRef = MCUM_LDC_SWInfo
        ComIPduSignalRef = MCUM_LDC_MTarOut_FA
        ComIPduSignalRef = MCUM_LDC_MTarOut_RA
        ComIPduSignalRef = MCUM_LDC_Available_FA
        ComIPduSignalRef = MCUM_LDC_OperationMode_FA
        ComIPduSignalRef = MCUM_LDC_Available_RA
        ComIPduSignalRef = MCUM_LDC_OperationMode_RA
        ComIPduSignalRef = MCUM_RTE_Exchange_Signal_Status
        ComIPduSignalRef = MCUM_MTarIn_FA
        ComIPduSignalRef = MCUM_MTarIn_RA
        ComIPduSignalRef = MCUM_InputQF_FA
        ComIPduSignalRef = MCUM_InputQF_RA
        ComTxIPdu: ComMinimumDelayTime=0.0, ComTxIPduUnusedAreasDefault=0
          ComTxModeTrue
            ComTxMode: ComTxModeTimePeriod=0.01, ComTxModeMode=PERIODIC, ComTxModeNumberOfRepetitions=0, ComTxModeRepetitionPeriod=0, ComTxModeTimeOffset=0.0
          ComTxModeFalse
            ComTxMode: ComTxModeTimePeriod=0.01, ComTxModeMode=PERIODIC, ComTxModeNumberOfRepetitions=0, ComTxModeRepetitionPeriod=0, ComTxModeTimeOffset=0.0
      14 x ComSignal, all with ComSignalInitValue=0, ComSignalEndianness=LITTLE_ENDIAN, ComUpdateBitPosition=-1, ComTransferProperty=PENDING:
        MCUM_CRC_135: ComSignalType=UINT8, ComBitSize=8, ComBitPosition=0, ComSystemTemplateSystemSignalRef=MCUM_CRC_135
        MCUM_RollingCounter_135: ComSignalType=UINT8, ComBitSize=4, ComBitPosition=8, ComSystemTemplateSystemSignalRef=MCUM_RollingCounter_135
        MCUM_LDC_SWInfo: ComSignalType=UINT16, ComBitSize=16, ComBitPosition=16, ComSystemTemplateSystemSignalRef=MCUM_LDC_SWInfo
        MCUM_LDC_MTarOut_FA: ComSignalType=UINT16, ComBitSize=16, ComBitPosition=32, ComSystemTemplateSystemSignalRef=MCUM_LDC_MTarOut_FA
        MCUM_LDC_MTarOut_RA: ComSignalType=UINT16, ComBitSize=16, ComBitPosition=48, ComSystemTemplateSystemSignalRef=MCUM_LDC_MTarOut_RA
        MCUM_LDC_Available_FA: ComSignalType=BOOLEAN, ComBitSize=1, ComBitPosition=64, ComSystemTemplateSystemSignalRef=MCUM_LDC_Available_FA
        MCUM_LDC_OperationMode_FA: ComSignalType=UINT8, ComBitSize=3, ComBitPosition=66, ComSystemTemplateSystemSignalRef=MCUM_LDC_OperationMode_FA
        MCUM_LDC_Available_RA: ComSignalType=BOOLEAN, ComBitSize=1, ComBitPosition=65, ComSystemTemplateSystemSignalRef=MCUM_LDC_Available_RA
        MCUM_LDC_OperationMode_RA: ComSignalType=UINT8, ComBitSize=3, ComBitPosition=69, ComSystemTemplateSystemSignalRef=MCUM_LDC_OperationMode_RA
        MCUM_MTarIn_FA: ComSignalType=UINT16, ComBitSize=16, ComBitPosition=80, ComSystemTemplateSystemSignalRef=MCUM_MTarIn_FA
        MCUM_MTarIn_RA: ComSignalType=UINT16, ComBitSize=16, ComBitPosition=96, ComSystemTemplateSystemSignalRef=MCUM_MTarIn_RA
        MCUM_InputQF_FA: ComSignalType=BOOLEAN, ComBitSize=1, ComBitPosition=112, ComSystemTemplateSystemSignalRef=MCUM_InputQF_FA
        MCUM_InputQF_RA: ComSignalType=BOOLEAN, ComBitSize=1, ComBitPosition=113, ComSystemTemplateSystemSignalRef=MCUM_InputQF_RA
        MCUM_RTE_Exchange_Signal_Status: ComSignalType=UINT8, ComBitSize=8, ComBitPosition=72, ComSystemTemplateSystemSignalRef=MCUM_RTE_Exchange_Signal_Status
      MCUS_0x14_VCU_CAN (ComIPdu):
        ComIPduSignalProcessing = IMMEDIATE
        ComIPduType = NORMAL
        ComIPduDirection = RECEIVE
        ComIPduCallout = ComCallOut_MCUS_0x14_VCU_CAN
        ComFirstTimeout = 2.1
        ComTimeout = 0.1
        ComIPduErrorNotification = ComCbk_RxTimeOut_MCUS_0x14_VCU_CAN
        ComIPduGroupRef = ComIPduGroup_Rx
        ComPduIdRef = PduCollection/MCUS_0x14_VCU_CAN_PduR2Com
        ComIPduSignalRef = MCUS_CRC_14
        ComIPduSignalRef = MCUS_RollingCounter_14
        ComIPduSignalRef = MCUS_DrvMotorRPM_prvt
        ComIPduSignalRef = MCUS_ActualTorqueFB_prvt
        ComIPduSignalRef = MCUS_DrvMotorRPMVD_prvt
        ComIPduSignalRef = MCUS_ActualTorqueFBVD_prvt
      6 x ComSignal, all with ComSignalInitValue=0, ComSignalEndianness=LITTLE_ENDIAN, ComUpdateBitPosition=-1, ComTransferProperty=TRIGGERED:
        MCUS_CRC_14: ComSignalType=UINT8, ComBitSize=8, ComBitPosition=0, ComNotification=Rte_COMCbk_MCUS_CRC_14, ComSystemTemplateSystemSignalRef=MCUS_CRC_14
        MCUS_RollingCounter_14: ComSignalType=UINT8, ComBitSize=4, ComBitPosition=8, ComNotification=Rte_COMCbk_MCUS_RollingCounter_14, ComSystemTemplateSystemSignalRef=MCUS_RollingCounter_14
        MCUS_DrvMotorRPM_prvt: ComSignalType=UINT16, ComBitSize=16, ComBitPosition=16, ComNotification=Rte_COMCbk_MCUS_DrvMotorRPM_prvt, ComSystemTemplateSystemSignalRef=MCUS_DrvMotorRPM_prvt
        MCUS_ActualTorqueFB_prvt: ComSignalType=UINT16, ComBitSize=16, ComBitPosition=32, ComNotification=Rte_COMCbk_MCUS_ActualTorqueFB_prvt, ComSystemTemplateSystemSignalRef=MCUS_ActualTorqueFB_prvt
        MCUS_DrvMotorRPMVD_prvt: ComSignalType=BOOLEAN, ComBitSize=1, ComBitPosition=48, ComNotification=Rte_COMCbk_MCUS_DrvMotorRPMVD_prvt, ComSystemTemplateSystemSignalRef=MCUS_DrvMotorRPMVD_prvt
        MCUS_ActualTorqueFBVD_prvt: ComSignalType=BOOLEAN, ComBitSize=1, ComBitPosition=49, ComNotification=Rte_COMCbk_MCUS_ActualTorqueFBVD_prvt, ComSystemTemplateSystemSignalRef=MCUS_ActualTorqueFBVD_prvt
      VCU_0x13_VCU_CAN (ComIPdu):
        ComIPduSignalProcessing = IMMEDIATE
        ComIPduType = NORMAL
        ComIPduDirection = SEND
        ComIPduCallout = ComCallOut_VCU_0x13_VCU_CAN
        ComIPduGroupRef = ComIPduGroup_Tx
        ComPduIdRef = PduCollection/VCU_0x13_VCU_CAN_Com2PduR
        ComIPduSignalRef = VCU_CRC_13
        ComIPduSignalRef = VCU_RollingCounter_13
        ComIPduSignalRef = VCU_SDrvRequestTorque_prvt
        ComIPduSignalRef = VCU_SDrvRequestTorqueVD_prvt
        ComIPduSignalRef = VCU_MCUSDampgLmtFactor_prvt
        ComIPduSignalRef = VCU_VehicleDirectS_prvt
        ComIPduSignalRef = VCU_VehicleDirectS_VD_prvt
        ComIPduSignalRef = VCU_MCUSMaxPosDampgTrq_prvt
        ComIPduSignalRef = VCU_MCUSMaxNegDampgTrq_prvt
        ComTxIPdu: ComMinimumDelayTime=0.0, ComTxIPduUnusedAreasDefault=0
          ComTxModeTrue
            ComTxMode: ComTxModeTimePeriod=0.002, ComTxModeMode=DIRECT, ComTxModeNumberOfRepetitions=0, ComTxModeRepetitionPeriod=0, ComTxModeTimeOffset=0.0
          ComTxModeFalse
            ComTxMode: ComTxModeTimePeriod=0.002, ComTxModeMode=PERIODIC, ComTxModeNumberOfRepetitions=0, ComTxModeRepetitionPeriod=0, ComTxModeTimeOffset=0.0
      9 x ComSignal, all with ComSignalInitValue=0, ComSignalEndianness=LITTLE_ENDIAN, ComUpdateBitPosition=-1, ComTransferProperty=PENDING:
        VCU_CRC_13: ComSignalType=UINT8, ComBitSize=8, ComBitPosition=0, ComSystemTemplateSystemSignalRef=VCU_CRC_13
        VCU_RollingCounter_13: ComSignalType=UINT8, ComBitSize=4, ComBitPosition=8, ComSystemTemplateSystemSignalRef=VCU_RollingCounter_13
        VCU_SDrvRequestTorque_prvt: ComSignalType=UINT16, ComBitSize=16, ComBitPosition=16, ComSystemTemplateSystemSignalRef=VCU_SDrvRequestTorque_prvt
        VCU_SDrvRequestTorqueVD_prvt: ComSignalType=BOOLEAN, ComBitSize=1, ComBitPosition=32, ComSystemTemplateSystemSignalRef=VCU_SDrvRequestTorqueVD_prvt
        VCU_MCUSDampgLmtFactor_prvt: ComSignalType=UINT8, ComBitSize=7, ComBitPosition=33, ComSystemTemplateSystemSignalRef=VCU_MCUSDampgLmtFactor_prvt
        VCU_VehicleDirectS_prvt: ComSignalType=BOOLEAN, ComBitSize=1, ComBitPosition=40, ComSystemTemplateSystemSignalRef=VCU_VehicleDirectS_prvt
        VCU_VehicleDirectS_VD_prvt: ComSignalType=BOOLEAN, ComBitSize=1, ComBitPosition=41, ComSystemTemplateSystemSignalRef=VCU_VehicleDirectS_VD_prvt
        VCU_MCUSMaxPosDampgTrq_prvt: ComSignalType=UINT8, ComBitSize=6, ComBitPosition=42, ComSystemTemplateSystemSignalRef=VCU_MCUSMaxPosDampgTrq_prvt
        VCU_MCUSMaxNegDampgTrq_prvt: ComSignalType=UINT8, ComBitSize=6, ComBitPosition=48, ComSystemTemplateSystemSignalRef=VCU_MCUSMaxNegDampgTrq_prvt
      ComIPduGroup_DevMCU (ComIPduGroup)
      3 x ComIPdu, all with ComIPduSignalProcessing=IMMEDIATE, ComIPduType=NORMAL:
        MCUM_0x42C_P_CANFD: ComIPduDirection=SEND, ComPduIdRef=PduCollection/MCUM_0x42C_P_CANFD_Com2PduR, ComIPduSignalRef=MCUM_NMControlRMR_Sts_P, ComIPduSignalRef=MCUM_WakeUpReason_P
          ComTxIPdu: ComTxIPduUnusedAreasDefault=0
            ComTxModeTrue
              ComTxMode: ComTxModeMode=DIRECT
        MCUM_0x42C_C_CANFD: ComIPduDirection=SEND, ComPduIdRef=PduCollection/MCUM_0x42C_C_CANFD_Com2PduR, ComIPduSignalRef=NM_PNC_DATA_T0, ComIPduSignalRef=MCUM_NMControlRMR_Sts, ComIPduSignalRef=MCUM_WakeUpReason
          ComTxIPdu: ComMinimumDelayTime=0.0, ComTxIPduUnusedAreasDefault=0
            ComTxModeTrue
              ComTxMode: ComTxModeMode=DIRECT
        HPCBCM_0x401_P_CANFD: ComIPduDirection=RECEIVE, ComFirstTimeout=1.5, ComTimeout=0.5, ComPduIdRef=PduCollection/HPCBCM_0x401_P_CANFD_PduR2Com, ComIPduGroupRef=ComIPduGroup_Rx, ComIPduSignalRef=NM_PNC_DATA_R0
      68 x ComSignal, all with ComUpdateBitPosition=-1:
        MCUM_NMControlRMR_Sts: ComSignalInitValue=0, ComSignalType=BOOLEAN, ComSignalEndianness=LITTLE_ENDIAN, ComBitSize=1, ComBitPosition=40, ComTransferProperty=PENDING, ComSystemTemplateSystemSignalRef=MCUM_NMControlRMR_Sts
        MCUM_WakeUpReason: ComSignalInitValue=0, ComSignalType=UINT8, ComSignalEndianness=LITTLE_ENDIAN, ComBitSize=7, ComBitPosition=41, ComTransferProperty=PENDING, ComSystemTemplateSystemSignalRef=MCUM_WakeUpReason
        NM_PNC_DATA_T0: ComSignalInitValue=0, ComSignalType=UINT8_N, ComSignalEndianness=opaque, ComBitSize=1, ComBitPosition=0, ComTransferProperty=PENDING, ComSignalLength=4
        NM_PNC_DATA_R0: ComSignalType=UINT8_N, ComSignalEndianness=opaque, ComBitSize=1, ComBitPosition=0, ComTransferProperty=PENDING, ComSignalLength=6
        MCUM_NMControlRMR_Sts_P: ComSignalInitValue=0, ComSignalType=BOOLEAN, ComSignalEndianness=LITTLE_ENDIAN, ComBitSize=1, ComBitPosition=40, ComTransferProperty=PENDING, ComSystemTemplateSystemSignalRef=MCUM_NMControlRMR_Sts_P
        MCUM_WakeUpReason_P: ComSignalInitValue=0, ComSignalType=UINT8, ComSignalEndianness=LITTLE_ENDIAN, ComBitSize=7, ComBitPosition=41, ComTransferProperty=PENDING, ComSystemTemplateSystemSignalRef=MCUM_WakeUpReason_P
        ECM_ClearingSparkcarbonedRequest: ComSignalInitValue=0, ComSignalType=UINT8, ComSignalEndianness=LITTLE_ENDIAN, ComBitSize=2, ComBitPosition=203, ComTransferProperty=TRIGGERED, ComNotification=Rte_COMCbk_ECM_ClearingSparkcarbonedRequest, ComSystemTemplateSystemSignalRef=ECM_ClearingSparkcarbonedRequest
        VCU_BrkPedOpen: ComSignalInitValue=0, ComSignalType=BOOLEAN, ComSignalEndianness=LITTLE_ENDIAN, ComBitSize=1, ComBitPosition=0, ComTransferProperty=PENDING, ComSystemTemplateSystemSignalRef=VCU_BrkPedOpen
        VCU_BrkPedClose: ComSignalInitValue=0, ComSignalType=BOOLEAN, ComSignalEndianness=LITTLE_ENDIAN, ComBitSize=1, ComBitPosition=1, ComTransferProperty=PENDING, ComSystemTemplateSystemSignalRef=VCU_BrkPedClose
        VCU_ColumnShiftP: ComSignalInitValue=0, ComSignalType=BOOLEAN, ComSignalEndianness=LITTLE_ENDIAN, ComBitSize=1, ComBitPosition=2, ComTransferProperty=PENDING, ComSystemTemplateSystemSignalRef=VCU_ColumnShiftP
        VCU_VehiCrashSts: ComSignalInitValue=0, ComSignalType=BOOLEAN, ComSignalEndianness=LITTLE_ENDIAN, ComBitSize=1, ComBitPosition=3, ComTransferProperty=PENDING, ComSystemTemplateSystemSignalRef=VCU_VehiCrashSts
        VCU_SleepSatisfiedSts: ComSignalInitValue=0, ComSignalType=BOOLEAN, ComSignalEndianness=LITTLE_ENDIAN, ComBitSize=1, ComBitPosition=4, ComTransferProperty=PENDING, ComSystemTemplateSystemSignalRef=VCU_SleepSatisfiedSts
        VCU_VehiHvCmd: ComSignalInitValue=0, ComSignalType=BOOLEAN, ComSignalEndianness=LITTLE_ENDIAN, ComBitSize=1, ComBitPosition=5, ComTransferProperty=PENDING, ComSystemTemplateSystemSignalRef=VCU_VehiHvCmd
        VCU_GearQuitAps: ComSignalInitValue=0, ComSignalType=BOOLEAN, ComSignalEndianness=LITTLE_ENDIAN, ComBitSize=1, ComBitPosition=6, ComTransferProperty=PENDING, ComSystemTemplateSystemSignalRef=VCU_GearQuitAps
        VCU_REOverChgPwrFlag: ComSignalInitValue=0, ComSignalType=BOOLEAN, ComSignalEndianness=LITTLE_ENDIAN, ComBitSize=1, ComBitPosition=7, ComTransferProperty=PENDING, ComSystemTemplateSystemSignalRef=VCU_REOverChgPwrFlag
        VCU_VehiAccnFilt: ComSignalInitValue=0, ComSignalType=UINT8, ComSignalEndianness=LITTLE_ENDIAN, ComBitSize=8, ComBitPosition=8, ComTransferProperty=PENDING, ComSystemTemplateSystemSignalRef=VCU_VehiAccnFilt
        VCU_HvOffSts: ComSignalInitValue=0, ComSignalType=UINT8, ComSignalEndianness=LITTLE_ENDIAN, ComBitSize=4, ComBitPosition=16, ComTransferProperty=PENDING, ComSystemTemplateSystemSignalRef=VCU_HvOffSts
        VCU_ElecPwrBalanceReq: ComSignalInitValue=0, ComSignalType=BOOLEAN, ComSignalEndianness=LITTLE_ENDIAN, ComBitSize=1, ComBitPosition=20, ComTransferProperty=PENDING, ComSystemTemplateSystemSignalRef=VCU_ElecPwrBalanceReq
        VCU_CDU_RecvTr: ComSignalInitValue=0, ComSignalType=BOOLEAN, ComSignalEndianness=LITTLE_ENDIAN, ComBitSize=1, ComBitPosition=21, ComTransferProperty=PENDING, ComSystemTemplateSystemSignalRef=VCU_CDU_RecvTr
        VCU_BMS_RecvTr: ComSignalInitValue=0, ComSignalType=BOOLEAN, ComSignalEndianness=LITTLE_ENDIAN, ComBitSize=1, ComBitPosition=22, ComTransferProperty=PENDING, ComSystemTemplateSystemSignalRef=VCU_BMS_RecvTr
        VCU_IVI_RecvTr: ComSignalInitValue=0, ComSignalType=BOOLEAN, ComSignalEndianness=LITTLE_ENDIAN, ComBitSize=1, ComBitPosition=23, ComTransferProperty=PENDING, ComSystemTemplateSystemSignalRef=VCU_IVI_RecvTr
        VCU_WheelMaxDrvTrq: ComSignalInitValue=0, ComSignalType=UINT16, ComSignalEndianness=LITTLE_ENDIAN, ComBitSize=10, ComBitPosition=24, ComTransferProperty=PENDING, ComSystemTemplateSystemSignalRef=VCU_WheelMaxDrvTrq
        VCU_WheelMaxRecTrq: ComSignalInitValue=0, ComSignalType=UINT16, ComSignalEndianness=LITTLE_ENDIAN, ComBitSize=10, ComBitPosition=34, ComTransferProperty=PENDING, ComSystemTemplateSystemSignalRef=VCU_WheelMaxRecTrq
        VCU_GCU_RecvTr: ComSignalInitValue=0, ComSignalType=BOOLEAN, ComSignalEndianness=LITTLE_ENDIAN, ComBitSize=1, ComBitPosition=44, ComTransferProperty=PENDING, ComSystemTemplateSystemSignalRef=VCU_GCU_RecvTr
        VCU_TCM_RecvTr: ComSignalInitValue=0, ComSignalType=BOOLEAN, ComSignalEndianness=LITTLE_ENDIAN, ComBitSize=1, ComBitPosition=45, ComTransferProperty=PENDING, ComSystemTemplateSystemSignalRef=VCU_TCM_RecvTr
        VCU_PTC_RecvTr: ComSignalInitValue=0, ComSignalType=BOOLEAN, ComSignalEndianness=LITTLE_ENDIAN, ComBitSize=1, ComBitPosition=46, ComTransferProperty=PENDING, ComSystemTemplateSystemSignalRef=VCU_PTC_RecvTr
        VCU_LossFctorFlgFL: ComSignalInitValue=0, ComSignalType=BOOLEAN, ComSignalEndianness=LITTLE_ENDIAN, ComBitSize=1, ComBitPosition=47, ComTransferProperty=PENDING, ComSystemTemplateSystemSignalRef=VCU_LossFctorFlgFL
        VCU_LowBattVolt: ComSignalInitValue=0, ComSignalType=UINT8, ComSignalEndianness=LITTLE_ENDIAN, ComBitSize=7, ComBitPosition=48, ComTransferProperty=PENDING, ComSystemTemplateSystemSignalRef=VCU_LowBattVolt
        VCU_HighPerforDisable: ComSignalInitValue=0, ComSignalType=BOOLEAN, ComSignalEndianness=LITTLE_ENDIAN, ComBitSize=1, ComBitPosition=55, ComTransferProperty=PENDING, ComSystemTemplateSystemSignalRef=VCU_HighPerforDisable
        VCU_AccPedHSigVolt: ComSignalInitValue=0, ComSignalType=UINT8, ComSignalEndianness=LITTLE_ENDIAN, ComBitSize=7, ComBitPosition=56, ComTransferProperty=PENDING, ComSystemTemplateSystemSignalRef=VCU_AccPedHSigVolt
        VCU_LossFctorFlgFR: ComSignalInitValue=0, ComSignalType=BOOLEAN, ComSignalEndianness=LITTLE_ENDIAN, ComBitSize=1, ComBitPosition=63, ComTransferProperty=PENDING, ComSystemTemplateSystemSignalRef=VCU_LossFctorFlgFR
        VCU_AccPedLSigVolt: ComSignalInitValue=0, ComSignalType=UINT8, ComSignalEndianness=LITTLE_ENDIAN, ComBitSize=7, ComBitPosition=64, ComTransferProperty=PENDING, ComSystemTemplateSystemSignalRef=VCU_AccPedLSigVolt
        VCU_LossFctorFlgRL: ComSignalInitValue=0, ComSignalType=BOOLEAN, ComSignalEndianness=LITTLE_ENDIAN, ComBitSize=1, ComBitPosition=71, ComTransferProperty=PENDING, ComSystemTemplateSystemSignalRef=VCU_LossFctorFlgRL
        VCU_AccPedHPwrVolt: ComSignalInitValue=0, ComSignalType=UINT8, ComSignalEndianness=LITTLE_ENDIAN, ComBitSize=7, ComBitPosition=72, ComTransferProperty=PENDING, ComSystemTemplateSystemSignalRef=VCU_AccPedHPwrVolt
        VCU_LossFctorFlgRR: ComSignalInitValue=0, ComSignalType=BOOLEAN, ComSignalEndianness=LITTLE_ENDIAN, ComBitSize=1, ComBitPosition=79, ComTransferProperty=PENDING, ComSystemTemplateSystemSignalRef=VCU_LossFctorFlgRR
        VCU_AccPedLPwrVolt: ComSignalInitValue=0, ComSignalType=UINT8, ComSignalEndianness=LITTLE_ENDIAN, ComBitSize=7, ComBitPosition=80, ComTransferProperty=PENDING, ComSystemTemplateSystemSignalRef=VCU_AccPedLPwrVolt
        VCU_PreReqChgPwr: ComSignalInitValue=0, ComSignalType=UINT8, ComSignalEndianness=LITTLE_ENDIAN, ComBitSize=8, ComBitPosition=88, ComTransferProperty=PENDING, ComSystemTemplateSystemSignalRef=VCU_PreReqChgPwr
        VCU_VehPwrChageLimit: ComSignalInitValue=0, ComSignalType=UINT8, ComSignalEndianness=LITTLE_ENDIAN, ComBitSize=8, ComBitPosition=96, ComTransferProperty=PENDING, ComSystemTemplateSystemSignalRef=VCU_VehPwrChageLimit
        VCU_FastPwrRequest: ComSignalInitValue=0, ComSignalType=UINT8, ComSignalEndianness=LITTLE_ENDIAN, ComBitSize=8, ComBitPosition=104, ComTransferProperty=PENDING, ComSystemTemplateSystemSignalRef=VCU_FastPwrRequest
        VCU_On2KL15_Volt: ComSignalInitValue=0, ComSignalType=UINT8, ComSignalEndianness=LITTLE_ENDIAN, ComBitSize=8, ComBitPosition=112, ComTransferProperty=PENDING, ComSystemTemplateSystemSignalRef=VCU_On2KL15_Volt
        VCU_ClutchWrkModDebug: ComSignalInitValue=0, ComSignalType=UINT8, ComSignalEndianness=LITTLE_ENDIAN, ComBitSize=5, ComBitPosition=120, ComTransferProperty=PENDING, ComSystemTemplateSystemSignalRef=VCU_ClutchWrkModDebug
        VCU_HighPerforSwtFlg: ComSignalInitValue=0, ComSignalType=BOOLEAN, ComSignalEndianness=LITTLE_ENDIAN, ComBitSize=1, ComBitPosition=127, ComTransferProperty=PENDING, ComSystemTemplateSystemSignalRef=VCU_HighPerforSwtFlg
        VCU_VehiPowrConsumption: ComSignalInitValue=0, ComSignalType=UINT16, ComSignalEndianness=LITTLE_ENDIAN, ComBitSize=13, ComBitPosition=128, ComTransferProperty=PENDING, ComSystemTemplateSystemSignalRef=VCU_VehiPowrConsumption
        VCU_MDrvFilterTrqRange: ComSignalInitValue=0, ComSignalType=UINT8, ComSignalEndianness=LITTLE_ENDIAN, ComBitSize=3, ComBitPosition=141, ComTransferProperty=PENDING, ComSystemTemplateSystemSignalRef=VCU_MDrvFilterTrqRange
        VCU_WheelPwrOvrLimitflgRE: ComSignalInitValue=0, ComSignalType=UINT8, ComSignalEndianness=LITTLE_ENDIAN, ComBitSize=2, ComBitPosition=125, ComTransferProperty=PENDING, ComSystemTemplateSystemSignalRef=VCU_WheelPwrOvrLimitflgRE
        VCU_MRDrvControlMode: ComSignalInitValue=0, ComSignalType=BOOLEAN, ComSignalEndianness=LITTLE_ENDIAN, ComBitSize=1, ComBitPosition=155, ComTransferProperty=PENDING, ComSystemTemplateSystemSignalRef=VCU_MRDrvControlMode
        VCU_MRDrvControlModeVD: ComSignalInitValue=0, ComSignalType=BOOLEAN, ComSignalEndianness=LITTLE_ENDIAN, ComBitSize=1, ComBitPosition=156, ComTransferProperty=PENDING, ComSystemTemplateSystemSignalRef=VCU_MRDrvControlModeVD
        VCU_VehicleDirectMR: ComSignalInitValue=0, ComSignalType=BOOLEAN, ComSignalEndianness=LITTLE_ENDIAN, ComBitSize=1, ComBitPosition=157, ComTransferProperty=PENDING, ComSystemTemplateSystemSignalRef=VCU_VehicleDirectMR
        VCU_VehicleDirectMRVD: ComSignalInitValue=0, ComSignalType=BOOLEAN, ComSignalEndianness=LITTLE_ENDIAN, ComBitSize=1, ComBitPosition=158, ComTransferProperty=PENDING, ComSystemTemplateSystemSignalRef=VCU_VehicleDirectMRVD
        VCU_MRDrvRequestTorque: ComSignalInitValue=5000, ComSignalType=UINT16, ComSignalEndianness=LITTLE_ENDIAN, ComBitSize=16, ComBitPosition=160, ComTransferProperty=PENDING, ComSystemTemplateSystemSignalRef=VCU_MRDrvRequestTorque
        VCU_MRDrvRequesSpeed: ComSignalInitValue=17000, ComSignalType=UINT16, ComSignalEndianness=LITTLE_ENDIAN, ComBitSize=16, ComBitPosition=176, ComTransferProperty=PENDING, ComSystemTemplateSystemSignalRef=VCU_MRDrvRequesSpeed
        VCU_MCUMRMaxDischargePower: ComSignalInitValue=0, ComSignalType=UINT16, ComSignalEndianness=LITTLE_ENDIAN, ComBitSize=9, ComBitPosition=192, ComTransferProperty=PENDING, ComSystemTemplateSystemSignalRef=VCU_MCUMRMaxDischargePower
        VCU_MCUMRMaxPosDampgTrq: ComSignalInitValue=50, ComSignalType=UINT8, ComSignalEndianness=LITTLE_ENDIAN, ComBitSize=6, ComBitPosition=201, ComTransferProperty=PENDING, ComSystemTemplateSystemSignalRef=VCU_MCUMRMaxPosDampgTrq
        VCU_MRDrvRequestTorqueVD: ComSignalInitValue=0, ComSignalType=BOOLEAN, ComSignalEndianness=LITTLE_ENDIAN, ComBitSize=1, ComBitPosition=207, ComTransferProperty=PENDING, ComSystemTemplateSystemSignalRef=VCU_MRDrvRequestTorqueVD
        VCU_MCUMRMaxChargePower: ComSignalInitValue=0, ComSignalType=UINT16, ComSignalEndianness=LITTLE_ENDIAN, ComBitSize=9, ComBitPosition=208, ComTransferProperty=PENDING, ComSystemTemplateSystemSignalRef=VCU_MCUMRMaxChargePower
        VCU_MCUMRMaxNegDampgTrq: ComSignalInitValue=0, ComSignalType=UINT8, ComSignalEndianness=LITTLE_ENDIAN, ComBitSize=6, ComBitPosition=217, ComTransferProperty=PENDING, ComSystemTemplateSystemSignalRef=VCU_MCUMRMaxNegDampgTrq
        VCU_MRDrvRequesSpeedVD: ComSignalInitValue=0, ComSignalType=BOOLEAN, ComSignalEndianness=LITTLE_ENDIAN, ComBitSize=1, ComBitPosition=223, ComTransferProperty=PENDING, ComSystemTemplateSystemSignalRef=VCU_MRDrvRequesSpeedVD
        VCU_MCUMRDampgLmtFactor: ComSignalInitValue=100, ComSignalType=UINT8, ComSignalEndianness=LITTLE_ENDIAN, ComBitSize=7, ComBitPosition=224, ComTransferProperty=PENDING, ComSystemTemplateSystemSignalRef=VCU_MCUMRDampgLmtFactor
        VCU_SuppressJitterMCUMRRequest: ComSignalInitValue=0, ComSignalType=BOOLEAN, ComSignalEndianness=LITTLE_ENDIAN, ComBitSize=1, ComBitPosition=231, ComTransferProperty=PENDING, ComSystemTemplateSystemSignalRef=VCU_SuppressJitterMCUMRRequest
        VCU_REStartReq: ComSignalInitValue=0, ComSignalType=BOOLEAN, ComSignalEndianness=LITTLE_ENDIAN, ComBitSize=1, ComBitPosition=18, ComTransferProperty=PENDING, ComSystemTemplateSystemSignalRef=VCU_REStartReq
        VCU_REStopReq: ComSignalInitValue=0, ComSignalType=BOOLEAN, ComSignalEndianness=LITTLE_ENDIAN, ComBitSize=1, ComBitPosition=19, ComTransferProperty=PENDING, ComSystemTemplateSystemSignalRef=VCU_REStopReq
        VCU_Vehicle_NVHPwrLimitVal: ComSignalInitValue=0, ComSignalType=UINT8, ComSignalEndianness=LITTLE_ENDIAN, ComBitSize=8, ComBitPosition=24, ComTransferProperty=PENDING, ComSystemTemplateSystemSignalRef=VCU_Vehicle_NVHPwrLimitVal
        VCU_EngineOff_Flag: ComSignalInitValue=0, ComSignalType=BOOLEAN, ComSignalEndianness=LITTLE_ENDIAN, ComBitSize=1, ComBitPosition=58, ComTransferProperty=PENDING, ComSystemTemplateSystemSignalRef=VCU_EngineOff_Flag
        VCU_EngineStopAllow: ComSignalInitValue=0, ComSignalType=BOOLEAN, ComSignalEndianness=LITTLE_ENDIAN, ComBitSize=1, ComBitPosition=59, ComTransferProperty=PENDING, ComSystemTemplateSystemSignalRef=VCU_EngineStopAllow
        VCU_REHighPerformVehiPwr: ComSignalInitValue=0, ComSignalType=UINT8, ComSignalEndianness=LITTLE_ENDIAN, ComBitSize=8, ComBitPosition=72, ComTransferProperty=PENDING, ComSystemTemplateSystemSignalRef=VCU_REHighPerformVehiPwr
        VCU_REPwrDampingFactor: ComSignalInitValue=0, ComSignalType=UINT8, ComSignalEndianness=LITTLE_ENDIAN, ComBitSize=7, ComBitPosition=80, ComTransferProperty=PENDING, ComSystemTemplateSystemSignalRef=VCU_REPwrDampingFactor
        VCU_REDrvTarPwrFit: ComSignalInitValue=0, ComSignalType=UINT16, ComSignalEndianness=LITTLE_ENDIAN, ComBitSize=9, ComBitPosition=87, ComTransferProperty=PENDING, ComSystemTemplateSystemSignalRef=VCU_REDrvTarPwrFit
        VCU_REVehiWheelTrqReq: ComSignalInitValue=0, ComSignalType=UINT8, ComSignalEndianness=LITTLE_ENDIAN, ComBitSize=8, ComBitPosition=64, ComTransferProperty=PENDING, ComSystemTemplateSystemSignalRef=VCU_REVehiWheelTrqReq
      ICU_0xDF_P_CANFD (ComIPdu):
        ComIPduSignalProcessing = IMMEDIATE
        ComIPduType = NORMAL
        ComIPduDirection = RECEIVE
        ComIPduCallout = ComCallOut_ICU_0xDF_P_CANFD
        ComIPduErrorNotification = ComCbk_RxTimeOut_ICU_0xDF_P_CANFD
        ComFirstTimeout = 1.1
        ComTimeout = 0.1
        ComIPduGroupRef = ComIPduGroup_Rx
        ComPduIdRef = ICU_0xDF_P_CANFD_PduR2Com
        ComIPduSignalRef = ICU_CRC_DF
        ComIPduSignalRef = ICU_RollingCounter_DF
        ComIPduSignalRef = ICU_IMU_ACC_x
        ComIPduSignalRef = ICU_IMU_ACC_y
        ComIPduSignalRef = ICU_IMU_ACC_z
        ComIPduSignalRef = ICU_IMU_ACC_Roll_Rate
        ComIPduSignalRef = ICU_IMU_ACC_Pitch_Rate
        ComIPduSignalRef = ICU_IMU_ACC_Yaw_Rate
        ComIPduSignalRef = ICU_IMU_Calibrated
        ComIPduSignalRef = ICU_IMU_Valid
      34 x ComSignal, all with ComSignalInitValue=0, ComSignalEndianness=LITTLE_ENDIAN, ComUpdateBitPosition=-1:
        ICU_CRC_DF: ComSignalType=UINT8, ComBitSize=8, ComBitPosition=0, ComTransferProperty=TRIGGERED, ComNotification=Rte_COMCbk_ICU_CRC_DF, ComSystemTemplateSystemSignalRef=ICU_CRC_DF
        ICU_RollingCounter_DF: ComSignalType=UINT8, ComBitSize=4, ComBitPosition=8, ComTransferProperty=TRIGGERED, ComNotification=Rte_COMCbk_ICU_RollingCounter_DF, ComSystemTemplateSystemSignalRef=ICU_RollingCounter_DF
        ICU_IMU_ACC_x: ComSignalType=UINT16, ComBitSize=16, ComBitPosition=16, ComTransferProperty=TRIGGERED, ComNotification=Rte_COMCbk_ICU_IMU_ACC_x, ComSystemTemplateSystemSignalRef=ICU_IMU_ACC_x
        ICU_IMU_ACC_y: ComSignalType=UINT16, ComBitSize=16, ComBitPosition=32, ComTransferProperty=TRIGGERED, ComNotification=Rte_COMCbk_ICU_IMU_ACC_y, ComSystemTemplateSystemSignalRef=ICU_IMU_ACC_y
        ICU_IMU_ACC_z: ComSignalType=UINT16, ComBitSize=16, ComBitPosition=48, ComTransferProperty=TRIGGERED, ComNotification=Rte_COMCbk_ICU_IMU_ACC_z, ComSystemTemplateSystemSignalRef=ICU_IMU_ACC_z
        ICU_IMU_ACC_Roll_Rate: ComSignalType=UINT16, ComBitSize=16, ComBitPosition=64, ComTransferProperty=TRIGGERED, ComNotification=Rte_COMCbk_ICU_IMU_ACC_Roll_Rate, ComSystemTemplateSystemSignalRef=ICU_IMU_ACC_Roll_Rate
        ICU_IMU_ACC_Pitch_Rate: ComSignalType=UINT16, ComBitSize=16, ComBitPosition=80, ComTransferProperty=TRIGGERED, ComNotification=Rte_COMCbk_ICU_IMU_ACC_Pitch_Rate, ComSystemTemplateSystemSignalRef=ICU_IMU_ACC_Pitch_Rate
        ICU_IMU_ACC_Yaw_Rate: ComSignalType=UINT16, ComBitSize=16, ComBitPosition=96, ComTransferProperty=TRIGGERED, ComNotification=Rte_COMCbk_ICU_IMU_ACC_Yaw_Rate, ComSystemTemplateSystemSignalRef=ICU_IMU_ACC_Yaw_Rate
        ICU_IMU_Calibrated: ComSignalType=UINT8, ComBitSize=2, ComBitPosition=112, ComTransferProperty=TRIGGERED, ComNotification=Rte_COMCbk_ICU_IMU_Calibrated, ComSystemTemplateSystemSignalRef=ICU_IMU_Calibrated
        ICU_IMU_Valid: ComSignalType=BOOLEAN, ComBitSize=1, ComBitPosition=114, ComTransferProperty=TRIGGERED, ComNotification=Rte_COMCbk_ICU_IMU_Valid, ComSystemTemplateSystemSignalRef=ICU_IMU_Valid
        IBC_WheelPressureReliabilityFL: ComSignalType=BOOLEAN, ComBitSize=1, ComBitPosition=68, ComTransferProperty=TRIGGERED, ComNotification=Rte_COMCbk_IBC_WheelPressureReliabilityFL, ComSystemTemplateSystemSignalRef=IBC_WheelPressureReliabilityFL
        IBC_WheelPressureReliabilityFR: ComSignalType=BOOLEAN, ComBitSize=1, ComBitPosition=69, ComTransferProperty=TRIGGERED, ComNotification=Rte_COMCbk_IBC_WheelPressureReliabilityFR, ComSystemTemplateSystemSignalRef=IBC_WheelPressureReliabilityFR
        IBC_WheelPressureReliabilityRL: ComSignalType=BOOLEAN, ComBitSize=1, ComBitPosition=70, ComTransferProperty=TRIGGERED, ComNotification=Rte_COMCbk_IBC_WheelPressureReliabilityRL, ComSystemTemplateSystemSignalRef=IBC_WheelPressureReliabilityRL
        IBC_WheelPressureReliabilityRR: ComSignalType=BOOLEAN, ComBitSize=1, ComBitPosition=71, ComTransferProperty=TRIGGERED, ComNotification=Rte_COMCbk_IBC_WheelPressureReliabilityRR, ComSystemTemplateSystemSignalRef=IBC_WheelPressureReliabilityRR
        LMC_EngTorqDec_Main_R: ComSignalType=UINT16, ComBitSize=10, ComBitPosition=232, ComTransferProperty=TRIGGERED, ComNotification=Rte_COMCbk_LMC_EngTorqDec_Main_R, ComSystemTemplateSystemSignalRef=LMC_EngTorqDec_Main_R
        LMC_EngTorqDecActive_Main_R: ComSignalType=BOOLEAN, ComBitSize=1, ComBitPosition=242, ComTransferProperty=TRIGGERED, ComNotification=Rte_COMCbk_LMC_EngTorqDecActive_Main_R, ComSystemTemplateSystemSignalRef=LMC_EngTorqDecActive_Main_R
        LMC_EngTorqInc_Main_R: ComSignalType=UINT16, ComBitSize=10, ComBitPosition=244, ComTransferProperty=TRIGGERED, ComNotification=Rte_COMCbk_LMC_EngTorqInc_Main_R, ComSystemTemplateSystemSignalRef=LMC_EngTorqInc_Main_R
        LMC_EngTorqIncActive_Main_R: ComSignalType=BOOLEAN, ComBitSize=1, ComBitPosition=254, ComTransferProperty=TRIGGERED, ComNotification=Rte_COMCbk_LMC_EngTorqIncActive_Main_R, ComSystemTemplateSystemSignalRef=LMC_EngTorqIncActive_Main_R
        IBC_EngTorqDec_MainR: ComSignalType=UINT16, ComBitSize=10, ComBitPosition=80, ComTransferProperty=TRIGGERED, ComNotification=Rte_COMCbk_IBC_EngTorqDec_MainR, ComSystemTemplateSystemSignalRef=IBC_EngTorqDec_MainR
        IBC_EngTorqDecActive_MainR: ComSignalType=BOOLEAN, ComBitSize=1, ComBitPosition=90, ComTransferProperty=TRIGGERED, ComNotification=Rte_COMCbk_IBC_EngTorqDecActive_MainR, ComSystemTemplateSystemSignalRef=IBC_EngTorqDecActive_MainR
        IBC_EngTorqInc_MainR: ComSignalType=UINT16, ComBitSize=10, ComBitPosition=96, ComTransferProperty=TRIGGERED, ComNotification=Rte_COMCbk_IBC_EngTorqInc_MainR, ComSystemTemplateSystemSignalRef=IBC_EngTorqInc_MainR
        IBC_EngTorqIncActive_MainR: ComSignalType=BOOLEAN, ComBitSize=1, ComBitPosition=106, ComTransferProperty=TRIGGERED, ComNotification=Rte_COMCbk_IBC_EngTorqIncActive_MainR, ComSystemTemplateSystemSignalRef=IBC_EngTorqIncActive_MainR
        VCU_MRDriverRequireTorque: ComSignalType=UINT16, ComBitSize=16, ComBitPosition=144, ComTransferProperty=PENDING, ComSystemTemplateSystemSignalRef=VCU_MRDriverRequireTorque
        VCU_MRDrvRequestTorque_IDB6_CCAN: ComSignalType=UINT16, ComBitSize=16, ComBitPosition=128, ComTransferProperty=PENDING, ComSystemTemplateSystemSignalRef=VCU_MRDrvRequestTorque_IDB6_CCAN
        MCUS_SystemError: ComSignalType=BOOLEAN, ComBitSize=1, ComBitPosition=23, ComTransferProperty=TRIGGERED, ComNotification=Rte_COMCbk_MCUS_SystemError, ComSystemTemplateSystemSignalRef=MCUS_SystemError
        MCUS_LVSystemError: ComSignalType=BOOLEAN, ComBitSize=1, ComBitPosition=57, ComTransferProperty=TRIGGERED, ComNotification=Rte_COMCbk_MCUS_LVSystemError, ComSystemTemplateSystemSignalRef=MCUS_LVSystemError
        MCUS_MotorTempAlarm: ComSignalType=BOOLEAN, ComBitSize=1, ComBitPosition=63, ComTransferProperty=TRIGGERED, ComNotification=Rte_COMCbk_MCUS_MotorTempAlarm, ComSystemTemplateSystemSignalRef=MCUS_MotorTempAlarm
        MCUS_HVSystemError: ComSignalType=BOOLEAN, ComBitSize=1, ComBitPosition=64, ComTransferProperty=TRIGGERED, ComNotification=Rte_COMCbk_MCUS_HVSystemError, ComSystemTemplateSystemSignalRef=MCUS_HVSystemError
        MCUS_SeriousWarning_Level: ComSignalType=UINT8, ComBitSize=2, ComBitPosition=66, ComTransferProperty=TRIGGERED, ComNotification=Rte_COMCbk_MCUS_SeriousWarning_Level, ComSystemTemplateSystemSignalRef=MCUS_SeriousWarning_Level
        MCUS_CtrlModeVD: ComSignalType=BOOLEAN, ComBitSize=1, ComBitPosition=70, ComTransferProperty=TRIGGERED, ComNotification=Rte_COMCbk_MCUS_CtrlModeVD, ComSystemTemplateSystemSignalRef=MCUS_CtrlModeVD
        MCUS_WaterPumpLevlReq: ComSignalType=UINT8, ComBitSize=4, ComBitPosition=104, ComTransferProperty=TRIGGERED, ComNotification=Rte_COMCbk_MCUS_WaterPumpLevlReq, ComSystemTemplateSystemSignalRef=MCUS_WaterPumpLevlReq
        MCUS_MotorTemp: ComSignalType=UINT8, ComBitSize=8, ComBitPosition=144, ComTransferProperty=TRIGGERED, ComNotification=Rte_COMCbk_MCUS_MotorTemp, ComSystemTemplateSystemSignalRef=MCUS_MotorTemp
        MCUS_IGBTTemp: ComSignalType=UINT8, ComBitSize=8, ComBitPosition=152, ComTransferProperty=TRIGGERED, ComNotification=Rte_COMCbk_MCUS_IGBTTemp, ComSystemTemplateSystemSignalRef=MCUS_IGBTTemp
        MCUS_InletTemp: ComSignalType=UINT8, ComBitSize=8, ComBitPosition=160, ComTransferProperty=TRIGGERED, ComNotification=Rte_COMCbk_MCUS_InletTemp, ComSystemTemplateSystemSignalRef=MCUS_InletTemp
      TMS_0x362_P_CANFD (ComIPdu):
        ComIPduSignalProcessing = IMMEDIATE
        ComIPduType = NORMAL
        ComIPduDirection = RECEIVE
        ComIPduGroupRef = ComIPduGroup_Rx
        ComPduIdRef = PduCollection/TMS_0x362_P_CANFD_PduR2Com
        ComIPduSignalRef = TMS_RAPTC_ModOprtgStsFrt
        ComIPduSignalRef = TMS_RAPTC_ModOpEnblCmd
        ComIPduSignalRef = TMS_RAPTC_MsrdPwrFrt
      3 x ComSignal, all with ComSignalInitValue=0, ComSignalEndianness=LITTLE_ENDIAN, ComUpdateBitPosition=-1, ComTransferProperty=TRIGGERED:
        TMS_RAPTC_ModOprtgStsFrt: ComSignalType=UINT8, ComBitSize=2, ComBitPosition=144, ComNotification=Rte_COMCbk_TMS_RAPTC_ModOprtgStsFrt, ComSystemTemplateSystemSignalRef=TMS_RAPTC_ModOprtgStsFrt
        TMS_RAPTC_ModOpEnblCmd: ComSignalType=BOOLEAN, ComBitSize=1, ComBitPosition=162, ComNotification=Rte_COMCbk_TMS_RAPTC_ModOpEnblCmd, ComSystemTemplateSystemSignalRef=TMS_RAPTC_ModOpEnblCmd
        TMS_RAPTC_MsrdPwrFrt: ComSignalType=UINT16, ComBitSize=10, ComBitPosition=152, ComNotification=Rte_COMCbk_TMS_RAPTC_MsrdPwrFrt, ComSystemTemplateSystemSignalRef=TMS_RAPTC_MsrdPwrFrt
      HPCBCM_0xDA_VCU_CAN (ComIPdu):
        ComIPduSignalProcessing = IMMEDIATE
        ComIPduType = NORMAL
        ComIPduDirection = RECEIVE
        ComIPduCallout = ComCallOut_HPCBCM_0xDA_VCU_CAN
        ComIPduErrorNotification = ComCbk_RxTimeOut_HPCBCM_0xDA_VCU_CAN
        ComFirstTimeout = 2.1
        ComTimeout = 0.1
        ComIPduGroupRef = ComIPduGroup_Rx
        ComPduIdRef = PduCollection/HPCBCM_0xDA_VCU_CAN_PduR2Com
        ComIPduSignalRef = BCM_CRC_DA
        ComIPduSignalRef = BCM_RollingCounter_DA
        ComIPduSignalRef = BCM_IMU_ACC_x
        ComIPduSignalRef = BCM_IMU_ACC_y
        ComIPduSignalRef = BCM_IMU_ACC_z
        ComIPduSignalRef = BCM_IMU_ACC_Roll_Rate
        ComIPduSignalRef = BCM_IMU_ACC_Pitch_Rate
        ComIPduSignalRef = BCM_IMU_ACC_Yaw_Rate
        ComIPduSignalRef = BCM_IMU_Valid
      9 x ComSignal, all with ComSignalInitValue=0, ComSignalEndianness=LITTLE_ENDIAN, ComUpdateBitPosition=-1, ComTransferProperty=TRIGGERED:
        BCM_CRC_DA: ComSignalType=UINT8, ComBitSize=8, ComBitPosition=0, ComNotification=Rte_COMCbk_BCM_CRC_DA, ComSystemTemplateSystemSignalRef=BCM_CRC_DA
        BCM_RollingCounter_DA: ComSignalType=UINT8, ComBitSize=4, ComBitPosition=8, ComNotification=Rte_COMCbk_BCM_RollingCounter_DA, ComSystemTemplateSystemSignalRef=BCM_RollingCounter_DA
        BCM_IMU_ACC_x: ComSignalType=UINT16, ComBitSize=16, ComBitPosition=16, ComNotification=Rte_COMCbk_BCM_IMU_ACC_x, ComSystemTemplateSystemSignalRef=BCM_IMU_ACC_x
        BCM_IMU_ACC_y: ComSignalType=UINT16, ComBitSize=16, ComBitPosition=32, ComNotification=Rte_COMCbk_BCM_IMU_ACC_y, ComSystemTemplateSystemSignalRef=BCM_IMU_ACC_y
        BCM_IMU_ACC_z: ComSignalType=UINT16, ComBitSize=16, ComBitPosition=48, ComNotification=Rte_COMCbk_BCM_IMU_ACC_z, ComSystemTemplateSystemSignalRef=BCM_IMU_ACC_z
        BCM_IMU_ACC_Roll_Rate: ComSignalType=UINT16, ComBitSize=16, ComBitPosition=64, ComNotification=Rte_COMCbk_BCM_IMU_ACC_Roll_Rate, ComSystemTemplateSystemSignalRef=BCM_IMU_ACC_Roll_Rate
        BCM_IMU_ACC_Pitch_Rate: ComSignalType=UINT16, ComBitSize=16, ComBitPosition=80, ComNotification=Rte_COMCbk_BCM_IMU_ACC_Pitch_Rate, ComSystemTemplateSystemSignalRef=BCM_IMU_ACC_Pitch_Rate
        BCM_IMU_ACC_Yaw_Rate: ComSignalType=UINT16, ComBitSize=16, ComBitPosition=96, ComNotification=Rte_COMCbk_BCM_IMU_ACC_Yaw_Rate, ComSystemTemplateSystemSignalRef=BCM_IMU_ACC_Yaw_Rate
        BCM_IMU_Valid: ComSignalType=UINT8, ComBitSize=1, ComBitPosition=114, ComNotification=Rte_COMCbk_BCM_IMU_Valid, ComSystemTemplateSystemSignalRef=BCM_IMU_Valid
      ACU_0x15_VCU_CAN (ComIPdu):
        ComIPduSignalProcessing = IMMEDIATE
        ComIPduType = NORMAL
        ComIPduDirection = RECEIVE
        ComIPduCallout = ComCallOut_ACU_0x15_VCU_CAN
        ComIPduErrorNotification = ComCbk_RxTimeOut_ACU_0x15_VCU_CAN
        ComFirstTimeout = 2.1
        ComTimeout = 0.1
        ComIPduGroupRef = ComIPduGroup_Rx
        ComPduIdRef = PduCollection/ACU_0x15_VCU_CAN_PduR2Com
        ComIPduSignalRef = ACU_IMU_CRC_15
        ComIPduSignalRef = ACU_IMU_RollingCounter_15
        ComIPduSignalRef = ACU_IMU_ACC_x
        ComIPduSignalRef = ACU_IMU_ACC_y
        ComIPduSignalRef = ACU_IMU_ACC_z
        ComIPduSignalRef = ACU_IMU_Roll_Rate
        ComIPduSignalRef = ACU_IMU_Pitch_Rate
        ComIPduSignalRef = ACU_IMU_Yaw_Rate
        ComIPduSignalRef = ACU_IMU_Calibrated
        ComIPduSignalRef = ACU_IMU_Valid
        ComIPduSignalRef = ACU_IMU_Fault_Status
        ComIPduSignalRef = ACU_IMU_MessageStatus
        ComIPduSignalRef = ACU_IMU_FunctionSafetyStatus
        ComIPduSignalRef = ACU_IMU_Temperature
      14 x ComSignal, all with ComSignalInitValue=0, ComSignalEndianness=LITTLE_ENDIAN, ComUpdateBitPosition=-1, ComTransferProperty=TRIGGERED:
        ACU_IMU_CRC_15: ComSignalType=UINT8, ComBitSize=8, ComBitPosition=0, ComNotification=Rte_COMCbk_ACU_IMU_CRC_15, ComSystemTemplateSystemSignalRef=ACU_IMU_CRC_15
        ACU_IMU_RollingCounter_15: ComSignalType=UINT8, ComBitSize=8, ComBitPosition=8, ComNotification=Rte_COMCbk_ACU_IMU_RollingCounter_15, ComSystemTemplateSystemSignalRef=ACU_IMU_RollingCounter_15
        ACU_IMU_ACC_x: ComSignalType=UINT16, ComBitSize=16, ComBitPosition=16, ComNotification=Rte_COMCbk_ACU_IMU_ACC_x, ComSystemTemplateSystemSignalRef=ACU_IMU_ACC_x
        ACU_IMU_ACC_y: ComSignalType=UINT16, ComBitSize=16, ComBitPosition=32, ComNotification=Rte_COMCbk_ACU_IMU_ACC_y, ComSystemTemplateSystemSignalRef=ACU_IMU_ACC_y
        ACU_IMU_ACC_z: ComSignalType=UINT16, ComBitSize=16, ComBitPosition=48, ComNotification=Rte_COMCbk_ACU_IMU_ACC_z, ComSystemTemplateSystemSignalRef=ACU_IMU_ACC_z
        ACU_IMU_Roll_Rate: ComSignalType=UINT16, ComBitSize=16, ComBitPosition=64, ComNotification=Rte_COMCbk_ACU_IMU_Roll_Rate, ComSystemTemplateSystemSignalRef=ACU_IMU_Roll_Rate
        ACU_IMU_Pitch_Rate: ComSignalType=UINT16, ComBitSize=16, ComBitPosition=80, ComNotification=Rte_COMCbk_ACU_IMU_Pitch_Rate, ComSystemTemplateSystemSignalRef=ACU_IMU_Pitch_Rate
        ACU_IMU_Yaw_Rate: ComSignalType=UINT16, ComBitSize=16, ComBitPosition=96, ComNotification=Rte_COMCbk_ACU_IMU_Yaw_Rate, ComSystemTemplateSystemSignalRef=ACU_IMU_Yaw_Rate
        ACU_IMU_Calibrated: ComSignalType=UINT8, ComBitSize=2, ComBitPosition=112, ComNotification=Rte_COMCbk_ACU_IMU_Calibrated, ComSystemTemplateSystemSignalRef=ACU_IMU_Calibrated
        ACU_IMU_Valid: ComSignalType=BOOLEAN, ComBitSize=1, ComBitPosition=114, ComNotification=Rte_COMCbk_ACU_IMU_Valid, ComSystemTemplateSystemSignalRef=ACU_IMU_Valid
        ACU_IMU_Fault_Status: ComSignalType=BOOLEAN, ComBitSize=1, ComBitPosition=216, ComNotification=Rte_COMCbk_ACU_IMU_Fault_Status, ComSystemTemplateSystemSignalRef=ACU_IMU_Fault_Status
        ACU_IMU_MessageStatus: ComSignalType=UINT8, ComBitSize=3, ComBitPosition=217, ComNotification=Rte_COMCbk_ACU_IMU_MessageStatus, ComSystemTemplateSystemSignalRef=ACU_IMU_MessageStatus
        ACU_IMU_FunctionSafetyStatus: ComSignalType=UINT8, ComBitSize=4, ComBitPosition=220, ComNotification=Rte_COMCbk_ACU_IMU_FunctionSafetyStatus, ComSystemTemplateSystemSignalRef=ACU_IMU_FunctionSafetyStatus
        ACU_IMU_Temperature: ComSignalType=UINT16, ComBitSize=16, ComBitPosition=224, ComNotification=Rte_COMCbk_ACU_IMU_Temperature, ComSystemTemplateSystemSignalRef=ACU_IMU_Temperature
      LMC_0x133_C_CANFD (ComIPdu):
        ComIPduSignalProcessing = IMMEDIATE
        ComIPduType = NORMAL
        ComIPduDirection = RECEIVE
        ComIPduCallout = ComCallOut_LMC_0x133_C_CANFD
        ComIPduErrorNotification = ComCbk_RxTimeOut_LMC_0x133_C_CANFD
        ComFirstTimeout = 2.1
        ComTimeout = 0.1
        ComIPduGroupRef = ComIPduGroup_Rx
        ComPduIdRef = PduCollection/LMC_0x133_C_CANFD_PduR2Com
        ComIPduSignalRef = LMC_CRC_133
        ComIPduSignalRef = LMC_RollingCounter_133
        ComIPduSignalRef = LMC_DrvReqTorque
      3 x ComSignal, all with ComSignalInitValue=0, ComSignalEndianness=LITTLE_ENDIAN, ComUpdateBitPosition=-1, ComTransferProperty=TRIGGERED:
        LMC_CRC_133: ComSignalType=UINT8, ComBitSize=8, ComBitPosition=0, ComNotification=Rte_COMCbk_LMC_CRC_133, ComSystemTemplateSystemSignalRef=LMC_CRC_133
        LMC_RollingCounter_133: ComSignalType=UINT8, ComBitSize=4, ComBitPosition=8, ComNotification=Rte_COMCbk_LMC_RollingCounter_133, ComSystemTemplateSystemSignalRef=LMC_RollingCounter_133
        LMC_DrvReqTorque: ComSignalType=UINT16, ComBitSize=15, ComBitPosition=40, ComNotification=Rte_COMCbk_LMC_DrvReqTorque, ComSystemTemplateSystemSignalRef=LMC_DrvReqTorque
      LMCSSU_0x25A_C_CANFD (ComIPdu):
        ComIPduSignalProcessing = IMMEDIATE
        ComIPduType = NORMAL
        ComIPduDirection = RECEIVE
        ComIPduCallout = ComCallOut_LMC_0x25A_C_CANFD
        ComIPduErrorNotification = ComCbk_RxTimeOut_LMC_0x25A_C_CANFD
        ComFirstTimeout = 3.0
        ComTimeout = 1.0
        ComIPduGroupRef = ComIPduGroup_Rx
        ComPduIdRef = PduCollection/LMCSSU_0x25A_C_CANFD_PduR2Com
        ComIPduSignalRef = LMC_CRC_25A
        ComIPduSignalRef = LMC_RollingCounter_25A
        ComIPduSignalRef = LMC_CDC_DriveModeFb
        ComIPduSignalRef = LMC_ECAS_DriveModeFb
      4 x ComSignal, all with ComSignalInitValue=0, ComSignalType=UINT8, ComSignalEndianness=LITTLE_ENDIAN, ComUpdateBitPosition=-1, ComTransferProperty=TRIGGERED:
        LMC_CRC_25A: ComBitSize=8, ComBitPosition=0, ComNotification=Rte_COMCbk_LMC_CRC_25A, ComSystemTemplateSystemSignalRef=LMC_CRC_25A
        LMC_RollingCounter_25A: ComBitSize=4, ComBitPosition=8, ComNotification=Rte_COMCbk_LMC_RollingCounter_25A, ComSystemTemplateSystemSignalRef=LMC_RollingCounter_25A
        LMC_CDC_DriveModeFb: ComBitSize=3, ComBitPosition=40, ComNotification=Rte_COMCbk_LMC_CDC_DriveModeFb, ComSystemTemplateSystemSignalRef=LMC_CDC_DriveModeFb
        LMC_ECAS_DriveModeFb: ComBitSize=4, ComBitPosition=44, ComNotification=Rte_COMCbk_LMC_ECAS_DriveModeFb, ComSystemTemplateSystemSignalRef=LMC_ECAS_DriveModeFb
      HPCBCM_0x4A_C_CANFD (ComIPdu):
        ComIPduSignalProcessing = IMMEDIATE
        ComIPduType = NORMAL
        ComIPduDirection = RECEIVE
        ComIPduCallout = ComCallOut_HPCBCM_0x4A_C_CANFD
        ComTimeout = 0.1
        ComIPduErrorNotification = ComCbk_RxTimeOut_HPCBCM_0x4A_C_CANFD
        ComIPduGroupRef = ComIPduGroup_Rx
        ComPduIdRef = PduCollection/HPCBCM_0x4A_C_CANFD_PduR2Com
        ComIPduSignalRef = BCM_CRC_4A
        ComIPduSignalRef = BCM_IBCLimphomeSts
        ComIPduSignalRef = BCM_EOLAutomaticActiveSts_C
        ComIPduSignalRef = BCM_TorqueLimte
        ComIPduSignalRef = BCM_RollingCounter_4A
      5 x ComSignal, all with ComSignalInitValue=0, ComSignalEndianness=LITTLE_ENDIAN, ComUpdateBitPosition=-1, ComTransferProperty=TRIGGERED:
        BCM_CRC_4A: ComSignalType=UINT8, ComBitSize=8, ComBitPosition=0, ComNotification=Rte_COMCbk_BCM_CRC_4A, ComSystemTemplateSystemSignalRef=BCM_CRC_4A
        BCM_IBCLimphomeSts: ComSignalType=BOOLEAN, ComBitSize=1, ComBitPosition=33, ComNotification=Rte_COMCbk_BCM_IBCLimphomeSts, ComSystemTemplateSystemSignalRef=BCM_IBCLimphomeSts
        BCM_EOLAutomaticActiveSts_C: ComSignalType=BOOLEAN, ComBitSize=1, ComBitPosition=32, ComNotification=Rte_COMCbk_BCM_EOLAutomaticActiveSts_C, ComSystemTemplateSystemSignalRef=BCM_EOLAutomaticActiveSts_C
        BCM_TorqueLimte: ComSignalType=UINT16, ComBitSize=16, ComBitPosition=16, ComNotification=Rte_COMCbk_BCM_TorqueLimte, ComSystemTemplateSystemSignalRef=BCM_TorqueLimte
        BCM_RollingCounter_4A: ComSignalType=UINT8, ComBitSize=4, ComBitPosition=8, ComNotification=Rte_COMCbk_BCM_RollingCounter_4A, ComSystemTemplateSystemSignalRef=BCM_RollingCounter_4A
      ICU_0x5BE_VCU_CAN (ComIPdu):
        ComIPduSignalProcessing = IMMEDIATE
        ComIPduType = NORMAL
        ComIPduDirection = RECEIVE
        ComIPduCallout = ComCallOut_ICU_0x5BE_VCU_CAN
        ComIPduGroupRef = ComIPduGroup_Rx
        ComPduIdRef = PduCollection/ICU_0x5BE_VCU_CAN_PduR2Com
        ComIPduSignalRef = ICU_RollingCounter_5BE
        ComIPduSignalRef = ICU_Imu_Cal_Staus
        ComIPduSignalRef = ICU_Imu_Cal_Gyro
        ComIPduSignalRef = ICU_Imu_Cal_Pitch
        ComIPduSignalRef = ICU_Imu_Cal_Roll
      5 x ComSignal, all with ComSignalInitValue=0, ComSignalType=UINT8, ComSignalEndianness=LITTLE_ENDIAN, ComUpdateBitPosition=-1, ComTransferProperty=TRIGGERED:
        ICU_RollingCounter_5BE: ComBitSize=4, ComBitPosition=8, ComNotification=Rte_COMCbk_ICU_RollingCounter_5BE, ComSystemTemplateSystemSignalRef=ICU_RollingCounter_5BE
        ICU_Imu_Cal_Staus: ComBitSize=2, ComBitPosition=40, ComNotification=Rte_COMCbk_ICU_Imu_Cal_Staus, ComSystemTemplateSystemSignalRef=ICU_Imu_Cal_Staus
        ICU_Imu_Cal_Gyro: ComBitSize=8, ComBitPosition=32, ComNotification=Rte_COMCbk_ICU_Imu_Cal_Gyro, ComSystemTemplateSystemSignalRef=ICU_Imu_Cal_Gyro
        ICU_Imu_Cal_Pitch: ComBitSize=8, ComBitPosition=24, ComNotification=Rte_COMCbk_ICU_Imu_Cal_Pitch, ComSystemTemplateSystemSignalRef=ICU_Imu_Cal_Pitch
        ICU_Imu_Cal_Roll: ComBitSize=8, ComBitPosition=16, ComNotification=Rte_COMCbk_ICU_Imu_Cal_Roll, ComSystemTemplateSystemSignalRef=ICU_Imu_Cal_Roll
    ComGeneral:
      ComVersionInfoApi = false
      ComCommonIPduTxPeriodFeature = false
      ComEnableJitterFilter = false
      ComEnableSignalGroupArrayApi = false
      ComCancellationSupport = false
      ComConfigurationUseDet = false
      ComTxIPduDeferredProcessing = false
