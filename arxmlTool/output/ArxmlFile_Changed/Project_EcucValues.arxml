[part 2 of 4: package /ETAS_Project/EcucModuleConfigurationValuess]
AUTOSAR XML (schema 4-2-2)
package /ETAS_Project/EcucModuleConfigurationValuess  (continued)
  module config Com: implementation-config-variant=VARIANT-PRE-COMPILE  (continued)
    ComConfig_0 (ComConfig)  (continued)
      HPCBCM_0x292_P_CANFD (ComIPdu):
        ComIPduSignalProcessing = IMMEDIATE
        ComIPduType = NORMAL
        ComIPduDirection = RECEIVE
        ComIPduGroupRef = ComIPduGroup_Rx
        ComPduIdRef = PduCollection/HPCBCM_0x292_P_CANFD_PduR2Com
        ComIPduSignalRef = BCM_VCU_Authentication_Sts
        ComIPduSignalRef = BCM_PTCLossMissErr
        ComIPduSignalRef = BCM_PTCRollCntErr
        ComIPduSignalRef = BCM_PTCChksumErr
        ComIPduSignalRef = BCM_PDUHVIL_STs
        ComIPduSignalRef = BCM_Cab220VHVIL_STs
        ComIPduSignalRef = BCM_Cabin220VHVIL_STs
      7 x ComSignal, all with ComSignalInitValue=0, ComSignalEndianness=LITTLE_ENDIAN, ComUpdateBitPosition=-1, ComTransferProperty=TRIGGERED:
        BCM_VCU_Authentication_Sts: ComSignalType=UINT8, ComBitSize=2, ComBitPosition=16, ComNotification=Rte_COMCbk_BCM_VCU_Authentication_Sts, ComSystemTemplateSystemSignalRef=BCM_VCU_Authentication_Sts
        BCM_PTCLossMissErr: ComSignalType=BOOLEAN, ComBitSize=1, ComBitPosition=18, ComNotification=Rte_COMCbk_BCM_PTCLossMissErr, ComSystemTemplateSystemSignalRef=BCM_PTCLossMissErr
        BCM_PTCRollCntErr: ComSignalType=BOOLEAN, ComBitSize=1, ComBitPosition=19, ComNotification=Rte_COMCbk_BCM_PTCRollCntErr, ComSystemTemplateSystemSignalRef=BCM_PTCRollCntErr
        BCM_PTCChksumErr: ComSignalType=BOOLEAN, ComBitSize=1, ComBitPosition=20, ComNotification=Rte_COMCbk_BCM_PTCChksumErr, ComSystemTemplateSystemSignalRef=BCM_PTCChksumErr
        BCM_PDUHVIL_STs: ComSignalType=BOOLEAN, ComBitSize=1, ComBitPosition=21, ComNotification=Rte_COMCbk_BCM_PDUHVIL_STs, ComSystemTemplateSystemSignalRef=BCM_PDUHVIL_STs
        BCM_Cab220VHVIL_STs: ComSignalType=BOOLEAN, ComBitSize=1, ComBitPosition=22, ComNotification=Rte_COMCbk_BCM_Cab220VHVIL_STs, ComSystemTemplateSystemSignalRef=BCM_Cab220VHVIL_STs
        BCM_Cabin220VHVIL_STs: ComSignalType=BOOLEAN, ComBitSize=1, ComBitPosition=23, ComNotification=Rte_COMCbk_BCM_Cabin220VHVIL_STs, ComSystemTemplateSystemSignalRef=BCM_Cabin220VHVIL_STs
      HPCGW_0x30B_P_CANFD (ComIPdu):
        ComIPduSignalProcessing = IMMEDIATE
        ComIPduType = NORMAL
        ComIPduDirection = RECEIVE
        ComIPduCallout = ComCallOut_HPCGW_0x30B_P_CANFD
        ComIPduErrorNotification = ComCbk_RxTimeOut_HPCGW_0x30B_P_CANFD
        ComFirstTimeout = 3.0
        ComTimeout = 1.0
        ComIPduGroupRef = ComIPduGroup_Rx
        ComPduIdRef = PduCollection/HPCGW_0x30B_P_CANFD_PduR2Com
        ComIPduSignalRef = GW_TCM_CRC_30B
        ComIPduSignalRef = GW_TCM_RollingCounter_30B
        ComIPduSignalRef = GW_TCM_ParkingSwSts
        ComIPduSignalRef = GW_TCM_STATUS_Park
        ComIPduSignalRef = GW_TCM_Counter_Park
        ComIPduSignalRef = GW_TCM_CRC_Park
        ComIPduSignalRef = GW_TCM_GearLevelSwitchSts
        ComIPduSignalRef = GW_TCM_STATUS_RND
        ComIPduSignalRef = GW_TCM_Counter_RND
        ComIPduSignalRef = GW_TCM_CRC_RND
        ComIPduSignalRef = GW_TCM_SelfCheckSt
      11 x ComSignal, all with ComSignalInitValue=0, ComSignalEndianness=LITTLE_ENDIAN, ComUpdateBitPosition=-1, ComTransferProperty=TRIGGERED:
        GW_TCM_CRC_30B: ComSignalType=UINT8, ComBitSize=8, ComBitPosition=0, ComNotification=Rte_COMCbk_GW_TCM_CRC_30B, ComSystemTemplateSystemSignalRef=GW_TCM_CRC_30B
        GW_TCM_RollingCounter_30B: ComSignalType=UINT8, ComBitSize=4, ComBitPosition=8, ComNotification=Rte_COMCbk_GW_TCM_RollingCounter_30B, ComSystemTemplateSystemSignalRef=GW_TCM_RollingCounter_30B
        GW_TCM_ParkingSwSts: ComSignalType=UINT8, ComBitSize=2, ComBitPosition=16, ComNotification=Rte_COMCbk_GW_TCM_ParkingSwSts, ComSystemTemplateSystemSignalRef=GW_TCM_ParkingSwSts
        GW_TCM_STATUS_Park: ComSignalType=BOOLEAN, ComBitSize=1, ComBitPosition=18, ComNotification=Rte_COMCbk_GW_TCM_STATUS_Park, ComSystemTemplateSystemSignalRef=GW_TCM_STATUS_Park
        GW_TCM_Counter_Park: ComSignalType=UINT8, ComBitSize=4, ComBitPosition=19, ComNotification=Rte_COMCbk_GW_TCM_Counter_Park, ComSystemTemplateSystemSignalRef=GW_TCM_Counter_Park
        GW_TCM_CRC_Park: ComSignalType=UINT8, ComBitSize=8, ComBitPosition=23, ComNotification=Rte_COMCbk_GW_TCM_CRC_Park, ComSystemTemplateSystemSignalRef=GW_TCM_CRC_Park
        GW_TCM_GearLevelSwitchSts: ComSignalType=UINT8, ComBitSize=3, ComBitPosition=31, ComNotification=Rte_COMCbk_GW_TCM_GearLevelSwitchSts, ComSystemTemplateSystemSignalRef=GW_TCM_GearLevelSwitchSts
        GW_TCM_STATUS_RND: ComSignalType=BOOLEAN, ComBitSize=1, ComBitPosition=34, ComNotification=Rte_COMCbk_GW_TCM_STATUS_RND, ComSystemTemplateSystemSignalRef=GW_TCM_STATUS_RND
        GW_TCM_Counter_RND: ComSignalType=UINT8, ComBitSize=4, ComBitPosition=35, ComNotification=Rte_COMCbk_GW_TCM_Counter_RND, ComSystemTemplateSystemSignalRef=GW_TCM_Counter_RND
        GW_TCM_CRC_RND: ComSignalType=UINT8, ComBitSize=8, ComBitPosition=39, ComNotification=Rte_COMCbk_GW_TCM_CRC_RND, ComSystemTemplateSystemSignalRef=GW_TCM_CRC_RND
        GW_TCM_SelfCheckSt: ComSignalType=BOOLEAN, ComBitSize=1, ComBitPosition=47, ComNotification=Rte_COMCbk_GW_TCM_SelfCheckSt, ComSystemTemplateSystemSignalRef=GW_TCM_SelfCheckSt
      BMS_0x1A1_P_CANFD (ComIPdu):
        ComIPduSignalProcessing = IMMEDIATE
        ComIPduType = NORMAL
        ComIPduDirection = RECEIVE
        ComIPduCallout = ComCallOut_BMS_0x1A1_P_CANFD
        ComIPduErrorNotification = ComCbk_RxTimeOut_BMS_0x1A1_P_CANFD
        ComFirstTimeout = 2.5
        ComTimeout = 0.5
        ComIPduGroupRef = ComIPduGroup_Rx
        ComPduIdRef = PduCollection/BMS_0x1A1_P_CANFD_PduR2Com
        ComIPduSignalRef = BMS_CRC_1A1
        ComIPduSignalRef = BMS_RollingCounter_1A1
        ComIPduSignalRef = BMS_Warning_Level
        ComIPduSignalRef = BMS_SelfCheck
        ComIPduSignalRef = BMS_BattChargerSts
        ComIPduSignalRef = BMS_RHighVolSts
        ComIPduSignalRef = BMS_RPreChargeRelayFB
        ComIPduSignalRef = BMS_RPositiveRelayFB
        ComIPduSignalRef = BMS_RNegativeRelayFB
        ComIPduSignalRef = BMS_RPositiveRelay_F
        ComIPduSignalRef = BMS_RNegativeRelay_F
        ComIPduSignalRef = BMS_RPreChargeFinishSts
        ComIPduSignalRef = BMS_MCUMHVILSts
        ComIPduSignalRef = BMS_ACPTCHVILSts
        ComIPduSignalRef = BMS_PTCHVILSts
        ComIPduSignalRef = BMS_CCMHVILSts
        ComIPduSignalRef = BMS_CDUHVILSts
        ComIPduSignalRef = BMS_DCChgHVILSts
        ComIPduSignalRef = BMS_MCUSHVILSts
        ComIPduSignalRef = BMS_HVOffSts
        ComIPduSignalRef = BMS_SeriousWarning_Level
        ComIPduSignalRef = BMS_DCChgRelayCloseReq
        ComIPduSignalRef = BMS_DCChgRelayFB
        ComIPduSignalRef = BMS_ChgStopReason
        ComIPduSignalRef = BMS_GCUHVILSts
        ComIPduSignalRef = BMS_MILlampReq
        ComIPduSignalRef = BMS_IsoRessistanceSts
        ComIPduSignalRef = BMS_Integrity_Check
        ComIPduSignalRef = BMS_BattVolt
        ComIPduSignalRef = BMS_BattCurr
        ComIPduSignalRef = BMS_BatDyn_Dchgpwr
        ComIPduSignalRef = BMS_BatDyn_Chgpwr
        ComIPduSignalRef = BMS_Precharge_CoolingSts
      33 x ComSignal, all with ComSignalInitValue=0, ComSignalEndianness=LITTLE_ENDIAN, ComUpdateBitPosition=-1, ComTransferProperty=TRIGGERED:
        BMS_CRC_1A1: ComSignalType=UINT8, ComBitSize=8, ComBitPosition=0, ComNotification=Rte_COMCbk_BMS_CRC_1A1, ComSystemTemplateSystemSignalRef=BMS_CRC_1A1
        BMS_RollingCounter_1A1: ComSignalType=UINT8, ComBitSize=4, ComBitPosition=8, ComNotification=Rte_COMCbk_BMS_RollingCounter_1A1, ComSystemTemplateSystemSignalRef=BMS_RollingCounter_1A1
        BMS_Warning_Level: ComSignalType=UINT8, ComBitSize=2, ComBitPosition=16, ComNotification=Rte_COMCbk_BMS_Warning_Level, ComSystemTemplateSystemSignalRef=BMS_Warning_Level
        BMS_SelfCheck: ComSignalType=UINT8, ComBitSize=2, ComBitPosition=18, ComNotification=Rte_COMCbk_BMS_SelfCheck, ComSystemTemplateSystemSignalRef=BMS_SelfCheck
        BMS_BattChargerSts: ComSignalType=UINT8, ComBitSize=3, ComBitPosition=20, ComNotification=Rte_COMCbk_BMS_BattChargerSts, ComSystemTemplateSystemSignalRef=BMS_BattChargerSts
        BMS_RHighVolSts: ComSignalType=BOOLEAN, ComBitSize=1, ComBitPosition=24, ComNotification=Rte_COMCbk_BMS_RHighVolSts, ComSystemTemplateSystemSignalRef=BMS_RHighVolSts
        BMS_RPreChargeRelayFB: ComSignalType=BOOLEAN, ComBitSize=1, ComBitPosition=25, ComNotification=Rte_COMCbk_BMS_RPreChargeRelayFB, ComSystemTemplateSystemSignalRef=BMS_RPreChargeRelayFB
        BMS_RPositiveRelayFB: ComSignalType=BOOLEAN, ComBitSize=1, ComBitPosition=26, ComNotification=Rte_COMCbk_BMS_RPositiveRelayFB, ComSystemTemplateSystemSignalRef=BMS_RPositiveRelayFB
        BMS_RNegativeRelayFB: ComSignalType=BOOLEAN, ComBitSize=1, ComBitPosition=27, ComNotification=Rte_COMCbk_BMS_RNegativeRelayFB, ComSystemTemplateSystemSignalRef=BMS_RNegativeRelayFB
        BMS_RPositiveRelay_F: ComSignalType=BOOLEAN, ComBitSize=1, ComBitPosition=28, ComNotification=Rte_COMCbk_BMS_RPositiveRelay_F, ComSystemTemplateSystemSignalRef=BMS_RPositiveRelay_F
        BMS_RNegativeRelay_F: ComSignalType=BOOLEAN, ComBitSize=1, ComBitPosition=29, ComNotification=Rte_COMCbk_BMS_RNegativeRelay_F, ComSystemTemplateSystemSignalRef=BMS_RNegativeRelay_F
        BMS_RPreChargeFinishSts: ComSignalType=UINT8, ComBitSize=2, ComBitPosition=30, ComNotification=Rte_COMCbk_BMS_RPreChargeFinishSts, ComSystemTemplateSystemSignalRef=BMS_RPreChargeFinishSts
        BMS_MCUMHVILSts: ComSignalType=BOOLEAN, ComBitSize=1, ComBitPosition=40, ComNotification=Rte_COMCbk_BMS_MCUMHVILSts, ComSystemTemplateSystemSignalRef=BMS_MCUMHVILSts
        BMS_ACPTCHVILSts: ComSignalType=BOOLEAN, ComBitSize=1, ComBitPosition=41, ComNotification=Rte_COMCbk_BMS_ACPTCHVILSts, ComSystemTemplateSystemSignalRef=BMS_ACPTCHVILSts
        BMS_PTCHVILSts: ComSignalType=BOOLEAN, ComBitSize=1, ComBitPosition=42, ComNotification=Rte_COMCbk_BMS_PTCHVILSts, ComSystemTemplateSystemSignalRef=BMS_PTCHVILSts
        BMS_CCMHVILSts: ComSignalType=BOOLEAN, ComBitSize=1, ComBitPosition=43, ComNotification=Rte_COMCbk_BMS_CCMHVILSts, ComSystemTemplateSystemSignalRef=BMS_CCMHVILSts
        BMS_CDUHVILSts: ComSignalType=BOOLEAN, ComBitSize=1, ComBitPosition=44, ComNotification=Rte_COMCbk_BMS_CDUHVILSts, ComSystemTemplateSystemSignalRef=BMS_CDUHVILSts
        BMS_DCChgHVILSts: ComSignalType=BOOLEAN, ComBitSize=1, ComBitPosition=45, ComNotification=Rte_COMCbk_BMS_DCChgHVILSts, ComSystemTemplateSystemSignalRef=BMS_DCChgHVILSts
        BMS_MCUSHVILSts: ComSignalType=BOOLEAN, ComBitSize=1, ComBitPosition=46, ComNotification=Rte_COMCbk_BMS_MCUSHVILSts, ComSystemTemplateSystemSignalRef=BMS_MCUSHVILSts
        BMS_HVOffSts: ComSignalType=BOOLEAN, ComBitSize=1, ComBitPosition=47, ComNotification=Rte_COMCbk_BMS_HVOffSts, ComSystemTemplateSystemSignalRef=BMS_HVOffSts
        BMS_SeriousWarning_Level: ComSignalType=UINT8, ComBitSize=2, ComBitPosition=48, ComNotification=Rte_COMCbk_BMS_SeriousWarning_Level, ComSystemTemplateSystemSignalRef=BMS_SeriousWarning_Level
        BMS_DCChgRelayCloseReq: ComSignalType=BOOLEAN, ComBitSize=1, ComBitPosition=50, ComNotification=Rte_COMCbk_BMS_DCChgRelayCloseReq, ComSystemTemplateSystemSignalRef=BMS_DCChgRelayCloseReq
        BMS_DCChgRelayFB: ComSignalType=BOOLEAN, ComBitSize=1, ComBitPosition=56, ComNotification=Rte_COMCbk_BMS_DCChgRelayFB, ComSystemTemplateSystemSignalRef=BMS_DCChgRelayFB
        BMS_ChgStopReason: ComSignalType=UINT8, ComBitSize=6, ComBitPosition=57, ComNotification=Rte_COMCbk_BMS_ChgStopReason, ComSystemTemplateSystemSignalRef=BMS_ChgStopReason
        BMS_GCUHVILSts: ComSignalType=BOOLEAN, ComBitSize=1, ComBitPosition=65, ComNotification=Rte_COMCbk_BMS_GCUHVILSts, ComSystemTemplateSystemSignalRef=BMS_GCUHVILSts
        BMS_MILlampReq: ComSignalType=BOOLEAN, ComBitSize=1, ComBitPosition=66, ComNotification=Rte_COMCbk_BMS_MILlampReq, ComSystemTemplateSystemSignalRef=BMS_MILlampReq
        BMS_IsoRessistanceSts: ComSignalType=BOOLEAN, ComBitSize=1, ComBitPosition=67, ComNotification=Rte_COMCbk_BMS_IsoRessistanceSts, ComSystemTemplateSystemSignalRef=BMS_IsoRessistanceSts
        BMS_Integrity_Check: ComSignalType=BOOLEAN, ComBitSize=1, ComBitPosition=70, ComNotification=Rte_COMCbk_BMS_Integrity_Check, ComSystemTemplateSystemSignalRef=BMS_Integrity_Check
        BMS_BattVolt: ComSignalType=UINT16, ComBitSize=16, ComBitPosition=72, ComNotification=Rte_COMCbk_BMS_BattVolt, ComSystemTemplateSystemSignalRef=BMS_BattVolt
        BMS_BattCurr: ComSignalType=UINT16, ComBitSize=16, ComBitPosition=88, ComNotification=Rte_COMCbk_BMS_BattCurr, ComSystemTemplateSystemSignalRef=BMS_BattCurr
        BMS_BatDyn_Dchgpwr: ComSignalType=UINT16, ComBitSize=13, ComBitPosition=104, ComNotification=Rte_COMCbk_BMS_BatDyn_Dchgpwr, ComSystemTemplateSystemSignalRef=BMS_BatDyn_Dchgpwr
        BMS_BatDyn_Chgpwr: ComSignalType=UINT16, ComBitSize=13, ComBitPosition=120, ComNotification=Rte_COMCbk_BMS_BatDyn_Chgpwr, ComSystemTemplateSystemSignalRef=BMS_BatDyn_Chgpwr
        BMS_Precharge_CoolingSts: ComSignalType=UINT8, ComBitSize=2, ComBitPosition=254, ComNotification=Rte_COMCbk_BMS_Precharge_CoolingSts, ComSystemTemplateSystemSignalRef=BMS_Precharge_CoolingSts
      MCUS_0xDB_P_CANFD (ComIPdu):
        ComIPduSignalProcessing = IMMEDIATE
        ComIPduType = NORMAL
        ComIPduDirection = RECEIVE
        ComIPduCallout = ComCallOut_MCUS_0xDB_P_CANFD
        ComIPduErrorNotification = ComCbk_RxTimeOut_MCUS_0xDB_P_CANFD
        ComFirstTimeout = 2.1
        ComTimeout = 0.1
        ComIPduGroupRef = ComIPduGroup_Rx
        ComPduIdRef = PduCollection/MCUS_0xDB_P_CANFD_PduR2Com
        ComIPduSignalRef = MCUS_CRC_DB
        ComIPduSignalRef = MCUS_Clutch_2_Fault
        ComIPduSignalRef = MCUS_Clutch_1_Fault
        ComIPduSignalRef = MCUS_Clutch_2_WarningLevel
        ComIPduSignalRef = MCUS_Clutch_1_WarningLevel
        ComIPduSignalRef = MCUS_Clutch_2_Pos
        ComIPduSignalRef = MCUS_Clutch_1_Pos
        ComIPduSignalRef = MCUS_RollingCounter_DB
        ComIPduSignalRef = MCUS_WarningLevel
        ComIPduSignalRef = MCUS_SelfCheckSts
        ComIPduSignalRef = MCUS_DrvMotorWorkSts
        ComIPduSignalRef = MCUS_PowerReduceSts
        ComIPduSignalRef = MCUS_DrvMotorRPM
        ComIPduSignalRef = MCUS_ActualTorqueFB
        ComIPduSignalRef = MCUS_HWRdcFault
        ComIPduSignalRef = MCUS_HighVoltPowerOffReq
        ComIPduSignalRef = MCUS_HVILSts
        ComIPduSignalRef = MCUS_DragSts
        ComIPduSignalRef = MCUS_CtrlMode
        ComIPduSignalRef = MCUS_MILlampReq
        ComIPduSignalRef = MCUS_DrvMotorRPMVD
        ComIPduSignalRef = MCUS_ActualTorqueFBVD
        ComIPduSignalRef = MCUS_MaxTorqueAllow
        ComIPduSignalRef = MCUS_MaxSpeedAllow
        ComIPduSignalRef = MCUS_ActiveReleaseSts
        ComIPduSignalRef = MCUS_MinTorqueAllow
        ComIPduSignalRef = MCUS_MainWireVolt
        ComIPduSignalRef = MCUS_MainWireCurr
        ComIPduSignalRef = MCUS_Clutch_Pos
        ComIPduSignalRef = MCUS_Clutch_Fault
        ComIPduSignalRef = MCUS_TMS_FrMotSelfHeatEnSts
        ComIPduSignalRef = MCUS_TMS_FrMotSelfHeatLvlFb
        ComIPduSignalRef = MCUS_HeatPwrAval
        ComIPduSignalRef = MCUS_SystemError
        ComIPduSignalRef = MCUS_LVSystemError
        ComIPduSignalRef = MCUS_MotorTempAlarm
        ComIPduSignalRef = MCUS_HVSystemError
        ComIPduSignalRef = MCUS_SeriousWarning_Level
        ComIPduSignalRef = MCUS_CtrlModeVD
        ComIPduSignalRef = MCUS_WaterPumpLevlReq
        ComIPduSignalRef = MCUS_MotorTemp
        ComIPduSignalRef = MCUS_IGBTTemp
        ComIPduSignalRef = MCUS_InletTemp
      33 x ComSignal, all with ComSignalInitValue=0, ComSignalEndianness=LITTLE_ENDIAN, ComUpdateBitPosition=-1, ComTransferProperty=TRIGGERED:
        MCUS_CRC_DB: ComSignalType=UINT8, ComBitSize=8, ComBitPosition=0, ComNotification=Rte_COMCbk_MCUS_CRC_DB, ComSystemTemplateSystemSignalRef=MCUS_CRC_DB
        MCUS_Clutch_2_Fault: ComSignalType=UINT16, ComBitSize=10, ComBitPosition=220, ComNotification=Rte_COMCbk_MCUS_Clutch_2_Fault, ComSystemTemplateSystemSignalRef=MCUS_Clutch_2_Fault
        MCUS_Clutch_1_Fault: ComSignalType=UINT16, ComBitSize=10, ComBitPosition=210, ComNotification=Rte_COMCbk_MCUS_Clutch_1_Fault, ComSystemTemplateSystemSignalRef=MCUS_Clutch_1_Fault
        MCUS_Clutch_2_WarningLevel: ComSignalType=UINT8, ComBitSize=2, ComBitPosition=208, ComNotification=Rte_COMCbk_MCUS_Clutch_2_WarningLevel, ComSystemTemplateSystemSignalRef=MCUS_Clutch_2_WarningLevel
        MCUS_Clutch_1_WarningLevel: ComSignalType=UINT8, ComBitSize=2, ComBitPosition=206, ComNotification=Rte_COMCbk_MCUS_Clutch_1_WarningLevel, ComSystemTemplateSystemSignalRef=MCUS_Clutch_1_WarningLevel
        MCUS_Clutch_2_Pos: ComSignalType=UINT8, ComBitSize=3, ComBitPosition=203, ComNotification=Rte_COMCbk_MCUS_Clutch_2_Pos, ComSystemTemplateSystemSignalRef=MCUS_Clutch_2_Pos
        MCUS_Clutch_1_Pos: ComSignalType=UINT8, ComBitSize=3, ComBitPosition=200, ComNotification=Rte_COMCbk_MCUS_Clutch_1_Pos, ComSystemTemplateSystemSignalRef=MCUS_Clutch_1_Pos
        MCUS_RollingCounter_DB: ComSignalType=UINT8, ComBitSize=4, ComBitPosition=8, ComNotification=Rte_COMCbk_MCUS_RollingCounter_DB, ComSystemTemplateSystemSignalRef=MCUS_RollingCounter_DB
        MCUS_WarningLevel: ComSignalType=UINT8, ComBitSize=2, ComBitPosition=16, ComNotification=Rte_COMCbk_MCUS_WarningLevel, ComSystemTemplateSystemSignalRef=MCUS_WarningLevel
        MCUS_SelfCheckSts: ComSignalType=UINT8, ComBitSize=2, ComBitPosition=18, ComNotification=Rte_COMCbk_MCUS_SelfCheckSts, ComSystemTemplateSystemSignalRef=MCUS_SelfCheckSts
        MCUS_DrvMotorWorkSts: ComSignalType=UINT8, ComBitSize=2, ComBitPosition=20, ComNotification=Rte_COMCbk_MCUS_DrvMotorWorkSts, ComSystemTemplateSystemSignalRef=MCUS_DrvMotorWorkSts
        MCUS_PowerReduceSts: ComSignalType=BOOLEAN, ComBitSize=1, ComBitPosition=22, ComNotification=Rte_COMCbk_MCUS_PowerReduceSts, ComSystemTemplateSystemSignalRef=MCUS_PowerReduceSts
        MCUS_DrvMotorRPM: ComSignalType=UINT16, ComBitSize=16, ComBitPosition=24, ComNotification=Rte_COMCbk_MCUS_DrvMotorRPM, ComSystemTemplateSystemSignalRef=MCUS_DrvMotorRPM
        MCUS_ActualTorqueFB: ComSignalType=UINT16, ComBitSize=16, ComBitPosition=40, ComNotification=Rte_COMCbk_MCUS_ActualTorqueFB, ComSystemTemplateSystemSignalRef=MCUS_ActualTorqueFB
        MCUS_HWRdcFault: ComSignalType=BOOLEAN, ComBitSize=1, ComBitPosition=56, ComNotification=Rte_COMCbk_MCUS_HWRdcFault, ComSystemTemplateSystemSignalRef=MCUS_HWRdcFault
        MCUS_HighVoltPowerOffReq: ComSignalType=BOOLEAN, ComBitSize=1, ComBitPosition=58, ComNotification=Rte_COMCbk_MCUS_HighVoltPowerOffReq, ComSystemTemplateSystemSignalRef=MCUS_HighVoltPowerOffReq
        MCUS_HVILSts: ComSignalType=BOOLEAN, ComBitSize=1, ComBitPosition=59, ComNotification=Rte_COMCbk_MCUS_HVILSts, ComSystemTemplateSystemSignalRef=MCUS_HVILSts
        MCUS_DragSts: ComSignalType=UINT8, ComBitSize=2, ComBitPosition=60, ComNotification=Rte_COMCbk_MCUS_DragSts, ComSystemTemplateSystemSignalRef=MCUS_DragSts
        MCUS_CtrlMode: ComSignalType=BOOLEAN, ComBitSize=1, ComBitPosition=62, ComNotification=Rte_COMCbk_MCUS_CtrlMode, ComSystemTemplateSystemSignalRef=MCUS_CtrlMode
        MCUS_MILlampReq: ComSignalType=BOOLEAN, ComBitSize=1, ComBitPosition=65, ComNotification=Rte_COMCbk_MCUS_MILlampReq, ComSystemTemplateSystemSignalRef=MCUS_MILlampReq
        MCUS_DrvMotorRPMVD: ComSignalType=BOOLEAN, ComBitSize=1, ComBitPosition=68, ComNotification=Rte_COMCbk_MCUS_DrvMotorRPMVD, ComSystemTemplateSystemSignalRef=MCUS_DrvMotorRPMVD
        MCUS_ActualTorqueFBVD: ComSignalType=BOOLEAN, ComBitSize=1, ComBitPosition=69, ComNotification=Rte_COMCbk_MCUS_ActualTorqueFBVD, ComSystemTemplateSystemSignalRef=MCUS_ActualTorqueFBVD
        MCUS_MaxTorqueAllow: ComSignalType=UINT16, ComBitSize=16, ComBitPosition=72, ComNotification=Rte_COMCbk_MCUS_MaxTorqueAllow, ComSystemTemplateSystemSignalRef=MCUS_MaxTorqueAllow
        MCUS_MaxSpeedAllow: ComSignalType=UINT16, ComBitSize=16, ComBitPosition=88, ComNotification=Rte_COMCbk_MCUS_MaxSpeedAllow, ComSystemTemplateSystemSignalRef=MCUS_MaxSpeedAllow
        MCUS_ActiveReleaseSts: ComSignalType=UINT8, ComBitSize=2, ComBitPosition=108, ComNotification=Rte_COMCbk_MCUS_ActiveReleaseSts, ComSystemTemplateSystemSignalRef=MCUS_ActiveReleaseSts
        MCUS_MinTorqueAllow: ComSignalType=UINT16, ComBitSize=16, ComBitPosition=112, ComNotification=Rte_COMCbk_MCUS_MinTorqueAllow, ComSystemTemplateSystemSignalRef=MCUS_MinTorqueAllow
        MCUS_MainWireVolt: ComSignalType=UINT16, ComBitSize=16, ComBitPosition=128, ComNotification=Rte_COMCbk_MCUS_MainWireVolt, ComSystemTemplateSystemSignalRef=MCUS_MainWireVolt
        MCUS_MainWireCurr: ComSignalType=UINT16, ComBitSize=16, ComBitPosition=168, ComNotification=Rte_COMCbk_MCUS_MainWireCurr, ComSystemTemplateSystemSignalRef=MCUS_MainWireCurr
        MCUS_Clutch_Pos: ComSignalType=UINT8, ComBitSize=3, ComBitPosition=184, ComNotification=Rte_COMCbk_MCUS_Clutch_Pos, ComSystemTemplateSystemSignalRef=MCUS_Clutch_Pos
        MCUS_Clutch_Fault: ComSignalType=UINT8, ComBitSize=4, ComBitPosition=187, ComNotification=Rte_COMCbk_MCUS_Clutch_Fault, ComSystemTemplateSystemSignalRef=MCUS_Clutch_Fault
        MCUS_TMS_FrMotSelfHeatEnSts: ComSignalType=UINT8, ComBitSize=1, ComBitPosition=191, ComNotification=Rte_COMCbk_MCUS_TMS_FrMotSelfHeatEnSts, ComSystemTemplateSystemSignalRef=MCUS_TMS_FrMotSelfHeatEnSts
        MCUS_TMS_FrMotSelfHeatLvlFb: ComSignalType=UINT8, ComBitSize=3, ComBitPosition=192, ComNotification=Rte_COMCbk_MCUS_TMS_FrMotSelfHeatLvlFb, ComSystemTemplateSystemSignalRef=MCUS_TMS_FrMotSelfHeatLvlFb
        MCUS_HeatPwrAval: ComSignalType=UINT8, ComBitSize=5, ComBitPosition=195, ComNotification=Rte_COMCbk_MCUS_HeatPwrAval, ComSystemTemplateSystemSignalRef=MCUS_HeatPwrAval
      ECM_0x5EC_P_CANFD (ComIPdu):
        ComIPduSignalProcessing = IMMEDIATE
        ComIPduType = NORMAL
        ComIPduDirection = RECEIVE
        ComIPduGroupRef = ComIPduGroup_Rx
        ComPduIdRef = PduCollection/ECM_0x5EC_P_CANFD_PduR2Com
        ComIPduSignalRef = ECM_EngineWorktime
      ECM_EngineWorktime (ComSignal):
        ComSignalInitValue = 0
        ComSignalType = UINT16
        ComSignalEndianness = LITTLE_ENDIAN
        ComBitSize = 16
        ComBitPosition = 32
        ComUpdateBitPosition = -1
        ComTransferProperty = TRIGGERED
        ComNotification = Rte_COMCbk_ECM_EngineWorktime
        ComSystemTemplateSystemSignalRef = ECM_EngineWorktime
      ECM_0x147_P_CANFD (ComIPdu):
        ComIPduSignalProcessing = IMMEDIATE
        ComIPduType = NORMAL
        ComIPduDirection = RECEIVE
        ComIPduGroupRef = ComIPduGroup_Rx
        ComPduIdRef = PduCollection/ECM_0x147_P_CANFD_PduR2Com
        ComIPduSignalRef = ECM_FuelConsumption
      ECM_FuelConsumption (ComSignal):
        ComSignalInitValue = 0
        ComSignalType = UINT8
        ComSignalEndianness = LITTLE_ENDIAN
        ComBitSize = 8
        ComBitPosition = 232
        ComUpdateBitPosition = -1
        ComTransferProperty = TRIGGERED
        ComNotification = Rte_COMCbk_ECM_FuelConsumption
        ComSystemTemplateSystemSignalRef = ECM_FuelConsumption
      HPCBCM_0x1E4_P_CANFD (ComIPdu):
        ComIPduSignalProcessing = IMMEDIATE
        ComIPduType = NORMAL
        ComIPduDirection = RECEIVE
        ComIPduCallout = ComCallOut_HPCBCM_0x1E4_P_CANFD
        ComIPduGroupRef = ComIPduGroup_Rx
        ComPduIdRef = PduCollection/HPCBCM_0x1E4_P_CANFD_PduR2Com
        ComIPduSignalRef = BCM_VCU_Authentication_Challenge_A{0..3}
      4 x ComSignal, all with ComSignalInitValue=0, ComSignalType=UINT8, ComSignalEndianness=LITTLE_ENDIAN, ComBitSize=8, ComUpdateBitPosition=-1, ComTransferProperty=TRIGGERED:
        BCM_VCU_Authentication_Challenge_A0: ComBitPosition=0, ComNotification=Rte_COMCbk_BCM_VCU_Authentication_Challenge_A0, ComSystemTemplateSystemSignalRef=BCM_VCU_Authentication_Challenge_A0
        BCM_VCU_Authentication_Challenge_A1: ComBitPosition=8, ComNotification=Rte_COMCbk_BCM_VCU_Authentication_Challenge_A1, ComSystemTemplateSystemSignalRef=BCM_VCU_Authentication_Challenge_A1
        BCM_VCU_Authentication_Challenge_A2: ComBitPosition=16, ComNotification=Rte_COMCbk_BCM_VCU_Authentication_Challenge_A2, ComSystemTemplateSystemSignalRef=BCM_VCU_Authentication_Challenge_A2
        BCM_VCU_Authentication_Challenge_A3: ComBitPosition=24, ComNotification=Rte_COMCbk_BCM_VCU_Authentication_Challenge_A3, ComSystemTemplateSystemSignalRef=BCM_VCU_Authentication_Challenge_A3
      VCU_0x1_P_CANFD (ComIPdu):
        ComIPduSignalProcessing = IMMEDIATE
        ComIPduType = NORMAL
        ComIPduDirection = RECEIVE
        ComIPduCallout = ComCallOut_VCU_0x1_P_CANFD
        ComIPduGroupRef = ComIPduGroup_Rx
        ComPduIdRef = PduCollection/VCU_0x1_P_CANFD_PduR2Com
        ComIPduSignalRef = EOL_CRC_13B
        ComIPduSignalRef = EOL_RollingCounter_13B
        ComIPduSignalRef = EOL_VehicleSts
        ComIPduSignalRef = EOL_GearLevelPosSts
        ComIPduSignalRef = EOL_GearLeverValid
        ComIPduSignalRef = EOL_AccPedalValid
        ComIPduSignalRef = EOL_ThrottlePosition
        ComIPduSignalRef = EOL_RMCUActiveReleaseCmd
        ComIPduSignalRef = EOL_VehicleDirect
        ComIPduSignalRef = EOL_SuppressJitterRMCURequest
        ComIPduSignalRef = EOL_RDrvControlMode
        ComIPduSignalRef = EOL_BrakePedalValue
        ComIPduSignalRef = EOL_RMCUMaxDischargePower
        ComIPduSignalRef = EOL_RMCUMaxChargePower
        ComIPduSignalRef = EOL_RDrvRequestTorque
        ComIPduSignalRef = EOL_RDrvRequesSpeed
        ComIPduSignalRef = EOL_FDrvRequestTorque
        ComIPduSignalRef = EOL_FDrvRequesSpeed
        ComIPduSignalRef = EOL_FVehicleSts
        ComIPduSignalRef = EOL_FDrvControlMode
        ComIPduSignalRef = EOL_ON2BRelayReq
        ComIPduSignalRef = EOL_VehicleDirectVD
        ComIPduSignalRef = EOL_RDrvControlModeVD
        ComIPduSignalRef = EOL_RDrvRequestTorqueVD
        ComIPduSignalRef = EOL_RDrvRequesSpeedVD
        ComIPduSignalRef = EOL_FDrvRequestTorqueVD
        ComIPduSignalRef = EOL_FDrvRequesSpeedVD
        ComIPduSignalRef = EOL_FDrvControlModeVD
        ComIPduSignalRef = EOL_MCUMDampgLmtFactor
        ComIPduSignalRef = EOL_VCU_BoostMode_Fail
        ComIPduSignalRef = EOL_VCU_BoostModeSts
        ComIPduSignalRef = EOL_MCUMMaxPosDampgTrq
        ComIPduSignalRef = EOL_MCUMMaxNegDampgTrq
      33 x ComSignal, all with ComSignalEndianness=LITTLE_ENDIAN, ComUpdateBitPosition=-1, ComTransferProperty=TRIGGERED:
        EOL_CRC_13B: ComSignalInitValue=0, ComSignalType=UINT8, ComBitSize=8, ComBitPosition=0, ComNotification=Rte_COMCbk_EOL_CRC_13B, ComSystemTemplateSystemSignalRef=EOL_CRC_13B
        EOL_RollingCounter_13B: ComSignalInitValue=0, ComSignalType=UINT8, ComBitSize=4, ComBitPosition=8, ComNotification=Rte_COMCbk_EOL_RollingCounter_13B, ComSystemTemplateSystemSignalRef=EOL_RollingCounter_13B
        EOL_VehicleSts: ComSignalInitValue=0, ComSignalType=BOOLEAN, ComBitSize=1, ComBitPosition=18, ComNotification=Rte_COMCbk_EOL_VehicleSts, ComSystemTemplateSystemSignalRef=EOL_VehicleSts
        EOL_GearLevelPosSts: ComSignalInitValue=0, ComSignalType=UINT8, ComBitSize=2, ComBitPosition=19, ComNotification=Rte_COMCbk_EOL_GearLevelPosSts, ComSystemTemplateSystemSignalRef=EOL_GearLevelPosSts
        EOL_GearLeverValid: ComSignalInitValue=0, ComSignalType=BOOLEAN, ComBitSize=1, ComBitPosition=21, ComNotification=Rte_COMCbk_EOL_GearLeverValid, ComSystemTemplateSystemSignalRef=EOL_GearLeverValid
        EOL_AccPedalValid: ComSignalInitValue=0, ComSignalType=BOOLEAN, ComBitSize=1, ComBitPosition=23, ComNotification=Rte_COMCbk_EOL_AccPedalValid, ComSystemTemplateSystemSignalRef=EOL_AccPedalValid
        EOL_ThrottlePosition: ComSignalInitValue=0, ComSignalType=UINT8, ComBitSize=8, ComBitPosition=24, ComNotification=Rte_COMCbk_EOL_ThrottlePosition, ComSystemTemplateSystemSignalRef=EOL_ThrottlePosition
        EOL_RMCUActiveReleaseCmd: ComSignalInitValue=0, ComSignalType=BOOLEAN, ComBitSize=1, ComBitPosition=35, ComNotification=Rte_COMCbk_EOL_RMCUActiveReleaseCmd, ComSystemTemplateSystemSignalRef=EOL_RMCUActiveReleaseCmd
        EOL_VehicleDirect: ComSignalInitValue=0, ComSignalType=BOOLEAN, ComBitSize=1, ComBitPosition=44, ComNotification=Rte_COMCbk_EOL_VehicleDirect, ComSystemTemplateSystemSignalRef=EOL_VehicleDirect
        EOL_SuppressJitterRMCURequest: ComSignalInitValue=0, ComSignalType=BOOLEAN, ComBitSize=1, ComBitPosition=46, ComNotification=Rte_COMCbk_EOL_SuppressJitterRMCURequest, ComSystemTemplateSystemSignalRef=EOL_SuppressJitterRMCURequest
        EOL_RDrvControlMode: ComSignalInitValue=0, ComSignalType=BOOLEAN, ComBitSize=1, ComBitPosition=47, ComNotification=Rte_COMCbk_EOL_RDrvControlMode, ComSystemTemplateSystemSignalRef=EOL_RDrvControlMode
        EOL_BrakePedalValue: ComSignalInitValue=0, ComSignalType=UINT8, ComBitSize=8, ComBitPosition=48, ComNotification=Rte_COMCbk_EOL_BrakePedalValue, ComSystemTemplateSystemSignalRef=EOL_BrakePedalValue
        EOL_RMCUMaxDischargePower: ComSignalInitValue=0, ComSignalType=UINT16, ComBitSize=9, ComBitPosition=56, ComNotification=Rte_COMCbk_EOL_RMCUMaxDischargePower, ComSystemTemplateSystemSignalRef=EOL_RMCUMaxDischargePower
        EOL_RMCUMaxChargePower: ComSignalInitValue=0, ComSignalType=UINT16, ComBitSize=9, ComBitPosition=71, ComNotification=Rte_COMCbk_EOL_RMCUMaxChargePower, ComSystemTemplateSystemSignalRef=EOL_RMCUMaxChargePower
        EOL_RDrvRequestTorque: ComSignalInitValue=0.0, ComSignalType=UINT16, ComBitSize=16, ComBitPosition=80, ComNotification=Rte_COMCbk_EOL_RDrvRequestTorque, ComSystemTemplateSystemSignalRef=EOL_RDrvRequestTorque
        EOL_RDrvRequesSpeed: ComSignalInitValue=0, ComSignalType=UINT16, ComBitSize=16, ComBitPosition=96, ComNotification=Rte_COMCbk_EOL_RDrvRequesSpeed, ComSystemTemplateSystemSignalRef=EOL_RDrvRequesSpeed
        EOL_FDrvRequestTorque: ComSignalInitValue=0, ComSignalType=UINT16, ComBitSize=16, ComBitPosition=112, ComNotification=Rte_COMCbk_EOL_FDrvRequestTorque, ComSystemTemplateSystemSignalRef=EOL_FDrvRequestTorque
        EOL_FDrvRequesSpeed: ComSignalInitValue=0, ComSignalType=UINT16, ComBitSize=16, ComBitPosition=128, ComNotification=Rte_COMCbk_EOL_FDrvRequesSpeed, ComSystemTemplateSystemSignalRef=EOL_FDrvRequesSpeed
        EOL_FVehicleSts: ComSignalInitValue=0, ComSignalType=BOOLEAN, ComBitSize=1, ComBitPosition=144, ComNotification=Rte_COMCbk_EOL_FVehicleSts, ComSystemTemplateSystemSignalRef=EOL_FVehicleSts
        EOL_FDrvControlMode: ComSignalInitValue=0, ComSignalType=BOOLEAN, ComBitSize=1, ComBitPosition=148, ComNotification=Rte_COMCbk_EOL_FDrvControlMode, ComSystemTemplateSystemSignalRef=EOL_FDrvControlMode
        EOL_ON2BRelayReq: ComSignalInitValue=0, ComSignalType=UINT8, ComBitSize=2, ComBitPosition=149, ComNotification=Rte_COMCbk_EOL_ON2BRelayReq, ComSystemTemplateSystemSignalRef=EOL_ON2BRelayReq
        EOL_VehicleDirectVD: ComSignalInitValue=0, ComSignalType=BOOLEAN, ComBitSize=1, ComBitPosition=177, ComNotification=Rte_COMCbk_EOL_VehicleDirectVD, ComSystemTemplateSystemSignalRef=EOL_VehicleDirectVD
        EOL_RDrvControlModeVD: ComSignalInitValue=0, ComSignalType=BOOLEAN, ComBitSize=1, ComBitPosition=178, ComNotification=Rte_COMCbk_EOL_RDrvControlModeVD, ComSystemTemplateSystemSignalRef=EOL_RDrvControlModeVD
        EOL_RDrvRequestTorqueVD: ComSignalInitValue=0, ComSignalType=BOOLEAN, ComBitSize=1, ComBitPosition=179, ComNotification=Rte_COMCbk_EOL_RDrvRequestTorqueVD, ComSystemTemplateSystemSignalRef=EOL_RDrvRequestTorqueVD
        EOL_RDrvRequesSpeedVD: ComSignalInitValue=0, ComSignalType=BOOLEAN, ComBitSize=1, ComBitPosition=180, ComNotification=Rte_COMCbk_EOL_RDrvRequesSpeedVD, ComSystemTemplateSystemSignalRef=EOL_RDrvRequesSpeedVD
        EOL_FDrvRequestTorqueVD: ComSignalInitValue=0, ComSignalType=BOOLEAN, ComBitSize=1, ComBitPosition=181, ComNotification=Rte_COMCbk_EOL_FDrvRequestTorqueVD, ComSystemTemplateSystemSignalRef=EOL_FDrvRequestTorqueVD
        EOL_FDrvRequesSpeedVD: ComSignalInitValue=0, ComSignalType=BOOLEAN, ComBitSize=1, ComBitPosition=182, ComNotification=Rte_COMCbk_EOL_FDrvRequesSpeedVD, ComSystemTemplateSystemSignalRef=EOL_FDrvRequesSpeedVD
        EOL_FDrvControlModeVD: ComSignalInitValue=0, ComSignalType=BOOLEAN, ComBitSize=1, ComBitPosition=183, ComNotification=Rte_COMCbk_EOL_FDrvControlModeVD, ComSystemTemplateSystemSignalRef=EOL_FDrvControlModeVD
        EOL_MCUMDampgLmtFactor: ComSignalInitValue=0, ComSignalType=UINT8, ComBitSize=7, ComBitPosition=202, ComNotification=Rte_COMCbk_EOL_MCUMDampgLmtFactor, ComSystemTemplateSystemSignalRef=EOL_MCUMDampgLmtFactor
        EOL_VCU_BoostMode_Fail: ComSignalInitValue=0, ComSignalType=UINT8, ComBitSize=3, ComBitPosition=221, ComNotification=Rte_COMCbk_EOL_VCU_BoostMode_Fail, ComSystemTemplateSystemSignalRef=EOL_VCU_BoostMode_Fail
        EOL_VCU_BoostModeSts: ComSignalInitValue=0, ComSignalType=UINT8, ComBitSize=2, ComBitPosition=224, ComNotification=Rte_COMCbk_EOL_VCU_BoostModeSts, ComSystemTemplateSystemSignalRef=EOL_VCU_BoostModeSts
        EOL_MCUMMaxPosDampgTrq: ComSignalInitValue=0, ComSignalType=UINT8, ComBitSize=6, ComBitPosition=244, ComNotification=Rte_COMCbk_EOL_MCUMMaxPosDampgTrq, ComSystemTemplateSystemSignalRef=EOL_MCUMMaxPosDampgTrq
        EOL_MCUMMaxNegDampgTrq: ComSignalInitValue=0, ComSignalType=UINT8, ComBitSize=6, ComBitPosition=250, ComNotification=Rte_COMCbk_EOL_MCUMMaxNegDampgTrq, ComSystemTemplateSystemSignalRef=EOL_MCUMMaxNegDampgTrq
      VCU_0x3_P_CANFD (ComIPdu):
        ComIPduSignalProcessing = IMMEDIATE
        ComIPduType = NORMAL
        ComIPduDirection = RECEIVE
        ComIPduCallout = ComCallOut_VCU_0x3_P_CANFD
        ComIPduGroupRef = ComIPduGroup_Rx
        ComPduIdRef = PduCollection/VCU_0x3_P_CANFD_PduR2Com
        ComIPduSignalRef = EOL_VCU_BrkPedOpen
        ComIPduSignalRef = EOL_VCU_BrkPedClose
        ComIPduSignalRef = EOL_VCU_ColumnShiftP
        ComIPduSignalRef = EOL_VCU_VehiCrashSts
        ComIPduSignalRef = EOL_VCU_SleepSatisfiedSts
        ComIPduSignalRef = EOL_VCU_VehiHvCmd
        ComIPduSignalRef = EOL_VCU_GearQuitAps
        ComIPduSignalRef = EOL_VCU_REOverChgPwrFlag
        ComIPduSignalRef = EOL_VCU_VehiAccnFilt
        ComIPduSignalRef = EOL_VCU_HvOffSts
        ComIPduSignalRef = EOL_VCU_ElecPwrBalanceReq
        ComIPduSignalRef = EOL_VCU_CDU_RecvTr
        ComIPduSignalRef = EOL_VCU_BMS_RecvTr
        ComIPduSignalRef = EOL_VCU_IVI_RecvTr
        ComIPduSignalRef = EOL_VCU_WheelMaxDrvTrq
        ComIPduSignalRef = EOL_VCU_WheelMaxRecTrq
        ComIPduSignalRef = EOL_VCU_GCU_RecvTr
        ComIPduSignalRef = EOL_VCU_TCM_RecvTr
        ComIPduSignalRef = EOL_VCU_PTC_RecvTr
        ComIPduSignalRef = EOL_VCU_LossFctorFlgFL
        ComIPduSignalRef = EOL_VCU_LowBattVolt
        ComIPduSignalRef = EOL_VCU_HighPerforDisable
        ComIPduSignalRef = EOL_VCU_AccPedHSigVolt
        ComIPduSignalRef = EOL_VCU_LossFctorFlgFR
        ComIPduSignalRef = EOL_VCU_AccPedLSigVolt
        ComIPduSignalRef = EOL_VCU_LossFctorFlgRL
        ComIPduSignalRef = EOL_VCU_AccPedHPwrVolt
        ComIPduSignalRef = EOL_VCU_LossFctorFlgRR
        ComIPduSignalRef = EOL_VCU_AccPedLPwrVolt
        ComIPduSignalRef = EOL_VCU_PreReqChgPwr
        ComIPduSignalRef = EOL_VCU_VehPwrChageLimit
        ComIPduSignalRef = EOL_VCU_FastPwrRequest
        ComIPduSignalRef = EOL_VCU_On2KL15_Volt
        ComIPduSignalRef = EOL_VCU_ClutchWrkModDebug
        ComIPduSignalRef = EOL_VCU_HighPerforSwtFlg
        ComIPduSignalRef = EOL_VCU_VehiPowrConsumption
        ComIPduSignalRef = EOL_VCU_MDrvFilterTrqRange
        ComIPduSignalRef = EOL_VCU_WheelPwrOvrLimitflgRE
        ComIPduSignalRef = EOL_VCU_MRDrvControlMode
        ComIPduSignalRef = EOL_VCU_MRDrvControlModeVD
        ComIPduSignalRef = EOL_VCU_VehicleDirectMR
        ComIPduSignalRef = EOL_VCU_VehicleDirectMRVD
        ComIPduSignalRef = EOL_VCU_MRDrvRequestTorque
        ComIPduSignalRef = EOL_VCU_MRDrvRequesSpeed
        ComIPduSignalRef = EOL_VCU_MCUMRMaxDischargePower
        ComIPduSignalRef = EOL_VCU_MCUMRMaxPosDampgTrq
        ComIPduSignalRef = EOL_VCU_MRDrvRequestTorqueVD
        ComIPduSignalRef = EOL_VCU_MCUMRMaxChargePower
        ComIPduSignalRef = EOL_VCU_MCUMRMaxNegDampgTrq
        ComIPduSignalRef = EOL_VCU_MRDrvRequesSpeedVD
        ComIPduSignalRef = EOL_VCU_MCUMRDampgLmtFactor
        ComIPduSignalRef = EOL_VCU_SuppressJitterMCUMRRequest
      52 x ComSignal, all with ComSignalEndianness=LITTLE_ENDIAN, ComUpdateBitPosition=-1, ComTransferProperty=TRIGGERED:
        EOL_VCU_BrkPedOpen: ComSignalInitValue=0, ComSignalType=BOOLEAN, ComBitSize=1, ComBitPosition=0, ComNotification=Rte_COMCbk_EOL_VCU_BrkPedOpen, ComSystemTemplateSystemSignalRef=EOL_VCU_BrkPedOpen
        EOL_VCU_BrkPedClose: ComSignalInitValue=0, ComSignalType=BOOLEAN, ComBitSize=1, ComBitPosition=1, ComNotification=Rte_COMCbk_EOL_VCU_BrkPedClose, ComSystemTemplateSystemSignalRef=EOL_VCU_BrkPedClose
        EOL_VCU_ColumnShiftP: ComSignalInitValue=0, ComSignalType=BOOLEAN, ComBitSize=1, ComBitPosition=2, ComNotification=Rte_COMCbk_EOL_VCU_ColumnShiftP, ComSystemTemplateSystemSignalRef=EOL_VCU_ColumnShiftP
        EOL_VCU_VehiCrashSts: ComSignalInitValue=0, ComSignalType=BOOLEAN, ComBitSize=1, ComBitPosition=3, ComNotification=Rte_COMCbk_EOL_VCU_VehiCrashSts, ComSystemTemplateSystemSignalRef=EOL_VCU_VehiCrashSts
        EOL_VCU_SleepSatisfiedSts: ComSignalInitValue=0, ComSignalType=BOOLEAN, ComBitSize=1, ComBitPosition=4, ComNotification=Rte_COMCbk_EOL_VCU_SleepSatisfiedSts, ComSystemTemplateSystemSignalRef=EOL_VCU_SleepSatisfiedSts
        EOL_VCU_VehiHvCmd: ComSignalInitValue=0, ComSignalType=BOOLEAN, ComBitSize=1, ComBitPosition=5, ComNotification=Rte_COMCbk_EOL_VCU_VehiHvCmd, ComSystemTemplateSystemSignalRef=EOL_VCU_VehiHvCmd
        EOL_VCU_GearQuitAps: ComSignalInitValue=0, ComSignalType=BOOLEAN, ComBitSize=1, ComBitPosition=6, ComNotification=Rte_COMCbk_EOL_VCU_GearQuitAps, ComSystemTemplateSystemSignalRef=EOL_VCU_GearQuitAps
        EOL_VCU_REOverChgPwrFlag: ComSignalInitValue=0, ComSignalType=BOOLEAN, ComBitSize=1, ComBitPosition=7, ComNotification=Rte_COMCbk_EOL_VCU_REOverChgPwrFlag, ComSystemTemplateSystemSignalRef=EOL_VCU_REOverChgPwrFlag
        EOL_VCU_VehiAccnFilt: ComSignalInitValue=0, ComSignalType=UINT8, ComBitSize=8, ComBitPosition=8, ComNotification=Rte_COMCbk_EOL_VCU_VehiAccnFilt, ComSystemTemplateSystemSignalRef=EOL_VCU_VehiAccnFilt
        EOL_VCU_HvOffSts: ComSignalInitValue=0, ComSignalType=UINT8, ComBitSize=4, ComBitPosition=16, ComNotification=Rte_COMCbk_EOL_VCU_HvOffSts, ComSystemTemplateSystemSignalRef=EOL_VCU_HvOffSts
        EOL_VCU_ElecPwrBalanceReq: ComSignalInitValue=0, ComSignalType=BOOLEAN, ComBitSize=1, ComBitPosition=20, ComNotification=Rte_COMCbk_EOL_VCU_ElecPwrBalanceReq, ComSystemTemplateSystemSignalRef=EOL_VCU_ElecPwrBalanceReq
        EOL_VCU_CDU_RecvTr: ComSignalInitValue=0, ComSignalType=BOOLEAN, ComBitSize=1, ComBitPosition=21, ComNotification=Rte_COMCbk_EOL_VCU_CDU_RecvTr, ComSystemTemplateSystemSignalRef=EOL_VCU_CDU_RecvTr
        EOL_VCU_BMS_RecvTr: ComSignalInitValue=0, ComSignalType=BOOLEAN, ComBitSize=1, ComBitPosition=22, ComNotification=Rte_COMCbk_EOL_VCU_BMS_RecvTr, ComSystemTemplateSystemSignalRef=EOL_VCU_BMS_RecvTr
        EOL_VCU_IVI_RecvTr: ComSignalInitValue=0, ComSignalType=BOOLEAN, ComBitSize=1, ComBitPosition=23, ComNotification=Rte_COMCbk_EOL_VCU_IVI_RecvTr, ComSystemTemplateSystemSignalRef=EOL_VCU_IVI_RecvTr
        EOL_VCU_WheelMaxDrvTrq: ComSignalInitValue=0, ComSignalType=UINT16, ComBitSize=10, ComBitPosition=24, ComNotification=Rte_COMCbk_EOL_VCU_WheelMaxDrvTrq, ComSystemTemplateSystemSignalRef=EOL_VCU_WheelMaxDrvTrq
        EOL_VCU_WheelMaxRecTrq: ComSignalInitValue=0, ComSignalType=UINT16, ComBitSize=10, ComBitPosition=34, ComNotification=Rte_COMCbk_EOL_VCU_WheelMaxRecTrq, ComSystemTemplateSystemSignalRef=EOL_VCU_WheelMaxRecTrq
        EOL_VCU_GCU_RecvTr: ComSignalInitValue=0, ComSignalType=BOOLEAN, ComBitSize=1, ComBitPosition=44, ComNotification=Rte_COMCbk_EOL_VCU_GCU_RecvTr, ComSystemTemplateSystemSignalRef=EOL_VCU_GCU_RecvTr
        EOL_VCU_TCM_RecvTr: ComSignalInitValue=0, ComSignalType=BOOLEAN, ComBitSize=1, ComBitPosition=45, ComNotification=Rte_COMCbk_EOL_VCU_TCM_RecvTr, ComSystemTemplateSystemSignalRef=EOL_VCU_TCM_RecvTr
        EOL_VCU_PTC_RecvTr: ComSignalInitValue=0, ComSignalType=BOOLEAN, ComBitSize=1, ComBitPosition=46, ComNotification=Rte_COMCbk_EOL_VCU_PTC_RecvTr, ComSystemTemplateSystemSignalRef=EOL_VCU_PTC_RecvTr
        EOL_VCU_LossFctorFlgFL: ComSignalInitValue=0, ComSignalType=BOOLEAN, ComBitSize=1, ComBitPosition=47, ComNotification=Rte_COMCbk_EOL_VCU_LossFctorFlgFL, ComSystemTemplateSystemSignalRef=EOL_VCU_LossFctorFlgFL
        EOL_VCU_LowBattVolt: ComSignalInitValue=0, ComSignalType=UINT8, ComBitSize=7, ComBitPosition=48, ComNotification=Rte_COMCbk_EOL_VCU_LowBattVolt, ComSystemTemplateSystemSignalRef=EOL_VCU_LowBattVolt
        EOL_VCU_HighPerforDisable: ComSignalInitValue=0, ComSignalType=BOOLEAN, ComBitSize=1, ComBitPosition=55, ComNotification=Rte_COMCbk_EOL_VCU_HighPerforDisable, ComSystemTemplateSystemSignalRef=EOL_VCU_HighPerforDisable
        EOL_VCU_AccPedHSigVolt: ComSignalInitValue=0, ComSignalType=UINT8, ComBitSize=7, ComBitPosition=56, ComNotification=Rte_COMCbk_EOL_VCU_AccPedHSigVolt, ComSystemTemplateSystemSignalRef=EOL_VCU_AccPedHSigVolt
        EOL_VCU_LossFctorFlgFR: ComSignalInitValue=0, ComSignalType=BOOLEAN, ComBitSize=1, ComBitPosition=63, ComNotification=Rte_COMCbk_EOL_VCU_LossFctorFlgFR, ComSystemTemplateSystemSignalRef=EOL_VCU_LossFctorFlgFR
        EOL_VCU_AccPedLSigVolt: ComSignalInitValue=0, ComSignalType=UINT8, ComBitSize=7, ComBitPosition=64, ComNotification=Rte_COMCbk_EOL_VCU_AccPedLSigVolt, ComSystemTemplateSystemSignalRef=EOL_VCU_AccPedLSigVolt
        EOL_VCU_LossFctorFlgRL: ComSignalInitValue=0, ComSignalType=BOOLEAN, ComBitSize=1, ComBitPosition=71, ComNotification=Rte_COMCbk_EOL_VCU_LossFctorFlgRL, ComSystemTemplateSystemSignalRef=EOL_VCU_LossFctorFlgRL
        EOL_VCU_AccPedHPwrVolt: ComSignalInitValue=0, ComSignalType=UINT8, ComBitSize=7, ComBitPosition=72, ComNotification=Rte_COMCbk_EOL_VCU_AccPedHPwrVolt, ComSystemTemplateSystemSignalRef=EOL_VCU_AccPedHPwrVolt
        EOL_VCU_LossFctorFlgRR: ComSignalInitValue=0, ComSignalType=BOOLEAN, ComBitSize=1, ComBitPosition=79, ComNotification=Rte_COMCbk_EOL_VCU_LossFctorFlgRR, ComSystemTemplateSystemSignalRef=EOL_VCU_LossFctorFlgRR
        EOL_VCU_AccPedLPwrVolt: ComSignalInitValue=0, ComSignalType=UINT8, ComBitSize=7, ComBitPosition=80, ComNotification=Rte_COMCbk_EOL_VCU_AccPedLPwrVolt, ComSystemTemplateSystemSignalRef=EOL_VCU_AccPedLPwrVolt
        EOL_VCU_PreReqChgPwr: ComSignalInitValue=0, ComSignalType=UINT8, ComBitSize=8, ComBitPosition=88, ComNotification=Rte_COMCbk_EOL_VCU_PreReqChgPwr, ComSystemTemplateSystemSignalRef=EOL_VCU_PreReqChgPwr
        EOL_VCU_VehPwrChageLimit: ComSignalInitValue=0, ComSignalType=UINT8, ComBitSize=8, ComBitPosition=96, ComNotification=Rte_COMCbk_EOL_VCU_VehPwrChageLimit, ComSystemTemplateSystemSignalRef=EOL_VCU_VehPwrChageLimit
        EOL_VCU_FastPwrRequest: ComSignalInitValue=0, ComSignalType=UINT8, ComBitSize=8, ComBitPosition=104, ComNotification=Rte_COMCbk_EOL_VCU_FastPwrRequest, ComSystemTemplateSystemSignalRef=EOL_VCU_FastPwrRequest
        EOL_VCU_On2KL15_Volt: ComSignalInitValue=0, ComSignalType=UINT8, ComBitSize=8, ComBitPosition=112, ComNotification=Rte_COMCbk_EOL_VCU_On2KL15_Volt, ComSystemTemplateSystemSignalRef=EOL_VCU_On2KL15_Volt
        EOL_VCU_ClutchWrkModDebug: ComSignalInitValue=0, ComSignalType=UINT8, ComBitSize=5, ComBitPosition=120, ComNotification=Rte_COMCbk_EOL_VCU_ClutchWrkModDebug, ComSystemTemplateSystemSignalRef=EOL_VCU_ClutchWrkModDebug
        EOL_VCU_HighPerforSwtFlg: ComSignalInitValue=0, ComSignalType=BOOLEAN, ComBitSize=1, ComBitPosition=127, ComNotification=Rte_COMCbk_EOL_VCU_HighPerforSwtFlg, ComSystemTemplateSystemSignalRef=EOL_VCU_HighPerforSwtFlg
        EOL_VCU_VehiPowrConsumption: ComSignalInitValue=0, ComSignalType=UINT16, ComBitSize=13, ComBitPosition=128, ComNotification=Rte_COMCbk_EOL_VCU_VehiPowrConsumption, ComSystemTemplateSystemSignalRef=EOL_VCU_VehiPowrConsumption
        EOL_VCU_MDrvFilterTrqRange: ComSignalInitValue=0, ComSignalType=UINT8, ComBitSize=3, ComBitPosition=141, ComNotification=Rte_COMCbk_EOL_VCU_MDrvFilterTrqRange, ComSystemTemplateSystemSignalRef=EOL_VCU_MDrvFilterTrqRange
        EOL_VCU_WheelPwrOvrLimitflgRE: ComSignalInitValue=0, ComSignalType=UINT8, ComBitSize=2, ComBitPosition=125, ComNotification=Rte_COMCbk_EOL_VCU_WheelPwrOvrLimitflgRE, ComSystemTemplateSystemSignalRef=EOL_VCU_WheelPwrOvrLimitflgRE
        EOL_VCU_MRDrvControlMode: ComSignalInitValue=0, ComSignalType=BOOLEAN, ComBitSize=1, ComBitPosition=155, ComNotification=Rte_COMCbk_EOL_VCU_MRDrvControlMode, ComSystemTemplateSystemSignalRef=EOL_VCU_MRDrvControlMode
        EOL_VCU_MRDrvControlModeVD: ComSignalInitValue=0, ComSignalType=BOOLEAN, ComBitSize=1, ComBitPosition=156, ComNotification=Rte_COMCbk_EOL_VCU_MRDrvControlModeVD, ComSystemTemplateSystemSignalRef=EOL_VCU_MRDrvControlModeVD
        EOL_VCU_VehicleDirectMR: ComSignalInitValue=0, ComSignalType=BOOLEAN, ComBitSize=1, ComBitPosition=157, ComNotification=Rte_COMCbk_EOL_VCU_VehicleDirectMR, ComSystemTemplateSystemSignalRef=EOL_VCU_VehicleDirectMR
        EOL_VCU_VehicleDirectMRVD: ComSignalInitValue=0, ComSignalType=BOOLEAN, ComBitSize=1, ComBitPosition=158, ComNotification=Rte_COMCbk_EOL_VCU_VehicleDirectMRVD, ComSystemTemplateSystemSignalRef=EOL_VCU_VehicleDirectMRVD
        EOL_VCU_MRDrvRequestTorque: ComSignalInitValue=5000, ComSignalType=UINT16, ComBitSize=16, ComBitPosition=160, ComNotification=Rte_COMCbk_EOL_VCU_MRDrvRequestTorque, ComSystemTemplateSystemSignalRef=EOL_VCU_MRDrvRequestTorque
        EOL_VCU_MRDrvRequesSpeed: ComSignalInitValue=17000, ComSignalType=UINT16, ComBitSize=16, ComBitPosition=176, ComNotification=Rte_COMCbk_EOL_VCU_MRDrvRequesSpeed, ComSystemTemplateSystemSignalRef=EOL_VCU_MRDrvRequesSpeed
        EOL_VCU_MCUMRMaxDischargePower: ComSignalInitValue=0, ComSignalType=UINT16, ComBitSize=9, ComBitPosition=192, ComNotification=Rte_COMCbk_EOL_VCU_MCUMRMaxDischargePower, ComSystemTemplateSystemSignalRef=EOL_VCU_MCUMRMaxDischargePower
        EOL_VCU_MCUMRMaxPosDampgTrq: ComSignalInitValue=50, ComSignalType=UINT8, ComBitSize=6, ComBitPosition=201, ComNotification=Rte_COMCbk_EOL_VCU_MCUMRMaxPosDampgTrq, ComSystemTemplateSystemSignalRef=EOL_VCU_MCUMRMaxPosDampgTrq
        EOL_VCU_MRDrvRequestTorqueVD: ComSignalInitValue=0, ComSignalType=BOOLEAN, ComBitSize=1, ComBitPosition=207, ComNotification=Rte_COMCbk_EOL_VCU_MRDrvRequestTorqueVD, ComSystemTemplateSystemSignalRef=EOL_VCU_MRDrvRequestTorqueVD
        EOL_VCU_MCUMRMaxChargePower: ComSignalInitValue=0, ComSignalType=UINT16, ComBitSize=9, ComBitPosition=208, ComNotification=Rte_COMCbk_EOL_VCU_MCUMRMaxChargePower, ComSystemTemplateSystemSignalRef=EOL_VCU_MCUMRMaxChargePower
        EOL_VCU_MCUMRMaxNegDampgTrq: ComSignalInitValue=0, ComSignalType=UINT8, ComBitSize=6, ComBitPosition=217, ComNotification=Rte_COMCbk_EOL_VCU_MCUMRMaxNegDampgTrq, ComSystemTemplateSystemSignalRef=EOL_VCU_MCUMRMaxNegDampgTrq
        EOL_VCU_MRDrvRequesSpeedVD: ComSignalInitValue=0, ComSignalType=BOOLEAN, ComBitSize=1, ComBitPosition=223, ComNotification=Rte_COMCbk_EOL_VCU_MRDrvRequesSpeedVD, ComSystemTemplateSystemSignalRef=EOL_VCU_MRDrvRequesSpeedVD
        EOL_VCU_MCUMRDampgLmtFactor: ComSignalInitValue=100, ComSignalType=UINT8, ComBitSize=7, ComBitPosition=224, ComNotification=Rte_COMCbk_EOL_VCU_MCUMRDampgLmtFactor, ComSystemTemplateSystemSignalRef=EOL_VCU_MCUMRDampgLmtFactor
        EOL_VCU_SuppressJitterMCUMRRequest: ComSignalInitValue=0, ComSignalType=BOOLEAN, ComBitSize=1, ComBitPosition=231, ComNotification=Rte_COMCbk_EOL_VCU_SuppressJitterMCUMRRequest, ComSystemTemplateSystemSignalRef=EOL_VCU_SuppressJitterMCUMRRequest
      GCU_0xBD_P_CANFD (ComIPdu):
        ComIPduSignalProcessing = IMMEDIATE
        ComIPduType = NORMAL
        ComIPduDirection = RECEIVE
        ComIPduCallout = ComCallOut_GCU_0xBD_P_CANFD
        ComIPduErrorNotification = ComCbk_RxTimeOut_GCU_0xBD_P_CANFD
        ComFirstTimeout = 2.3
        ComTimeout = 0.3
        ComIPduGroupRef = ComIPduGroup_Rx
        ComPduIdRef = PduCollection/GCU_0xBD_P_CANFD_PduR2Com
        ComIPduSignalRef = GCU_CRC_BD
        ComIPduSignalRef = GCU_EngineCylinderDeactivationStatus
        ComIPduSignalRef = GCU_EngineFuelInhibitReq
        ComIPduSignalRef = GCU_RollingCounter_BD
        ComIPduSignalRef = GCU_MainWireCurr
        ComIPduSignalRef = GCU_MainWireVolt
        ComIPduSignalRef = GCU_SystemWarning
        ComIPduSignalRef = GCU_MILlampReq
        ComIPduSignalRef = GCU_MoterTemp
        ComIPduSignalRef = GCU_Temp
        ComIPduSignalRef = GCU_SelfCheck
        ComIPduSignalRef = GCU_Warning_Level
        ComIPduSignalRef = GCU_HVILSts
        ComIPduSignalRef = GCU__PowerReduceSts
        ComIPduSignalRef = GCU_ActualMotorRPM_VD
        ComIPduSignalRef = GCU_ActualMotorTorque_VD
        ComIPduSignalRef = GCU_ActualMotorTorque
        ComIPduSignalRef = GCU_MaxTorque
        ComIPduSignalRef = GCU_ActiveReleaseFB
        ComIPduSignalRef = GCU_MAXPower
        ComIPduSignalRef = GCU_TransientPower
        ComIPduSignalRef = GCU_HVOffReq
        ComIPduSignalRef = GCU_ControlMode
        ComIPduSignalRef = GCU_Operating_Mode
        ComIPduSignalRef = GCU_ActualMotorRPM
      25 x ComSignal, all with ComSignalInitValue=0, ComSignalEndianness=LITTLE_ENDIAN, ComUpdateBitPosition=-1, ComTransferProperty=TRIGGERED:
        GCU_CRC_BD: ComSignalType=UINT8, ComBitSize=8, ComBitPosition=0, ComNotification=Rte_COMCbk_GCU_CRC_BD, ComSystemTemplateSystemSignalRef=GCU_CRC_BD
        GCU_EngineCylinderDeactivationStatus: ComSignalType=UINT8, ComBitSize=2, ComBitPosition=160, ComNotification=Rte_COMCbk_GCU_EngineCylinderDeactivationStatus, ComSystemTemplateSystemSignalRef=GCU_EngineCylinderDeactivationStatus
        GCU_EngineFuelInhibitReq: ComSignalType=BOOLEAN, ComBitSize=1, ComBitPosition=96, ComNotification=Rte_COMCbk_GCU_EngineFuelInhibitReq, ComSystemTemplateSystemSignalRef=GCU_EngineFuelInhibitReq
        GCU_RollingCounter_BD: ComSignalType=UINT8, ComBitSize=4, ComBitPosition=8, ComNotification=Rte_COMCbk_GCU_RollingCounter_BD, ComSystemTemplateSystemSignalRef=GCU_RollingCounter_BD
        GCU_MainWireCurr: ComSignalType=UINT16, ComBitSize=16, ComBitPosition=16, ComNotification=Rte_COMCbk_GCU_MainWireCurr, ComSystemTemplateSystemSignalRef=GCU_MainWireCurr
        GCU_MainWireVolt: ComSignalType=UINT16, ComBitSize=13, ComBitPosition=32, ComNotification=Rte_COMCbk_GCU_MainWireVolt, ComSystemTemplateSystemSignalRef=GCU_MainWireVolt
        GCU_SystemWarning: ComSignalType=BOOLEAN, ComBitSize=1, ComBitPosition=45, ComNotification=Rte_COMCbk_GCU_SystemWarning, ComSystemTemplateSystemSignalRef=GCU_SystemWarning
        GCU_MILlampReq: ComSignalType=BOOLEAN, ComBitSize=1, ComBitPosition=46, ComNotification=Rte_COMCbk_GCU_MILlampReq, ComSystemTemplateSystemSignalRef=GCU_MILlampReq
        GCU_MoterTemp: ComSignalType=UINT8, ComBitSize=8, ComBitPosition=48, ComNotification=Rte_COMCbk_GCU_MoterTemp, ComSystemTemplateSystemSignalRef=GCU_MoterTemp
        GCU_Temp: ComSignalType=UINT8, ComBitSize=8, ComBitPosition=56, ComNotification=Rte_COMCbk_GCU_Temp, ComSystemTemplateSystemSignalRef=GCU_Temp
        GCU_SelfCheck: ComSignalType=UINT8, ComBitSize=2, ComBitPosition=64, ComNotification=Rte_COMCbk_GCU_SelfCheck, ComSystemTemplateSystemSignalRef=GCU_SelfCheck
        GCU_Warning_Level: ComSignalType=UINT8, ComBitSize=2, ComBitPosition=66, ComNotification=Rte_COMCbk_GCU_Warning_Level, ComSystemTemplateSystemSignalRef=GCU_Warning_Level
        GCU_HVILSts: ComSignalType=BOOLEAN, ComBitSize=1, ComBitPosition=68, ComNotification=Rte_COMCbk_GCU_HVILSts, ComSystemTemplateSystemSignalRef=GCU_HVILSts
        GCU__PowerReduceSts: ComSignalType=BOOLEAN, ComBitSize=1, ComBitPosition=69, ComNotification=Rte_COMCbk_GCU__PowerReduceSts, ComSystemTemplateSystemSignalRef=GCU__PowerReduceSts
        GCU_ActualMotorRPM_VD: ComSignalType=BOOLEAN, ComBitSize=1, ComBitPosition=70, ComNotification=Rte_COMCbk_GCU_ActualMotorRPM_VD, ComSystemTemplateSystemSignalRef=GCU_ActualMotorRPM_VD
        GCU_ActualMotorTorque_VD: ComSignalType=BOOLEAN, ComBitSize=1, ComBitPosition=71, ComNotification=Rte_COMCbk_GCU_ActualMotorTorque_VD, ComSystemTemplateSystemSignalRef=GCU_ActualMotorTorque_VD
        GCU_ActualMotorTorque: ComSignalType=UINT16, ComBitSize=12, ComBitPosition=72, ComNotification=Rte_COMCbk_GCU_ActualMotorTorque, ComSystemTemplateSystemSignalRef=GCU_ActualMotorTorque
        GCU_MaxTorque: ComSignalType=UINT16, ComBitSize=12, ComBitPosition=84, ComNotification=Rte_COMCbk_GCU_MaxTorque, ComSystemTemplateSystemSignalRef=GCU_MaxTorque
        GCU_ActiveReleaseFB: ComSignalType=UINT8, ComBitSize=2, ComBitPosition=110, ComNotification=Rte_COMCbk_GCU_ActiveReleaseFB, ComSystemTemplateSystemSignalRef=GCU_ActiveReleaseFB
        GCU_MAXPower: ComSignalType=UINT8, ComBitSize=8, ComBitPosition=112, ComNotification=Rte_COMCbk_GCU_MAXPower, ComSystemTemplateSystemSignalRef=GCU_MAXPower
        GCU_TransientPower: ComSignalType=UINT16, ComBitSize=12, ComBitPosition=120, ComNotification=Rte_COMCbk_GCU_TransientPower, ComSystemTemplateSystemSignalRef=GCU_TransientPower
        GCU_HVOffReq: ComSignalType=BOOLEAN, ComBitSize=1, ComBitPosition=132, ComNotification=Rte_COMCbk_GCU_HVOffReq, ComSystemTemplateSystemSignalRef=GCU_HVOffReq
        GCU_ControlMode: ComSignalType=UINT8, ComBitSize=3, ComBitPosition=133, ComNotification=Rte_COMCbk_GCU_ControlMode, ComSystemTemplateSystemSignalRef=GCU_ControlMode
        GCU_Operating_Mode: ComSignalType=UINT8, ComBitSize=4, ComBitPosition=140, ComNotification=Rte_COMCbk_GCU_Operating_Mode, ComSystemTemplateSystemSignalRef=GCU_Operating_Mode
        GCU_ActualMotorRPM: ComSignalType=UINT16, ComBitSize=16, ComBitPosition=144, ComNotification=Rte_COMCbk_GCU_ActualMotorRPM, ComSystemTemplateSystemSignalRef=GCU_ActualMotorRPM
      RMCU_0x2_P_CANFD (ComIPdu):
        ComIPduSignalProcessing = IMMEDIATE
        ComIPduType = NORMAL
        ComIPduDirection = RECEIVE
        ComIPduCallout = ComCallOut_MCUM_0x2_P_CANFD
        ComIPduGroupRef = ComIPduGroup_Rx
        ComPduIdRef = PduCollection/RMCU_0x2_P_CANFD_PduR2Com
        ComIPduSignalRef = Debug_MCU_CRC_CA
        ComIPduSignalRef = Debug_MCU_RollingCounter_CA
        ComIPduSignalRef = Debug_MCU_WarningLevel
        ComIPduSignalRef = Debug_MCU_SelfCheckSts
        ComIPduSignalRef = Debug_MCU_DrvMotorWorkSts
        ComIPduSignalRef = Debug_MCU_PowerReduceSts
        ComIPduSignalRef = Debug_MCU_DrvMotorRPM
        ComIPduSignalRef = Debug_MCU_ActualTorqueFB
        ComIPduSignalRef = Debug_MCU_HWRdcFault
        ComIPduSignalRef = Debug_MCU_HighVoltPowerOffReq
        ComIPduSignalRef = Debug_MCU_HVILSts
        ComIPduSignalRef = Debug_MCU_DragSts
        ComIPduSignalRef = Debug_MCU_CtrlMode
        ComIPduSignalRef = Debug_MCU_MILlampReq
        ComIPduSignalRef = Debug_MCU_DrvMotorRPMVD
        ComIPduSignalRef = Debug_MCU_ActualTorqueFBVD
        ComIPduSignalRef = Debug_MCU_MaxTorqueAllow
        ComIPduSignalRef = Debug_MCU_MaxSpeedAllow
        ComIPduSignalRef = Debug_MCU_ActiveReleaseSts
        ComIPduSignalRef = Debug_MCU_DCChargRelaySts
        ComIPduSignalRef = Debug_MCUM_MinTorqueAllow
        ComIPduSignalRef = Debug_MCU_MainWireVolt
        ComIPduSignalRef = Debug_MCU_MainWireCurr
        ComIPduSignalRef = Debug_MCUM_TMS_MotSelfHeatEnSts
        ComIPduSignalRef = Debug_MCUM_TMS_MotSelfHeatLvlFb
        ComIPduSignalRef = Debug_MCUM_RPowerReduceSts
        ComIPduSignalRef = Debug_MCUM_HeatPwrAval
        ComIPduSignalRef = Debug_MCUM_RCtrlMode
        ComIPduSignalRef = Debug_MCUM_RWarningLevel
        ComIPduSignalRef = Debug_MCUM_RSelfCheckSts
        ComIPduSignalRef = Debug_MCUM_RDrvMotorWorkSts
        ComIPduSignalRef = Debug_MCUM_RCtrlModeVD
        ComIPduSignalRef = Debug_MCUM_RHWRdcFault
        ComIPduSignalRef = Debug_MCUM_RDrvMotorRPMVD
        ComIPduSignalRef = Debug_MCUM_RActualTorqueFBVD
        ComIPduSignalRef = Debug_MCUM_RDrvMotorRPM
        ComIPduSignalRef = Debug_MCUM_RActualTorqueFB
      37 x ComSignal, all with ComSignalInitValue=0, ComSignalEndianness=LITTLE_ENDIAN, ComUpdateBitPosition=-1, ComTransferProperty=TRIGGERED:
        Debug_MCU_CRC_CA: ComSignalType=UINT8, ComBitSize=8, ComBitPosition=0, ComNotification=Rte_COMCbk_Debug_MCU_CRC_CA, ComSystemTemplateSystemSignalRef=Debug_MCU_CRC_CA
        Debug_MCU_RollingCounter_CA: ComSignalType=UINT8, ComBitSize=4, ComBitPosition=8, ComNotification=Rte_COMCbk_Debug_MCU_RollingCounter_CA, ComSystemTemplateSystemSignalRef=Debug_MCU_RollingCounter_CA
        Debug_MCU_WarningLevel: ComSignalType=UINT8, ComBitSize=2, ComBitPosition=16, ComNotification=Rte_COMCbk_Debug_MCU_WarningLevel, ComSystemTemplateSystemSignalRef=Debug_MCU_WarningLevel
        Debug_MCU_SelfCheckSts: ComSignalType=UINT8, ComBitSize=2, ComBitPosition=18, ComNotification=Rte_COMCbk_Debug_MCU_SelfCheckSts, ComSystemTemplateSystemSignalRef=Debug_MCU_SelfCheckSts
        Debug_MCU_DrvMotorWorkSts: ComSignalType=UINT8, ComBitSize=2, ComBitPosition=20, ComNotification=Rte_COMCbk_Debug_MCU_DrvMotorWorkSts, ComSystemTemplateSystemSignalRef=Debug_MCU_DrvMotorWorkSts
        Debug_MCU_PowerReduceSts: ComSignalType=BOOLEAN, ComBitSize=1, ComBitPosition=22, ComNotification=Rte_COMCbk_Debug_MCU_PowerReduceSts, ComSystemTemplateSystemSignalRef=Debug_MCU_PowerReduceSts
        Debug_MCU_DrvMotorRPM: ComSignalType=UINT16, ComBitSize=16, ComBitPosition=24, ComNotification=Rte_COMCbk_Debug_MCU_DrvMotorRPM, ComSystemTemplateSystemSignalRef=Debug_MCU_DrvMotorRPM
        Debug_MCU_ActualTorqueFB: ComSignalType=UINT16, ComBitSize=16, ComBitPosition=40, ComNotification=Rte_COMCbk_Debug_MCU_ActualTorqueFB, ComSystemTemplateSystemSignalRef=Debug_MCU_ActualTorqueFB
        Debug_MCU_HWRdcFault: ComSignalType=BOOLEAN, ComBitSize=1, ComBitPosition=56, ComNotification=Rte_COMCbk_Debug_MCU_HWRdcFault, ComSystemTemplateSystemSignalRef=Debug_MCU_HWRdcFault
        Debug_MCU_HighVoltPowerOffReq: ComSignalType=BOOLEAN, ComBitSize=1, ComBitPosition=58, ComNotification=Rte_COMCbk_Debug_MCU_HighVoltPowerOffReq, ComSystemTemplateSystemSignalRef=Debug_MCU_HighVoltPowerOffReq
        Debug_MCU_HVILSts: ComSignalType=BOOLEAN, ComBitSize=1, ComBitPosition=59, ComNotification=Rte_COMCbk_Debug_MCU_HVILSts, ComSystemTemplateSystemSignalRef=Debug_MCU_HVILSts
        Debug_MCU_DragSts: ComSignalType=UINT8, ComBitSize=2, ComBitPosition=60, ComNotification=Rte_COMCbk_Debug_MCU_DragSts, ComSystemTemplateSystemSignalRef=Debug_MCU_DragSts
        Debug_MCU_CtrlMode: ComSignalType=BOOLEAN, ComBitSize=1, ComBitPosition=62, ComNotification=Rte_COMCbk_Debug_MCU_CtrlMode, ComSystemTemplateSystemSignalRef=Debug_MCU_CtrlMode
        Debug_MCU_MILlampReq: ComSignalType=BOOLEAN, ComBitSize=1, ComBitPosition=65, ComNotification=Rte_COMCbk_Debug_MCU_MILlampReq, ComSystemTemplateSystemSignalRef=Debug_MCU_MILlampReq
        Debug_MCU_DrvMotorRPMVD: ComSignalType=BOOLEAN, ComBitSize=1, ComBitPosition=68, ComNotification=Rte_COMCbk_Debug_MCU_DrvMotorRPMVD, ComSystemTemplateSystemSignalRef=Debug_MCU_DrvMotorRPMVD
        Debug_MCU_ActualTorqueFBVD: ComSignalType=BOOLEAN, ComBitSize=1, ComBitPosition=69, ComNotification=Rte_COMCbk_Debug_MCU_ActualTorqueFBVD, ComSystemTemplateSystemSignalRef=Debug_MCU_ActualTorqueFBVD
        Debug_MCU_MaxTorqueAllow: ComSignalType=UINT16, ComBitSize=16, ComBitPosition=72, ComNotification=Rte_COMCbk_Debug_MCU_MaxTorqueAllow, ComSystemTemplateSystemSignalRef=Debug_MCU_MaxTorqueAllow
        Debug_MCU_MaxSpeedAllow: ComSignalType=UINT16, ComBitSize=16, ComBitPosition=88, ComNotification=Rte_COMCbk_Debug_MCU_MaxSpeedAllow, ComSystemTemplateSystemSignalRef=Debug_MCU_MaxSpeedAllow
        Debug_MCU_ActiveReleaseSts: ComSignalType=UINT8, ComBitSize=2, ComBitPosition=108, ComNotification=Rte_COMCbk_Debug_MCU_ActiveReleaseSts, ComSystemTemplateSystemSignalRef=Debug_MCU_ActiveReleaseSts
        Debug_MCU_DCChargRelaySts: ComSignalType=BOOLEAN, ComBitSize=1, ComBitPosition=110, ComNotification=Rte_COMCbk_Debug_MCU_DCChargRelaySts, ComSystemTemplateSystemSignalRef=Debug_MCU_DCChargRelaySts
        Debug_MCUM_MinTorqueAllow: ComSignalType=UINT16, ComBitSize=16, ComBitPosition=112, ComNotification=Rte_COMCbk_Debug_MCUM_MinTorqueAllow, ComSystemTemplateSystemSignalRef=Debug_MCUM_MinTorqueAllow
        Debug_MCU_MainWireVolt: ComSignalType=UINT16, ComBitSize=16, ComBitPosition=128, ComNotification=Rte_COMCbk_Debug_MCU_MainWireVolt, ComSystemTemplateSystemSignalRef=Debug_MCU_MainWireVolt
        Debug_MCU_MainWireCurr: ComSignalType=UINT16, ComBitSize=16, ComBitPosition=168, ComNotification=Rte_COMCbk_Debug_MCU_MainWireCurr, ComSystemTemplateSystemSignalRef=Debug_MCU_MainWireCurr
        Debug_MCUM_TMS_MotSelfHeatEnSts: ComSignalType=BOOLEAN, ComBitSize=1, ComBitPosition=184, ComNotification=Rte_COMCbk_Debug_MCUM_TMS_MotSelfHeatEnSts, ComSystemTemplateSystemSignalRef=Debug_MCUM_TMS_MotSelfHeatEnSts
        Debug_MCUM_TMS_MotSelfHeatLvlFb: ComSignalType=UINT8, ComBitSize=3, ComBitPosition=185, ComNotification=Rte_COMCbk_Debug_MCUM_TMS_MotSelfHeatLvlFb, ComSystemTemplateSystemSignalRef=Debug_MCUM_TMS_MotSelfHeatLvlFb
        Debug_MCUM_RPowerReduceSts: ComSignalType=UINT8, ComBitSize=1, ComBitPosition=191, ComNotification=Rte_COMCbk_Debug_MCUM_RPowerReduceSts, ComSystemTemplateSystemSignalRef=Debug_MCUM_RPowerReduceSts
        Debug_MCUM_HeatPwrAval: ComSignalType=UINT8, ComBitSize=5, ComBitPosition=208, ComNotification=Rte_COMCbk_Debug_MCUM_HeatPwrAval, ComSystemTemplateSystemSignalRef=Debug_MCUM_HeatPwrAval
        Debug_MCUM_RCtrlMode: ComSignalType=UINT8, ComBitSize=1, ComBitPosition=213, ComNotification=Rte_COMCbk_Debug_MCUM_RCtrlMode, ComSystemTemplateSystemSignalRef=Debug_MCUM_RCtrlMode
        Debug_MCUM_RWarningLevel: ComSignalType=UINT8, ComBitSize=2, ComBitPosition=214, ComNotification=Rte_COMCbk_Debug_MCUM_RWarningLevel, ComSystemTemplateSystemSignalRef=Debug_MCUM_RWarningLevel
        Debug_MCUM_RSelfCheckSts: ComSignalType=UINT8, ComBitSize=2, ComBitPosition=216, ComNotification=Rte_COMCbk_Debug_MCUM_RSelfCheckSts, ComSystemTemplateSystemSignalRef=Debug_MCUM_RSelfCheckSts
        Debug_MCUM_RDrvMotorWorkSts: ComSignalType=UINT8, ComBitSize=2, ComBitPosition=218, ComNotification=Rte_COMCbk_Debug_MCUM_RDrvMotorWorkSts, ComSystemTemplateSystemSignalRef=Debug_MCUM_RDrvMotorWorkSts
        Debug_MCUM_RCtrlModeVD: ComSignalType=UINT8, ComBitSize=1, ComBitPosition=220, ComNotification=Rte_COMCbk_Debug_MCUM_RCtrlModeVD, ComSystemTemplateSystemSignalRef=Debug_MCUM_RCtrlModeVD
        Debug_MCUM_RHWRdcFault: ComSignalType=UINT8, ComBitSize=1, ComBitPosition=221, ComNotification=Rte_COMCbk_Debug_MCUM_RHWRdcFault, ComSystemTemplateSystemSignalRef=Debug_MCUM_RHWRdcFault
        Debug_MCUM_RDrvMotorRPMVD: ComSignalType=UINT8, ComBitSize=1, ComBitPosition=222, ComNotification=Rte_COMCbk_Debug_MCUM_RDrvMotorRPMVD, ComSystemTemplateSystemSignalRef=Debug_MCUM_RDrvMotorRPMVD
        Debug_MCUM_RActualTorqueFBVD: ComSignalType=UINT8, ComBitSize=1, ComBitPosition=223, ComNotification=Rte_COMCbk_Debug_MCUM_RActualTorqueFBVD, ComSystemTemplateSystemSignalRef=Debug_MCUM_RActualTorqueFBVD
        Debug_MCUM_RDrvMotorRPM: ComSignalType=UINT16, ComBitSize=16, ComBitPosition=224, ComNotification=Rte_COMCbk_Debug_MCUM_RDrvMotorRPM, ComSystemTemplateSystemSignalRef=Debug_MCUM_RDrvMotorRPM
        Debug_MCUM_RActualTorqueFB: ComSignalType=UINT16, ComBitSize=16, ComBitPosition=240, ComNotification=Rte_COMCbk_Debug_MCUM_RActualTorqueFB, ComSystemTemplateSystemSignalRef=Debug_MCUM_RActualTorqueFB
      ICU_0x249_P_CANFD (ComIPdu):
        ComIPduSignalProcessing = IMMEDIATE
        ComIPduType = NORMAL
        ComIPduDirection = RECEIVE
        ComIPduCallout = ComCallOut_ICU_0x249_P_CANFD
        ComIPduErrorNotification = ComCbk_RxTimeOut_ICU_0x249_P_CANFD
        ComFirstTimeout = 15.5
        ComTimeout = 0.5
        ComIPduGroupRef = ComIPduGroup_Rx
        ComPduIdRef = PduCollection/ICU_0x249_P_CANFD_PduR2Com
        ComIPduSignalRef = ICU_TotalOilmeterkm
        ComIPduSignalRef = ICU_CLTCoilMileage
        ComIPduSignalRef = ICU_WLTC_oilMileage
        ComIPduSignalRef = ICU_CLTC_ElectticityMileage
        ComIPduSignalRef = ICU_WLTC_ElectticityMileage
        ComIPduSignalRef = ICU_Switch_CLTCOrWLTC
        ComIPduSignalRef = ICU_FuelPercent
      7 x ComSignal, all with ComSignalInitValue=0, ComSignalEndianness=LITTLE_ENDIAN, ComUpdateBitPosition=-1, ComTransferProperty=TRIGGERED:
        ICU_TotalOilmeterkm: ComSignalType=UINT32, ComBitSize=20, ComBitPosition=44, ComNotification=Rte_COMCbk_ICU_TotalOilmeterkm, ComSystemTemplateSystemSignalRef=ICU_TotalOilmeterkm
        ICU_CLTCoilMileage: ComSignalType=UINT16, ComBitSize=11, ComBitPosition=64, ComNotification=Rte_COMCbk_ICU_CLTCoilMileage, ComSystemTemplateSystemSignalRef=ICU_CLTCoilMileage
        ICU_WLTC_oilMileage: ComSignalType=UINT16, ComBitSize=11, ComBitPosition=75, ComNotification=Rte_COMCbk_ICU_WLTC_oilMileage, ComSystemTemplateSystemSignalRef=ICU_WLTC_oilMileage
        ICU_CLTC_ElectticityMileage: ComSignalType=UINT16, ComBitSize=11, ComBitPosition=86, ComNotification=Rte_COMCbk_ICU_CLTC_ElectticityMileage, ComSystemTemplateSystemSignalRef=ICU_CLTC_ElectticityMileage
        ICU_WLTC_ElectticityMileage: ComSignalType=UINT16, ComBitSize=11, ComBitPosition=97, ComNotification=Rte_COMCbk_ICU_WLTC_ElectticityMileage, ComSystemTemplateSystemSignalRef=ICU_WLTC_ElectticityMileage
        ICU_Switch_CLTCOrWLTC: ComSignalType=UINT8, ComBitSize=3, ComBitPosition=128, ComNotification=Rte_COMCbk_ICU_Switch_CLTCOrWLTC, ComSystemTemplateSystemSignalRef=ICU_Switch_CLTCOrWLTC
        ICU_FuelPercent: ComSignalType=UINT16, ComBitSize=10, ComBitPosition=135, ComNotification=Rte_COMCbk_ICU_FuelPercent, ComSystemTemplateSystemSignalRef=ICU_FuelPercent
      HPCBCM_0x1E6_P_CANFD (ComIPdu):
        ComIPduSignalProcessing = IMMEDIATE
        ComIPduType = NORMAL
        ComIPduDirection = RECEIVE
        ComIPduCallout = ComCallOut_HPCBCM_0x1E6_P_CANFD
        ComIPduGroupRef = ComIPduGroup_Rx
        ComPduIdRef = PduCollection/HPCBCM_0x1E6_P_CANFD_PduR2Com
        ComIPduSignalRef = BCM_VCU_Authentication_MAC_B{0..15}
      16 x ComSignal, all with ComSignalInitValue=0, ComSignalType=UINT8, ComSignalEndianness=LITTLE_ENDIAN, ComBitSize=8, ComUpdateBitPosition=-1, ComTransferProperty=TRIGGERED:
        BCM_VCU_Authentication_MAC_B0: ComBitPosition=0, ComNotification=Rte_COMCbk_BCM_VCU_Authentication_MAC_B0, ComSystemTemplateSystemSignalRef=BCM_VCU_Authentication_MAC_B0
        BCM_VCU_Authentication_MAC_B1: ComBitPosition=8, ComNotification=Rte_COMCbk_BCM_VCU_Authentication_MAC_B1, ComSystemTemplateSystemSignalRef=BCM_VCU_Authentication_MAC_B1
        BCM_VCU_Authentication_MAC_B2: ComBitPosition=16, ComNotification=Rte_COMCbk_BCM_VCU_Authentication_MAC_B2, ComSystemTemplateSystemSignalRef=BCM_VCU_Authentication_MAC_B2
        BCM_VCU_Authentication_MAC_B3: ComBitPosition=24, ComNotification=Rte_COMCbk_BCM_VCU_Authentication_MAC_B3, ComSystemTemplateSystemSignalRef=BCM_VCU_Authentication_MAC_B3
        BCM_VCU_Authentication_MAC_B4: ComBitPosition=32, ComNotification=Rte_COMCbk_BCM_VCU_Authentication_MAC_B4, ComSystemTemplateSystemSignalRef=BCM_VCU_Authentication_MAC_B4
        BCM_VCU_Authentication_MAC_B5: ComBitPosition=40, ComNotification=Rte_COMCbk_BCM_VCU_Authentication_MAC_B5, ComSystemTemplateSystemSignalRef=BCM_VCU_Authentication_MAC_B5
        BCM_VCU_Authentication_MAC_B6: ComBitPosition=48, ComNotification=Rte_COMCbk_BCM_VCU_Authentication_MAC_B6, ComSystemTemplateSystemSignalRef=BCM_VCU_Authentication_MAC_B6
        BCM_VCU_Authentication_MAC_B7: ComBitPosition=56, ComNotification=Rte_COMCbk_BCM_VCU_Authentication_MAC_B7, ComSystemTemplateSystemSignalRef=BCM_VCU_Authentication_MAC_B7
        BCM_VCU_Authentication_MAC_B8: ComBitPosition=64, ComNotification=Rte_COMCbk_BCM_VCU_Authentication_MAC_B8, ComSystemTemplateSystemSignalRef=BCM_VCU_Authentication_MAC_B8
        BCM_VCU_Authentication_MAC_B9: ComBitPosition=72, ComNotification=Rte_COMCbk_BCM_VCU_Authentication_MAC_B9, ComSystemTemplateSystemSignalRef=BCM_VCU_Authentication_MAC_B9
        BCM_VCU_Authentication_MAC_B10: ComBitPosition=80, ComNotification=Rte_COMCbk_BCM_VCU_Authentication_MAC_B10, ComSystemTemplateSystemSignalRef=BCM_VCU_Authentication_MAC_B10
        BCM_VCU_Authentication_MAC_B11: ComBitPosition=88, ComNotification=Rte_COMCbk_BCM_VCU_Authentication_MAC_B11, ComSystemTemplateSystemSignalRef=BCM_VCU_Authentication_MAC_B11
        BCM_VCU_Authentication_MAC_B12: ComBitPosition=96, ComNotification=Rte_COMCbk_BCM_VCU_Authentication_MAC_B12, ComSystemTemplateSystemSignalRef=BCM_VCU_Authentication_MAC_B12
        BCM_VCU_Authentication_MAC_B13: ComBitPosition=104, ComNotification=Rte_COMCbk_BCM_VCU_Authentication_MAC_B13, ComSystemTemplateSystemSignalRef=BCM_VCU_Authentication_MAC_B13
        BCM_VCU_Authentication_MAC_B14: ComBitPosition=112, ComNotification=Rte_COMCbk_BCM_VCU_Authentication_MAC_B14, ComSystemTemplateSystemSignalRef=BCM_VCU_Authentication_MAC_B14
        BCM_VCU_Authentication_MAC_B15: ComBitPosition=120, ComNotification=Rte_COMCbk_BCM_VCU_Authentication_MAC_B15, ComSystemTemplateSystemSignalRef=BCM_VCU_Authentication_MAC_B15
      BMS_0x310_P_CANFD (ComIPdu):
        ComIPduSignalProcessing = IMMEDIATE
        ComIPduType = NORMAL
        ComIPduDirection = RECEIVE
        ComIPduCallout = ComCallOut_BMS_0x310_P_CANFD
        ComIPduErrorNotification = ComCbk_RxTimeOut_BMS_0x310_P_CANFD
        ComFirstTimeout = 3.0
        ComTimeout = 1.0
        ComIPduGroupRef = ComIPduGroup_Rx
        ComPduIdRef = PduCollection/BMS_0x310_P_CANFD_PduR2Com
        ComIPduSignalRef = BMS_InverterPower
        ComIPduSignalRef = BMS_MaxChargeVolt
        ComIPduSignalRef = BMS_MaxChargeCurr
        ComIPduSignalRef = BMS_OBCWorkModeCtrl
        ComIPduSignalRef = BMS_MaxPower
        ComIPduSignalRef = BMS_ChargerACInput
        ComIPduSignalRef = BMS_ChargerDCInput
        ComIPduSignalRef = BMS_ChargeRequest
        ComIPduSignalRef = BMS_InverterRequest
        ComIPduSignalRef = BMS_ChargeQuantity
        ComIPduSignalRef = BMS_BattMaxTemp
        ComIPduSignalRef = BMS_BattMinTemp
        ComIPduSignalRef = BMS_BattIntakeTemp
        ComIPduSignalRef = BMS_BattIOutletTemp
        ComIPduSignalRef = BMS_BattSOC_Display
        ComIPduSignalRef = BMS_Req_Cab220VInverter_Sts
        ComIPduSignalRef = BMS_Req_Cabin220VInverter_Sts
        ComIPduSignalRef = BMS_RemainEnergy
        ComIPduSignalRef = BMS_StateOfEngeryMax
        ComIPduSignalRef = BMS_ThermalManageRequest
        ComIPduSignalRef = BMS_PreHeatingState
      21 x ComSignal, all with ComSignalInitValue=0, ComSignalEndianness=LITTLE_ENDIAN, ComUpdateBitPosition=-1, ComTransferProperty=TRIGGERED:
        BMS_InverterPower: ComSignalType=UINT8, ComBitSize=8, ComBitPosition=8, ComNotification=Rte_COMCbk_BMS_InverterPower, ComSystemTemplateSystemSignalRef=BMS_InverterPower
        BMS_MaxChargeVolt: ComSignalType=UINT16, ComBitSize=16, ComBitPosition=16, ComNotification=Rte_COMCbk_BMS_MaxChargeVolt, ComSystemTemplateSystemSignalRef=BMS_MaxChargeVolt
        BMS_MaxChargeCurr: ComSignalType=UINT16, ComBitSize=12, ComBitPosition=32, ComNotification=Rte_COMCbk_BMS_MaxChargeCurr, ComSystemTemplateSystemSignalRef=BMS_MaxChargeCurr
        BMS_OBCWorkModeCtrl: ComSignalType=UINT8, ComBitSize=3, ComBitPosition=44, ComNotification=Rte_COMCbk_BMS_OBCWorkModeCtrl, ComSystemTemplateSystemSignalRef=BMS_OBCWorkModeCtrl
        BMS_MaxPower: ComSignalType=UINT16, ComBitSize=9, ComBitPosition=47, ComNotification=Rte_COMCbk_BMS_MaxPower, ComSystemTemplateSystemSignalRef=BMS_MaxPower
        BMS_ChargerACInput: ComSignalType=BOOLEAN, ComBitSize=1, ComBitPosition=56, ComNotification=Rte_COMCbk_BMS_ChargerACInput, ComSystemTemplateSystemSignalRef=BMS_ChargerACInput
        BMS_ChargerDCInput: ComSignalType=BOOLEAN, ComBitSize=1, ComBitPosition=57, ComNotification=Rte_COMCbk_BMS_ChargerDCInput, ComSystemTemplateSystemSignalRef=BMS_ChargerDCInput
        BMS_ChargeRequest: ComSignalType=BOOLEAN, ComBitSize=1, ComBitPosition=58, ComNotification=Rte_COMCbk_BMS_ChargeRequest, ComSystemTemplateSystemSignalRef=BMS_ChargeRequest
        BMS_InverterRequest: ComSignalType=BOOLEAN, ComBitSize=1, ComBitPosition=59, ComNotification=Rte_COMCbk_BMS_InverterRequest, ComSystemTemplateSystemSignalRef=BMS_InverterRequest
        BMS_ChargeQuantity: ComSignalType=UINT16, ComBitSize=10, ComBitPosition=70, ComNotification=Rte_COMCbk_BMS_ChargeQuantity, ComSystemTemplateSystemSignalRef=BMS_ChargeQuantity
        BMS_BattMaxTemp: ComSignalType=UINT8, ComBitSize=8, ComBitPosition=80, ComNotification=Rte_COMCbk_BMS_BattMaxTemp, ComSystemTemplateSystemSignalRef=BMS_BattMaxTemp
        BMS_BattMinTemp: ComSignalType=UINT8, ComBitSize=8, ComBitPosition=88, ComNotification=Rte_COMCbk_BMS_BattMinTemp, ComSystemTemplateSystemSignalRef=BMS_BattMinTemp
        BMS_BattIntakeTemp: ComSignalType=UINT8, ComBitSize=8, ComBitPosition=120, ComNotification=Rte_COMCbk_BMS_BattIntakeTemp, ComSystemTemplateSystemSignalRef=BMS_BattIntakeTemp
        BMS_BattIOutletTemp: ComSignalType=UINT8, ComBitSize=8, ComBitPosition=128, ComNotification=Rte_COMCbk_BMS_BattIOutletTemp, ComSystemTemplateSystemSignalRef=BMS_BattIOutletTemp
        BMS_BattSOC_Display: ComSignalType=UINT16, ComBitSize=10, ComBitPosition=144, ComNotification=Rte_COMCbk_BMS_BattSOC_Display, ComSystemTemplateSystemSignalRef=BMS_BattSOC_Display
        BMS_Req_Cab220VInverter_Sts: ComSignalType=BOOLEAN, ComBitSize=1, ComBitPosition=174, ComNotification=Rte_COMCbk_BMS_Req_Cab220VInverter_Sts, ComSystemTemplateSystemSignalRef=BMS_Req_Cab220VInverter_Sts
        BMS_Req_Cabin220VInverter_Sts: ComSignalType=BOOLEAN, ComBitSize=1, ComBitPosition=175, ComNotification=Rte_COMCbk_BMS_Req_Cabin220VInverter_Sts, ComSystemTemplateSystemSignalRef=BMS_Req_Cabin220VInverter_Sts
        BMS_RemainEnergy: ComSignalType=UINT16, ComBitSize=16, ComBitPosition=176, ComNotification=Rte_COMCbk_BMS_RemainEnergy, ComSystemTemplateSystemSignalRef=BMS_RemainEnergy
        BMS_StateOfEngeryMax: ComSignalType=UINT16, ComBitSize=16, ComBitPosition=192, ComNotification=Rte_COMCbk_BMS_StateOfEngeryMax, ComSystemTemplateSystemSignalRef=BMS_StateOfEngeryMax
        BMS_ThermalManageRequest: ComSignalType=UINT8, ComBitSize=3, ComBitPosition=240, ComNotification=Rte_COMCbk_BMS_ThermalManageRequest, ComSystemTemplateSystemSignalRef=BMS_ThermalManageRequest
        BMS_PreHeatingState: ComSignalType=UINT8, ComBitSize=2, ComBitPosition=244, ComNotification=Rte_COMCbk_BMS_PreHeatingState, ComSystemTemplateSystemSignalRef=BMS_PreHeatingState
      UDS_Phy_Rx_7E0_ECM_P_CANFD (ComIPdu):
        ComIPduSignalProcessing = IMMEDIATE
        ComIPduType = NORMAL
        ComIPduDirection = RECEIVE
        ComIPduGroupRef = ComIPduGroup_Rx
        ComPduIdRef = PduCollection/UDS_Phy_Rx_7E0_ECM_P_CANFD_PduR2Com
        ComIPduSignalRef = ECM_UDS_PhyReq_Byte{0..7}
      8 x ComSignal, all with ComSignalInitValue=0, ComSignalType=UINT8, ComSignalEndianness=LITTLE_ENDIAN, ComBitSize=8, ComUpdateBitPosition=-1, ComTransferProperty=TRIGGERED:
        ECM_UDS_PhyReq_Byte0: ComBitPosition=0, ComNotification=Rte_COMCbk_ECM_UDS_PhyReq_Byte0, ComSystemTemplateSystemSignalRef=ECM_UDS_PhyReq_Byte0
        ECM_UDS_PhyReq_Byte1: ComBitPosition=8, ComNotification=Rte_COMCbk_ECM_UDS_PhyReq_Byte1, ComSystemTemplateSystemSignalRef=ECM_UDS_PhyReq_Byte1
        ECM_UDS_PhyReq_Byte2: ComBitPosition=16, ComNotification=Rte_COMCbk_ECM_UDS_PhyReq_Byte2, ComSystemTemplateSystemSignalRef=ECM_UDS_PhyReq_Byte2
        ECM_UDS_PhyReq_Byte3: ComBitPosition=24, ComNotification=Rte_COMCbk_ECM_UDS_PhyReq_Byte3, ComSystemTemplateSystemSignalRef=ECM_UDS_PhyReq_Byte3
        ECM_UDS_PhyReq_Byte4: ComBitPosition=32, ComNotification=Rte_COMCbk_ECM_UDS_PhyReq_Byte4, ComSystemTemplateSystemSignalRef=ECM_UDS_PhyReq_Byte4
        ECM_UDS_PhyReq_Byte5: ComBitPosition=40, ComNotification=Rte_COMCbk_ECM_UDS_PhyReq_Byte5, ComSystemTemplateSystemSignalRef=ECM_UDS_PhyReq_Byte5
        ECM_UDS_PhyReq_Byte6: ComBitPosition=48, ComNotification=Rte_COMCbk_ECM_UDS_PhyReq_Byte6, ComSystemTemplateSystemSignalRef=ECM_UDS_PhyReq_Byte6
        ECM_UDS_PhyReq_Byte7: ComBitPosition=56, ComNotification=Rte_COMCbk_ECM_UDS_PhyReq_Byte7, ComSystemTemplateSystemSignalRef=ECM_UDS_PhyReq_Byte7
      IVI_0x3D8_P_CANFD (ComIPdu):
        ComIPduSignalProcessing = IMMEDIATE
        ComIPduType = NORMAL
        ComIPduDirection = RECEIVE
        ComIPduCallout = ComCallOut_IVI_0x3D8_P_CANFD
        ComIPduErrorNotification = ComCbk_RxTimeOut_IVI_0x3D8_P_CANFD
        ComFirstTimeout = 3.0
        ComTimeout = 1.0
        ComIPduGroupRef = ComIPduGroup_Rx
        ComPduIdRef = PduCollection/IVI_0x3D8_P_CANFD_PduR2Com
        ComIPduSignalRef = IVI_InventerLimitOdometerkm
        ComIPduSignalRef = IVI_FuelDetMode
        ComIPduSignalRef = IVI_EngineIdlingMode
        ComIPduSignalRef = IVI_CarWashMode
        ComIPduSignalRef = IVI_CampingModeSW
        ComIPduSignalRef = IVI_SpeedLimitModeSW
        ComIPduSignalRef = IVI_FuelupReq
        ComIPduSignalRef = IVI_FuelChgLevel
        ComIPduSignalRef = IVI_FuelChgMode
        ComIPduSignalRef = IVI_InventerLimitOdometerkmVD
        ComIPduSignalRef = IVI_EMSRepairModeReq
        ComIPduSignalRef = IVI_ForceChgModeReq
        ComIPduSignalRef = IVI_ForceChgTargetSOCVD
        ComIPduSignalRef = IVI_SpeedLimitModeSpeed
        ComIPduSignalRef = IVI_AWDModeSW
        ComIPduSignalRef = IVI_ForceChgTargetSOC
      16 x ComSignal, all with ComSignalInitValue=0, ComSignalEndianness=LITTLE_ENDIAN, ComUpdateBitPosition=-1, ComTransferProperty=TRIGGERED:
        IVI_InventerLimitOdometerkm: ComSignalType=UINT16, ComBitSize=12, ComBitPosition=0, ComNotification=Rte_COMCbk_IVI_InventerLimitOdometerkm, ComSystemTemplateSystemSignalRef=IVI_InventerLimitOdometerkm
        IVI_FuelDetMode: ComSignalType=BOOLEAN, ComBitSize=1, ComBitPosition=12, ComNotification=Rte_COMCbk_IVI_FuelDetMode, ComSystemTemplateSystemSignalRef=IVI_FuelDetMode
        IVI_EngineIdlingMode: ComSignalType=BOOLEAN, ComBitSize=1, ComBitPosition=13, ComNotification=Rte_COMCbk_IVI_EngineIdlingMode, ComSystemTemplateSystemSignalRef=IVI_EngineIdlingMode
        IVI_CarWashMode: ComSignalType=BOOLEAN, ComBitSize=1, ComBitPosition=14, ComNotification=Rte_COMCbk_IVI_CarWashMode, ComSystemTemplateSystemSignalRef=IVI_CarWashMode
        IVI_CampingModeSW: ComSignalType=BOOLEAN, ComBitSize=1, ComBitPosition=15, ComNotification=Rte_COMCbk_IVI_CampingModeSW, ComSystemTemplateSystemSignalRef=IVI_CampingModeSW
        IVI_SpeedLimitModeSW: ComSignalType=BOOLEAN, ComBitSize=1, ComBitPosition=18, ComNotification=Rte_COMCbk_IVI_SpeedLimitModeSW, ComSystemTemplateSystemSignalRef=IVI_SpeedLimitModeSW
        IVI_FuelupReq: ComSignalType=BOOLEAN, ComBitSize=1, ComBitPosition=19, ComNotification=Rte_COMCbk_IVI_FuelupReq, ComSystemTemplateSystemSignalRef=IVI_FuelupReq
        IVI_FuelChgLevel: ComSignalType=UINT8, ComBitSize=2, ComBitPosition=57, ComNotification=Rte_COMCbk_IVI_FuelChgLevel, ComSystemTemplateSystemSignalRef=IVI_FuelChgLevel
        IVI_FuelChgMode: ComSignalType=BOOLEAN, ComBitSize=1, ComBitPosition=56, ComNotification=Rte_COMCbk_IVI_FuelChgMode, ComSystemTemplateSystemSignalRef=IVI_FuelChgMode
        IVI_InventerLimitOdometerkmVD: ComSignalType=BOOLEAN, ComBitSize=1, ComBitPosition=20, ComNotification=Rte_COMCbk_IVI_InventerLimitOdometerkmVD, ComSystemTemplateSystemSignalRef=IVI_InventerLimitOdometerkmVD
        IVI_EMSRepairModeReq: ComSignalType=BOOLEAN, ComBitSize=1, ComBitPosition=21, ComNotification=Rte_COMCbk_IVI_EMSRepairModeReq, ComSystemTemplateSystemSignalRef=IVI_EMSRepairModeReq
        IVI_ForceChgModeReq: ComSignalType=BOOLEAN, ComBitSize=1, ComBitPosition=22, ComNotification=Rte_COMCbk_IVI_ForceChgModeReq, ComSystemTemplateSystemSignalRef=IVI_ForceChgModeReq
        IVI_ForceChgTargetSOCVD: ComSignalType=BOOLEAN, ComBitSize=1, ComBitPosition=23, ComNotification=Rte_COMCbk_IVI_ForceChgTargetSOCVD, ComSystemTemplateSystemSignalRef=IVI_ForceChgTargetSOCVD
        IVI_SpeedLimitModeSpeed: ComSignalType=UINT8, ComBitSize=8, ComBitPosition=24, ComNotification=Rte_COMCbk_IVI_SpeedLimitModeSpeed, ComSystemTemplateSystemSignalRef=IVI_SpeedLimitModeSpeed
        IVI_AWDModeSW: ComSignalType=BOOLEAN, ComBitSize=1, ComBitPosition=38, ComNotification=Rte_COMCbk_IVI_AWDModeSW, ComSystemTemplateSystemSignalRef=IVI_AWDModeSW
        IVI_ForceChgTargetSOC: ComSignalType=UINT8, ComBitSize=8, ComBitPosition=48, ComNotification=Rte_COMCbk_IVI_ForceChgTargetSOC, ComSystemTemplateSystemSignalRef=IVI_ForceChgTargetSOC
      ICU_0x24C_P_CANFD (ComIPdu):
        ComIPduSignalProcessing = IMMEDIATE
        ComIPduType = NORMAL
        ComIPduDirection = RECEIVE
        ComIPduCallout = ComCallOut_ICU_0x24C_P_CANFD
        ComIPduErrorNotification = ComCbk_RxTimeOut_ICU_0x24C_P_CANFD
        ComFirstTimeout = 15.5
        ComTimeout = 0.5
        ComIPduGroupRef = ComIPduGroup_Rx
        ComPduIdRef = PduCollection/ICU_0x24C_P_CANFD_PduR2Com
        ComIPduSignalRef = ICU_CRC_24C
        ComIPduSignalRef = ICU_PHEVMode
        ComIPduSignalRef = ICU_RollingCounter_24C
        ComIPduSignalRef = ICU_TotalOdometerkm
        ComIPduSignalRef = ICU_AccelerationMode
        ComIPduSignalRef = ICU_REMode
        ComIPduSignalRef = ICU_CreepMode
        ComIPduSignalRef = ICU_EnergyRecoveryMode
      8 x ComSignal, all with ComSignalInitValue=0, ComSignalEndianness=LITTLE_ENDIAN, ComUpdateBitPosition=-1, ComTransferProperty=TRIGGERED:
        ICU_CRC_24C: ComSignalType=UINT8, ComBitSize=8, ComBitPosition=0, ComNotification=Rte_COMCbk_ICU_CRC_24C, ComSystemTemplateSystemSignalRef=ICU_CRC_24C
        ICU_PHEVMode: ComSignalType=UINT8, ComBitSize=3, ComBitPosition=50, ComNotification=Rte_COMCbk_ICU_PHEVMode, ComSystemTemplateSystemSignalRef=ICU_PHEVMode
        ICU_RollingCounter_24C: ComSignalType=UINT8, ComBitSize=4, ComBitPosition=8, ComNotification=Rte_COMCbk_ICU_RollingCounter_24C, ComSystemTemplateSystemSignalRef=ICU_RollingCounter_24C
        ICU_TotalOdometerkm: ComSignalType=UINT32, ComBitSize=20, ComBitPosition=16, ComNotification=Rte_COMCbk_ICU_TotalOdometerkm, ComSystemTemplateSystemSignalRef=ICU_TotalOdometerkm
        ICU_AccelerationMode: ComSignalType=UINT8, ComBitSize=3, ComBitPosition=40, ComNotification=Rte_COMCbk_ICU_AccelerationMode, ComSystemTemplateSystemSignalRef=ICU_AccelerationMode
        ICU_REMode: ComSignalType=UINT8, ComBitSize=3, ComBitPosition=43, ComNotification=Rte_COMCbk_ICU_REMode, ComSystemTemplateSystemSignalRef=ICU_REMode
        ICU_CreepMode: ComSignalType=UINT8, ComBitSize=2, ComBitPosition=46, ComNotification=Rte_COMCbk_ICU_CreepMode, ComSystemTemplateSystemSignalRef=ICU_CreepMode
        ICU_EnergyRecoveryMode: ComSignalType=UINT8, ComBitSize=2, ComBitPosition=48, ComNotification=Rte_COMCbk_ICU_EnergyRecoveryMode, ComSystemTemplateSystemSignalRef=ICU_EnergyRecoveryMode
      IVI_0x34A_P_CANFD (ComIPdu):
        ComIPduSignalProcessing = IMMEDIATE
        ComIPduType = NORMAL
        ComIPduDirection = RECEIVE
        ComIPduCallout = ComCallOut_IVI_0x34A_P_CANFD
        ComIPduErrorNotification = ComCbk_RxTimeOut_IVI_0x34A_P_CANFD
        ComFirstTimeout = 1.3
        ComTimeout = 0.05
        ComIPduGroupRef = ComIPduGroup_Rx
        ComPduIdRef = PduCollection/IVI_0x34A_P_CANFD_PduR2Com
        ComIPduSignalRef = IVI_DeliveryModeReq
        ComIPduSignalRef = IVI_ShowCarModeReq
      IVI_DeliveryModeReq (ComSignal):
        ComSignalInitValue = 0
        ComSignalType = UINT8
        ComSignalEndianness = LITTLE_ENDIAN
        ComBitSize = 2
        ComBitPosition = 20
        ComUpdateBitPosition = -1
        ComTransferProperty = TRIGGERED
        ComNotification = Rte_COMCbk_IVI_DeliveryModeReq
        ComSystemTemplateSystemSignalRef = IVI_DeliveryModeReq
      IVI_ShowCarModeReq (ComSignal):
        ComSignalInitValue = 0
        ComSignalType = UINT8
        ComSignalEndianness = LITTLE_ENDIAN
        ComBitSize = 2
        ComBitPosition = 22
        ComUpdateBitPosition = -1
        ComTransferProperty = TRIGGERED
        ComNotification = Rte_COMCbk_IVI_ShowCarModeReq
        ComSystemTemplateSystemSignalRef = IVI_ShowCarModeReq
      TMS_0x5A2_P_CANFD (ComIPdu):
        ComIPduSignalProcessing = IMMEDIATE
        ComIPduType = NORMAL
        ComIPduDirection = RECEIVE
        ComIPduCallout = ComCallOut_TMS_0x5A2_P_CANFD
        ComIPduErrorNotification = ComCbk_RxTimeOut_TMS_0x5A2_P_CANFD
        ComFirstTimeout = 7.0
        ComTimeout = 5.0
        ComIPduGroupRef = ComIPduGroup_Rx
        ComPduIdRef = PduCollection/TMS_0x5A2_P_CANFD_PduR2Com
        ComIPduSignalRef = TMS_MainMotPumpSpdResp
        ComIPduSignalRef = TMS_MainMotPump_Operation_Temp
        ComIPduSignalRef = TMS_MainMotPump_Operation_Current
        ComIPduSignalRef = TMS_MainMotPump_Supplied_Voltage
        ComIPduSignalRef = TMS_MainMotPumpErrSts
      5 x ComSignal, all with ComSignalInitValue=0, ComSignalType=UINT8, ComSignalEndianness=LITTLE_ENDIAN, ComUpdateBitPosition=-1, ComTransferProperty=TRIGGERED:
        TMS_MainMotPumpSpdResp: ComBitSize=8, ComBitPosition=24, ComNotification=Rte_COMCbk_TMS_MainMotPumpSpdResp, ComSystemTemplateSystemSignalRef=TMS_MainMotPumpSpdResp
        TMS_MainMotPump_Operation_Temp: ComBitSize=8, ComBitPosition=32, ComNotification=Rte_COMCbk_TMS_MainMotPump_Operation_Temp, ComSystemTemplateSystemSignalRef=TMS_MainMotPump_Operation_Temp
        TMS_MainMotPump_Operation_Current: ComBitSize=8, ComBitPosition=40, ComNotification=Rte_COMCbk_TMS_MainMotPump_Operation_Current, ComSystemTemplateSystemSignalRef=TMS_MainMotPump_Operation_Current
        TMS_MainMotPump_Supplied_Voltage: ComBitSize=8, ComBitPosition=48, ComNotification=Rte_COMCbk_TMS_MainMotPump_Supplied_Voltage, ComSystemTemplateSystemSignalRef=TMS_MainMotPump_Supplied_Voltage
        TMS_MainMotPumpErrSts: ComBitSize=4, ComBitPosition=56, ComNotification=Rte_COMCbk_TMS_MainMotPumpErrSts, ComSystemTemplateSystemSignalRef=TMS_MainMotPumpErrSts
      TMS_0x363_P_CANFD (ComIPdu):
        ComIPduSignalProcessing = IMMEDIATE
        ComIPduType = NORMAL
        ComIPduDirection = RECEIVE
        ComIPduCallout = ComCallOut_TMS_0x363_P_CANFD
        ComIPduErrorNotification = ComCbk_RxTimeOut_TMS_0x363_P_CANFD
        ComFirstTimeout = 3.0
        ComTimeout = 1.0
        ComIPduGroupRef = ComIPduGroup_Rx
        ComPduIdRef = PduCollection/TMS_0x363_P_CANFD_PduR2Com
        ComIPduSignalRef = TMS_RollingCounter_363
        ComIPduSignalRef = TMS_AC_Command
        ComIPduSignalRef = TMS_PTCHeatingReq
        ComIPduSignalRef = TMS_PTCPowerSet
        ComIPduSignalRef = TMS_OutsideTempVD
        ComIPduSignalRef = TMS_OutsideTemp_Corrected
      6 x ComSignal, all with ComSignalInitValue=0, ComSignalEndianness=LITTLE_ENDIAN, ComUpdateBitPosition=-1, ComTransferProperty=TRIGGERED:
        TMS_RollingCounter_363: ComSignalType=UINT8, ComBitSize=4, ComBitPosition=0, ComNotification=Rte_COMCbk_TMS_RollingCounter_363, ComSystemTemplateSystemSignalRef=TMS_RollingCounter_363
        TMS_AC_Command: ComSignalType=BOOLEAN, ComBitSize=1, ComBitPosition=22, ComNotification=Rte_COMCbk_TMS_AC_Command, ComSystemTemplateSystemSignalRef=TMS_AC_Command
        TMS_PTCHeatingReq: ComSignalType=BOOLEAN, ComBitSize=1, ComBitPosition=23, ComNotification=Rte_COMCbk_TMS_PTCHeatingReq, ComSystemTemplateSystemSignalRef=TMS_PTCHeatingReq
        TMS_PTCPowerSet: ComSignalType=UINT8, ComBitSize=8, ComBitPosition=32, ComNotification=Rte_COMCbk_TMS_PTCPowerSet, ComSystemTemplateSystemSignalRef=TMS_PTCPowerSet
        TMS_OutsideTempVD: ComSignalType=BOOLEAN, ComBitSize=1, ComBitPosition=55, ComNotification=Rte_COMCbk_TMS_OutsideTempVD, ComSystemTemplateSystemSignalRef=TMS_OutsideTempVD
        TMS_OutsideTemp_Corrected: ComSignalType=UINT8, ComBitSize=8, ComBitPosition=64, ComNotification=Rte_COMCbk_TMS_OutsideTemp_Corrected, ComSystemTemplateSystemSignalRef=TMS_OutsideTemp_Corrected
      ECM_0x148_P_CANFD (ComIPdu):
        ComIPduSignalProcessing = IMMEDIATE
        ComIPduType = NORMAL
        ComIPduDirection = RECEIVE
        ComIPduGroupRef = ComIPduGroup_Rx
        ComPduIdRef = PduCollection/ECM_0x148_P_CANFD_PduR2Com
        ComIPduSignalRef = ECM_SWVersionC
        ComIPduSignalRef = ECM_SWVersionB
        ComIPduSignalRef = ECM_SWVersionA
        ComIPduSignalRef = ECM_Total_fuel_consumed
      4 x ComSignal, all with ComSignalInitValue=0, ComSignalEndianness=LITTLE_ENDIAN, ComUpdateBitPosition=-1, ComTransferProperty=TRIGGERED:
        ECM_SWVersionC: ComSignalType=UINT8, ComBitSize=8, ComBitPosition=0, ComNotification=Rte_COMCbk_ECM_SWVersionC, ComSystemTemplateSystemSignalRef=ECM_SWVersionC
        ECM_SWVersionB: ComSignalType=UINT8, ComBitSize=8, ComBitPosition=8, ComNotification=Rte_COMCbk_ECM_SWVersionB, ComSystemTemplateSystemSignalRef=ECM_SWVersionB
        ECM_SWVersionA: ComSignalType=UINT8, ComBitSize=4, ComBitPosition=16, ComNotification=Rte_COMCbk_ECM_SWVersionA, ComSystemTemplateSystemSignalRef=ECM_SWVersionA
        ECM_Total_fuel_consumed: ComSignalType=UINT32, ComBitSize=32, ComBitPosition=64, ComNotification=Rte_COMCbk_ECM_Total_fuel_consumed, ComSystemTemplateSystemSignalRef=ECM_Total_fuel_consumed
      IBS_0x225_P_CANFD (ComIPdu):
        ComIPduSignalProcessing = IMMEDIATE
        ComIPduType = NORMAL
        ComIPduDirection = RECEIVE
        ComIPduCallout = ComCallOut_IBS_0x225_P_CANFD
        ComIPduErrorNotification = ComCbk_RxTimeOut_IBS_0x225_P_CANFD
        ComTimeout = 0.2
        ComFirstTimeout = 2.2
        ComIPduGroupRef = ComIPduGroup_Rx
        ComPduIdRef = PduCollection/IBS_0x225_P_CANFD_PduR2Com
        ComIPduSignalRef = IBS_CRC_225
        ComIPduSignalRef = IBS_RollingCounter_225
        ComIPduSignalRef = IBS_Warning_Level
      3 x ComSignal, all with ComSignalInitValue=0, ComSignalType=UINT8, ComSignalEndianness=LITTLE_ENDIAN, ComUpdateBitPosition=-1, ComTransferProperty=TRIGGERED:
        IBS_CRC_225: ComBitSize=8, ComBitPosition=0, ComNotification=Rte_COMCbk_IBS_CRC_225, ComSystemTemplateSystemSignalRef=IBS_CRC_225
        IBS_RollingCounter_225: ComBitSize=4, ComBitPosition=8, ComNotification=Rte_COMCbk_IBS_RollingCounter_225, ComSystemTemplateSystemSignalRef=IBS_RollingCounter_225
        IBS_Warning_Level: ComBitSize=2, ComBitPosition=46, ComNotification=Rte_COMCbk_IBS_Warning_Level, ComSystemTemplateSystemSignalRef=IBS_Warning_Level
      HPCGW_0x3B1_P_CANFD (ComIPdu):
        ComIPduSignalProcessing = IMMEDIATE
        ComIPduType = NORMAL
        ComIPduDirection = RECEIVE
        ComIPduCallout = ComCallOut_HPCGW_0x3B1_P_CANFD
        ComIPduErrorNotification = ComCbk_RxTimeOut_HPCGW_0x3B1_P_CANFD
        ComFirstTimeout = 3.0
        ComTimeout = 1.0
        ComIPduGroupRef = ComIPduGroup_Rx
        ComPduIdRef = PduCollection/HPCGW_0x3B1_P_CANFD_PduR2Com
        ComIPduSignalRef = GW_CRC_3B1
        ComIPduSignalRef = GW_RollingCounter_3B1
        ComIPduSignalRef = GW_ACU_FLSeatBeltRSt
        ComIPduSignalRef = GW_ACU_FRSeatBeltRSt
        ComIPduSignalRef = GW_IBC_EPB_Status
        ComIPduSignalRef = GW_ACU_TotalCrashOutputSts
        ComIPduSignalRef = GW_BZCU_DCChgExitTemp_Pos
        ComIPduSignalRef = GW_BZCU_DCChgExitTemp_Neg
        ComIPduSignalRef = GW_BZCU_ACChgExitTemp_Pos
        ComIPduSignalRef = GW_BZCU_FuelTankSts
        ComIPduSignalRef = GW_BZCU_LBMS_VoltA
        ComIPduSignalRef = GW_BZCU_ACChgExitTemp_Neg
        ComIPduSignalRef = GW_BZCU_FuelTankStsLockSts
        ComIPduSignalRef = GW_BZCU_FuelTankLockCtrl
        ComIPduSignalRef = GW_BZCU_ACChgLockSts
        ComIPduSignalRef = GW_RZCU_Cabin_220Vconnect_Sts
        ComIPduSignalRef = GW_BZCU_Cab_220VRelay_CtrlSts
        ComIPduSignalRef = GW_BZCU_Cab_PDU220VRelay_CtrlSts
        ComIPduSignalRef = GW_BZCU_Cabin_220VRelay_CtrlSts
        ComIPduSignalRef = GW_BZCU_Cab_220Vconnect_Sts
        ComIPduSignalRef = GW_TBOXSOC_Altitude
      21 x ComSignal, all with ComSignalInitValue=0, ComSignalEndianness=LITTLE_ENDIAN, ComUpdateBitPosition=-1, ComTransferProperty=TRIGGERED:
        GW_CRC_3B1: ComSignalType=UINT8, ComBitSize=8, ComBitPosition=0, ComNotification=Rte_COMCbk_GW_CRC_3B1, ComSystemTemplateSystemSignalRef=GW_CRC_3B1
        GW_RollingCounter_3B1: ComSignalType=UINT8, ComBitSize=4, ComBitPosition=8, ComNotification=Rte_COMCbk_GW_RollingCounter_3B1, ComSystemTemplateSystemSignalRef=GW_RollingCounter_3B1
        GW_ACU_FLSeatBeltRSt: ComSignalType=UINT8, ComBitSize=2, ComBitPosition=16, ComNotification=Rte_COMCbk_GW_ACU_FLSeatBeltRSt, ComSystemTemplateSystemSignalRef=GW_ACU_FLSeatBeltRSt
        GW_ACU_FRSeatBeltRSt: ComSignalType=UINT8, ComBitSize=2, ComBitPosition=18, ComNotification=Rte_COMCbk_GW_ACU_FRSeatBeltRSt, ComSystemTemplateSystemSignalRef=GW_ACU_FRSeatBeltRSt
        GW_IBC_EPB_Status: ComSignalType=UINT8, ComBitSize=3, ComBitPosition=20, ComNotification=Rte_COMCbk_GW_IBC_EPB_Status, ComSystemTemplateSystemSignalRef=GW_IBC_EPB_Status
        GW_ACU_TotalCrashOutputSts: ComSignalType=BOOLEAN, ComBitSize=1, ComBitPosition=40, ComNotification=Rte_COMCbk_GW_ACU_TotalCrashOutputSts, ComSystemTemplateSystemSignalRef=GW_ACU_TotalCrashOutputSts
        GW_BZCU_DCChgExitTemp_Pos: ComSignalType=UINT8, ComBitSize=8, ComBitPosition=56, ComNotification=Rte_COMCbk_GW_BZCU_DCChgExitTemp_Pos, ComSystemTemplateSystemSignalRef=GW_BZCU_DCChgExitTemp_Pos
        GW_BZCU_DCChgExitTemp_Neg: ComSignalType=UINT8, ComBitSize=8, ComBitPosition=64, ComNotification=Rte_COMCbk_GW_BZCU_DCChgExitTemp_Neg, ComSystemTemplateSystemSignalRef=GW_BZCU_DCChgExitTemp_Neg
        GW_BZCU_ACChgExitTemp_Pos: ComSignalType=UINT8, ComBitSize=8, ComBitPosition=72, ComNotification=Rte_COMCbk_GW_BZCU_ACChgExitTemp_Pos, ComSystemTemplateSystemSignalRef=GW_BZCU_ACChgExitTemp_Pos
        GW_BZCU_FuelTankSts: ComSignalType=BOOLEAN, ComBitSize=1, ComBitPosition=94, ComNotification=Rte_COMCbk_GW_BZCU_FuelTankSts, ComSystemTemplateSystemSignalRef=GW_BZCU_FuelTankSts
        GW_BZCU_LBMS_VoltA: ComSignalType=UINT8, ComBitSize=8, ComBitPosition=136, ComNotification=Rte_COMCbk_GW_BZCU_LBMS_VoltA, ComSystemTemplateSystemSignalRef=GW_BZCU_LBMS_VoltA
        GW_BZCU_ACChgExitTemp_Neg: ComSignalType=UINT8, ComBitSize=8, ComBitPosition=152, ComNotification=Rte_COMCbk_GW_BZCU_ACChgExitTemp_Neg, ComSystemTemplateSystemSignalRef=GW_BZCU_ACChgExitTemp_Neg
        GW_BZCU_FuelTankStsLockSts: ComSignalType=UINT8, ComBitSize=2, ComBitPosition=204, ComNotification=Rte_COMCbk_GW_BZCU_FuelTankStsLockSts, ComSystemTemplateSystemSignalRef=GW_BZCU_FuelTankStsLockSts
        GW_BZCU_FuelTankLockCtrl: ComSignalType=UINT8, ComBitSize=2, ComBitPosition=206, ComNotification=Rte_COMCbk_GW_BZCU_FuelTankLockCtrl, ComSystemTemplateSystemSignalRef=GW_BZCU_FuelTankLockCtrl
        GW_BZCU_ACChgLockSts: ComSignalType=UINT8, ComBitSize=2, ComBitPosition=208, ComNotification=Rte_COMCbk_GW_BZCU_ACChgLockSts, ComSystemTemplateSystemSignalRef=GW_BZCU_ACChgLockSts
        GW_RZCU_Cabin_220Vconnect_Sts: ComSignalType=BOOLEAN, ComBitSize=1, ComBitPosition=210, ComNotification=Rte_COMCbk_GW_RZCU_Cabin_220Vconnect_Sts, ComSystemTemplateSystemSignalRef=GW_RZCU_Cabin_220Vconnect_Sts
        GW_BZCU_Cab_220VRelay_CtrlSts: ComSignalType=BOOLEAN, ComBitSize=1, ComBitPosition=211, ComNotification=Rte_COMCbk_GW_BZCU_Cab_220VRelay_CtrlSts, ComSystemTemplateSystemSignalRef=GW_BZCU_Cab_220VRelay_CtrlSts
        GW_BZCU_Cab_PDU220VRelay_CtrlSts: ComSignalType=BOOLEAN, ComBitSize=1, ComBitPosition=212, ComNotification=Rte_COMCbk_GW_BZCU_Cab_PDU220VRelay_CtrlSts, ComSystemTemplateSystemSignalRef=GW_BZCU_Cab_PDU220VRelay_CtrlSts
        GW_BZCU_Cabin_220VRelay_CtrlSts: ComSignalType=BOOLEAN, ComBitSize=1, ComBitPosition=213, ComNotification=Rte_COMCbk_GW_BZCU_Cabin_220VRelay_CtrlSts, ComSystemTemplateSystemSignalRef=GW_BZCU_Cabin_220VRelay_CtrlSts
        GW_BZCU_Cab_220Vconnect_Sts: ComSignalType=BOOLEAN, ComBitSize=1, ComBitPosition=214, ComNotification=Rte_COMCbk_GW_BZCU_Cab_220Vconnect_Sts, ComSystemTemplateSystemSignalRef=GW_BZCU_Cab_220Vconnect_Sts
        GW_TBOXSOC_Altitude: ComSignalType=UINT16, ComBitSize=14, ComBitPosition=236, ComNotification=Rte_COMCbk_GW_TBOXSOC_Altitude, ComSystemTemplateSystemSignalRef=GW_TBOXSOC_Altitude
      GCU_0x2C1_P_CANFD (ComIPdu):
        ComIPduSignalProcessing = IMMEDIATE
        ComIPduType = NORMAL
        ComIPduDirection = RECEIVE
        ComIPduGroupRef = ComIPduGroup_Rx
        ComPduIdRef = PduCollection/GCU_0x2C1_P_CANFD_PduR2Com
        ComIPduSignalRef = GCU_SWVersionC
        ComIPduSignalRef = GCU_SWVersionB
        ComIPduSignalRef = GCU_SWVersionA
      3 x ComSignal, all with ComSignalInitValue=0, ComSignalType=UINT8, ComSignalEndianness=LITTLE_ENDIAN, ComUpdateBitPosition=-1, ComTransferProperty=TRIGGERED:
        GCU_SWVersionC: ComBitSize=8, ComBitPosition=0, ComNotification=Rte_COMCbk_GCU_SWVersionC, ComSystemTemplateSystemSignalRef=GCU_SWVersionC
        GCU_SWVersionB: ComBitSize=8, ComBitPosition=8, ComNotification=Rte_COMCbk_GCU_SWVersionB, ComSystemTemplateSystemSignalRef=GCU_SWVersionB
        GCU_SWVersionA: ComBitSize=4, ComBitPosition=16, ComNotification=Rte_COMCbk_GCU_SWVersionA, ComSystemTemplateSystemSignalRef=GCU_SWVersionA
      DCDC_0x324_P_CANFD (ComIPdu):
        ComIPduSignalProcessing = IMMEDIATE
        ComIPduType = NORMAL
        ComIPduDirection = RECEIVE
        ComIPduCallout = ComCallOut_DCDC_0x324_P_CANFD
        ComIPduErrorNotification = ComCbk_RxTimeOut_DCDC_0x324_P_CANFD
        ComFirstTimeout = 3.0
        ComTimeout = 1.0
        ComIPduGroupRef = ComIPduGroup_Rx
        ComPduIdRef = PduCollection/DCDC_0x324_P_CANFD_PduR2Com
        ComIPduSignalRef = DCDC_CRC_324
        ComIPduSignalRef = DCDC_RollingCounter_324
        ComIPduSignalRef = DCDC_WorkSts
        ComIPduSignalRef = DCDC_Under_Output_Voltage
        ComIPduSignalRef = DCDC_Over_Output_Voltage
        ComIPduSignalRef = DCDC_Under_Input_Voltage
        ComIPduSignalRef = DCDC_Over_Input_Voltage
        ComIPduSignalRef = DCDC_Over_Input_Current
        ComIPduSignalRef = DCDC_Real_Output_Current
        ComIPduSignalRef = DCDC_Real_Output_Voltage
        ComIPduSignalRef = DCDC_Real_Input_Current
        ComIPduSignalRef = DCDC_Real_Input_Voltage
        ComIPduSignalRef = DCDC_Derating
        ComIPduSignalRef = DCDC_Hardware_Fault_Flag
        ComIPduSignalRef = CDU_ACChg_HIVSts
        ComIPduSignalRef = CDU_OBC_OverTemp
        ComIPduSignalRef = CDU_SelfCheckSt
        ComIPduSignalRef = CDU_HV_HIVSts
      18 x ComSignal, all with ComSignalInitValue=0, ComSignalEndianness=LITTLE_ENDIAN, ComUpdateBitPosition=-1, ComTransferProperty=TRIGGERED:
        DCDC_CRC_324: ComSignalType=UINT8, ComBitSize=8, ComBitPosition=0, ComNotification=Rte_COMCbk_DCDC_CRC_324, ComSystemTemplateSystemSignalRef=DCDC_CRC_324
        DCDC_RollingCounter_324: ComSignalType=UINT8, ComBitSize=4, ComBitPosition=8, ComNotification=Rte_COMCbk_DCDC_RollingCounter_324, ComSystemTemplateSystemSignalRef=DCDC_RollingCounter_324
        DCDC_WorkSts: ComSignalType=UINT8, ComBitSize=3, ComBitPosition=16, ComNotification=Rte_COMCbk_DCDC_WorkSts, ComSystemTemplateSystemSignalRef=DCDC_WorkSts
        DCDC_Under_Output_Voltage: ComSignalType=BOOLEAN, ComBitSize=1, ComBitPosition=19, ComNotification=Rte_COMCbk_DCDC_Under_Output_Voltage, ComSystemTemplateSystemSignalRef=DCDC_Under_Output_Voltage
        DCDC_Over_Output_Voltage: ComSignalType=BOOLEAN, ComBitSize=1, ComBitPosition=20, ComNotification=Rte_COMCbk_DCDC_Over_Output_Voltage, ComSystemTemplateSystemSignalRef=DCDC_Over_Output_Voltage
        DCDC_Under_Input_Voltage: ComSignalType=BOOLEAN, ComBitSize=1, ComBitPosition=21, ComNotification=Rte_COMCbk_DCDC_Under_Input_Voltage, ComSystemTemplateSystemSignalRef=DCDC_Under_Input_Voltage
        DCDC_Over_Input_Voltage: ComSignalType=BOOLEAN, ComBitSize=1, ComBitPosition=22, ComNotification=Rte_COMCbk_DCDC_Over_Input_Voltage, ComSystemTemplateSystemSignalRef=DCDC_Over_Input_Voltage
        DCDC_Over_Input_Current: ComSignalType=BOOLEAN, ComBitSize=1, ComBitPosition=23, ComNotification=Rte_COMCbk_DCDC_Over_Input_Current, ComSystemTemplateSystemSignalRef=DCDC_Over_Input_Current
        DCDC_Real_Output_Current: ComSignalType=UINT16, ComBitSize=12, ComBitPosition=24, ComNotification=Rte_COMCbk_DCDC_Real_Output_Current, ComSystemTemplateSystemSignalRef=DCDC_Real_Output_Current
        DCDC_Real_Output_Voltage: ComSignalType=UINT16, ComBitSize=12, ComBitPosition=36, ComNotification=Rte_COMCbk_DCDC_Real_Output_Voltage, ComSystemTemplateSystemSignalRef=DCDC_Real_Output_Voltage
        DCDC_Real_Input_Current: ComSignalType=UINT8, ComBitSize=8, ComBitPosition=48, ComNotification=Rte_COMCbk_DCDC_Real_Input_Current, ComSystemTemplateSystemSignalRef=DCDC_Real_Input_Current
        DCDC_Real_Input_Voltage: ComSignalType=UINT16, ComBitSize=13, ComBitPosition=56, ComNotification=Rte_COMCbk_DCDC_Real_Input_Voltage, ComSystemTemplateSystemSignalRef=DCDC_Real_Input_Voltage
        DCDC_Derating: ComSignalType=BOOLEAN, ComBitSize=1, ComBitPosition=69, ComNotification=Rte_COMCbk_DCDC_Derating, ComSystemTemplateSystemSignalRef=DCDC_Derating
        DCDC_Hardware_Fault_Flag: ComSignalType=BOOLEAN, ComBitSize=1, ComBitPosition=71, ComNotification=Rte_COMCbk_DCDC_Hardware_Fault_Flag, ComSystemTemplateSystemSignalRef=DCDC_Hardware_Fault_Flag
        CDU_ACChg_HIVSts: ComSignalType=BOOLEAN, ComBitSize=1, ComBitPosition=83, ComNotification=Rte_COMCbk_CDU_ACChg_HIVSts, ComSystemTemplateSystemSignalRef=CDU_ACChg_HIVSts
        CDU_OBC_OverTemp: ComSignalType=BOOLEAN, ComBitSize=1, ComBitPosition=90, ComNotification=Rte_COMCbk_CDU_OBC_OverTemp, ComSystemTemplateSystemSignalRef=CDU_OBC_OverTemp
        CDU_SelfCheckSt: ComSignalType=BOOLEAN, ComBitSize=1, ComBitPosition=112, ComNotification=Rte_COMCbk_CDU_SelfCheckSt, ComSystemTemplateSystemSignalRef=CDU_SelfCheckSt
        CDU_HV_HIVSts: ComSignalType=BOOLEAN, ComBitSize=1, ComBitPosition=113, ComNotification=Rte_COMCbk_CDU_HV_HIVSts, ComSystemTemplateSystemSignalRef=CDU_HV_HIVSts
      EVCC_0x260_P_CANFD (ComIPdu):
        ComIPduSignalProcessing = IMMEDIATE
        ComIPduType = NORMAL
        ComIPduDirection = RECEIVE
        ComIPduGroupRef = ComIPduGroup_Rx
        ComPduIdRef = PduCollection/EVCC_0x260_P_CANFD_PduR2Com
        ComIPduSignalRef = EVCC_DCAC_ChgMode
        ComIPduSignalRef = EVCC_CP_status
        ComIPduSignalRef = EVCC_CPDutyCycleValue
        ComIPduSignalRef = EVCC_EVSEMaximumCurrentLimit
        ComIPduSignalRef = EVCC_EVSEMaximumPowerLimit
      5 x ComSignal, all with ComSignalInitValue=0, ComSignalEndianness=LITTLE_ENDIAN, ComUpdateBitPosition=-1, ComTransferProperty=TRIGGERED:
        EVCC_DCAC_ChgMode: ComSignalType=UINT8, ComBitSize=4, ComBitPosition=0, ComNotification=Rte_COMCbk_EVCC_DCAC_ChgMode, ComSystemTemplateSystemSignalRef=EVCC_DCAC_ChgMode
        EVCC_CP_status: ComSignalType=UINT8, ComBitSize=4, ComBitPosition=12, ComNotification=Rte_COMCbk_EVCC_CP_status, ComSystemTemplateSystemSignalRef=EVCC_CP_status
        EVCC_CPDutyCycleValue: ComSignalType=UINT8, ComBitSize=8, ComBitPosition=32, ComNotification=Rte_COMCbk_EVCC_CPDutyCycleValue, ComSystemTemplateSystemSignalRef=EVCC_CPDutyCycleValue
        EVCC_EVSEMaximumCurrentLimit: ComSignalType=UINT8, ComBitSize=8, ComBitPosition=40, ComNotification=Rte_COMCbk_EVCC_EVSEMaximumCurrentLimit, ComSystemTemplateSystemSignalRef=EVCC_EVSEMaximumCurrentLimit
        EVCC_EVSEMaximumPowerLimit: ComSignalType=UINT16, ComBitSize=16, ComBitPosition=48, ComNotification=Rte_COMCbk_EVCC_EVSEMaximumPowerLimit, ComSystemTemplateSystemSignalRef=EVCC_EVSEMaximumPowerLimit
      IVI_0x5F6_P_CANFD (ComIPdu):
        ComIPduSignalProcessing = IMMEDIATE
        ComIPduType = NORMAL
        ComIPduDirection = RECEIVE
        ComIPduGroupRef = ComIPduGroup_Rx
        ComPduIdRef = PduCollection/IVI_0x5F6_P_CANFD_PduR2Com
        ComIPduSignalRef = IVI_Year
        ComIPduSignalRef = IVI_Month
        ComIPduSignalRef = IVI_Data
        ComIPduSignalRef = IVI_Hour
        ComIPduSignalRef = IVI_Minute
        ComIPduSignalRef = IVI_Second
      6 x ComSignal, all with ComSignalInitValue=0, ComSignalEndianness=LITTLE_ENDIAN, ComUpdateBitPosition=-1, ComTransferProperty=TRIGGERED:
        IVI_Year: ComSignalType=UINT16, ComBitSize=12, ComBitPosition=16, ComNotification=Rte_COMCbk_IVI_Year, ComSystemTemplateSystemSignalRef=IVI_Year
        IVI_Month: ComSignalType=UINT8, ComBitSize=4, ComBitPosition=28, ComNotification=Rte_COMCbk_IVI_Month, ComSystemTemplateSystemSignalRef=IVI_Month
        IVI_Data: ComSignalType=UINT8, ComBitSize=5, ComBitPosition=32, ComNotification=Rte_COMCbk_IVI_Data, ComSystemTemplateSystemSignalRef=IVI_Data
        IVI_Hour: ComSignalType=UINT8, ComBitSize=5, ComBitPosition=40, ComNotification=Rte_COMCbk_IVI_Hour, ComSystemTemplateSystemSignalRef=IVI_Hour
        IVI_Minute: ComSignalType=UINT8, ComBitSize=6, ComBitPosition=48, ComNotification=Rte_COMCbk_IVI_Minute, ComSystemTemplateSystemSignalRef=IVI_Minute
        IVI_Second: ComSignalType=UINT8, ComBitSize=6, ComBitPosition=56, ComNotification=Rte_COMCbk_IVI_Second, ComSystemTemplateSystemSignalRef=IVI_Second
      ComIPduGroup_Tx (ComIPduGroup)
      MCU_0x5CB_P_CANFD (ComIPdu):
        ComIPduSignalProcessing = IMMEDIATE
        ComIPduType = NORMAL
        ComIPduDirection = SEND
        ComFirstTimeout = 0.01
        ComTimeout = 0.01
        ComPduIdRef = PduCollection/MCU_0x5CB_P_CANFD_Com2PduR
        ComIPduSignalRef = GTC_TestSts
        ComIPduSignalRef = GTC_ThetaPos
        ComIPduSignalRef = GTC_ThetaNeg
        ComIPduSignalRef = GTC_ThetaDelt
        ComIPduSignalRef = GTC_TestRslt
        ComIPduSignalRef = MCUMR_GTC_TestSts
        ComIPduSignalRef = MCUMR_GTC_ThetaPos
        ComIPduSignalRef = MCUMR_GTC_ThetaNeg
        ComIPduSignalRef = MCUMR_GTC_ThetaDelt
        ComIPduSignalRef = MCUMR_GTC_TestRslt
        ComIPduGroupRef = ComIPduGroup_DevMCU
        ComTxIPdu: ComMinimumDelayTime=0.0, ComTxIPduUnusedAreasDefault=0
          ComTxModeTrue
            ComTxMode: ComTxModeTimePeriod=0.01, ComTxModeMode=DIRECT, ComTxModeNumberOfRepetitions=0, ComTxModeRepetitionPeriod=0, ComTxModeTimeOffset=0.0
          ComTxModeFalse
            ComTxMode: ComTxModeTimePeriod=0.01, ComTxModeMode=PERIODIC, ComTxModeNumberOfRepetitions=0, ComTxModeRepetitionPeriod=0, ComTxModeTimeOffset=0.0
      10 x ComSignal, all with ComSignalInitValue=0, ComSignalEndianness=LITTLE_ENDIAN, ComUpdateBitPosition=-1, ComTransferProperty=PENDING:
        GTC_TestSts: ComSignalType=UINT8, ComBitSize=8, ComBitPosition=0, ComSystemTemplateSystemSignalRef=GTC_TestSts
        GTC_ThetaPos: ComSignalType=UINT16, ComBitSize=16, ComBitPosition=8, ComSystemTemplateSystemSignalRef=GTC_ThetaPos
        GTC_ThetaNeg: ComSignalType=UINT16, ComBitSize=16, ComBitPosition=24, ComSystemTemplateSystemSignalRef=GTC_ThetaNeg
        GTC_ThetaDelt: ComSignalType=UINT16, ComBitSize=16, ComBitPosition=40, ComSystemTemplateSystemSignalRef=GTC_ThetaDelt
        GTC_TestRslt: ComSignalType=UINT8, ComBitSize=8, ComBitPosition=56, ComSystemTemplateSystemSignalRef=GTC_TestRslt
        MCUMR_GTC_TestSts: ComSignalType=UINT8, ComBitSize=8, ComBitPosition=64, ComSystemTemplateSystemSignalRef=MCUMR_GTC_TestSts
        MCUMR_GTC_ThetaPos: ComSignalType=UINT16, ComBitSize=16, ComBitPosition=72, ComSystemTemplateSystemSignalRef=MCUMR_GTC_ThetaPos
        MCUMR_GTC_ThetaNeg: ComSignalType=UINT16, ComBitSize=16, ComBitPosition=88, ComSystemTemplateSystemSignalRef=MCUMR_GTC_ThetaNeg
        MCUMR_GTC_ThetaDelt: ComSignalType=UINT16, ComBitSize=16, ComBitPosition=104, ComSystemTemplateSystemSignalRef=MCUMR_GTC_ThetaDelt
        MCUMR_GTC_TestRslt: ComSignalType=UINT8, ComBitSize=8, ComBitPosition=120, ComSystemTemplateSystemSignalRef=MCUMR_GTC_TestRslt
      MCU_0x5CA_P_CANFD (ComIPdu):
        ComIPduSignalProcessing = IMMEDIATE
        ComIPduType = NORMAL
        ComIPduDirection = SEND
        ComFirstTimeout = 0.01
        ComTimeout = 0.01
        ComPduIdRef = PduCollection/MCU_0x5CA_P_CANFD_Com2PduR
        ComIPduSignalRef = EddyCur_Para_Cos_m
        ComIPduSignalRef = EddyCur_Stage
        ComIPduSignalRef = EddyCur_IdenFinish_Flag
        ComIPduSignalRef = EddyCur_Para_Sin_m
        ComIPduSignalRef = EddyCur_Write_Flag
        ComIPduSignalRef = EddyCur_FauPro_IDEL_OTime_Flag
        ComIPduSignalRef = EddyCur_FauPro_SpdInstab_Flag
        ComIPduSignalRef = EddyCur_FauPro_IDPara_OVal_Flag
        ComIPduSignalRef = EddyCur_Para_Cos_k
        ComIPduSignalRef = EddyCur_Enable
        ComIPduSignalRef = EddyCur_Para_Sin_k
        ComIPduSignalRef = EddyCur_IdenFail_Flag
        ComIPduSignalRef = EddyCur_Para_Cos_Pha
        ComIPduSignalRef = EddyCur_Para_Sin_Pha
        ComIPduSignalRef = EddyCur_ReadSuccess_Flag
        ComIPduSignalRef = OfsIden_ReadSuccess_Flag
        ComIPduSignalRef = OfsIden_SpdUp_Overtime
        ComIPduSignalRef = OfsIden_SpdUp_OverSpd
        ComIPduSignalRef = OfsIden_IdenDiverge
        ComIPduSignalRef = OfsIden_IdenCntOver
        ComIPduSignalRef = OfsIden_MtrLock
        ComIPduSignalRef = OfsIden_OfsRslt
        ComIPduSignalRef = OfsIden_Sts
        ComIPduSignalRef = OfsIden_Finish
        ComIPduSignalRef = OfsIden_OfsWrite_Finish
        ComIPduSignalRef = OfsIden_DirWrite_Finish
        ComIPduSignalRef = OfsIden_DirIden_Rslt
        ComIPduSignalRef = OfsIden_ZeroAlign_OverTime
        ComIPduSignalRef = OfsIden_ZeroAlign_Fail
        ComIPduSignalRef = OfsIden_IFStart_Overtime
        ComIPduSignalRef = OfsIden_IFStart_Fail
        ComIPduSignalRef = PosDly_Cal_RslvDelayTime
        ComIPduSignalRef = PosDly_Theta_k_Std
        ComIPduSignalRef = PosDly_Supplier
        ComIPduSignalRef = PosDly_FauPro_Ident_OTm_Flag
        ComIPduSignalRef = PosDly_FauPro_SpdDn_OTm_Flag
        ComIPduSignalRef = PosDly_RslvOffsetComp
        ComIPduSignalRef = PosDly_Enable
        ComIPduSignalRef = PosDly_IdentFail_Flag
        ComIPduSignalRef = PosDly_IdentFinish_Flag
        ComIPduSignalRef = PosDly_Write_Flag
        ComIPduSignalRef = PosDly_FauPro_Chk_DlyTime_OVal
        ComIPduSignalRef = PosDly_FauPro_Chk_RslvOfst_OVal
        ComIPduSignalRef = PosDly_FauPro_Check_Divergence
        ComIPduSignalRef = PosDly_FauPro_SpdUp_OTm_Flag
        ComIPduSignalRef = PosDly_Stage
        ComIPduSignalRef = IMParaIdent_ParEstMainStep
        ComIPduSignalRef = IMParaIdent_Rs
        ComIPduSignalRef = IMParaIdent_Rr
        ComIPduSignalRef = IMParaIdent_Ll
        ComIPduSignalRef = IMParaIdent_Lm
        ComIPduSignalRef = IMParaIdent_TotalLo
        ComIPduSignalRef = IMParaIdent_IdentSubStep
        ComIPduSignalRef = MCUMR_EddyCur_Para_Cos_m
        ComIPduSignalRef = MCUMR_EddyCur_Stage
        ComIPduSignalRef = MCUMR_EddyCur_IdenFinish_Flag
        ComIPduSignalRef = MCUMR_EddyCur_Para_Sin_m
        ComIPduSignalRef = MCUMR_EddyCur_Write_Flag
        ComIPduSignalRef = MCUMR_EddyCur_FauPro_IDEL_OTime_Flag
        ComIPduSignalRef = MCUMR_EddyCur_FauPro_SpdInstab_Flag
        ComIPduSignalRef = MCUMR_EddyCur_FauPro_IDPara_OVal_Flag
        ComIPduSignalRef = MCUMR_EddyCur_Para_Cos_k
        ComIPduSignalRef = MCUMR_EddyCur_Enable
        ComIPduSignalRef = MCUMR_EddyCur_Para_Sin_k
        ComIPduSignalRef = MCUMR_EddyCur_IdenFail_Flag
        ComIPduSignalRef = MCUMR_EddyCur_Para_Cos_Pha
        ComIPduSignalRef = MCUMR_EddyCur_Para_Sin_Pha
        ComIPduSignalRef = MCUMR_EddyCur_ReadSuccess_Flag
        ComIPduSignalRef = MCUMR_OfsIden_ReadSuccess_Flag
        ComIPduSignalRef = MCUMR_OfsIden_SpdUp_Overtime
        ComIPduSignalRef = MCUMR_OfsIden_SpdUp_OverSpd
        ComIPduSignalRef = MCUMR_OfsIden_IdenDiverge
        ComIPduSignalRef = MCUMR_OfsIden_IdenCntOver
        ComIPduSignalRef = MCUMR_OfsIden_MtrLock
        ComIPduSignalRef = MCUMR_OfsIden_OfsRslt
        ComIPduSignalRef = MCUMR_OfsIden_Sts
        ComIPduSignalRef = MCUMR_OfsIden_Finish
        ComIPduSignalRef = MCUMR_OfsIden_OfsWrite_Finish
        ComIPduSignalRef = MCUMR_OfsIden_DirWrite_Finish
        ComIPduSignalRef = MCUMR_OfsIden_DirIden_Rslt
        ComIPduSignalRef = MCUMR_OfsIden_ZeroAlign_OverTime
        ComIPduSignalRef = MCUMR_OfsIden_ZeroAlign_Fail
        ComIPduSignalRef = MCUMR_OfsIden_IFStart_Overtime
        ComIPduSignalRef = MCUMR_OfsIden_IFStart_Fail
        ComIPduGroupRef = ComIPduGroup_DevMCU
        ComTxIPdu: ComMinimumDelayTime=0.0, ComTxIPduUnusedAreasDefault=0
          ComTxModeTrue
            ComTxMode: ComTxModeTimePeriod=0.01, ComTxModeMode=DIRECT, ComTxModeNumberOfRepetitions=0, ComTxModeRepetitionPeriod=0, ComTxModeTimeOffset=0.0
          ComTxModeFalse
            ComTxMode: ComTxModeTimePeriod=0.01, ComTxModeMode=PERIODIC, ComTxModeNumberOfRepetitions=0, ComTxModeRepetitionPeriod=0, ComTxModeTimeOffset=0.0
      84 x ComSignal, all with ComSignalInitValue=0, ComSignalEndianness=LITTLE_ENDIAN, ComUpdateBitPosition=-1, ComTransferProperty=PENDING:
        EddyCur_Para_Cos_m: ComSignalType=UINT16, ComBitSize=12, ComBitPosition=0, ComSystemTemplateSystemSignalRef=EddyCur_Para_Cos_m
        EddyCur_Stage: ComSignalType=UINT8, ComBitSize=3, ComBitPosition=12, ComSystemTemplateSystemSignalRef=EddyCur_Stage
        EddyCur_IdenFinish_Flag: ComSignalType=BOOLEAN, ComBitSize=1, ComBitPosition=15, ComSystemTemplateSystemSignalRef=EddyCur_IdenFinish_Flag
        EddyCur_Para_Sin_m: ComSignalType=UINT16, ComBitSize=12, ComBitPosition=16, ComSystemTemplateSystemSignalRef=EddyCur_Para_Sin_m
        EddyCur_Write_Flag: ComSignalType=BOOLEAN, ComBitSize=1, ComBitPosition=28, ComSystemTemplateSystemSignalRef=EddyCur_Write_Flag
        EddyCur_FauPro_IDEL_OTime_Flag: ComSignalType=BOOLEAN, ComBitSize=1, ComBitPosition=29, ComSystemTemplateSystemSignalRef=EddyCur_FauPro_IDEL_OTime_Flag
        EddyCur_FauPro_SpdInstab_Flag: ComSignalType=BOOLEAN, ComBitSize=1, ComBitPosition=30, ComSystemTemplateSystemSignalRef=EddyCur_FauPro_SpdInstab_Flag
        EddyCur_FauPro_IDPara_OVal_Flag: ComSignalType=BOOLEAN, ComBitSize=1, ComBitPosition=31, ComSystemTemplateSystemSignalRef=EddyCur_FauPro_IDPara_OVal_Flag
        EddyCur_Para_Cos_k: ComSignalType=UINT16, ComBitSize=15, ComBitPosition=32, ComSystemTemplateSystemSignalRef=EddyCur_Para_Cos_k
        EddyCur_Enable: ComSignalType=BOOLEAN, ComBitSize=1, ComBitPosition=47, ComSystemTemplateSystemSignalRef=EddyCur_Enable
        EddyCur_Para_Sin_k: ComSignalType=UINT16, ComBitSize=15, ComBitPosition=48, ComSystemTemplateSystemSignalRef=EddyCur_Para_Sin_k
        EddyCur_IdenFail_Flag: ComSignalType=BOOLEAN, ComBitSize=1, ComBitPosition=63, ComSystemTemplateSystemSignalRef=EddyCur_IdenFail_Flag
        EddyCur_Para_Cos_Pha: ComSignalType=UINT16, ComBitSize=16, ComBitPosition=64, ComSystemTemplateSystemSignalRef=EddyCur_Para_Cos_Pha
        EddyCur_Para_Sin_Pha: ComSignalType=UINT16, ComBitSize=16, ComBitPosition=80, ComSystemTemplateSystemSignalRef=EddyCur_Para_Sin_Pha
        EddyCur_ReadSuccess_Flag: ComSignalType=BOOLEAN, ComBitSize=1, ComBitPosition=96, ComSystemTemplateSystemSignalRef=EddyCur_ReadSuccess_Flag
        OfsIden_ReadSuccess_Flag: ComSignalType=BOOLEAN, ComBitSize=1, ComBitPosition=98, ComSystemTemplateSystemSignalRef=OfsIden_ReadSuccess_Flag
        OfsIden_SpdUp_Overtime: ComSignalType=BOOLEAN, ComBitSize=1, ComBitPosition=99, ComSystemTemplateSystemSignalRef=OfsIden_SpdUp_Overtime
        OfsIden_SpdUp_OverSpd: ComSignalType=BOOLEAN, ComBitSize=1, ComBitPosition=100, ComSystemTemplateSystemSignalRef=OfsIden_SpdUp_OverSpd
        OfsIden_IdenDiverge: ComSignalType=BOOLEAN, ComBitSize=1, ComBitPosition=101, ComSystemTemplateSystemSignalRef=OfsIden_IdenDiverge
        OfsIden_IdenCntOver: ComSignalType=BOOLEAN, ComBitSize=1, ComBitPosition=102, ComSystemTemplateSystemSignalRef=OfsIden_IdenCntOver
        OfsIden_MtrLock: ComSignalType=BOOLEAN, ComBitSize=1, ComBitPosition=103, ComSystemTemplateSystemSignalRef=OfsIden_MtrLock
        OfsIden_OfsRslt: ComSignalType=UINT16, ComBitSize=12, ComBitPosition=104, ComSystemTemplateSystemSignalRef=OfsIden_OfsRslt
        OfsIden_Sts: ComSignalType=UINT8, ComBitSize=3, ComBitPosition=116, ComSystemTemplateSystemSignalRef=OfsIden_Sts
        OfsIden_Finish: ComSignalType=BOOLEAN, ComBitSize=1, ComBitPosition=119, ComSystemTemplateSystemSignalRef=OfsIden_Finish
        OfsIden_OfsWrite_Finish: ComSignalType=BOOLEAN, ComBitSize=1, ComBitPosition=120, ComSystemTemplateSystemSignalRef=OfsIden_OfsWrite_Finish
        OfsIden_DirWrite_Finish: ComSignalType=BOOLEAN, ComBitSize=1, ComBitPosition=121, ComSystemTemplateSystemSignalRef=OfsIden_DirWrite_Finish
        OfsIden_DirIden_Rslt: ComSignalType=UINT8, ComBitSize=2, ComBitPosition=122, ComSystemTemplateSystemSignalRef=OfsIden_DirIden_Rslt
        OfsIden_ZeroAlign_OverTime: ComSignalType=BOOLEAN, ComBitSize=1, ComBitPosition=124, ComSystemTemplateSystemSignalRef=OfsIden_ZeroAlign_OverTime
        OfsIden_ZeroAlign_Fail: ComSignalType=BOOLEAN, ComBitSize=1, ComBitPosition=125, ComSystemTemplateSystemSignalRef=OfsIden_ZeroAlign_Fail
        OfsIden_IFStart_Overtime: ComSignalType=BOOLEAN, ComBitSize=1, ComBitPosition=126, ComSystemTemplateSystemSignalRef=OfsIden_IFStart_Overtime
        OfsIden_IFStart_Fail: ComSignalType=BOOLEAN, ComBitSize=1, ComBitPosition=127, ComSystemTemplateSystemSignalRef=OfsIden_IFStart_Fail
        PosDly_Cal_RslvDelayTime: ComSignalType=UINT16, ComBitSize=16, ComBitPosition=128, ComSystemTemplateSystemSignalRef=PosDly_Cal_RslvDelayTime
        PosDly_Theta_k_Std: ComSignalType=UINT16, ComBitSize=15, ComBitPosition=144, ComSystemTemplateSystemSignalRef=PosDly_Theta_k_Std
        PosDly_Supplier: ComSignalType=BOOLEAN, ComBitSize=1, ComBitPosition=159, ComSystemTemplateSystemSignalRef=PosDly_Supplier
        PosDly_FauPro_Ident_OTm_Flag: ComSignalType=BOOLEAN, ComBitSize=1, ComBitPosition=160, ComSystemTemplateSystemSignalRef=PosDly_FauPro_Ident_OTm_Flag
        PosDly_FauPro_SpdDn_OTm_Flag: ComSignalType=BOOLEAN, ComBitSize=1, ComBitPosition=161, ComSystemTemplateSystemSignalRef=PosDly_FauPro_SpdDn_OTm_Flag
        PosDly_RslvOffsetComp: ComSignalType=UINT8, ComBitSize=6, ComBitPosition=162, ComSystemTemplateSystemSignalRef=PosDly_RslvOffsetComp
        PosDly_Enable: ComSignalType=BOOLEAN, ComBitSize=1, ComBitPosition=168, ComSystemTemplateSystemSignalRef=PosDly_Enable
        PosDly_IdentFail_Flag: ComSignalType=BOOLEAN, ComBitSize=1, ComBitPosition=169, ComSystemTemplateSystemSignalRef=PosDly_IdentFail_Flag
        PosDly_IdentFinish_Flag: ComSignalType=BOOLEAN, ComBitSize=1, ComBitPosition=170, ComSystemTemplateSystemSignalRef=PosDly_IdentFinish_Flag
        PosDly_Write_Flag: ComSignalType=BOOLEAN, ComBitSize=1, ComBitPosition=171, ComSystemTemplateSystemSignalRef=PosDly_Write_Flag
        PosDly_FauPro_Chk_DlyTime_OVal: ComSignalType=BOOLEAN, ComBitSize=1, ComBitPosition=172, ComSystemTemplateSystemSignalRef=PosDly_FauPro_Chk_DlyTime_OVal
        PosDly_FauPro_Chk_RslvOfst_OVal: ComSignalType=BOOLEAN, ComBitSize=1, ComBitPosition=173, ComSystemTemplateSystemSignalRef=PosDly_FauPro_Chk_RslvOfst_OVal
        PosDly_FauPro_Check_Divergence: ComSignalType=BOOLEAN, ComBitSize=1, ComBitPosition=174, ComSystemTemplateSystemSignalRef=PosDly_FauPro_Check_Divergence
        PosDly_FauPro_SpdUp_OTm_Flag: ComSignalType=BOOLEAN, ComBitSize=1, ComBitPosition=175, ComSystemTemplateSystemSignalRef=PosDly_FauPro_SpdUp_OTm_Flag
        PosDly_Stage: ComSignalType=UINT8, ComBitSize=3, ComBitPosition=176, ComSystemTemplateSystemSignalRef=PosDly_Stage
        IMParaIdent_ParEstMainStep: ComSignalType=UINT8, ComBitSize=4, ComBitPosition=179, ComSystemTemplateSystemSignalRef=IMParaIdent_ParEstMainStep
        IMParaIdent_Rs: ComSignalType=UINT16, ComBitSize=10, ComBitPosition=183, ComSystemTemplateSystemSignalRef=IMParaIdent_Rs
        IMParaIdent_Rr: ComSignalType=UINT16, ComBitSize=10, ComBitPosition=193, ComSystemTemplateSystemSignalRef=IMParaIdent_Rr
        IMParaIdent_Ll: ComSignalType=UINT16, ComBitSize=14, ComBitPosition=203, ComSystemTemplateSystemSignalRef=IMParaIdent_Ll
        IMParaIdent_Lm: ComSignalType=UINT16, ComBitSize=14, ComBitPosition=217, ComSystemTemplateSystemSignalRef=IMParaIdent_Lm
        IMParaIdent_TotalLo: ComSignalType=UINT16, ComBitSize=14, ComBitPosition=231, ComSystemTemplateSystemSignalRef=IMParaIdent_TotalLo
        IMParaIdent_IdentSubStep: ComSignalType=UINT8, ComBitSize=5, ComBitPosition=245, ComSystemTemplateSystemSignalRef=IMParaIdent_IdentSubStep
        MCUMR_EddyCur_Para_Cos_m: ComSignalType=UINT16, ComBitSize=12, ComBitPosition=256, ComSystemTemplateSystemSignalRef=MCUMR_EddyCur_Para_Cos_m
        MCUMR_EddyCur_Stage: ComSignalType=UINT8, ComBitSize=3, ComBitPosition=268, ComSystemTemplateSystemSignalRef=MCUMR_EddyCur_Stage
        MCUMR_EddyCur_IdenFinish_Flag: ComSignalType=BOOLEAN, ComBitSize=1, ComBitPosition=271, ComSystemTemplateSystemSignalRef=MCUMR_EddyCur_IdenFinish_Flag
        MCUMR_EddyCur_Para_Sin_m: ComSignalType=UINT16, ComBitSize=12, ComBitPosition=272, ComSystemTemplateSystemSignalRef=MCUMR_EddyCur_Para_Sin_m
        MCUMR_EddyCur_Write_Flag: ComSignalType=BOOLEAN, ComBitSize=1, ComBitPosition=284, ComSystemTemplateSystemSignalRef=MCUMR_EddyCur_Write_Flag
        MCUMR_EddyCur_FauPro_IDEL_OTime_Flag: ComSignalType=BOOLEAN, ComBitSize=1, ComBitPosition=285, ComSystemTemplateSystemSignalRef=MCUMR_EddyCur_FauPro_IDEL_OTime_Flag
        MCUMR_EddyCur_FauPro_SpdInstab_Flag: ComSignalType=BOOLEAN, ComBitSize=1, ComBitPosition=286, ComSystemTemplateSystemSignalRef=MCUMR_EddyCur_FauPro_SpdInstab_Flag
        MCUMR_EddyCur_FauPro_IDPara_OVal_Flag: ComSignalType=BOOLEAN, ComBitSize=1, ComBitPosition=287, ComSystemTemplateSystemSignalRef=MCUMR_EddyCur_FauPro_IDPara_OVal_Flag
        MCUMR_EddyCur_Para_Cos_k: ComSignalType=UINT16, ComBitSize=15, ComBitPosition=288, ComSystemTemplateSystemSignalRef=MCUMR_EddyCur_Para_Cos_k
        MCUMR_EddyCur_Enable: ComSignalType=BOOLEAN, ComBitSize=1, ComBitPosition=303, ComSystemTemplateSystemSignalRef=MCUMR_EddyCur_Enable
        MCUMR_EddyCur_Para_Sin_k: ComSignalType=UINT16, ComBitSize=15, ComBitPosition=304, ComSystemTemplateSystemSignalRef=MCUMR_EddyCur_Para_Sin_k
        MCUMR_EddyCur_IdenFail_Flag: ComSignalType=BOOLEAN, ComBitSize=1, ComBitPosition=319, ComSystemTemplateSystemSignalRef=MCUMR_EddyCur_IdenFail_Flag
        MCUMR_EddyCur_Para_Cos_Pha: ComSignalType=UINT16, ComBitSize=16, ComBitPosition=320, ComSystemTemplateSystemSignalRef=MCUMR_EddyCur_Para_Cos_Pha
        MCUMR_EddyCur_Para_Sin_Pha: ComSignalType=UINT16, ComBitSize=16, ComBitPosition=336, ComSystemTemplateSystemSignalRef=MCUMR_EddyCur_Para_Sin_Pha
        MCUMR_EddyCur_ReadSuccess_Flag: ComSignalType=BOOLEAN, ComBitSize=1, ComBitPosition=352, ComSystemTemplateSystemSignalRef=MCUMR_EddyCur_ReadSuccess_Flag
        MCUMR_OfsIden_ReadSuccess_Flag: ComSignalType=BOOLEAN, ComBitSize=1, ComBitPosition=353, ComSystemTemplateSystemSignalRef=MCUMR_OfsIden_ReadSuccess_Flag
        MCUMR_OfsIden_SpdUp_Overtime: ComSignalType=BOOLEAN, ComBitSize=1, ComBitPosition=354, ComSystemTemplateSystemSignalRef=MCUMR_OfsIden_SpdUp_Overtime
        MCUMR_OfsIden_SpdUp_OverSpd: ComSignalType=BOOLEAN, ComBitSize=1, ComBitPosition=355, ComSystemTemplateSystemSignalRef=MCUMR_OfsIden_SpdUp_OverSpd
        MCUMR_OfsIden_IdenDiverge: ComSignalType=BOOLEAN, ComBitSize=1, ComBitPosition=356, ComSystemTemplateSystemSignalRef=MCUMR_OfsIden_IdenDiverge
        MCUMR_OfsIden_IdenCntOver: ComSignalType=BOOLEAN, ComBitSize=1, ComBitPosition=357, ComSystemTemplateSystemSignalRef=MCUMR_OfsIden_IdenCntOver
        MCUMR_OfsIden_MtrLock: ComSignalType=BOOLEAN, ComBitSize=1, ComBitPosition=358, ComSystemTemplateSystemSignalRef=MCUMR_OfsIden_MtrLock
        MCUMR_OfsIden_OfsRslt: ComSignalType=UINT16, ComBitSize=12, ComBitPosition=359, ComSystemTemplateSystemSignalRef=MCUMR_OfsIden_OfsRslt
        MCUMR_OfsIden_Sts: ComSignalType=UINT8, ComBitSize=3, ComBitPosition=371, ComSystemTemplateSystemSignalRef=MCUMR_OfsIden_Sts
        MCUMR_OfsIden_Finish: ComSignalType=BOOLEAN, ComBitSize=1, ComBitPosition=374, ComSystemTemplateSystemSignalRef=MCUMR_OfsIden_Finish
        MCUMR_OfsIden_OfsWrite_Finish: ComSignalType=BOOLEAN, ComBitSize=1, ComBitPosition=375, ComSystemTemplateSystemSignalRef=MCUMR_OfsIden_OfsWrite_Finish
        MCUMR_OfsIden_DirWrite_Finish: ComSignalType=BOOLEAN, ComBitSize=1, ComBitPosition=376, ComSystemTemplateSystemSignalRef=MCUMR_OfsIden_DirWrite_Finish
        MCUMR_OfsIden_DirIden_Rslt: ComSignalType=UINT8, ComBitSize=2, ComBitPosition=377, ComSystemTemplateSystemSignalRef=MCUMR_OfsIden_DirIden_Rslt
        MCUMR_OfsIden_ZeroAlign_OverTime: ComSignalType=BOOLEAN, ComBitSize=1, ComBitPosition=379, ComSystemTemplateSystemSignalRef=MCUMR_OfsIden_ZeroAlign_OverTime
        MCUMR_OfsIden_ZeroAlign_Fail: ComSignalType=BOOLEAN, ComBitSize=1, ComBitPosition=380, ComSystemTemplateSystemSignalRef=MCUMR_OfsIden_ZeroAlign_Fail
        MCUMR_OfsIden_IFStart_Overtime: ComSignalType=BOOLEAN, ComBitSize=1, ComBitPosition=381, ComSystemTemplateSystemSignalRef=MCUMR_OfsIden_IFStart_Overtime
        MCUMR_OfsIden_IFStart_Fail: ComSignalType=BOOLEAN, ComBitSize=1, ComBitPosition=382, ComSystemTemplateSystemSignalRef=MCUMR_OfsIden_IFStart_Fail
      MCU_0x5C9_P_CANFD (ComIPdu):
        ComIPduSignalProcessing = IMMEDIATE
        ComIPduType = NORMAL
        ComIPduDirection = SEND
        ComFirstTimeout = 0.01
        ComTimeout = 0.01
        ComPduIdRef = PduCollection/MCU_0x5C9_P_CANFD_Com2PduR
        ComIPduSignalRef = DelayIden_Rslt_Avg
        ComIPduSignalRef = DelayIden_OverRange
        ComIPduSignalRef = DelayIden_Iden_Finish
        ComIPduSignalRef = DelayIden_Write_Finish
        ComIPduSignalRef = DelayIden_Rslt_U
        ComIPduSignalRef = DelayIden_Rslt_V
        ComIPduSignalRef = DelayIden_Rslt_W
        ComIPduSignalRef = GainIden_Is_Samp_U
        ComIPduSignalRef = GainIden_Rslt_U
        ComIPduSignalRef = GainIden_OverRange
        ComIPduSignalRef = GainIden_Is_Samp_V
        ComIPduSignalRef = GainIden_Rslt_V
        ComIPduSignalRef = GainIden_Iden_Finish
        ComIPduSignalRef = GainIden_Is_Samp_W
        ComIPduSignalRef = GainIden_Rslt_W
        ComIPduSignalRef = GainIden_Write_Finish
        ComIPduSignalRef = GainIden_Curr_Peak_U
        ComIPduSignalRef = GainIden_Curr_Peak_V
        ComIPduSignalRef = GainIden_Curr_Peak_W
        ComIPduSignalRef = CurrLoad_CurExt_U
        ComIPduSignalRef = CurrLoad_CurExt_V
        ComIPduSignalRef = CurrLoad_CurExt_W
        ComIPduSignalRef = CurrLoad_offset_Iu
        ComIPduSignalRef = CurrLoad_offset_Iv
        ComIPduSignalRef = CurrLoad_offset_Iw
        ComIPduSignalRef = MCUMR_DelayIden_Rslt_Avg
        ComIPduSignalRef = MCUMR_DelayIden_OverRange
        ComIPduSignalRef = MCUMR_DelayIden_Iden_Finish
        ComIPduSignalRef = MCUMR_DelayIden_Write_Finish
        ComIPduSignalRef = MCUMR_DelayIden_Rslt_U
        ComIPduSignalRef = MCUMR_DelayIden_Rslt_V
        ComIPduSignalRef = MCUMR_DelayIden_Rslt_W
        ComIPduSignalRef = MCUMR_GainIden_Is_Samp_U
        ComIPduSignalRef = MCUMR_GainIden_Rslt_U
        ComIPduSignalRef = MCUMR_GainIden_OverRange
        ComIPduSignalRef = MCUMR_GainIden_Is_Samp_V
        ComIPduSignalRef = MCUMR_GainIden_Rslt_V
        ComIPduSignalRef = MCUMR_GainIden_Iden_Finish
        ComIPduSignalRef = MCUMR_GainIden_Is_Samp_W
        ComIPduSignalRef = MCUMR_GainIden_Rslt_W
        ComIPduSignalRef = MCUMR_GainIden_Write_Finish
        ComIPduSignalRef = MCUMR_GainIden_Curr_Peak_U
        ComIPduSignalRef = MCUMR_GainIden_Curr_Peak_V
        ComIPduSignalRef = MCUMR_GainIden_Curr_Peak_W
        ComIPduSignalRef = MCUMR_CurrLoad_CurExt_U
        ComIPduSignalRef = MCUMR_CurrLoad_CurExt_V
        ComIPduSignalRef = MCUMR_CurrLoad_CurExt_W
        ComIPduSignalRef = MCUMR_CurrLoad_offset_Iu
        ComIPduSignalRef = MCUMR_CurrLoad_offset_Iv
        ComIPduSignalRef = MCUMR_CurrLoad_offset_Iw
        ComIPduGroupRef = ComIPduGroup_DevMCU
        ComTxIPdu: ComMinimumDelayTime=0.0, ComTxIPduUnusedAreasDefault=0
          ComTxModeTrue
            ComTxMode: ComTxModeTimePeriod=0.01, ComTxModeMode=DIRECT, ComTxModeNumberOfRepetitions=0, ComTxModeRepetitionPeriod=0, ComTxModeTimeOffset=0.0
          ComTxModeFalse
            ComTxMode: ComTxModeTimePeriod=0.01, ComTxModeMode=PERIODIC, ComTxModeNumberOfRepetitions=0, ComTxModeRepetitionPeriod=0, ComTxModeTimeOffset=0.0
      50 x ComSignal, all with ComSignalInitValue=0, ComSignalEndianness=LITTLE_ENDIAN, ComUpdateBitPosition=-1, ComTransferProperty=PENDING:
        DelayIden_Rslt_Avg: ComSignalType=UINT16, ComBitSize=13, ComBitPosition=0, ComSystemTemplateSystemSignalRef=DelayIden_Rslt_Avg
        DelayIden_OverRange: ComSignalType=BOOLEAN, ComBitSize=1, ComBitPosition=13, ComSystemTemplateSystemSignalRef=DelayIden_OverRange
        DelayIden_Iden_Finish: ComSignalType=BOOLEAN, ComBitSize=1, ComBitPosition=14, ComSystemTemplateSystemSignalRef=DelayIden_Iden_Finish
        DelayIden_Write_Finish: ComSignalType=BOOLEAN, ComBitSize=1, ComBitPosition=15, ComSystemTemplateSystemSignalRef=DelayIden_Write_Finish
        DelayIden_Rslt_U: ComSignalType=UINT16, ComBitSize=13, ComBitPosition=16, ComSystemTemplateSystemSignalRef=DelayIden_Rslt_U
        DelayIden_Rslt_V: ComSignalType=UINT16, ComBitSize=13, ComBitPosition=29, ComSystemTemplateSystemSignalRef=DelayIden_Rslt_V
        DelayIden_Rslt_W: ComSignalType=UINT16, ComBitSize=13, ComBitPosition=42, ComSystemTemplateSystemSignalRef=DelayIden_Rslt_W
        GainIden_Is_Samp_U: ComSignalType=UINT16, ComBitSize=14, ComBitPosition=56, ComSystemTemplateSystemSignalRef=GainIden_Is_Samp_U
        GainIden_Rslt_U: ComSignalType=UINT16, ComBitSize=9, ComBitPosition=70, ComSystemTemplateSystemSignalRef=GainIden_Rslt_U
        GainIden_OverRange: ComSignalType=BOOLEAN, ComBitSize=1, ComBitPosition=79, ComSystemTemplateSystemSignalRef=GainIden_OverRange
        GainIden_Is_Samp_V: ComSignalType=UINT16, ComBitSize=14, ComBitPosition=80, ComSystemTemplateSystemSignalRef=GainIden_Is_Samp_V
        GainIden_Rslt_V: ComSignalType=UINT16, ComBitSize=9, ComBitPosition=94, ComSystemTemplateSystemSignalRef=GainIden_Rslt_V
        GainIden_Iden_Finish: ComSignalType=BOOLEAN, ComBitSize=1, ComBitPosition=103, ComSystemTemplateSystemSignalRef=GainIden_Iden_Finish
        GainIden_Is_Samp_W: ComSignalType=UINT16, ComBitSize=14, ComBitPosition=104, ComSystemTemplateSystemSignalRef=GainIden_Is_Samp_W
        GainIden_Rslt_W: ComSignalType=UINT16, ComBitSize=9, ComBitPosition=118, ComSystemTemplateSystemSignalRef=GainIden_Rslt_W
        GainIden_Write_Finish: ComSignalType=BOOLEAN, ComBitSize=1, ComBitPosition=127, ComSystemTemplateSystemSignalRef=GainIden_Write_Finish
        GainIden_Curr_Peak_U: ComSignalType=UINT16, ComBitSize=11, ComBitPosition=128, ComSystemTemplateSystemSignalRef=GainIden_Curr_Peak_U
        GainIden_Curr_Peak_V: ComSignalType=UINT16, ComBitSize=11, ComBitPosition=139, ComSystemTemplateSystemSignalRef=GainIden_Curr_Peak_V
        GainIden_Curr_Peak_W: ComSignalType=UINT16, ComBitSize=11, ComBitPosition=150, ComSystemTemplateSystemSignalRef=GainIden_Curr_Peak_W
        CurrLoad_CurExt_U: ComSignalType=UINT16, ComBitSize=12, ComBitPosition=168, ComSystemTemplateSystemSignalRef=CurrLoad_CurExt_U
        CurrLoad_CurExt_V: ComSignalType=UINT16, ComBitSize=12, ComBitPosition=180, ComSystemTemplateSystemSignalRef=CurrLoad_CurExt_V
        CurrLoad_CurExt_W: ComSignalType=UINT16, ComBitSize=12, ComBitPosition=192, ComSystemTemplateSystemSignalRef=CurrLoad_CurExt_W
        CurrLoad_offset_Iu: ComSignalType=UINT16, ComBitSize=12, ComBitPosition=204, ComSystemTemplateSystemSignalRef=CurrLoad_offset_Iu
        CurrLoad_offset_Iv: ComSignalType=UINT16, ComBitSize=12, ComBitPosition=216, ComSystemTemplateSystemSignalRef=CurrLoad_offset_Iv
        CurrLoad_offset_Iw: ComSignalType=UINT16, ComBitSize=12, ComBitPosition=228, ComSystemTemplateSystemSignalRef=CurrLoad_offset_Iw
        MCUMR_DelayIden_Rslt_Avg: ComSignalType=UINT16, ComBitSize=13, ComBitPosition=256, ComSystemTemplateSystemSignalRef=MCUMR_DelayIden_Rslt_Avg
        MCUMR_DelayIden_OverRange: ComSignalType=BOOLEAN, ComBitSize=1, ComBitPosition=269, ComSystemTemplateSystemSignalRef=MCUMR_DelayIden_OverRange
        MCUMR_DelayIden_Iden_Finish: ComSignalType=BOOLEAN, ComBitSize=1, ComBitPosition=270, ComSystemTemplateSystemSignalRef=MCUMR_DelayIden_Iden_Finish
        MCUMR_DelayIden_Write_Finish: ComSignalType=BOOLEAN, ComBitSize=1, ComBitPosition=271, ComSystemTemplateSystemSignalRef=MCUMR_DelayIden_Write_Finish
        MCUMR_DelayIden_Rslt_U: ComSignalType=UINT16, ComBitSize=13, ComBitPosition=272, ComSystemTemplateSystemSignalRef=MCUMR_DelayIden_Rslt_U
        MCUMR_DelayIden_Rslt_V: ComSignalType=UINT16, ComBitSize=13, ComBitPosition=285, ComSystemTemplateSystemSignalRef=MCUMR_DelayIden_Rslt_V
        MCUMR_DelayIden_Rslt_W: ComSignalType=UINT16, ComBitSize=13, ComBitPosition=298, ComSystemTemplateSystemSignalRef=MCUMR_DelayIden_Rslt_W
        MCUMR_GainIden_Is_Samp_U: ComSignalType=UINT16, ComBitSize=14, ComBitPosition=311, ComSystemTemplateSystemSignalRef=MCUMR_GainIden_Is_Samp_U
        MCUMR_GainIden_Rslt_U: ComSignalType=UINT16, ComBitSize=9, ComBitPosition=325, ComSystemTemplateSystemSignalRef=MCUMR_GainIden_Rslt_U
        MCUMR_GainIden_OverRange: ComSignalType=BOOLEAN, ComBitSize=1, ComBitPosition=334, ComSystemTemplateSystemSignalRef=MCUMR_GainIden_OverRange
        MCUMR_GainIden_Is_Samp_V: ComSignalType=UINT16, ComBitSize=14, ComBitPosition=335, ComSystemTemplateSystemSignalRef=MCUMR_GainIden_Is_Samp_V
        MCUMR_GainIden_Rslt_V: ComSignalType=UINT16, ComBitSize=9, ComBitPosition=349, ComSystemTemplateSystemSignalRef=MCUMR_GainIden_Rslt_V
        MCUMR_GainIden_Iden_Finish: ComSignalType=BOOLEAN, ComBitSize=1, ComBitPosition=358, ComSystemTemplateSystemSignalRef=MCUMR_GainIden_Iden_Finish
        MCUMR_GainIden_Is_Samp_W: ComSignalType=UINT16, ComBitSize=14, ComBitPosition=359, ComSystemTemplateSystemSignalRef=MCUMR_GainIden_Is_Samp_W
        MCUMR_GainIden_Rslt_W: ComSignalType=UINT16, ComBitSize=9, ComBitPosition=373, ComSystemTemplateSystemSignalRef=MCUMR_GainIden_Rslt_W
        MCUMR_GainIden_Write_Finish: ComSignalType=BOOLEAN, ComBitSize=1, ComBitPosition=382, ComSystemTemplateSystemSignalRef=MCUMR_GainIden_Write_Finish
        MCUMR_GainIden_Curr_Peak_U: ComSignalType=UINT16, ComBitSize=11, ComBitPosition=383, ComSystemTemplateSystemSignalRef=MCUMR_GainIden_Curr_Peak_U
        MCUMR_GainIden_Curr_Peak_V: ComSignalType=UINT16, ComBitSize=11, ComBitPosition=394, ComSystemTemplateSystemSignalRef=MCUMR_GainIden_Curr_Peak_V
        MCUMR_GainIden_Curr_Peak_W: ComSignalType=UINT16, ComBitSize=11, ComBitPosition=405, ComSystemTemplateSystemSignalRef=MCUMR_GainIden_Curr_Peak_W
        MCUMR_CurrLoad_CurExt_U: ComSignalType=UINT16, ComBitSize=12, ComBitPosition=416, ComSystemTemplateSystemSignalRef=MCUMR_CurrLoad_CurExt_U
        MCUMR_CurrLoad_CurExt_V: ComSignalType=UINT16, ComBitSize=12, ComBitPosition=428, ComSystemTemplateSystemSignalRef=MCUMR_CurrLoad_CurExt_V
        MCUMR_CurrLoad_CurExt_W: ComSignalType=UINT16, ComBitSize=12, ComBitPosition=440, ComSystemTemplateSystemSignalRef=MCUMR_CurrLoad_CurExt_W
        MCUMR_CurrLoad_offset_Iu: ComSignalType=UINT16, ComBitSize=12, ComBitPosition=452, ComSystemTemplateSystemSignalRef=MCUMR_CurrLoad_offset_Iu
        MCUMR_CurrLoad_offset_Iv: ComSignalType=UINT16, ComBitSize=12, ComBitPosition=464, ComSystemTemplateSystemSignalRef=MCUMR_CurrLoad_offset_Iv
        MCUMR_CurrLoad_offset_Iw: ComSignalType=UINT16, ComBitSize=12, ComBitPosition=476, ComSystemTemplateSystemSignalRef=MCUMR_CurrLoad_offset_Iw
      MCU_0x5C8_P_CANFD (ComIPdu):
        ComIPduSignalProcessing = IMMEDIATE
        ComIPduType = NORMAL
        ComIPduDirection = SEND
        ComFirstTimeout = 0.01
        ComTimeout = 0.01
        ComPduIdRef = PduCollection/MCU_0x5C8_P_CANFD_Com2PduR
        ComIPduSignalRef = Harness_igbt_temp{1..3}
        ComIPduSignalRef = Harness_CoolWaterTemp
        ComIPduSignalRef = Harness_V_DC
        ComIPduSignalRef = Harness_PWM_DIR
        ComIPduSignalRef = Harness_HVIL_State
        ComIPduSignalRef = Harness_crash_err_flag
        ComIPduSignalRef = Harness_KeyON
        ComIPduSignalRef = Harness_HWRdc
        ComIPduSignalRef = Harness_HWFoT
        ComIPduSignalRef = Harness_HWVoltLower
        ComIPduSignalRef = Harness_HWFoB
        ComIPduSignalRef = Harness_MotorTemp1
        ComIPduSignalRef = Harness_MotorTemp2
        ComIPduSignalRef = Harness_I_U
        ComIPduSignalRef = Harness_I_W
        ComIPduSignalRef = Harness_I_V
        ComIPduSignalRef = Harness_HVRelayPosVolt
        ComIPduSignalRef = MCUMR_Harness_igbt_temp{1..3}
        ComIPduSignalRef = MCUMR_Harness_CoolWaterTemp
        ComIPduSignalRef = MCUMR_Harness_V_DC
        ComIPduSignalRef = MCUMR_Harness_PWM_DIR
        ComIPduSignalRef = MCUMR_Harness_HWRdc
        ComIPduSignalRef = MCUMR_Harness_HWFoT
        ComIPduSignalRef = MCUMR_Harness_HWVoltLower
        ComIPduSignalRef = MCUMR_Harness_HWFoB
        ComIPduSignalRef = MCUMR_Harness_MotorTemp1
        ComIPduSignalRef = MCUMR_Harness_MotorTemp2
        ComIPduSignalRef = MCUMR_Harness_I_U
        ComIPduSignalRef = MCUMR_Harness_I_W
        ComIPduSignalRef = MCUMR_Harness_I_V
        ComIPduGroupRef = ComIPduGroup_DevMCU
        ComTxIPdu: ComMinimumDelayTime=0.0, ComTxIPduUnusedAreasDefault=0
          ComTxModeTrue
            ComTxMode: ComTxModeTimePeriod=0.01, ComTxModeMode=DIRECT, ComTxModeNumberOfRepetitions=0, ComTxModeRepetitionPeriod=0, ComTxModeTimeOffset=0.0
          ComTxModeFalse
            ComTxMode: ComTxModeTimePeriod=0.01, ComTxModeMode=PERIODIC, ComTxModeNumberOfRepetitions=0, ComTxModeRepetitionPeriod=0, ComTxModeTimeOffset=0.0
      34 x ComSignal, all with ComSignalInitValue=0, ComSignalEndianness=LITTLE_ENDIAN, ComUpdateBitPosition=-1, ComTransferProperty=PENDING:
        Harness_igbt_temp1: ComSignalType=UINT8, ComBitSize=8, ComBitPosition=0, ComSystemTemplateSystemSignalRef=Harness_igbt_temp1
        Harness_igbt_temp2: ComSignalType=UINT8, ComBitSize=8, ComBitPosition=8, ComSystemTemplateSystemSignalRef=Harness_igbt_temp2
        Harness_igbt_temp3: ComSignalType=UINT8, ComBitSize=8, ComBitPosition=16, ComSystemTemplateSystemSignalRef=Harness_igbt_temp3
        Harness_CoolWaterTemp: ComSignalType=UINT8, ComBitSize=8, ComBitPosition=24, ComSystemTemplateSystemSignalRef=Harness_CoolWaterTemp
        Harness_V_DC: ComSignalType=UINT16, ComBitSize=16, ComBitPosition=32, ComSystemTemplateSystemSignalRef=Harness_V_DC
        Harness_PWM_DIR: ComSignalType=UINT8, ComBitSize=8, ComBitPosition=48, ComSystemTemplateSystemSignalRef=Harness_PWM_DIR
        Harness_HVIL_State: ComSignalType=BOOLEAN, ComBitSize=1, ComBitPosition=57, ComSystemTemplateSystemSignalRef=Harness_HVIL_State
        Harness_crash_err_flag: ComSignalType=BOOLEAN, ComBitSize=1, ComBitPosition=58, ComSystemTemplateSystemSignalRef=Harness_crash_err_flag
        Harness_KeyON: ComSignalType=BOOLEAN, ComBitSize=1, ComBitPosition=59, ComSystemTemplateSystemSignalRef=Harness_KeyON
        Harness_HWRdc: ComSignalType=BOOLEAN, ComBitSize=1, ComBitPosition=60, ComSystemTemplateSystemSignalRef=Harness_HWRdc
        Harness_HWFoT: ComSignalType=BOOLEAN, ComBitSize=1, ComBitPosition=61, ComSystemTemplateSystemSignalRef=Harness_HWFoT
        Harness_HWVoltLower: ComSignalType=BOOLEAN, ComBitSize=1, ComBitPosition=62, ComSystemTemplateSystemSignalRef=Harness_HWVoltLower
        Harness_HWFoB: ComSignalType=BOOLEAN, ComBitSize=1, ComBitPosition=63, ComSystemTemplateSystemSignalRef=Harness_HWFoB
        Harness_MotorTemp1: ComSignalType=UINT16, ComBitSize=16, ComBitPosition=64, ComSystemTemplateSystemSignalRef=Harness_MotorTemp1
        Harness_MotorTemp2: ComSignalType=UINT16, ComBitSize=16, ComBitPosition=80, ComSystemTemplateSystemSignalRef=Harness_MotorTemp2
        Harness_I_U: ComSignalType=UINT8, ComBitSize=8, ComBitPosition=96, ComSystemTemplateSystemSignalRef=Harness_I_U
        Harness_I_W: ComSignalType=UINT8, ComBitSize=8, ComBitPosition=104, ComSystemTemplateSystemSignalRef=Harness_I_W
        Harness_I_V: ComSignalType=UINT8, ComBitSize=8, ComBitPosition=112, ComSystemTemplateSystemSignalRef=Harness_I_V
        Harness_HVRelayPosVolt: ComSignalType=UINT8, ComBitSize=8, ComBitPosition=120, ComSystemTemplateSystemSignalRef=Harness_HVRelayPosVolt
        MCUMR_Harness_igbt_temp1: ComSignalType=UINT8, ComBitSize=8, ComBitPosition=128, ComSystemTemplateSystemSignalRef=MCUMR_Harness_igbt_temp1
        MCUMR_Harness_igbt_temp2: ComSignalType=UINT8, ComBitSize=8, ComBitPosition=136, ComSystemTemplateSystemSignalRef=MCUMR_Harness_igbt_temp2
        MCUMR_Harness_igbt_temp3: ComSignalType=UINT8, ComBitSize=8, ComBitPosition=144, ComSystemTemplateSystemSignalRef=MCUMR_Harness_igbt_temp3
        MCUMR_Harness_CoolWaterTemp: ComSignalType=UINT8, ComBitSize=8, ComBitPosition=152, ComSystemTemplateSystemSignalRef=MCUMR_Harness_CoolWaterTemp
        MCUMR_Harness_V_DC: ComSignalType=UINT16, ComBitSize=16, ComBitPosition=160, ComSystemTemplateSystemSignalRef=MCUMR_Harness_V_DC
        MCUMR_Harness_PWM_DIR: ComSignalType=UINT8, ComBitSize=8, ComBitPosition=176, ComSystemTemplateSystemSignalRef=MCUMR_Harness_PWM_DIR
        MCUMR_Harness_HWRdc: ComSignalType=BOOLEAN, ComBitSize=1, ComBitPosition=184, ComSystemTemplateSystemSignalRef=MCUMR_Harness_HWRdc
        MCUMR_Harness_HWFoT: ComSignalType=BOOLEAN, ComBitSize=1, ComBitPosition=185, ComSystemTemplateSystemSignalRef=MCUMR_Harness_HWFoT
        MCUMR_Harness_HWVoltLower: ComSignalType=BOOLEAN, ComBitSize=1, ComBitPosition=186, ComSystemTemplateSystemSignalRef=MCUMR_Harness_HWVoltLower
        MCUMR_Harness_HWFoB: ComSignalType=BOOLEAN, ComBitSize=1, ComBitPosition=187, ComSystemTemplateSystemSignalRef=MCUMR_Harness_HWFoB
        MCUMR_Harness_MotorTemp1: ComSignalType=UINT16, ComBitSize=16, ComBitPosition=188, ComSystemTemplateSystemSignalRef=MCUMR_Harness_MotorTemp1
        MCUMR_Harness_MotorTemp2: ComSignalType=UINT16, ComBitSize=16, ComBitPosition=204, ComSystemTemplateSystemSignalRef=MCUMR_Harness_MotorTemp2
        MCUMR_Harness_I_U: ComSignalType=UINT8, ComBitSize=8, ComBitPosition=220, ComSystemTemplateSystemSignalRef=MCUMR_Harness_I_U
        MCUMR_Harness_I_W: ComSignalType=UINT8, ComBitSize=8, ComBitPosition=228, ComSystemTemplateSystemSignalRef=MCUMR_Harness_I_W
        MCUMR_Harness_I_V: ComSignalType=UINT8, ComBitSize=8, ComBitPosition=236, ComSystemTemplateSystemSignalRef=MCUMR_Harness_I_V
      VCU_0x600_P_CANFD (ComIPdu):
        ComIPduSignalProcessing = IMMEDIATE
        ComIPduType = NORMAL
        ComIPduDirection = SEND
        ComFirstTimeout = 0.2
        ComTimeout = 0.2
        ComIPduGroupRef = ComIPduGroup_Tx
        ComPduIdRef = PduCollection/VCU_0x600_P_CANFD_Com2PduR
        ComIPduSignalRef = VCU_FaultData{0..31}
        ComTxIPdu: ComMinimumDelayTime=0.0, ComTxIPduUnusedAreasDefault=0
          ComTxModeTrue
            ComTxMode: ComTxModeTimePeriod=0.2, ComTxModeMode=PERIODIC, ComTxModeNumberOfRepetitions=0, ComTxModeRepetitionPeriod=0, ComTxModeTimeOffset=0.0
          ComTxModeFalse
            ComTxMode: ComTxModeTimePeriod=0.2, ComTxModeMode=PERIODIC, ComTxModeNumberOfRepetitions=0, ComTxModeRepetitionPeriod=0, ComTxModeTimeOffset=0.0
      32 x ComSignal, all with ComSignalInitValue=0, ComSignalType=UINT8, ComSignalEndianness=LITTLE_ENDIAN, ComBitSize=8, ComUpdateBitPosition=-1, ComTransferProperty=PENDING:
        VCU_FaultData0: ComBitPosition=0, ComSystemTemplateSystemSignalRef=VCU_FaultData0
        VCU_FaultData1: ComBitPosition=8, ComSystemTemplateSystemSignalRef=VCU_FaultData1
        VCU_FaultData2: ComBitPosition=16, ComSystemTemplateSystemSignalRef=VCU_FaultData2
        VCU_FaultData3: ComBitPosition=24, ComSystemTemplateSystemSignalRef=VCU_FaultData3
        VCU_FaultData4: ComBitPosition=32, ComSystemTemplateSystemSignalRef=VCU_FaultData4
        VCU_FaultData5: ComBitPosition=40, ComSystemTemplateSystemSignalRef=VCU_FaultData5
        VCU_FaultData6: ComBitPosition=48, ComSystemTemplateSystemSignalRef=VCU_FaultData6
        VCU_FaultData7: ComBitPosition=56, ComSystemTemplateSystemSignalRef=VCU_FaultData7
        VCU_FaultData8: ComBitPosition=64, ComSystemTemplateSystemSignalRef=VCU_FaultData8
        VCU_FaultData9: ComBitPosition=72, ComSystemTemplateSystemSignalRef=VCU_FaultData9
        VCU_FaultData10: ComBitPosition=80, ComSystemTemplateSystemSignalRef=VCU_FaultData10
        VCU_FaultData11: ComBitPosition=88, ComSystemTemplateSystemSignalRef=VCU_FaultData11
        VCU_FaultData12: ComBitPosition=96, ComSystemTemplateSystemSignalRef=VCU_FaultData12
        VCU_FaultData13: ComBitPosition=104, ComSystemTemplateSystemSignalRef=VCU_FaultData13
        VCU_FaultData14: ComBitPosition=112, ComSystemTemplateSystemSignalRef=VCU_FaultData14
        VCU_FaultData15: ComBitPosition=120, ComSystemTemplateSystemSignalRef=VCU_FaultData15
        VCU_FaultData16: ComBitPosition=128, ComSystemTemplateSystemSignalRef=VCU_FaultData16
        VCU_FaultData17: ComBitPosition=136, ComSystemTemplateSystemSignalRef=VCU_FaultData17
        VCU_FaultData18: ComBitPosition=144, ComSystemTemplateSystemSignalRef=VCU_FaultData18
        VCU_FaultData19: ComBitPosition=152, ComSystemTemplateSystemSignalRef=VCU_FaultData19
        VCU_FaultData20: ComBitPosition=160, ComSystemTemplateSystemSignalRef=VCU_FaultData20
        VCU_FaultData21: ComBitPosition=168, ComSystemTemplateSystemSignalRef=VCU_FaultData21
        VCU_FaultData22: ComBitPosition=176, ComSystemTemplateSystemSignalRef=VCU_FaultData22
        VCU_FaultData23: ComBitPosition=184, ComSystemTemplateSystemSignalRef=VCU_FaultData23
        VCU_FaultData24: ComBitPosition=192, ComSystemTemplateSystemSignalRef=VCU_FaultData24
        VCU_FaultData25: ComBitPosition=200, ComSystemTemplateSystemSignalRef=VCU_FaultData25
        VCU_FaultData26: ComBitPosition=208, ComSystemTemplateSystemSignalRef=VCU_FaultData26
        VCU_FaultData27: ComBitPosition=216, ComSystemTemplateSystemSignalRef=VCU_FaultData27
        VCU_FaultData28: ComBitPosition=224, ComSystemTemplateSystemSignalRef=VCU_FaultData28
        VCU_FaultData29: ComBitPosition=232, ComSystemTemplateSystemSignalRef=VCU_FaultData29
        VCU_FaultData30: ComBitPosition=240, ComSystemTemplateSystemSignalRef=VCU_FaultData30
        VCU_FaultData31: ComBitPosition=248, ComSystemTemplateSystemSignalRef=VCU_FaultData31
      MCU_0x5C6_P_CANFD (ComIPdu):
        ComIPduSignalProcessing = IMMEDIATE
        ComIPduType = NORMAL
        ComIPduDirection = SEND
        ComFirstTimeout = 0.01
        ComTimeout = 0.01
        ComPduIdRef = PduCollection/MCU_0x5C6_P_CANFD_Com2PduR
        ComIPduSignalRef = MotClb_FaultCode{1..8}
        ComIPduSignalRef = MotClb_OfsApply
        ComIPduSignalRef = MCUMR_MotClb_FaultCode{1..8}
        ComIPduSignalRef = MCUMR_MotClb_OfsApply
        ComIPduGroupRef = ComIPduGroup_DevMCU
        ComTxIPdu: ComMinimumDelayTime=0.0, ComTxIPduUnusedAreasDefault=0
          ComTxModeTrue
            ComTxMode: ComTxModeTimePeriod=0.01, ComTxModeMode=DIRECT, ComTxModeNumberOfRepetitions=0, ComTxModeRepetitionPeriod=0, ComTxModeTimeOffset=0.0
          ComTxModeFalse
            ComTxMode: ComTxModeTimePeriod=0.01, ComTxModeMode=PERIODIC, ComTxModeNumberOfRepetitions=0, ComTxModeRepetitionPeriod=0, ComTxModeTimeOffset=0.0
