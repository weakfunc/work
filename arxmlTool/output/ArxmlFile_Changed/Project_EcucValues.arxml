[part 1 of 4: package /ETAS_Project/EcucModuleConfigurationValuess]
AUTOSAR XML (schema 4-2-2)
package /ETAS_Project/EcucModuleConfigurationValuess
  module config ComM: implementation-config-variant=VARIANT-PRE-COMPILE
    ComMGeneral:
      ComMEcuGroupClassification = 0
      ComMModeLimitationEnabled = false
      ComMTMinFullComModeDuration = 0.01
      ComMVersionInfoApi = false
      ComMWakeupInhibitionEnabled = false
      ComMPncGatewayEnabled = false
      ComMPncSupport = true
      ComMResetAfterForcingNoComm = false
      ComMSynchronousWakeUp = false
      ComMRteEnabled = false
      ComMDevErrorDetect = false
      ComMPncPrepareSleepTimer = 0.01
    ComMConfigSet: ComMPncEnabled=true
      ComMUser_P_CANFD_Channel (ComMUser)
      ComMChannel_P_CANFD_Channel (ComMChannel):
        ComMMainFunctionPeriod = 0.01
        ComMFullCommRequestNotificationEnabled = false
        ComMNoCom = false
        ComMNoWakeUpInhibitionNvmStorage = false
        ComMNoWakeup = false
        ComMBusType = COMM_BUS_TYPE_CAN
        ComMNetworkManagement: ComMNmLightTimeout=10, ComMNmVariant=FULL, ComMPncNmRequest=true
        ComMUserPerChannel: ComMUserChannel=ComMUser_P_CANFD_Channel
      ComMUser_C_CANFD_Channel (ComMUser)
      ComMChannel_C_CANFD_Channel (ComMChannel):
        ComMMainFunctionPeriod = 0.01
        ComMFullCommRequestNotificationEnabled = false
        ComMNoCom = false
        ComMNoWakeUpInhibitionNvmStorage = false
        ComMNoWakeup = false
        ComMBusType = COMM_BUS_TYPE_CAN
        ComMNetworkManagement: ComMNmLightTimeout=10, ComMNmVariant=FULL, ComMPncNmRequest=false
      ComMUser_VCU_CAN_Channel (ComMUser)
      ComMChannel_VCU_CAN_Channel (ComMChannel):
        ComMMainFunctionPeriod = 0.01
        ComMFullCommRequestNotificationEnabled = false
        ComMNoCom = true
        ComMNoWakeUpInhibitionNvmStorage = false
        ComMNoWakeup = true
        ComMBusType = COMM_BUS_TYPE_CAN
        ComMNetworkManagement: ComMNmLightTimeout=10, ComMNmVariant=NONE, ComMPncNmRequest=false
        ComMUserPerChannel_VCU_CAN_Channel (ComMUserPerChannel): ComMUserChannel=ComMUser_VCU_CAN_Channel
      ComMPnc: ComMPncId=32, ComMPncMainFunctionPeriod=0.01, ComMChannelPerPnc=ComMChannel_C_CANFD_Channel, ComMUserPerPnc=ComMUser_C_CANFD_Channel
        ComMPncComSignal_TX (ComMPncComSignal):
          ComMPncComSignalDirection = TX
          ComMPncComSignalKind = EIRA
          ComMPncComSignalChannelRef = ComMChannel_C_CANFD_Channel
          ComMPncComSignalRef = NM_PNC_DATA_T0
  module config CanIf: implementation-config-variant=VARIANT-PRE-COMPILE
    CanIfInitCfg: CanIfInitCfgSet=0
      CanIfInitHohCfg
        44 x CanIfHrhCfg, all with CanIfHrhCanCtrlIdRef=P_CANFD:
          P_CANFD_Rx_Std_MailBox_{1..21}: CanIfHrhIdSymRef=P_CANFD_Rx_Std_MailBox_{1..21}
          P_CANFD_Rx_Std_MailBox_22: CanIfHrhIdSymRef=P_CANFD_Rx_Std_MailBox_22
            CanIfHrhListCfg: CanIfHrhListCanId=2019
          P_CANFD_Rx_Std_MailBox_{23..29}: CanIfHrhIdSymRef=P_CANFD_Rx_Std_MailBox_{23..29}
          P_CANFD_Rx_Std_MailBox_30: CanIfHrhIdSymRef=P_CANFD_Rx_Std_MailBox_30
            CanIfHrhListCfg: CanIfHrhListCanId=2015, CanIfHrhListCanId=2014
          P_CANFD_Rx_Std_MailBox_{31..40}: CanIfHrhIdSymRef=P_CANFD_Rx_Std_MailBox_{31..40}
          P_CANFD_Rx_Std_MailBox_41: CanIfHrhIdSymRef=P_CANFD_Rx_Std_MailBox_41
            CanIfHrhListCfg: CanIfHrhListCanId=1825
          P_CANFD_Rx_Std_MailBox_{42..44}: CanIfHrhIdSymRef=P_CANFD_Rx_Std_MailBox_{42..44}
        26 x CanIfHthCfg, all with CanIfHthCanCtrlIdRef=P_CANFD:
          P_CANFD_Tx_Std_MailBox_{1..26}: CanIfHthIdSymRef=P_CANFD_Tx_Std_MailBox_{1..26}
        23 x CanIfHrhCfg:
          P_CANFD_Rx_Std_MailBox_{45..47}: CanIfHrhCanCtrlIdRef=P_CANFD, CanIfHrhIdSymRef=P_CANFD_Rx_Std_MailBox_{45..47}
          C_CANFD_Rx_Std_MailBox_{1..20}: CanIfHrhIdSymRef=C_CANFD_Rx_Std_MailBox_{1..20}, CanIfHrhCanCtrlIdRef=C_CANFD
        3 x CanIfHthCfg, all with CanIfHthCanCtrlIdRef=C_CANFD:
          C_CANFD_Tx_Std_MailBox_{1..3}: CanIfHthIdSymRef=C_CANFD_Tx_Std_MailBox_{1..3}
        5 x CanIfHrhCfg:
          C_CANFD_Rx_Std_MailBox_21: CanIfHrhIdSymRef=C_CANFD_Rx_Std_MailBox_21, CanIfHrhCanCtrlIdRef=C_CANFD
          C_CANFD_Rx_Std_MailBox_22: CanIfHrhIdSymRef=C_CANFD_Rx_Std_MailBox_22, CanIfHrhCanCtrlIdRef=C_CANFD
          C_CANFD_Rx_Std_MailBox_23: CanIfHrhCanCtrlIdRef=C_CANFD, CanIfHrhIdSymRef=C_CANFD_Rx_Std_MailBox_23
          C_CANFD_Rx_Std_MailBox_24: CanIfHrhCanCtrlIdRef=C_CANFD, CanIfHrhIdSymRef=C_CANFD_Rx_Std_MailBox_24
          VCU_CAN_Rx_Std_MailBox_1: CanIfHrhIdSymRef=VCU_CAN_Rx_Std_MailBox_1, CanIfHrhCanCtrlIdRef=VCU_CAN
        6 x CanIfHthCfg:
          VCU_CAN_Tx_Std_MailBox_1: CanIfHthIdSymRef=VCU_CAN_Tx_Std_MailBox_1, CanIfHthCanCtrlIdRef=VCU_CAN
          C_CANFD_Tx_Std_MailBox_4: CanIfHthIdSymRef=C_CANFD_Tx_Std_MailBox_4, CanIfHthCanCtrlIdRef=C_CANFD
          C_CANFD_Tx_Std_MailBox_5: CanIfHthIdSymRef=C_CANFD_Tx_Std_MailBox_5, CanIfHthCanCtrlIdRef=C_CANFD
          P_CANFD_Tx_Std_MailBox_{27..29}: CanIfHthIdSymRef=P_CANFD_Tx_Std_MailBox_{27..29}, CanIfHthCanCtrlIdRef=P_CANFD
        3 x CanIfHrhCfg, all with CanIfHrhCanCtrlIdRef=VCU_CAN:
          VCU_CAN_Rx_Std_MailBox_3: CanIfHrhIdSymRef=VCU_CAN_Rx_Std_MailBox_3
          VCU_CAN_Rx_Std_MailBox_4: CanIfHrhIdSymRef=VCU_CAN_Rx_Std_MailBox_4
          VCU_CAN_Rx_Std_MailBox_2: CanIfHrhIdSymRef=VCU_CAN_Rx_Std_MailBox_2
      39 x CanIfRxPduCfg, all with CanIfRxPduReadData=false, CanIfRxPduReadNotifyStatus=true, CanIfRxPduCanIdType=STANDARD_FD_CAN:
        EMS_0xBE_P_CANFD: CanIfRxPduCanId=190, CanIfRxPduDlc=32, CanIfRxPduUserRxIndicationName=PduR_CanIfRxIndication, CanIfRxPduUserRxIndicationUL=PDUR, CanIfRxPduHrhIdRef=P_CANFD_Rx_Std_MailBox_1, CanIfRxPduRef=PduCollection/EMS_0xBE_P_CANFD_CanIf2PduR
        BMS_0x5B5_P_CANFD: CanIfRxPduCanId=1461, CanIfRxPduDlc=64, CanIfRxPduUserRxIndicationName=PduR_CanIfRxIndication, CanIfRxPduUserRxIndicationUL=PDUR, CanIfRxPduHrhIdRef=P_CANFD_Rx_Std_MailBox_2, CanIfRxPduRef=PduCollection/BMS_0x5B5_P_CANFD_CanIf2PduR
        OBC_0x316_P_CANFD: CanIfRxPduCanId=790, CanIfRxPduDlc=32, CanIfRxPduUserRxIndicationName=PduR_CanIfRxIndication, CanIfRxPduUserRxIndicationUL=PDUR, CanIfRxPduHrhIdRef=P_CANFD_Rx_Std_MailBox_3, CanIfRxPduRef=PduCollection/OBC_0x316_P_CANFD_CanIf2PduR
        TMS_0x5FF_P_CANFD: CanIfRxPduCanId=1535, CanIfRxPduDlc=16, CanIfRxPduUserRxIndicationName=PduR_CanIfRxIndication, CanIfRxPduUserRxIndicationUL=PDUR, CanIfRxPduHrhIdRef=P_CANFD_Rx_Std_MailBox_4, CanIfRxPduRef=PduCollection/TMS_0x5FF_P_CANFD_CanIf2PduR
        TMS_0x5FE_P_CANFD: CanIfRxPduCanId=1534, CanIfRxPduDlc=8, CanIfRxPduUserRxIndicationName=PduR_CanIfRxIndication, CanIfRxPduUserRxIndicationUL=PDUR, CanIfRxPduHrhIdRef=P_CANFD_Rx_Std_MailBox_5, CanIfRxPduRef=PduCollection/TMS_0x5FE_P_CANFD_CanIf2PduR
        BMS_0x5B1_P_CANFD: CanIfRxPduCanId=1457, CanIfRxPduDlc=64, CanIfRxPduUserRxIndicationName=PduR_CanIfRxIndication, CanIfRxPduUserRxIndicationUL=PDUR, CanIfRxPduHrhIdRef=P_CANFD_Rx_Std_MailBox_6, CanIfRxPduRef=PduCollection/BMS_0x5B1_P_CANFD_CanIf2PduR
        PTC_0x367_P_CANFD: CanIfRxPduCanId=871, CanIfRxPduDlc=16, CanIfRxPduUserRxIndicationName=PduR_CanIfRxIndication, CanIfRxPduUserRxIndicationUL=PDUR, CanIfRxPduHrhIdRef=P_CANFD_Rx_Std_MailBox_7, CanIfRxPduRef=PduCollection/PTC_0x367_P_CANFD_CanIf2PduR
        MCU_0x5C7_P_CANFD: CanIfRxPduCanId=1479, CanIfRxPduDlc=32, CanIfRxPduUserRxIndicationName=PduR_CanIfRxIndication, CanIfRxPduUserRxIndicationUL=PDUR, CanIfRxPduHrhIdRef=P_CANFD_Rx_Std_MailBox_8, CanIfRxPduRef=PduCollection/MCU_0x5C7_P_CANFD_CanIf2PduR
        MCU_0x5C5_P_CANFD: CanIfRxPduCanId=1477, CanIfRxPduDlc=24, CanIfRxPduUserRxIndicationName=PduR_CanIfRxIndication, CanIfRxPduUserRxIndicationUL=PDUR, CanIfRxPduHrhIdRef=P_CANFD_Rx_Std_MailBox_9, CanIfRxPduRef=PduCollection/MCU_0x5C5_P_CANFD_CanIf2PduR
        CCM_0x36A_P_CANFD: CanIfRxPduCanId=874, CanIfRxPduDlc=16, CanIfRxPduUserRxIndicationName=PduR_CanIfRxIndication, CanIfRxPduUserRxIndicationUL=PDUR, CanIfRxPduHrhIdRef=P_CANFD_Rx_Std_MailBox_10, CanIfRxPduRef=PduCollection/CCM_0x36A_P_CANFD_CanIf2PduR
        TMS_0x561_P_CANFD: CanIfRxPduCanId=1377, CanIfRxPduDlc=32, CanIfRxPduUserRxIndicationName=PduR_CanIfRxIndication, CanIfRxPduUserRxIndicationUL=PDUR, CanIfRxPduHrhIdRef=P_CANFD_Rx_Std_MailBox_11, CanIfRxPduRef=PduCollection/TMS_0x561_P_CANFD_CanIf2PduR
        HPCGW_0x13A_P_CANFD: CanIfRxPduCanId=314, CanIfRxPduDlc=16, CanIfRxPduUserRxIndicationName=PduR_CanIfRxIndication, CanIfRxPduUserRxIndicationUL=PDUR, CanIfRxPduHrhIdRef=P_CANFD_Rx_Std_MailBox_12, CanIfRxPduRef=PduCollection/HPCGW_0x13A_P_CANFD_CanIf2PduR
        HPCBCM_0x291_P_CANFD: CanIfRxPduCanId=657, CanIfRxPduDlc=16, CanIfRxPduUserRxIndicationName=PduR_CanIfRxIndication, CanIfRxPduUserRxIndicationUL=PDUR, CanIfRxPduHrhIdRef=P_CANFD_Rx_Std_MailBox_13, CanIfRxPduRef=PduCollection/HPCBCM_0x291_P_CANFD_CanIf2PduR
        HPCBCM_0x292_P_CANFD: CanIfRxPduCanId=658, CanIfRxPduDlc=8, CanIfRxPduUserRxIndicationName=PduR_CanIfRxIndication, CanIfRxPduUserRxIndicationUL=PDUR, CanIfRxPduHrhIdRef=P_CANFD_Rx_Std_MailBox_14, CanIfRxPduRef=PduCollection/HPCBCM_0x292_P_CANFD_CanIf2PduR
        HPCGW_0x30B_P_CANFD: CanIfRxPduCanId=779, CanIfRxPduDlc=8, CanIfRxPduUserRxIndicationName=PduR_CanIfRxIndication, CanIfRxPduUserRxIndicationUL=PDUR, CanIfRxPduHrhIdRef=P_CANFD_Rx_Std_MailBox_15, CanIfRxPduRef=PduCollection/HPCGW_0x30B_P_CANFD_CanIf2PduR
        BMS_0x1A1_P_CANFD: CanIfRxPduCanId=417, CanIfRxPduDlc=32, CanIfRxPduUserRxIndicationName=PduR_CanIfRxIndication, CanIfRxPduUserRxIndicationUL=PDUR, CanIfRxPduHrhIdRef=P_CANFD_Rx_Std_MailBox_16, CanIfRxPduRef=PduCollection/BMS_0x1A1_P_CANFD_CanIf2PduR
        MCUS_0xDB_P_CANFD: CanIfRxPduCanId=219, CanIfRxPduDlc=32, CanIfRxPduUserRxIndicationName=PduR_CanIfRxIndication, CanIfRxPduUserRxIndicationUL=PDUR, CanIfRxPduHrhIdRef=P_CANFD_Rx_Std_MailBox_17, CanIfRxPduRef=PduCollection/MCUS_0xDB_P_CANFD_CanIf2PduR
        XCP_Rx_603_VCU_P_CANFD: CanIfRxPduCanId=1539, CanIfRxPduDlc=1, CanIfRxPduUserRxIndicationUL=XCP, CanIfRxPduHrhIdRef=P_CANFD_Rx_Std_MailBox_18, CanIfRxPduRef=XCP_Rx_603_VCU_P_CANFD_CanIf2Xcp
        ECM_0x5EC_P_CANFD: CanIfRxPduCanId=1516, CanIfRxPduDlc=32, CanIfRxPduUserRxIndicationName=PduR_CanIfRxIndication, CanIfRxPduUserRxIndicationUL=PDUR, CanIfRxPduHrhIdRef=P_CANFD_Rx_Std_MailBox_19, CanIfRxPduRef=PduCollection/ECM_0x5EC_P_CANFD_CanIf2PduR
        ECM_0x147_P_CANFD: CanIfRxPduCanId=327, CanIfRxPduDlc=32, CanIfRxPduUserRxIndicationName=PduR_CanIfRxIndication, CanIfRxPduUserRxIndicationUL=PDUR, CanIfRxPduHrhIdRef=P_CANFD_Rx_Std_MailBox_44, CanIfRxPduRef=PduCollection/ECM_0x147_P_CANFD_CanIf2PduR
        HPCBCM_0x1E4_P_CANFD: CanIfRxPduCanId=484, CanIfRxPduDlc=8, CanIfRxPduUserRxIndicationName=PduR_CanIfRxIndication, CanIfRxPduUserRxIndicationUL=PDUR, CanIfRxPduHrhIdRef=P_CANFD_Rx_Std_MailBox_20, CanIfRxPduRef=PduCollection/HPCBCM_0x1E4_P_CANFD_CanIf2PduR
        VCU_0x1_P_CANFD: CanIfRxPduCanId=1, CanIfRxPduDlc=32, CanIfRxPduUserRxIndicationName=PduR_CanIfRxIndication, CanIfRxPduUserRxIndicationUL=PDUR, CanIfRxPduHrhIdRef=P_CANFD_Rx_Std_MailBox_21, CanIfRxPduRef=PduCollection/VCU_0x1_P_CANFD_CanIf2PduR
        GCU_0xBD_P_CANFD: CanIfRxPduCanId=189, CanIfRxPduDlc=32, CanIfRxPduUserRxIndicationName=PduR_CanIfRxIndication, CanIfRxPduUserRxIndicationUL=PDUR, CanIfRxPduHrhIdRef=P_CANFD_Rx_Std_MailBox_23, CanIfRxPduRef=PduCollection/GCU_0xBD_P_CANFD_CanIf2PduR
        RMCU_0x2_P_CANFD: CanIfRxPduCanId=2, CanIfRxPduDlc=32, CanIfRxPduUserRxIndicationName=PduR_CanIfRxIndication, CanIfRxPduUserRxIndicationUL=PDUR, CanIfRxPduHrhIdRef=P_CANFD_Rx_Std_MailBox_24, CanIfRxPduRef=PduCollection/RMCU_0x2_P_CANFD_CanIf2PduR
        ICU_0x249_P_CANFD: CanIfRxPduCanId=585, CanIfRxPduDlc=64, CanIfRxPduUserRxIndicationName=PduR_CanIfRxIndication, CanIfRxPduUserRxIndicationUL=PDUR, CanIfRxPduHrhIdRef=P_CANFD_Rx_Std_MailBox_25, CanIfRxPduRef=PduCollection/ICU_0x249_P_CANFD_CanIf2PduR
        HPCBCM_0x1E6_P_CANFD: CanIfRxPduCanId=486, CanIfRxPduDlc=16, CanIfRxPduUserRxIndicationName=PduR_CanIfRxIndication, CanIfRxPduUserRxIndicationUL=PDUR, CanIfRxPduHrhIdRef=P_CANFD_Rx_Std_MailBox_26, CanIfRxPduRef=PduCollection/HPCBCM_0x1E6_P_CANFD_CanIf2PduR
        BMS_0x310_P_CANFD: CanIfRxPduCanId=784, CanIfRxPduDlc=32, CanIfRxPduUserRxIndicationName=PduR_CanIfRxIndication, CanIfRxPduUserRxIndicationUL=PDUR, CanIfRxPduHrhIdRef=P_CANFD_Rx_Std_MailBox_27, CanIfRxPduRef=PduCollection/BMS_0x310_P_CANFD_CanIf2PduR
        IVI_0x3D8_P_CANFD: CanIfRxPduCanId=984, CanIfRxPduDlc=8, CanIfRxPduUserRxIndicationName=PduR_CanIfRxIndication, CanIfRxPduUserRxIndicationUL=PDUR, CanIfRxPduHrhIdRef=P_CANFD_Rx_Std_MailBox_29, CanIfRxPduRef=PduCollection/IVI_0x3D8_P_CANFD_CanIf2PduR
        ICU_0x24C_P_CANFD: CanIfRxPduCanId=588, CanIfRxPduDlc=8, CanIfRxPduUserRxIndicationName=PduR_CanIfRxIndication, CanIfRxPduUserRxIndicationUL=PDUR, CanIfRxPduHrhIdRef=P_CANFD_Rx_Std_MailBox_31, CanIfRxPduRef=PduCollection/ICU_0x24C_P_CANFD_CanIf2PduR
        IVI_0x34A_P_CANFD: CanIfRxPduCanId=842, CanIfRxPduDlc=8, CanIfRxPduUserRxIndicationName=PduR_CanIfRxIndication, CanIfRxPduUserRxIndicationUL=PDUR, CanIfRxPduHrhIdRef=P_CANFD_Rx_Std_MailBox_33, CanIfRxPduRef=PduCollection/IVI_0x34A_P_CANFD_CanIf2PduR
        TMS_0x5A2_P_CANFD: CanIfRxPduCanId=1442, CanIfRxPduDlc=64, CanIfRxPduUserRxIndicationName=PduR_CanIfRxIndication, CanIfRxPduUserRxIndicationUL=PDUR, CanIfRxPduHrhIdRef=P_CANFD_Rx_Std_MailBox_34, CanIfRxPduRef=PduCollection/TMS_0x5A2_P_CANFD_CanIf2PduR
        TMS_0x363_P_CANFD: CanIfRxPduCanId=867, CanIfRxPduDlc=16, CanIfRxPduUserRxIndicationName=PduR_CanIfRxIndication, CanIfRxPduUserRxIndicationUL=PDUR, CanIfRxPduHrhIdRef=P_CANFD_Rx_Std_MailBox_35, CanIfRxPduRef=PduCollection/TMS_0x363_P_CANFD_CanIf2PduR
        ECM_0x148_P_CANFD: CanIfRxPduCanId=328, CanIfRxPduDlc=16, CanIfRxPduUserRxIndicationName=PduR_CanIfRxIndication, CanIfRxPduUserRxIndicationUL=PDUR, CanIfRxPduHrhIdRef=P_CANFD_Rx_Std_MailBox_36, CanIfRxPduRef=PduCollection/ECM_0x148_P_CANFD_CanIf2PduR
        IBS_0x225_P_CANFD: CanIfRxPduCanId=549, CanIfRxPduDlc=32, CanIfRxPduUserRxIndicationName=PduR_CanIfRxIndication, CanIfRxPduUserRxIndicationUL=PDUR, CanIfRxPduHrhIdRef=P_CANFD_Rx_Std_MailBox_37, CanIfRxPduRef=PduCollection/IBS_0x225_P_CANFD_CanIf2PduR
        HPCGW_0x3B1_P_CANFD: CanIfRxPduCanId=945, CanIfRxPduDlc=32, CanIfRxPduUserRxIndicationName=PduR_CanIfRxIndication, CanIfRxPduUserRxIndicationUL=PDUR, CanIfRxPduHrhIdRef=P_CANFD_Rx_Std_MailBox_38, CanIfRxPduRef=PduCollection/HPCGW_0x3B1_P_CANFD_CanIf2PduR
        GCU_0x2C1_P_CANFD: CanIfRxPduCanId=705, CanIfRxPduDlc=8, CanIfRxPduUserRxIndicationName=PduR_CanIfRxIndication, CanIfRxPduUserRxIndicationUL=PDUR, CanIfRxPduHrhIdRef=P_CANFD_Rx_Std_MailBox_39, CanIfRxPduRef=PduCollection/GCU_0x2C1_P_CANFD_CanIf2PduR
        DCDC_0x324_P_CANFD: CanIfRxPduCanId=804, CanIfRxPduDlc=16, CanIfRxPduUserRxIndicationName=PduR_CanIfRxIndication, CanIfRxPduUserRxIndicationUL=PDUR, CanIfRxPduHrhIdRef=P_CANFD_Rx_Std_MailBox_40, CanIfRxPduRef=PduCollection/DCDC_0x324_P_CANFD_CanIf2PduR
        EVCC_0x260_P_CANFD: CanIfRxPduCanId=608, CanIfRxPduDlc=8, CanIfRxPduUserRxIndicationName=PduR_CanIfRxIndication, CanIfRxPduUserRxIndicationUL=PDUR, CanIfRxPduHrhIdRef=P_CANFD_Rx_Std_MailBox_42, CanIfRxPduRef=PduCollection/EVCC_0x260_P_CANFD_CanIf2PduR
        IVI_0x5F6_P_CANFD: CanIfRxPduCanId=1526, CanIfRxPduDlc=8, CanIfRxPduUserRxIndicationName=PduR_CanIfRxIndication, CanIfRxPduUserRxIndicationUL=PDUR, CanIfRxPduHrhIdRef=P_CANFD_Rx_Std_MailBox_43, CanIfRxPduRef=PduCollection/IVI_0x5F6_P_CANFD_CanIf2PduR
      Buffer_P_CANFD_Tx_Std_MailBox_1 (CanIfBufferCfg): CanIfBufferSize=0, CanIfBufferHthRef=P_CANFD_Tx_Std_MailBox_1
      MCU_0x5CB_P_CANFD (CanIfTxPduCfg):
        CanIfTxPduReadNotifyStatus = false
        CanIfTxPduType = STATIC
        CanIfTxPduTruncation = false
        CanIfTxPduCanIdType = STANDARD_FD_CAN
        CanIfTxPduCanId = 1483
        CanIfTxPduUserTxConfirmationUL = PDUR
        CanIfTxPduBufferRef = Buffer_P_CANFD_Tx_Std_MailBox_1
        CanIfTxPduRef = PduCollection/MCU_0x5CB_P_CANFD_PduR2CanIf
      Buffer_P_CANFD_Tx_Std_MailBox_2 (CanIfBufferCfg): CanIfBufferSize=0, CanIfBufferHthRef=P_CANFD_Tx_Std_MailBox_2
      MCU_0x5CA_P_CANFD (CanIfTxPduCfg):
        CanIfTxPduReadNotifyStatus = false
        CanIfTxPduType = STATIC
        CanIfTxPduTruncation = false
        CanIfTxPduCanIdType = STANDARD_FD_CAN
        CanIfTxPduCanId = 1482
        CanIfTxPduUserTxConfirmationUL = PDUR
        CanIfTxPduBufferRef = Buffer_P_CANFD_Tx_Std_MailBox_2
        CanIfTxPduRef = PduCollection/MCU_0x5CA_P_CANFD_PduR2CanIf
      Buffer_P_CANFD_Tx_Std_MailBox_3 (CanIfBufferCfg): CanIfBufferSize=0, CanIfBufferHthRef=P_CANFD_Tx_Std_MailBox_3
      MCU_0x5C9_P_CANFD (CanIfTxPduCfg):
        CanIfTxPduReadNotifyStatus = false
        CanIfTxPduType = STATIC
        CanIfTxPduTruncation = false
        CanIfTxPduCanIdType = STANDARD_FD_CAN
        CanIfTxPduCanId = 1481
        CanIfTxPduUserTxConfirmationUL = PDUR
        CanIfTxPduBufferRef = Buffer_P_CANFD_Tx_Std_MailBox_3
        CanIfTxPduRef = PduCollection/MCU_0x5C9_P_CANFD_PduR2CanIf
      Buffer_P_CANFD_Tx_Std_MailBox_4 (CanIfBufferCfg): CanIfBufferSize=0, CanIfBufferHthRef=P_CANFD_Tx_Std_MailBox_4
      MCU_0x5C8_P_CANFD (CanIfTxPduCfg):
        CanIfTxPduReadNotifyStatus = false
        CanIfTxPduType = STATIC
        CanIfTxPduTruncation = false
        CanIfTxPduCanIdType = STANDARD_FD_CAN
        CanIfTxPduCanId = 1480
        CanIfTxPduUserTxConfirmationUL = PDUR
        CanIfTxPduBufferRef = Buffer_P_CANFD_Tx_Std_MailBox_4
        CanIfTxPduRef = PduCollection/MCU_0x5C8_P_CANFD_PduR2CanIf
      Buffer_P_CANFD_Tx_Std_MailBox_5 (CanIfBufferCfg): CanIfBufferSize=0, CanIfBufferHthRef=P_CANFD_Tx_Std_MailBox_5
      Buffer_P_CANFD_Tx_Std_MailBox_6 (CanIfBufferCfg): CanIfBufferSize=0, CanIfBufferHthRef=P_CANFD_Tx_Std_MailBox_6
      VCU_0x600_P_CANFD (CanIfTxPduCfg):
        CanIfTxPduReadNotifyStatus = false
        CanIfTxPduType = STATIC
        CanIfTxPduTruncation = false
        CanIfTxPduCanIdType = STANDARD_FD_CAN
        CanIfTxPduCanId = 1536
        CanIfTxPduUserTxConfirmationUL = PDUR
        CanIfTxPduBufferRef = Buffer_P_CANFD_Tx_Std_MailBox_6
        CanIfTxPduRef = PduCollection/VCU_0x600_P_CANFD_PduR2CanIf
      Buffer_P_CANFD_Tx_Std_MailBox_7 (CanIfBufferCfg): CanIfBufferSize=0, CanIfBufferHthRef=P_CANFD_Tx_Std_MailBox_7
      MCU_0x5C6_P_CANFD (CanIfTxPduCfg):
        CanIfTxPduReadNotifyStatus = false
        CanIfTxPduType = STATIC
        CanIfTxPduTruncation = false
        CanIfTxPduCanIdType = STANDARD_FD_CAN
        CanIfTxPduCanId = 1478
        CanIfTxPduUserTxConfirmationUL = PDUR
        CanIfTxPduBufferRef = Buffer_P_CANFD_Tx_Std_MailBox_7
        CanIfTxPduRef = PduCollection/MCU_0x5C6_P_CANFD_PduR2CanIf
      Buffer_P_CANFD_Tx_Std_MailBox_8 (CanIfBufferCfg): CanIfBufferSize=0, CanIfBufferHthRef=P_CANFD_Tx_Std_MailBox_8
      Buffer_P_CANFD_Tx_Std_MailBox_9 (CanIfBufferCfg): CanIfBufferSize=0, CanIfBufferHthRef=P_CANFD_Tx_Std_MailBox_9
      MCU_0x5C4_P_CANFD (CanIfTxPduCfg):
        CanIfTxPduReadNotifyStatus = false
        CanIfTxPduType = STATIC
        CanIfTxPduTruncation = false
        CanIfTxPduCanIdType = STANDARD_FD_CAN
        CanIfTxPduCanId = 1476
        CanIfTxPduUserTxConfirmationUL = PDUR
        CanIfTxPduBufferRef = Buffer_P_CANFD_Tx_Std_MailBox_9
        CanIfTxPduRef = PduCollection/MCU_0x5C4_P_CANFD_PduR2CanIf
      Buffer_P_CANFD_Tx_Std_MailBox_10 (CanIfBufferCfg): CanIfBufferSize=0, CanIfBufferHthRef=P_CANFD_Tx_Std_MailBox_10
      VCU_0x13B_P_CANFD (CanIfTxPduCfg):
        CanIfTxPduReadNotifyStatus = false
        CanIfTxPduType = STATIC
        CanIfTxPduTruncation = false
        CanIfTxPduCanIdType = STANDARD_FD_CAN
        CanIfTxPduCanId = 315
        CanIfTxPduUserTxConfirmationUL = PDUR
        CanIfTxPduBufferRef = Buffer_P_CANFD_Tx_Std_MailBox_10
        CanIfTxPduRef = PduCollection/VCU_0x13B_P_CANFD_PduR2CanIf
      Buffer_P_CANFD_Tx_Std_MailBox_11 (CanIfBufferCfg): CanIfBufferSize=0, CanIfBufferHthRef=P_CANFD_Tx_Std_MailBox_11
      UDS_Phy_Tx_7E8_ECM_P_CANFD (CanIfTxPduCfg):
        CanIfTxPduReadNotifyStatus = false
        CanIfTxPduType = STATIC
        CanIfTxPduTruncation = false
        CanIfTxPduCanIdType = STANDARD_FD_CAN
        CanIfTxPduCanId = 2024
        CanIfTxPduUserTxConfirmationUL = PDUR
        CanIfTxPduBufferRef = Buffer_P_CANFD_Tx_Std_MailBox_11
        CanIfTxPduRef = PduCollection/UDS_Phy_Tx_7E8_ECM_P_CANFD_PduR2CanIf
      Buffer_P_CANFD_Tx_Std_MailBox_12 (CanIfBufferCfg): CanIfBufferSize=0, CanIfBufferHthRef=P_CANFD_Tx_Std_MailBox_12
      VCU_0x358_P_CANFD (CanIfTxPduCfg):
        CanIfTxPduReadNotifyStatus = false
        CanIfTxPduType = STATIC
        CanIfTxPduTruncation = false
        CanIfTxPduCanIdType = STANDARD_FD_CAN
        CanIfTxPduCanId = 856
        CanIfTxPduUserTxConfirmationUL = PDUR
        CanIfTxPduBufferRef = Buffer_P_CANFD_Tx_Std_MailBox_12
        CanIfTxPduRef = PduCollection/VCU_0x358_P_CANFD_PduR2CanIf
      Buffer_P_CANFD_Tx_Std_MailBox_13 (CanIfBufferCfg): CanIfBufferSize=0, CanIfBufferHthRef=P_CANFD_Tx_Std_MailBox_13
      VCU_0x359_P_CANFD (CanIfTxPduCfg):
        CanIfTxPduReadNotifyStatus = false
        CanIfTxPduType = STATIC
        CanIfTxPduTruncation = false
        CanIfTxPduCanIdType = STANDARD_FD_CAN
        CanIfTxPduCanId = 857
        CanIfTxPduUserTxConfirmationUL = PDUR
        CanIfTxPduBufferRef = Buffer_P_CANFD_Tx_Std_MailBox_13
        CanIfTxPduRef = PduCollection/VCU_0x359_P_CANFD_PduR2CanIf
      Buffer_P_CANFD_Tx_Std_MailBox_14 (CanIfBufferCfg): CanIfBufferSize=0, CanIfBufferHthRef=P_CANFD_Tx_Std_MailBox_14
      XCP_Tx_602_VCU_P_CANFD (CanIfTxPduCfg):
        CanIfTxPduReadNotifyStatus = false
        CanIfTxPduType = STATIC
        CanIfTxPduTruncation = false
        CanIfTxPduCanIdType = STANDARD_FD_CAN
        CanIfTxPduCanId = 1538
        CanIfTxPduUserTxConfirmationUL = XCP
        CanIfTxPduBufferRef = Buffer_P_CANFD_Tx_Std_MailBox_14
        CanIfTxPduRef = XCP_Tx_602_VCU_P_CANFD_Xcp2CanIf
      Buffer_P_CANFD_Tx_Std_MailBox_15 (CanIfBufferCfg): CanIfBufferSize=0, CanIfBufferHthRef=P_CANFD_Tx_Std_MailBox_15
      MCUM_0x5D3_P_CANFD (CanIfTxPduCfg):
        CanIfTxPduReadNotifyStatus = false
        CanIfTxPduType = STATIC
        CanIfTxPduTruncation = false
        CanIfTxPduCanIdType = STANDARD_FD_CAN
        CanIfTxPduCanId = 1491
        CanIfTxPduUserTxConfirmationUL = PDUR
        CanIfTxPduBufferRef = Buffer_P_CANFD_Tx_Std_MailBox_15
        CanIfTxPduRef = PduCollection/MCUM_0x5D3_P_CANFD_PduR2CanIf
      Buffer_P_CANFD_Tx_Std_MailBox_16 (CanIfBufferCfg): CanIfBufferSize=0, CanIfBufferHthRef=P_CANFD_Tx_Std_MailBox_16
      VCU_0xBB_P_CANFD (CanIfTxPduCfg):
        CanIfTxPduReadNotifyStatus = false
        CanIfTxPduType = STATIC
        CanIfTxPduTruncation = false
        CanIfTxPduCanIdType = STANDARD_FD_CAN
        CanIfTxPduCanId = 187
        CanIfTxPduUserTxConfirmationUL = PDUR
        CanIfTxPduBufferRef = Buffer_P_CANFD_Tx_Std_MailBox_16
        CanIfTxPduRef = PduCollection/VCU_0xBB_P_CANFD_PduR2CanIf
      Buffer_P_CANFD_Tx_Std_MailBox_17 (CanIfBufferCfg): CanIfBufferSize=0, CanIfBufferHthRef=P_CANFD_Tx_Std_MailBox_17
      VCU_0xBC_P_CANFD (CanIfTxPduCfg):
        CanIfTxPduReadNotifyStatus = false
        CanIfTxPduType = STATIC
        CanIfTxPduTruncation = false
        CanIfTxPduCanIdType = STANDARD_FD_CAN
        CanIfTxPduCanId = 188
        CanIfTxPduUserTxConfirmationUL = PDUR
        CanIfTxPduBufferRef = Buffer_P_CANFD_Tx_Std_MailBox_17
        CanIfTxPduRef = PduCollection/VCU_0xBC_P_CANFD_PduR2CanIf
      Buffer_P_CANFD_Tx_Std_MailBox_18 (CanIfBufferCfg): CanIfBufferSize=0, CanIfBufferHthRef=P_CANFD_Tx_Std_MailBox_18
      VCU_0x1E5_P_CANFD (CanIfTxPduCfg):
        CanIfTxPduReadNotifyStatus = false
        CanIfTxPduType = STATIC
        CanIfTxPduTruncation = false
        CanIfTxPduCanIdType = STANDARD_FD_CAN
        CanIfTxPduCanId = 485
        CanIfTxPduUserTxConfirmationUL = PDUR
        CanIfTxPduBufferRef = Buffer_P_CANFD_Tx_Std_MailBox_18
        CanIfTxPduRef = PduCollection/VCU_0x1E5_P_CANFD_PduR2CanIf
      Buffer_P_CANFD_Tx_Std_MailBox_19 (CanIfBufferCfg): CanIfBufferSize=0, CanIfBufferHthRef=P_CANFD_Tx_Std_MailBox_19
      VCU_0xDE_P_CANFD (CanIfTxPduCfg):
        CanIfTxPduReadNotifyStatus = false
        CanIfTxPduType = STATIC
        CanIfTxPduTruncation = false
        CanIfTxPduCanIdType = STANDARD_FD_CAN
        CanIfTxPduCanId = 222
        CanIfTxPduUserTxConfirmationUL = PDUR
        CanIfTxPduBufferRef = Buffer_P_CANFD_Tx_Std_MailBox_19
        CanIfTxPduRef = PduCollection/VCU_0xDE_P_CANFD_PduR2CanIf
      Buffer_P_CANFD_Tx_Std_MailBox_20 (CanIfBufferCfg): CanIfBufferSize=0, CanIfBufferHthRef=P_CANFD_Tx_Std_MailBox_20
      MCUM_0x5D0_P_CANFD (CanIfTxPduCfg):
        CanIfTxPduReadNotifyStatus = false
        CanIfTxPduType = STATIC
        CanIfTxPduTruncation = false
        CanIfTxPduCanIdType = STANDARD_FD_CAN
        CanIfTxPduCanId = 1488
        CanIfTxPduUserTxConfirmationUL = PDUR
        CanIfTxPduBufferRef = Buffer_P_CANFD_Tx_Std_MailBox_20
        CanIfTxPduRef = PduCollection/MCUM_0x5D0_P_CANFD_PduR2CanIf
      Buffer_P_CANFD_Tx_Std_MailBox_21 (CanIfBufferCfg): CanIfBufferSize=0, CanIfBufferHthRef=P_CANFD_Tx_Std_MailBox_21
      VCU_0x515_P_CANFD (CanIfTxPduCfg):
        CanIfTxPduReadNotifyStatus = false
        CanIfTxPduType = STATIC
        CanIfTxPduTruncation = false
        CanIfTxPduCanIdType = STANDARD_FD_CAN
        CanIfTxPduCanId = 1301
        CanIfTxPduUserTxConfirmationUL = PDUR
        CanIfTxPduBufferRef = Buffer_P_CANFD_Tx_Std_MailBox_21
        CanIfTxPduRef = PduCollection/VCU_0x515_P_CANFD_PduR2CanIf
      Buffer_P_CANFD_Tx_Std_MailBox_22 (CanIfBufferCfg): CanIfBufferSize=0, CanIfBufferHthRef=P_CANFD_Tx_Std_MailBox_22
      MCUM_0xCA_P_CANFD (CanIfTxPduCfg):
        CanIfTxPduReadNotifyStatus = false
        CanIfTxPduType = STATIC
        CanIfTxPduTruncation = false
        CanIfTxPduCanIdType = STANDARD_FD_CAN
        CanIfTxPduCanId = 202
        CanIfTxPduUserTxConfirmationUL = PDUR
        CanIfTxPduBufferRef = Buffer_P_CANFD_Tx_Std_MailBox_22
        CanIfTxPduRef = PduCollection/MCUM_0xCA_P_CANFD_PduR2CanIf
      Buffer_P_CANFD_Tx_Std_MailBox_23 (CanIfBufferCfg): CanIfBufferSize=0, CanIfBufferHthRef=P_CANFD_Tx_Std_MailBox_23
      MCUM_0x6F8_P_CANFD (CanIfTxPduCfg):
        CanIfTxPduReadNotifyStatus = false
        CanIfTxPduType = STATIC
        CanIfTxPduTruncation = false
        CanIfTxPduCanIdType = STANDARD_FD_CAN
        CanIfTxPduCanId = 1784
        CanIfTxPduUserTxConfirmationUL = PDUR
        CanIfTxPduBufferRef = Buffer_P_CANFD_Tx_Std_MailBox_23
        CanIfTxPduRef = PduCollection/MCUM_0x6F8_P_CANFD_PduR2CanIf
      Buffer_P_CANFD_Tx_Std_MailBox_24 (CanIfBufferCfg): CanIfBufferSize=0, CanIfBufferHthRef=P_CANFD_Tx_Std_MailBox_24
      VCU_0x514_P_CANFD (CanIfTxPduCfg):
        CanIfTxPduReadNotifyStatus = false
        CanIfTxPduType = STATIC
        CanIfTxPduTruncation = false
        CanIfTxPduCanIdType = STANDARD_FD_CAN
        CanIfTxPduCanId = 1300
        CanIfTxPduUserTxConfirmationUL = PDUR
        CanIfTxPduBufferRef = Buffer_P_CANFD_Tx_Std_MailBox_24
        CanIfTxPduRef = PduCollection/VCU_0x514_P_CANFD_PduR2CanIf
      Buffer_P_CANFD_Tx_Std_MailBox_25 (CanIfBufferCfg): CanIfBufferSize=0, CanIfBufferHthRef=P_CANFD_Tx_Std_MailBox_25
      MCUM_0x605_P_CANFD (CanIfTxPduCfg):
        CanIfTxPduReadNotifyStatus = false
        CanIfTxPduType = STATIC
        CanIfTxPduTruncation = false
        CanIfTxPduCanIdType = STANDARD_FD_CAN
        CanIfTxPduCanId = 1541
        CanIfTxPduUserTxConfirmationUL = PDUR
        CanIfTxPduBufferRef = Buffer_P_CANFD_Tx_Std_MailBox_25
        CanIfTxPduRef = PduCollection/MCUM_0x605_P_CANFD_PduR2CanIf
      Buffer_P_CANFD_Tx_Std_MailBox_26 (CanIfBufferCfg): CanIfBufferSize=0, CanIfBufferHthRef=P_CANFD_Tx_Std_MailBox_26
      19 x CanIfRxPduCfg, all with CanIfRxPduReadData=false, CanIfRxPduReadNotifyStatus=true, CanIfRxPduCanIdType=STANDARD_FD_CAN, CanIfRxPduUserRxIndicationName=PduR_CanIfRxIndication, CanIfRxPduUserRxIndicationUL=PDUR:
        IBC_0x186_C_CANFD: CanIfRxPduCanId=390, CanIfRxPduDlc=32, CanIfRxPduHrhIdRef=C_CANFD_Rx_Std_MailBox_1, CanIfRxPduRef=PduCollection/IBC_0x186_C_CANFD_CanIf2PduR
        LMC_0xFA_C_CANFD: CanIfRxPduCanId=250, CanIfRxPduDlc=32, CanIfRxPduHrhIdRef=C_CANFD_Rx_Std_MailBox_2, CanIfRxPduRef=PduCollection/LMC_0xFA_C_CANFD_CanIf2PduR
        ADDC_0x83_C_CANFD: CanIfRxPduCanId=131, CanIfRxPduDlc=32, CanIfRxPduHrhIdRef=C_CANFD_Rx_Std_MailBox_3, CanIfRxPduRef=PduCollection/ADDC_0x83_C_CANFD_CanIf2PduR
        IBC_0x136_C_CANFD: CanIfRxPduCanId=310, CanIfRxPduDlc=32, CanIfRxPduHrhIdRef=C_CANFD_Rx_Std_MailBox_4, CanIfRxPduRef=PduCollection/IBC_0x136_C_CANFD_CanIf2PduR
        ADDC_0x84_C_CANFD: CanIfRxPduCanId=132, CanIfRxPduDlc=16, CanIfRxPduHrhIdRef=C_CANFD_Rx_Std_MailBox_5, CanIfRxPduRef=PduCollection/ADDC_0x84_C_CANFD_CanIf2PduR
        IBC_0xB1_C_CANFD: CanIfRxPduCanId=177, CanIfRxPduDlc=16, CanIfRxPduHrhIdRef=C_CANFD_Rx_Std_MailBox_6, CanIfRxPduRef=PduCollection/IBC_0xB1_C_CANFD_CanIf2PduR
        IBC_0x227_C_CANFD: CanIfRxPduCanId=551, CanIfRxPduDlc=8, CanIfRxPduHrhIdRef=C_CANFD_Rx_Std_MailBox_7, CanIfRxPduRef=PduCollection/IBC_0x227_C_CANFD_CanIf2PduR
        EPS_0x18D_C_CANFD: CanIfRxPduCanId=397, CanIfRxPduDlc=32, CanIfRxPduHrhIdRef=C_CANFD_Rx_Std_MailBox_8, CanIfRxPduRef=PduCollection/EPS_0x18D_C_CANFD_CanIf2PduR
        IBC_0x182_C_CANFD: CanIfRxPduCanId=386, CanIfRxPduDlc=8, CanIfRxPduHrhIdRef=C_CANFD_Rx_Std_MailBox_9, CanIfRxPduRef=PduCollection/IBC_0x182_C_CANFD_CanIf2PduR
        IBC_0x183_C_CANFD: CanIfRxPduCanId=387, CanIfRxPduDlc=16, CanIfRxPduHrhIdRef=C_CANFD_Rx_Std_MailBox_10, CanIfRxPduRef=PduCollection/IBC_0x183_C_CANFD_CanIf2PduR
        ACU_0x233_C_CANFD: CanIfRxPduCanId=563, CanIfRxPduDlc=8, CanIfRxPduHrhIdRef=C_CANFD_Rx_Std_MailBox_11, CanIfRxPduRef=PduCollection/ACU_0x233_C_CANFD_CanIf2PduR
        IBC_0x184_C_CANFD: CanIfRxPduCanId=388, CanIfRxPduDlc=32, CanIfRxPduHrhIdRef=C_CANFD_Rx_Std_MailBox_12, CanIfRxPduRef=PduCollection/IBC_0x184_C_CANFD_CanIf2PduR
        FSC_0x142_C_CANFD: CanIfRxPduCanId=322, CanIfRxPduDlc=16, CanIfRxPduHrhIdRef=C_CANFD_Rx_Std_MailBox_13, CanIfRxPduRef=PduCollection/FSC_0x142_C_CANFD_CanIf2PduR
        IBC_0x185_C_CANFD: CanIfRxPduCanId=389, CanIfRxPduDlc=16, CanIfRxPduHrhIdRef=C_CANFD_Rx_Std_MailBox_14, CanIfRxPduRef=PduCollection/IBC_0x185_C_CANFD_CanIf2PduR
        ACU_0x2A3_C_CANFD: CanIfRxPduCanId=675, CanIfRxPduDlc=16, CanIfRxPduHrhIdRef=C_CANFD_Rx_Std_MailBox_15, CanIfRxPduRef=PduCollection/ACU_0x2A3_C_CANFD_CanIf2PduR
        ICU_0x24D_C_CANFD: CanIfRxPduCanId=589, CanIfRxPduDlc=32, CanIfRxPduHrhIdRef=C_CANFD_Rx_Std_MailBox_16, CanIfRxPduRef=PduCollection/ICU_0x24D_C_CANFD_CanIf2PduR
        HPCBCM_0x290_C_CANFD: CanIfRxPduCanId=656, CanIfRxPduDlc=8, CanIfRxPduHrhIdRef=C_CANFD_Rx_Std_MailBox_17, CanIfRxPduRef=PduCollection/HPCBCM_0x290_C_CANFD_CanIf2PduR
        IVI_0x331_C_CANFD: CanIfRxPduCanId=817, CanIfRxPduDlc=16, CanIfRxPduHrhIdRef=C_CANFD_Rx_Std_MailBox_19, CanIfRxPduRef=PduCollection/IVI_0x331_C_CANFD_CanIf2PduR
        ICU_0x332_C_CANFD: CanIfRxPduCanId=818, CanIfRxPduDlc=8, CanIfRxPduHrhIdRef=C_CANFD_Rx_Std_MailBox_20, CanIfRxPduRef=PduCollection/ICU_0x332_C_CANFD_CanIf2PduR
      Buffer_C_CANFD_Tx_Std_MailBox_1 (CanIfBufferCfg): CanIfBufferSize=0, CanIfBufferHthRef=C_CANFD_Tx_Std_MailBox_1
      VCU_0xB6_C_CANFD (CanIfTxPduCfg):
        CanIfTxPduReadNotifyStatus = false
        CanIfTxPduType = STATIC
        CanIfTxPduTruncation = false
        CanIfTxPduCanIdType = STANDARD_FD_CAN
        CanIfTxPduCanId = 182
        CanIfTxPduUserTxConfirmationUL = PDUR
        CanIfTxPduBufferRef = Buffer_C_CANFD_Tx_Std_MailBox_1
        CanIfTxPduRef = PduCollection/VCU_0xB6_C_CANFD_PduR2CanIf
      Buffer_C_CANFD_Tx_Std_MailBox_2 (CanIfBufferCfg): CanIfBufferSize=0, CanIfBufferHthRef=C_CANFD_Tx_Std_MailBox_2
      VCU_0xB7_C_CANFD (CanIfTxPduCfg):
        CanIfTxPduReadNotifyStatus = false
        CanIfTxPduType = STATIC
        CanIfTxPduTruncation = false
        CanIfTxPduCanIdType = STANDARD_FD_CAN
        CanIfTxPduCanId = 183
        CanIfTxPduUserTxConfirmationUL = PDUR
        CanIfTxPduBufferRef = Buffer_C_CANFD_Tx_Std_MailBox_2
        CanIfTxPduRef = PduCollection/VCU_0xB7_C_CANFD_PduR2CanIf
      Buffer_C_CANFD_Tx_Std_MailBox_3 (CanIfBufferCfg): CanIfBufferSize=0, CanIfBufferHthRef=C_CANFD_Tx_Std_MailBox_3
      MCUM_0x135_C_CANFD (CanIfTxPduCfg):
        CanIfTxPduReadNotifyStatus = false
        CanIfTxPduType = STATIC
        CanIfTxPduTruncation = false
        CanIfTxPduCanIdType = STANDARD_FD_CAN
        CanIfTxPduCanId = 309
        CanIfTxPduUserTxConfirmationUL = PDUR
        CanIfTxPduBufferRef = Buffer_C_CANFD_Tx_Std_MailBox_3
        CanIfTxPduRef = PduCollection/MCUM_0x135_C_CANFD_PduR2CanIf
      Buffer_C_CANFD_Tx_Std_MailBox_5 (CanIfBufferCfg): CanIfBufferSize=0, CanIfBufferHthRef=C_CANFD_Tx_Std_MailBox_5
      VCU_0xE6_C_CANFD (CanIfTxPduCfg):
        CanIfTxPduReadNotifyStatus = false
        CanIfTxPduType = STATIC
        CanIfTxPduTruncation = false
        CanIfTxPduCanIdType = STANDARD_FD_CAN
        CanIfTxPduCanId = 230
        CanIfTxPduUserTxConfirmationUL = PDUR
        CanIfTxPduBufferRef = Buffer_C_CANFD_Tx_Std_MailBox_5
        CanIfTxPduRef = PduCollection/VCU_0xE6_C_CANFD_PduR2CanIf
      MCUS_0x14_VCU_CAN (CanIfRxPduCfg):
        CanIfRxPduReadData = false
        CanIfRxPduReadNotifyStatus = true
        CanIfRxPduCanId = 20
        CanIfRxPduCanIdType = STANDARD_FD_CAN
        CanIfRxPduDlc = 8
        CanIfRxPduUserRxIndicationName = PduR_CanIfRxIndication
        CanIfRxPduUserRxIndicationUL = PDUR
        CanIfRxPduHrhIdRef = VCU_CAN_Rx_Std_MailBox_1
        CanIfRxPduRef = PduCollection/MCUS_0x14_VCU_CAN_CanIf2PduR
      HPCBCM_0x401_P_CANFD (CanIfRxPduCfg):
        CanIfRxPduReadData = false
        CanIfRxPduReadNotifyStatus = true
        CanIfRxPduCanId = 1025
        CanIfRxPduCanIdType = STANDARD_NO_FD_CAN
        CanIfRxPduDlc = 8
        CanIfRxPduUserRxIndicationUL = CAN_NM
        CanIfRxPduHrhIdRef = P_CANFD_Rx_Std_MailBox_32
        CanIfRxPduRef = HPCBCM_0x401_P_CANFD_CanIf2CanNm
      Buffer_VCU_CAN_Tx_Std_MailBox_1 (CanIfBufferCfg): CanIfBufferSize=0, CanIfBufferHthRef=VCU_CAN_Tx_Std_MailBox_1
      3 x CanIfTxPduCfg, all with CanIfTxPduReadNotifyStatus=false, CanIfTxPduType=STATIC, CanIfTxPduTruncation=false:
        VCU_0x13_VCU_CAN: CanIfTxPduCanIdType=STANDARD_FD_CAN, CanIfTxPduCanId=19, CanIfTxPduUserTxConfirmationUL=PDUR, CanIfTxPduBufferRef=Buffer_VCU_CAN_Tx_Std_MailBox_1, CanIfTxPduRef=PduCollection/VCU_0x13_VCU_CAN_PduR2CanIf
        MCUM_0x42C_C_CANFD: CanIfTxPduCanIdType=STANDARD_CAN, CanIfTxPduCanId=1068, CanIfTxPduUserTxConfirmationUL=CAN_NM, CanIfTxPduRef=MCUM_0x42C_C_CANFD_CanNm2CanIf, CanIfTxPduBufferRef=Buffer_C_CANFD_Tx_Std_MailBox_4
        MCUM_0x42C_P_CANFD: CanIfTxPduCanIdType=STANDARD_CAN, CanIfTxPduCanId=1068, CanIfTxPduUserTxConfirmationUL=CAN_NM, CanIfTxPduRef=MCUM_0x42C_P_CANFD_CanNm2CanIf, CanIfTxPduBufferRef=Buffer_P_CANFD_Tx_Std_MailBox_26
      Buffer_C_CANFD_Tx_Std_MailBox_4 (CanIfBufferCfg): CanIfBufferSize=0, CanIfBufferHthRef=C_CANFD_Tx_Std_MailBox_4
      HPCBCM_0x402_C_CANFD (CanIfRxPduCfg):
        CanIfRxPduReadData = false
        CanIfRxPduReadNotifyStatus = true
        CanIfRxPduCanId = 1026
        CanIfRxPduCanIdType = STANDARD_NO_FD_CAN
        CanIfRxPduDlc = 8
        CanIfRxPduUserRxIndicationUL = CAN_NM
        CanIfRxPduHrhIdRef = C_CANFD_Rx_Std_MailBox_21
        CanIfRxPduRef = HPCBCM_0x402_C_CANFD_CanIf2CanNm
      ICU_0xDF_P_CANFD (CanIfRxPduCfg):
        CanIfRxPduReadData = false
        CanIfRxPduReadNotifyStatus = true
        CanIfRxPduCanId = 223
        CanIfRxPduCanIdType = STANDARD_FD_CAN
        CanIfRxPduDlc = 16
        CanIfRxPduUserRxIndicationName = PduR_CanIfRxIndication
        CanIfRxPduUserRxIndicationUL = PDUR
        CanIfRxPduHrhIdRef = P_CANFD_Rx_Std_MailBox_45
        CanIfRxPduRef = ICU_0xDF_P_CANFD_CanIf2PduR
      3 x CanIfBufferCfg, all with CanIfBufferSize=0:
        Buffer_P_CANFD_Tx_Std_MailBox_{27..29}: CanIfBufferHthRef=P_CANFD_Tx_Std_MailBox_{27..29}
      7 x CanIfTxPduCfg, all with CanIfTxPduReadNotifyStatus=false, CanIfTxPduType=STATIC, CanIfTxPduTruncation=false:
        MCUM_0x607_P_CANFD: CanIfTxPduCanIdType=STANDARD_FD_CAN, CanIfTxPduCanId=1543, CanIfTxPduUserTxConfirmationUL=PDUR, CanIfTxPduBufferRef=Buffer_P_CANFD_Tx_Std_MailBox_27, CanIfTxPduRef=PduCollection/MCUM_0x607_P_CANFD_PduR2CanIf
        MCUM_0x5D1_P_CANFD: CanIfTxPduCanIdType=STANDARD_FD_CAN, CanIfTxPduCanId=1489, CanIfTxPduUserTxConfirmationUL=PDUR, CanIfTxPduBufferRef=Buffer_P_CANFD_Tx_Std_MailBox_28, CanIfTxPduRef=PduCollection/MCUM_0x5D1_P_CANFD_PduR2CanIf
        MCUM_0x5D2_P_CANFD: CanIfTxPduCanIdType=STANDARD_FD_CAN, CanIfTxPduCanId=1490, CanIfTxPduUserTxConfirmationUL=PDUR, CanIfTxPduBufferRef=Buffer_P_CANFD_Tx_Std_MailBox_29, CanIfTxPduRef=PduCollection/MCUM_0x5D2_P_CANFD_PduR2CanIf
        UDS_Phy_Tx_729_MCUM_P_CANFD: CanIfTxPduCanIdType=STANDARD_FD_CAN, CanIfTxPduCanId=1833, CanIfTxPduUserTxConfirmationUL=CAN_TP, CanIfTxPduBufferRef=Buffer_P_CANFD_Tx_Std_MailBox_5, CanIfTxPduRef=UDS_Phy_Tx_729_MCUM_P_CANFD_Phys_CanTp2CanIf
        OBD_Phy_Tx_7EB_MCUM_P_CANFD: CanIfTxPduCanIdType=STANDARD_FD_CAN, CanIfTxPduCanId=2027, CanIfTxPduUserTxConfirmationUL=CAN_TP, CanIfTxPduBufferRef=Buffer_P_CANFD_Tx_Std_MailBox_8, CanIfTxPduRef=OBD_Phy_Tx_7EB_MCUM_P_CANFD_Phys_CanTp2CanIf
        UDS_Phy_Tx_729_MCUM_P_CAN: CanIfTxPduCanIdType=STANDARD_CAN, CanIfTxPduCanId=1833, CanIfTxPduUserTxConfirmationUL=CAN_TP, CanIfTxPduBufferRef=Buffer_P_CANFD_Tx_Std_MailBox_5, CanIfTxPduRef=UDS_Phy_Tx_729_MCUM_P_CAN_Phys_CanTp2CanIf
        OBD_Phy_Tx_7EB_MCUM_P_CAN: CanIfTxPduCanIdType=STANDARD_CAN, CanIfTxPduCanId=2027, CanIfTxPduUserTxConfirmationUL=CAN_TP, CanIfTxPduBufferRef=Buffer_P_CANFD_Tx_Std_MailBox_8, CanIfTxPduRef=OBD_Phy_Tx_7EB_MCUM_P_CAN_Phys_CanTp2CanIf
      18 x CanIfRxPduCfg, all with CanIfRxPduReadData=false, CanIfRxPduReadNotifyStatus=true:
        VCU_0x3_P_CANFD: CanIfRxPduCanId=3, CanIfRxPduCanIdType=STANDARD_FD_CAN, CanIfRxPduDlc=32, CanIfRxPduUserRxIndicationName=PduR_CanIfRxIndication, CanIfRxPduUserRxIndicationUL=PDUR, CanIfRxPduHrhIdRef=P_CANFD_Rx_Std_MailBox_46, CanIfRxPduRef=PduCollection/VCU_0x3_P_CANFD_CanIf2PduR
        LMC_0x18C_C_CANFD: CanIfRxPduCanId=396, CanIfRxPduCanIdType=STANDARD_FD_CAN, CanIfRxPduDlc=32, CanIfRxPduUserRxIndicationUL=PDUR, CanIfRxPduUserRxIndicationName=PduR_CanIfRxIndication, CanIfRxPduHrhIdRef=C_CANFD_Rx_Std_MailBox_22, CanIfRxPduRef=PduCollection/LMC_0x18C_C_CANFD_CanIf2PduR
        TMS_0x362_P_CANFD: CanIfRxPduCanId=866, CanIfRxPduCanIdType=STANDARD_FD_CAN, CanIfRxPduDlc=32, CanIfRxPduUserRxIndicationName=PduR_CanIfRxIndication, CanIfRxPduUserRxIndicationUL=PDUR, CanIfRxPduHrhIdRef=P_CANFD_Rx_Std_MailBox_47, CanIfRxPduRef=PduCollection/TMS_0x362_P_CANFD_CanIf2PduR
        HPCBCM_0xDA_VCU_CAN: CanIfRxPduCanId=218, CanIfRxPduCanIdType=STANDARD_FD_CAN, CanIfRxPduDlc=1, CanIfRxPduUserRxIndicationName=PduR_CanIfRxIndication, CanIfRxPduUserRxIndicationUL=PDUR, CanIfRxPduHrhIdRef=VCU_CAN_Rx_Std_MailBox_3, CanIfRxPduRef=PduCollection/HPCBCM_0xDA_VCU_CAN_CanIf2PduR
        ACU_0x15_VCU_CAN: CanIfRxPduCanId=21, CanIfRxPduCanIdType=STANDARD_FD_CAN, CanIfRxPduDlc=1, CanIfRxPduUserRxIndicationName=PduR_CanIfRxIndication, CanIfRxPduUserRxIndicationUL=PDUR, CanIfRxPduHrhIdRef=VCU_CAN_Rx_Std_MailBox_2, CanIfRxPduRef=PduCollection/ACU_0x15_VCU_CAN_CanIf2PduR
        LMC_0x133_C_CANFD: CanIfRxPduCanId=307, CanIfRxPduCanIdType=STANDARD_FD_CAN, CanIfRxPduDlc=1, CanIfRxPduUserRxIndicationName=PduR_CanIfRxIndication, CanIfRxPduUserRxIndicationUL=PDUR, CanIfRxPduRef=PduCollection/LMC_0x133_C_CANFD_CanIf2PduR, CanIfRxPduHrhIdRef=C_CANFD_Rx_Std_MailBox_18
        LMCSSU_0x25A_C_CANFD: CanIfRxPduCanId=602, CanIfRxPduCanIdType=STANDARD_FD_CAN, CanIfRxPduDlc=32, CanIfRxPduUserRxIndicationName=PduR_CanIfRxIndication, CanIfRxPduUserRxIndicationUL=PDUR, CanIfRxPduRef=PduCollection/LMCSSU_0x25A_C_CANFD_CanIf2PduR, CanIfRxPduHrhIdRef=C_CANFD_Rx_Std_MailBox_23
        HPCBCM_0x4A_C_CANFD: CanIfRxPduCanId=74, CanIfRxPduCanIdType=STANDARD_FD_CAN, CanIfRxPduDlc=1, CanIfRxPduUserRxIndicationName=PduR_CanIfRxIndication, CanIfRxPduUserRxIndicationUL=PDUR, CanIfRxPduRef=PduCollection/HPCBCM_0x4A_C_CANFD_CanIf2PduR, CanIfRxPduHrhIdRef=C_CANFD_Rx_Std_MailBox_24
        ICU_0x5BE_VCU_CAN: CanIfRxPduCanId=1470, CanIfRxPduCanIdType=STANDARD_FD_CAN, CanIfRxPduDlc=2, CanIfRxPduUserRxIndicationName=PduR_CanIfRxIndication, CanIfRxPduUserRxIndicationUL=PDUR, CanIfRxPduHrhIdRef=VCU_CAN_Rx_Std_MailBox_4, CanIfRxPduRef=PduCollection/ICU_0x5BE_VCU_CAN_CanIf2PduR
        UDS_Phy_Rx_7E0_ECM_P_CANFD: CanIfRxPduCanId=2016, CanIfRxPduCanIdType=STANDARD_FD_CAN, CanIfRxPduDlc=8, CanIfRxPduUserRxIndicationName=PduR_CanIfRxIndication, CanIfRxPduUserRxIndicationUL=PDUR, CanIfRxPduHrhIdRef=P_CANFD_Rx_Std_MailBox_28, CanIfRxPduRef=PduCollection/UDS_Phy_Rx_7E0_ECM_P_CANFD_CanIf2PduR
        UDS_Phy_Rx_721_MCUM_P_CANFD: CanIfRxPduCanId=1825, CanIfRxPduCanIdType=STANDARD_FD_CAN, CanIfRxPduDlc=1, CanIfRxPduUserRxIndicationUL=CAN_TP, CanIfRxPduHrhIdRef=P_CANFD_Rx_Std_MailBox_41, CanIfRxPduRef=UDS_Phy_Rx_721_MCUM_P_CANFD_CanIf2CanTp
        UDS_Fun_Rx_7DF_MCUM_P_CANFD: CanIfRxPduCanId=2015, CanIfRxPduCanIdType=STANDARD_FD_CAN, CanIfRxPduDlc=1, CanIfRxPduUserRxIndicationUL=CAN_TP, CanIfRxPduHrhIdRef=P_CANFD_Rx_Std_MailBox_30, CanIfRxPduRef=UDS_Fun_Rx_7DF_MCUM_P_CANFD_CanIf2CanTp
        OBD_Phy_Rx_7E3_MCUM_P_CANFD: CanIfRxPduCanId=2019, CanIfRxPduCanIdType=STANDARD_FD_CAN, CanIfRxPduDlc=1, CanIfRxPduUserRxIndicationUL=CAN_TP, CanIfRxPduHrhIdRef=P_CANFD_Rx_Std_MailBox_22, CanIfRxPduRef=OBD_Phy_Rx_7E3_MCUM_P_CANFD_CanIf2CanTp
        OBD_Fun_Rx_7DE_MCUM_P_CANFD: CanIfRxPduCanId=2014, CanIfRxPduCanIdType=STANDARD_FD_CAN, CanIfRxPduDlc=1, CanIfRxPduUserRxIndicationUL=CAN_TP, CanIfRxPduHrhIdRef=P_CANFD_Rx_Std_MailBox_30, CanIfRxPduRef=OBD_Fun_Rx_7DE_MCUM_P_CANFD_CanIf2CanTp
        UDS_Phy_Rx_721_MCUM_P_CAN: CanIfRxPduCanId=1825, CanIfRxPduCanIdType=STANDARD_NO_FD_CAN, CanIfRxPduDlc=1, CanIfRxPduUserRxIndicationUL=CAN_TP, CanIfRxPduHrhIdRef=P_CANFD_Rx_Std_MailBox_41, CanIfRxPduRef=UDS_Phy_Rx_721_MCUM_P_CAN_CanIf2CanTp
        UDS_Fun_Rx_7DF_MCUM_P_CAN: CanIfRxPduCanId=2015, CanIfRxPduCanIdType=STANDARD_NO_FD_CAN, CanIfRxPduDlc=1, CanIfRxPduUserRxIndicationUL=CAN_TP, CanIfRxPduHrhIdRef=P_CANFD_Rx_Std_MailBox_30, CanIfRxPduRef=UDS_Fun_Rx_7DF_MCUM_P_CAN_CanIf2CanTp
        OBD_Phy_Rx_7E3_MCUM_P_CAN: CanIfRxPduCanId=2019, CanIfRxPduCanIdType=STANDARD_NO_FD_CAN, CanIfRxPduDlc=1, CanIfRxPduUserRxIndicationUL=CAN_TP, CanIfRxPduHrhIdRef=P_CANFD_Rx_Std_MailBox_22, CanIfRxPduRef=OBD_Phy_Rx_7E3_MCUM_P_CAN_CanIf2CanTp
        OBD_Fun_Rx_7DE_MCUM_P_CAN: CanIfRxPduCanId=2014, CanIfRxPduCanIdType=STANDARD_NO_FD_CAN, CanIfRxPduDlc=1, CanIfRxPduUserRxIndicationUL=CAN_TP, CanIfRxPduHrhIdRef=P_CANFD_Rx_Std_MailBox_30, CanIfRxPduRef=OBD_Fun_Rx_7DE_MCUM_P_CAN_CanIf2CanTp
    CanIfCtrlDrvCfg: CanIfRbCtrlDrvPrefix=CanConf_CanHardwareObject, CanIfCtrlDrvNameRef=CanGeneral, CanIfCtrlDrvInitHohConfigRef=CanIfInitHohCfg
      3 x CanIfCtrlCfg, all with CanIfCtrlWakeupSupport=false, CanIfCtrlTrcvRef=CanIfTrcvCfg:
        P_CANFD: CanIfCtrlCanCtrlRef=P_CANFD
        C_CANFD: CanIfCtrlCanCtrlRef=C_CANFD
        VCU_CAN: CanIfCtrlCanCtrlRef=VCU_CAN
    CanIfDispatchCfg:
      CanIfDispatchUserCtrlBusOffUL = CAN_SM
      CanIfDispatchUserCtrlModeIndicationUL = CAN_SM
      CanIfDispatchUserTrcvModeIndicationName = CAN_SM
      CanIfDispatchUserCtrlBusOffName = CanSM_ControllerBusOff
      CanIfDispatchUserCheckTrcvWakeFlagIndicationName = CanSM_CheckTransceiverWakeFlagIndication
      CanIfDispatchUserCheckTrcvWakeFlagIndicationUL = CAN_SM
      CanIfDispatchUserClearTrcvWufFlagIndicationName = CanSM_ClearTrcvWufFlagIndication
      CanIfDispatchUserClearTrcvWufFlagIndicationUL = CAN_SM
      CanIfDispatchUserTrcvModeIndicationUL = CAN_SM
      CanIfDispatchUserConfirmPnAvailabilityUL = CAN_SM
      CanIfDispatchUserConfirmPnAvailabilityName = CanSM_ConfirmPnAvailability
    CanIfPrivateCfg: CanIfPrivateDlcCheck=true
    CanIfPublicCfg:
      CanIfPublicReadRxPduDataApi = false
      CanIfPublicReadRxPduNotifyStatusApi = true
      CanIfPublicReadTxPduNotifyStatusApi = true
      CanIfPublicSetDynamicTxIdApi = false
      CanIfPublicTxBuffering = true
      CanIfPublicTxConfirmPollingSupport = true
      CanIfPublicVersionInfoApi = false
      CanIfPublicCancelTransmitSupport = false
      CanIfPublicErrorPassiveSupport = false
      CanIfPublicCanIfLiteConfiguration = false
      CanIfPublicUserTpTxInOfflineMode = false
      CanIfPublicWakeupCheckValidSupport = false
      CanIfPublicPnSupport = true
      CanIfPublicBusoffRecoveryfromRxIndication = false
      CanIfTriggerTransmitSupport = false
      CanIfTxOfflineActiveSupport = false
      CanIfWakeupSupport = true
      CanIfPublicDevErrorDetect = false
      CanIfReadMsgIdApi = true
    CanIfTrcvDrvCfg
      CanIfTrcvCfg: CanIfTrcvWakeupSupport=true, CanIfTrcvCanTrcvRef=CanTrcvChannel_0
  module config CanSM: implementation-config-variant=VARIANT-PRE-COMPILE
    CanSMConfiguration: CanSMModeRequestRepetitionMax=5, CanSMModeRequestRepetitionTime=0.07
      3 x CanSMManagerNetwork, all with CanSMBorCounterL1ToL2=5, CanSMBorTimeL1=0.05, CanSMBorTimeL2=0.2, CanSMBorTimeTxEnsured=0.02:
        CanSMManagerNetwork_P_CANFD: CanSMBorTxConfirmationPolling=false, CanSMComMNetworkHandleRef=ComMChannel_P_CANFD_Channel, CanSMTransceiverId=CanIfTrcvCfg
          CanSMDemEventParameterRefs: CanSMRbDynCreate_CANSM_E_BUS_OFF=Disabled, CANSM_E_BUS_OFF=DEP_DDMP_CAN1_BUS_OFF
          CanSMController_P_CANFD (CanSMController): CanSMControllerId=P_CANFD
        CanSMManagerNetwork_C_CANFD: CanSMBorTxConfirmationPolling=true, CanSMComMNetworkHandleRef=ComMChannel_C_CANFD_Channel
          CanSMDemEventParameterRefs: CanSMRbDynCreate_CANSM_E_BUS_OFF=Disabled, CANSM_E_BUS_OFF=DEP_DDMP_VCU_C_CAN_BUS_OFF
          CanSMController_C_CANFD (CanSMController): CanSMControllerId=C_CANFD
        CanSMManagerNetwork_VCU_CAN: CanSMBorTxConfirmationPolling=true, CanSMEnableBusOffDelay=false, CanSMComMNetworkHandleRef=ComMChannel_VCU_CAN_Channel
          CanSMDemEventParameterRefs: CanSMRbDynCreate_CANSM_E_BUS_OFF=Disabled, CANSM_E_BUS_OFF=DEP_DDMP_VCU_CAN_BUS_OFF
          CanSMController_VCU_CAN (CanSMController): CanSMControllerId=VCU_CAN
    CanSMGeneral: CanSMMainFunctionTimePeriod=0.01, CanSMVersionInfoApi=false, CanSMDevErrorDetect=false, CanSMPncSupport=true
  module config PduR: implementation-config-variant=VARIANT-PRE-COMPILE
    PduRGeneral:
      PduRVersionInfoApi = false
      PduRZeroCostOperation = false
      PduRFifoTxBufferSupport = false
      PduRIFGatewayOperation = false
      PduRTPGatewayOperation = false
      PduRMemorySize = 0
      PduRMinimumRoutingLoRxPduId = 0
      PduRMinimumRoutingLoTxPduId = 0
      PduRMinimumRoutingUpRxPduId = 0
      PduRMinimumRoutingUpTxPduId = 0
      PduRMulticastFromIfSupport = false
      PduRMulticastFromTpSupport = false
      PduRMulticastToIfSupport = false
      PduRMulticastToTpSupport = false
      PduRSbTxBufferSupport = false
      PduRQueueingSupport = false
      PduRCanTpChangeParameterRequestApi = false
      PduRFrTpChangeParameterRequestApi = false
      PduRGwTpWithLimitedBuffer = false
      PduRDevErrorDetect = false
    PduRRoutingTables: PduRConfigurationId=0
      PduRRoutingTable
        114 x PduRRoutingPath:
          EMS_0xBE_P_CANFD_CanIf2Com
            EMS_0xBE_P_CANFD_CanIf2PduR (PduRSrcPdu): PduRSrcPduRef=PduCollection/EMS_0xBE_P_CANFD_CanIf2PduR
            EMS_0xBE_P_CANFD_PduR2Com (PduRDestPdu): PduRTransmissionConfirmation=false, PduRDestPduRef=PduCollection/EMS_0xBE_P_CANFD_PduR2Com
          BMS_0x5B5_P_CANFD_CanIf2Com
            BMS_0x5B5_P_CANFD_CanIf2PduR (PduRSrcPdu): PduRSrcPduRef=PduCollection/BMS_0x5B5_P_CANFD_CanIf2PduR
            BMS_0x5B5_P_CANFD_PduR2Com (PduRDestPdu): PduRTransmissionConfirmation=false, PduRDestPduRef=PduCollection/BMS_0x5B5_P_CANFD_PduR2Com
          OBC_0x316_P_CANFD_CanIf2Com
            OBC_0x316_P_CANFD_CanIf2PduR (PduRSrcPdu): PduRSrcPduRef=PduCollection/OBC_0x316_P_CANFD_CanIf2PduR
            OBC_0x316_P_CANFD_PduR2Com (PduRDestPdu): PduRTransmissionConfirmation=false, PduRDestPduRef=PduCollection/OBC_0x316_P_CANFD_PduR2Com
          TMS_0x5FF_P_CANFD_CanIf2Com
            TMS_0x5FF_P_CANFD_CanIf2PduR (PduRSrcPdu): PduRSrcPduRef=PduCollection/TMS_0x5FF_P_CANFD_CanIf2PduR
            TMS_0x5FF_P_CANFD_PduR2Com (PduRDestPdu): PduRTransmissionConfirmation=false, PduRDestPduRef=PduCollection/TMS_0x5FF_P_CANFD_PduR2Com
          TMS_0x5FE_P_CANFD_CanIf2Com
            TMS_0x5FE_P_CANFD_CanIf2PduR (PduRSrcPdu): PduRSrcPduRef=PduCollection/TMS_0x5FE_P_CANFD_CanIf2PduR
            TMS_0x5FE_P_CANFD_PduR2Com (PduRDestPdu): PduRTransmissionConfirmation=false, PduRDestPduRef=PduCollection/TMS_0x5FE_P_CANFD_PduR2Com
          BMS_0x5B1_P_CANFD_CanIf2Com
            BMS_0x5B1_P_CANFD_CanIf2PduR (PduRSrcPdu): PduRSrcPduRef=PduCollection/BMS_0x5B1_P_CANFD_CanIf2PduR
            BMS_0x5B1_P_CANFD_PduR2Com (PduRDestPdu): PduRTransmissionConfirmation=false, PduRDestPduRef=PduCollection/BMS_0x5B1_P_CANFD_PduR2Com
          PTC_0x367_P_CANFD_CanIf2Com
            PTC_0x367_P_CANFD_CanIf2PduR (PduRSrcPdu): PduRSrcPduRef=PduCollection/PTC_0x367_P_CANFD_CanIf2PduR
            PTC_0x367_P_CANFD_PduR2Com (PduRDestPdu): PduRTransmissionConfirmation=false, PduRDestPduRef=PduCollection/PTC_0x367_P_CANFD_PduR2Com
          MCU_0x5C7_P_CANFD_CanIf2Com
            MCU_0x5C7_P_CANFD_CanIf2PduR (PduRSrcPdu): PduRSrcPduRef=PduCollection/MCU_0x5C7_P_CANFD_CanIf2PduR
            MCU_0x5C7_P_CANFD_PduR2Com (PduRDestPdu): PduRTransmissionConfirmation=false, PduRDestPduRef=PduCollection/MCU_0x5C7_P_CANFD_PduR2Com
          MCU_0x5C5_P_CANFD_CanIf2Com
            MCU_0x5C5_P_CANFD_CanIf2PduR (PduRSrcPdu): PduRSrcPduRef=PduCollection/MCU_0x5C5_P_CANFD_CanIf2PduR
            MCU_0x5C5_P_CANFD_PduR2Com (PduRDestPdu): PduRTransmissionConfirmation=false, PduRDestPduRef=PduCollection/MCU_0x5C5_P_CANFD_PduR2Com
          CCM_0x36A_P_CANFD_CanIf2Com
            CCM_0x36A_P_CANFD_CanIf2PduR (PduRSrcPdu): PduRSrcPduRef=PduCollection/CCM_0x36A_P_CANFD_CanIf2PduR
            CCM_0x36A_P_CANFD_PduR2Com (PduRDestPdu): PduRTransmissionConfirmation=false, PduRDestPduRef=PduCollection/CCM_0x36A_P_CANFD_PduR2Com
          TMS_0x561_P_CANFD_CanIf2Com
            TMS_0x561_P_CANFD_CanIf2PduR (PduRSrcPdu): PduRSrcPduRef=PduCollection/TMS_0x561_P_CANFD_CanIf2PduR
            TMS_0x561_P_CANFD_PduR2Com (PduRDestPdu): PduRTransmissionConfirmation=false, PduRDestPduRef=PduCollection/TMS_0x561_P_CANFD_PduR2Com
          HPCGW_0x13A_P_CANFD_CanIf2Com
            HPCGW_0x13A_P_CANFD_CanIf2PduR (PduRSrcPdu): PduRSrcPduRef=PduCollection/HPCGW_0x13A_P_CANFD_CanIf2PduR
            HPCGW_0x13A_P_CANFD_PduR2Com (PduRDestPdu): PduRTransmissionConfirmation=false, PduRDestPduRef=PduCollection/HPCGW_0x13A_P_CANFD_PduR2Com
          HPCBCM_0x291_P_CANFD_CanIf2Com
            HPCBCM_0x291_P_CANFD_CanIf2PduR (PduRSrcPdu): PduRSrcPduRef=PduCollection/HPCBCM_0x291_P_CANFD_CanIf2PduR
            HPCBCM_0x291_P_CANFD_PduR2Com (PduRDestPdu): PduRTransmissionConfirmation=false, PduRDestPduRef=PduCollection/HPCBCM_0x291_P_CANFD_PduR2Com
          HPCBCM_0x292_P_CANFD_CanIf2Com
            HPCBCM_0x292_P_CANFD_CanIf2PduR (PduRSrcPdu): PduRSrcPduRef=PduCollection/HPCBCM_0x292_P_CANFD_CanIf2PduR
            HPCBCM_0x292_P_CANFD_PduR2Com (PduRDestPdu): PduRTransmissionConfirmation=false, PduRDestPduRef=PduCollection/HPCBCM_0x292_P_CANFD_PduR2Com
          HPCGW_0x30B_P_CANFD_CanIf2Com
            HPCGW_0x30B_P_CANFD_CanIf2PduR (PduRSrcPdu): PduRSrcPduRef=PduCollection/HPCGW_0x30B_P_CANFD_CanIf2PduR
            HPCGW_0x30B_P_CANFD_PduR2Com (PduRDestPdu): PduRTransmissionConfirmation=false, PduRDestPduRef=PduCollection/HPCGW_0x30B_P_CANFD_PduR2Com
          BMS_0x1A1_P_CANFD_CanIf2Com
            BMS_0x1A1_P_CANFD_CanIf2PduR (PduRSrcPdu): PduRSrcPduRef=PduCollection/BMS_0x1A1_P_CANFD_CanIf2PduR
            BMS_0x1A1_P_CANFD_PduR2Com (PduRDestPdu): PduRTransmissionConfirmation=false, PduRDestPduRef=PduCollection/BMS_0x1A1_P_CANFD_PduR2Com
          MCUS_0xDB_P_CANFD_CanIf2Com
            MCUS_0xDB_P_CANFD_CanIf2PduR (PduRSrcPdu): PduRSrcPduRef=PduCollection/MCUS_0xDB_P_CANFD_CanIf2PduR
            MCUS_0xDB_P_CANFD_PduR2Com (PduRDestPdu): PduRTransmissionConfirmation=false, PduRDestPduRef=PduCollection/MCUS_0xDB_P_CANFD_PduR2Com
          ECM_0x5EC_P_CANFD_CanIf2Com
            ECM_0x5EC_P_CANFD_CanIf2PduR (PduRSrcPdu): PduRSrcPduRef=PduCollection/ECM_0x5EC_P_CANFD_CanIf2PduR
            ECM_0x5EC_P_CANFD_PduR2Com (PduRDestPdu): PduRTransmissionConfirmation=false, PduRDestPduRef=PduCollection/ECM_0x5EC_P_CANFD_PduR2Com
          ECM_0x147_P_CANFD_CanIf2Com
            ECM_0x147_P_CANFD_CanIf2PduR (PduRSrcPdu): PduRSrcPduRef=PduCollection/ECM_0x147_P_CANFD_CanIf2PduR
            ECM_0x147_P_CANFD_PduR2Com (PduRDestPdu): PduRTransmissionConfirmation=false, PduRDestPduRef=PduCollection/ECM_0x147_P_CANFD_PduR2Com
          HPCBCM_0x1E4_P_CANFD_CanIf2Com
            HPCBCM_0x1E4_P_CANFD_CanIf2PduR (PduRSrcPdu): PduRSrcPduRef=PduCollection/HPCBCM_0x1E4_P_CANFD_CanIf2PduR
            HPCBCM_0x1E4_P_CANFD_PduR2Com (PduRDestPdu): PduRTransmissionConfirmation=false, PduRDestPduRef=PduCollection/HPCBCM_0x1E4_P_CANFD_PduR2Com
          VCU_0x1_P_CANFD_CanIf2Com
            VCU_0x1_P_CANFD_CanIf2PduR (PduRSrcPdu): PduRSrcPduRef=PduCollection/VCU_0x1_P_CANFD_CanIf2PduR
            VCU_0x1_P_CANFD_PduR2Com (PduRDestPdu): PduRTransmissionConfirmation=false, PduRDestPduRef=PduCollection/VCU_0x1_P_CANFD_PduR2Com
          GCU_0xBD_P_CANFD_CanIf2Com
            GCU_0xBD_P_CANFD_CanIf2PduR (PduRSrcPdu): PduRSrcPduRef=PduCollection/GCU_0xBD_P_CANFD_CanIf2PduR
            GCU_0xBD_P_CANFD_PduR2Com (PduRDestPdu): PduRTransmissionConfirmation=false, PduRDestPduRef=PduCollection/GCU_0xBD_P_CANFD_PduR2Com
          RMCU_0x2_P_CANFD_CanIf2Com
            RMCU_0x2_P_CANFD_CanIf2PduR (PduRSrcPdu): PduRSrcPduRef=PduCollection/RMCU_0x2_P_CANFD_CanIf2PduR
            RMCU_0x2_P_CANFD_PduR2Com (PduRDestPdu): PduRTransmissionConfirmation=false, PduRDestPduRef=PduCollection/RMCU_0x2_P_CANFD_PduR2Com
          ICU_0x249_P_CANFD_CanIf2Com
            ICU_0x249_P_CANFD_CanIf2PduR (PduRSrcPdu): PduRSrcPduRef=PduCollection/ICU_0x249_P_CANFD_CanIf2PduR
            ICU_0x249_P_CANFD_PduR2Com (PduRDestPdu): PduRTransmissionConfirmation=false, PduRDestPduRef=PduCollection/ICU_0x249_P_CANFD_PduR2Com
          HPCBCM_0x1E6_P_CANFD_CanIf2Com
            HPCBCM_0x1E6_P_CANFD_CanIf2PduR (PduRSrcPdu): PduRSrcPduRef=PduCollection/HPCBCM_0x1E6_P_CANFD_CanIf2PduR
            HPCBCM_0x1E6_P_CANFD_PduR2Com (PduRDestPdu): PduRTransmissionConfirmation=false, PduRDestPduRef=PduCollection/HPCBCM_0x1E6_P_CANFD_PduR2Com
          BMS_0x310_P_CANFD_CanIf2Com
            BMS_0x310_P_CANFD_CanIf2PduR (PduRSrcPdu): PduRSrcPduRef=PduCollection/BMS_0x310_P_CANFD_CanIf2PduR
            BMS_0x310_P_CANFD_PduR2Com (PduRDestPdu): PduRTransmissionConfirmation=false, PduRDestPduRef=PduCollection/BMS_0x310_P_CANFD_PduR2Com
          UDS_Phy_Rx_7E0_ECM_P_CANFD_CanIf2Com
            UDS_Phy_Rx_7E0_ECM_P_CANFD_CanIf2PduR (PduRSrcPdu): PduRSrcPduRef=PduCollection/UDS_Phy_Rx_7E0_ECM_P_CANFD_CanIf2PduR
            UDS_Phy_Rx_7E0_ECM_P_CANFD_PduR2Com (PduRDestPdu): PduRTransmissionConfirmation=false, PduRDestPduRef=PduCollection/UDS_Phy_Rx_7E0_ECM_P_CANFD_PduR2Com
          IVI_0x3D8_P_CANFD_CanIf2Com
            IVI_0x3D8_P_CANFD_CanIf2PduR (PduRSrcPdu): PduRSrcPduRef=PduCollection/IVI_0x3D8_P_CANFD_CanIf2PduR
            IVI_0x3D8_P_CANFD_PduR2Com (PduRDestPdu): PduRTransmissionConfirmation=false, PduRDestPduRef=PduCollection/IVI_0x3D8_P_CANFD_PduR2Com
          ICU_0x24C_P_CANFD_CanIf2Com
            ICU_0x24C_P_CANFD_CanIf2PduR (PduRSrcPdu): PduRSrcPduRef=PduCollection/ICU_0x24C_P_CANFD_CanIf2PduR
            ICU_0x24C_P_CANFD_PduR2Com (PduRDestPdu): PduRTransmissionConfirmation=false, PduRDestPduRef=PduCollection/ICU_0x24C_P_CANFD_PduR2Com
          IVI_0x34A_P_CANFD_CanIf2Com
            IVI_0x34A_P_CANFD_CanIf2PduR (PduRSrcPdu): PduRSrcPduRef=PduCollection/IVI_0x34A_P_CANFD_CanIf2PduR
            IVI_0x34A_P_CANFD_PduR2Com (PduRDestPdu): PduRTransmissionConfirmation=false, PduRDestPduRef=PduCollection/IVI_0x34A_P_CANFD_PduR2Com
          TMS_0x5A2_P_CANFD_CanIf2Com
            TMS_0x5A2_P_CANFD_CanIf2PduR (PduRSrcPdu): PduRSrcPduRef=PduCollection/TMS_0x5A2_P_CANFD_CanIf2PduR
            TMS_0x5A2_P_CANFD_PduR2Com (PduRDestPdu): PduRTransmissionConfirmation=false, PduRDestPduRef=PduCollection/TMS_0x5A2_P_CANFD_PduR2Com
          TMS_0x363_P_CANFD_CanIf2Com
            TMS_0x363_P_CANFD_CanIf2PduR (PduRSrcPdu): PduRSrcPduRef=PduCollection/TMS_0x363_P_CANFD_CanIf2PduR
            TMS_0x363_P_CANFD_PduR2Com (PduRDestPdu): PduRTransmissionConfirmation=false, PduRDestPduRef=PduCollection/TMS_0x363_P_CANFD_PduR2Com
          ECM_0x148_P_CANFD_CanIf2Com
            ECM_0x148_P_CANFD_CanIf2PduR (PduRSrcPdu): PduRSrcPduRef=PduCollection/ECM_0x148_P_CANFD_CanIf2PduR
            ECM_0x148_P_CANFD_PduR2Com (PduRDestPdu): PduRTransmissionConfirmation=false, PduRDestPduRef=PduCollection/ECM_0x148_P_CANFD_PduR2Com
          IBS_0x225_P_CANFD_CanIf2Com
            IBS_0x225_P_CANFD_CanIf2PduR (PduRSrcPdu): PduRSrcPduRef=PduCollection/IBS_0x225_P_CANFD_CanIf2PduR
            IBS_0x225_P_CANFD_PduR2Com (PduRDestPdu): PduRTransmissionConfirmation=false, PduRDestPduRef=PduCollection/IBS_0x225_P_CANFD_PduR2Com
          HPCGW_0x3B1_P_CANFD_CanIf2Com
            HPCGW_0x3B1_P_CANFD_CanIf2PduR (PduRSrcPdu): PduRSrcPduRef=PduCollection/HPCGW_0x3B1_P_CANFD_CanIf2PduR
            HPCGW_0x3B1_P_CANFD_PduR2Com (PduRDestPdu): PduRTransmissionConfirmation=false, PduRDestPduRef=PduCollection/HPCGW_0x3B1_P_CANFD_PduR2Com
          GCU_0x2C1_P_CANFD_CanIf2Com
            GCU_0x2C1_P_CANFD_CanIf2PduR (PduRSrcPdu): PduRSrcPduRef=PduCollection/GCU_0x2C1_P_CANFD_CanIf2PduR
            GCU_0x2C1_P_CANFD_PduR2Com (PduRDestPdu): PduRTransmissionConfirmation=false, PduRDestPduRef=PduCollection/GCU_0x2C1_P_CANFD_PduR2Com
          DCDC_0x324_P_CANFD_CanIf2Com
            DCDC_0x324_P_CANFD_CanIf2PduR (PduRSrcPdu): PduRSrcPduRef=PduCollection/DCDC_0x324_P_CANFD_CanIf2PduR
            DCDC_0x324_P_CANFD_PduR2Com (PduRDestPdu): PduRTransmissionConfirmation=false, PduRDestPduRef=PduCollection/DCDC_0x324_P_CANFD_PduR2Com
          EVCC_0x260_P_CANFD_CanIf2Com
            EVCC_0x260_P_CANFD_CanIf2PduR (PduRSrcPdu): PduRSrcPduRef=PduCollection/EVCC_0x260_P_CANFD_CanIf2PduR
            EVCC_0x260_P_CANFD_PduR2Com (PduRDestPdu): PduRTransmissionConfirmation=false, PduRDestPduRef=PduCollection/EVCC_0x260_P_CANFD_PduR2Com
          IVI_0x5F6_P_CANFD_CanIf2Com
            IVI_0x5F6_P_CANFD_CanIf2PduR (PduRSrcPdu): PduRSrcPduRef=PduCollection/IVI_0x5F6_P_CANFD_CanIf2PduR
            IVI_0x5F6_P_CANFD_PduR2Com (PduRDestPdu): PduRTransmissionConfirmation=false, PduRDestPduRef=PduCollection/IVI_0x5F6_P_CANFD_PduR2Com
          MCU_0x5CB_P_CANFD_Com2CanIf
            MCU_0x5CB_P_CANFD_Com2PduR (PduRSrcPdu): PduRSrcPduRef=PduCollection/MCU_0x5CB_P_CANFD_Com2PduR
            MCU_0x5CB_P_CANFD_PduR2CanIf (PduRDestPdu): PduRTransmissionConfirmation=false, PduRDestPduRef=PduCollection/MCU_0x5CB_P_CANFD_PduR2CanIf
          MCU_0x5CA_P_CANFD_Com2CanIf
            MCU_0x5CA_P_CANFD_Com2PduR (PduRSrcPdu): PduRSrcPduRef=PduCollection/MCU_0x5CA_P_CANFD_Com2PduR
            MCU_0x5CA_P_CANFD_PduR2CanIf (PduRDestPdu): PduRTransmissionConfirmation=false, PduRDestPduRef=PduCollection/MCU_0x5CA_P_CANFD_PduR2CanIf
          MCU_0x5C9_P_CANFD_Com2CanIf
            MCU_0x5C9_P_CANFD_Com2PduR (PduRSrcPdu): PduRSrcPduRef=PduCollection/MCU_0x5C9_P_CANFD_Com2PduR
            MCU_0x5C9_P_CANFD_PduR2CanIf (PduRDestPdu): PduRTransmissionConfirmation=false, PduRDestPduRef=PduCollection/MCU_0x5C9_P_CANFD_PduR2CanIf
          MCU_0x5C8_P_CANFD_Com2CanIf
            MCU_0x5C8_P_CANFD_Com2PduR (PduRSrcPdu): PduRSrcPduRef=PduCollection/MCU_0x5C8_P_CANFD_Com2PduR
            MCU_0x5C8_P_CANFD_PduR2CanIf (PduRDestPdu): PduRTransmissionConfirmation=false, PduRDestPduRef=PduCollection/MCU_0x5C8_P_CANFD_PduR2CanIf
          VCU_0x600_P_CANFD_Com2CanIf
            VCU_0x600_P_CANFD_Com2PduR (PduRSrcPdu): PduRSrcPduRef=PduCollection/VCU_0x600_P_CANFD_Com2PduR
            VCU_0x600_P_CANFD_PduR2CanIf (PduRDestPdu): PduRTransmissionConfirmation=false, PduRDestPduRef=PduCollection/VCU_0x600_P_CANFD_PduR2CanIf
          MCU_0x5C6_P_CANFD_Com2CanIf
            MCU_0x5C6_P_CANFD_Com2PduR (PduRSrcPdu): PduRSrcPduRef=PduCollection/MCU_0x5C6_P_CANFD_Com2PduR
            MCU_0x5C6_P_CANFD_PduR2CanIf (PduRDestPdu): PduRTransmissionConfirmation=false, PduRDestPduRef=PduCollection/MCU_0x5C6_P_CANFD_PduR2CanIf
          MCU_0x5C4_P_CANFD_Com2CanIf
            MCU_0x5C4_P_CANFD_Com2PduR (PduRSrcPdu): PduRSrcPduRef=PduCollection/MCU_0x5C4_P_CANFD_Com2PduR
            MCU_0x5C4_P_CANFD_PduR2CanIf (PduRDestPdu): PduRTransmissionConfirmation=false, PduRDestPduRef=PduCollection/MCU_0x5C4_P_CANFD_PduR2CanIf
          VCU_0x13B_P_CANFD_Com2CanIf
            VCU_0x13B_P_CANFD_Com2PduR (PduRSrcPdu): PduRSrcPduRef=PduCollection/VCU_0x13B_P_CANFD_Com2PduR
            VCU_0x13B_P_CANFD_PduR2CanIf (PduRDestPdu): PduRTransmissionConfirmation=false, PduRDestPduRef=PduCollection/VCU_0x13B_P_CANFD_PduR2CanIf
          UDS_Phy_Tx_7E8_ECM_P_CANFD_Com2CanIf
            UDS_Phy_Tx_7E8_ECM_P_CANFD_Com2PduR (PduRSrcPdu): PduRSrcPduRef=PduCollection/UDS_Phy_Tx_7E8_ECM_P_CANFD_Com2PduR
            UDS_Phy_Tx_7E8_ECM_P_CANFD_PduR2CanIf (PduRDestPdu): PduRTransmissionConfirmation=false, PduRDestPduRef=PduCollection/UDS_Phy_Tx_7E8_ECM_P_CANFD_PduR2CanIf
          VCU_0x358_P_CANFD_Com2CanIf
            VCU_0x358_P_CANFD_Com2PduR (PduRSrcPdu): PduRSrcPduRef=PduCollection/VCU_0x358_P_CANFD_Com2PduR
            VCU_0x358_P_CANFD_PduR2CanIf (PduRDestPdu): PduRTransmissionConfirmation=false, PduRDestPduRef=PduCollection/VCU_0x358_P_CANFD_PduR2CanIf
          VCU_0x359_P_CANFD_Com2CanIf
            VCU_0x359_P_CANFD_Com2PduR (PduRSrcPdu): PduRSrcPduRef=PduCollection/VCU_0x359_P_CANFD_Com2PduR
            VCU_0x359_P_CANFD_PduR2CanIf (PduRDestPdu): PduRTransmissionConfirmation=false, PduRDestPduRef=PduCollection/VCU_0x359_P_CANFD_PduR2CanIf
          MCUM_0x5D3_P_CANFD_Com2CanIf
            MCUM_0x5D3_P_CANFD_Com2PduR (PduRSrcPdu): PduRSrcPduRef=PduCollection/MCUM_0x5D3_P_CANFD_Com2PduR
            MCUM_0x5D3_P_CANFD_PduR2CanIf (PduRDestPdu): PduRTransmissionConfirmation=false, PduRDestPduRef=PduCollection/MCUM_0x5D3_P_CANFD_PduR2CanIf
          VCU_0xBB_P_CANFD_Com2CanIf
            VCU_0xBB_P_CANFD_Com2PduR (PduRSrcPdu): PduRSrcPduRef=PduCollection/VCU_0xBB_P_CANFD_Com2PduR
            VCU_0xBB_P_CANFD_PduR2CanIf (PduRDestPdu): PduRTransmissionConfirmation=false, PduRDestPduRef=PduCollection/VCU_0xBB_P_CANFD_PduR2CanIf
          VCU_0xBC_P_CANFD_Com2CanIf
            VCU_0xBC_P_CANFD_Com2PduR (PduRSrcPdu): PduRSrcPduRef=PduCollection/VCU_0xBC_P_CANFD_Com2PduR
            VCU_0xBC_P_CANFD_PduR2CanIf (PduRDestPdu): PduRTransmissionConfirmation=false, PduRDestPduRef=PduCollection/VCU_0xBC_P_CANFD_PduR2CanIf
          VCU_0x1E5_P_CANFD_Com2CanIf
            VCU_0x1E5_P_CANFD_Com2PduR (PduRSrcPdu): PduRSrcPduRef=PduCollection/VCU_0x1E5_P_CANFD_Com2PduR
            VCU_0x1E5_P_CANFD_PduR2CanIf (PduRDestPdu): PduRTransmissionConfirmation=false, PduRDestPduRef=PduCollection/VCU_0x1E5_P_CANFD_PduR2CanIf
          VCU_0xDE_P_CANFD_Com2CanIf
            VCU_0xDE_P_CANFD_Com2PduR (PduRSrcPdu): PduRSrcPduRef=PduCollection/VCU_0xDE_P_CANFD_Com2PduR
            VCU_0xDE_P_CANFD_PduR2CanIf (PduRDestPdu): PduRTransmissionConfirmation=false, PduRDestPduRef=PduCollection/VCU_0xDE_P_CANFD_PduR2CanIf
          MCUM_0x5D0_P_CANFD_Com2CanIf
            MCUM_0x5D0_P_CANFD_Com2PduR (PduRSrcPdu): PduRSrcPduRef=PduCollection/MCUM_0x5D0_P_CANFD_Com2PduR
            MCUM_0x5D0_P_CANFD_PduR2CanIf (PduRDestPdu): PduRTransmissionConfirmation=false, PduRDestPduRef=PduCollection/MCUM_0x5D0_P_CANFD_PduR2CanIf
          MCUM_0x5D1_P_CANFD_Com2CanIf
            MCUM_0x5D1_P_CANFD_Com2PduR (PduRSrcPdu): PduRSrcPduRef=PduCollection/MCUM_0x5D1_P_CANFD_Com2PduR
            MCUM_0x5D1_P_CANFD_PduR2CanIf (PduRDestPdu): PduRTransmissionConfirmation=false, PduRDestPduRef=PduCollection/MCUM_0x5D1_P_CANFD_PduR2CanIf
          MCUM_0x5D2_P_CANFD_Com2CanIf
            MCUM_0x5D2_P_CANFD_Com2PduR (PduRSrcPdu): PduRSrcPduRef=PduCollection/MCUM_0x5D2_P_CANFD_Com2PduR
            MCUM_0x5D2_P_CANFD_PduR2CanIf (PduRDestPdu): PduRTransmissionConfirmation=false, PduRDestPduRef=PduCollection/MCUM_0x5D2_P_CANFD_PduR2CanIf
          VCU_0x515_P_CANFD_Com2CanIf
            VCU_0x515_P_CANFD_Com2PduR (PduRSrcPdu): PduRSrcPduRef=PduCollection/VCU_0x515_P_CANFD_Com2PduR
            VCU_0x515_P_CANFD_PduR2CanIf (PduRDestPdu): PduRTransmissionConfirmation=false, PduRDestPduRef=PduCollection/VCU_0x515_P_CANFD_PduR2CanIf
          MCUM_0xCA_P_CANFD_Com2CanIf
            MCUM_0xCA_P_CANFD_Com2PduR (PduRSrcPdu): PduRSrcPduRef=PduCollection/MCUM_0xCA_P_CANFD_Com2PduR
            MCUM_0xCA_P_CANFD_PduR2CanIf (PduRDestPdu): PduRTransmissionConfirmation=false, PduRDestPduRef=PduCollection/MCUM_0xCA_P_CANFD_PduR2CanIf
          MCUM_0x6F8_P_CANFD_Com2CanIf
            MCUM_0x6F8_P_CANFD_Com2PduR (PduRSrcPdu): PduRSrcPduRef=PduCollection/MCUM_0x6F8_P_CANFD_Com2PduR
            MCUM_0x6F8_P_CANFD_PduR2CanIf (PduRDestPdu): PduRTransmissionConfirmation=false, PduRDestPduRef=PduCollection/MCUM_0x6F8_P_CANFD_PduR2CanIf
          VCU_0x514_P_CANFD_Com2CanIf
            VCU_0x514_P_CANFD_Com2PduR (PduRSrcPdu): PduRSrcPduRef=PduCollection/VCU_0x514_P_CANFD_Com2PduR
            VCU_0x514_P_CANFD_PduR2CanIf (PduRDestPdu): PduRTransmissionConfirmation=false, PduRDestPduRef=PduCollection/VCU_0x514_P_CANFD_PduR2CanIf
          MCUM_0x605_P_CANFD_Com2CanIf
            MCUM_0x605_P_CANFD_Com2PduR (PduRSrcPdu): PduRSrcPduRef=PduCollection/MCUM_0x605_P_CANFD_Com2PduR
            MCUM_0x605_P_CANFD_PduR2CanIf (PduRDestPdu): PduRTransmissionConfirmation=false, PduRDestPduRef=PduCollection/MCUM_0x605_P_CANFD_PduR2CanIf
          MCUM_0x607_P_CANFD_Com2CanIf
            MCUM_0x607_P_CANFD_Com2PduR (PduRSrcPdu): PduRSrcPduRef=PduCollection/MCUM_0x607_P_CANFD_Com2PduR
            MCUM_0x607_P_CANFD_PduR2CanIf (PduRDestPdu): PduRTransmissionConfirmation=false, PduRDestPduRef=PduCollection/MCUM_0x607_P_CANFD_PduR2CanIf
          IBC_0x186_C_CANFD_CanIf2Com
            IBC_0x186_C_CANFD_CanIf2PduR (PduRSrcPdu): PduRSrcPduRef=PduCollection/IBC_0x186_C_CANFD_CanIf2PduR
            IBC_0x186_C_CANFD_PduR2Com (PduRDestPdu): PduRTransmissionConfirmation=false, PduRDestPduRef=PduCollection/IBC_0x186_C_CANFD_PduR2Com
          LMC_0xFA_C_CANFD_CanIf2Com
            LMC_0xFA_C_CANFD_CanIf2PduR (PduRSrcPdu): PduRSrcPduRef=PduCollection/LMC_0xFA_C_CANFD_CanIf2PduR
            LMC_0xFA_C_CANFD_PduR2Com (PduRDestPdu): PduRTransmissionConfirmation=false, PduRDestPduRef=PduCollection/LMC_0xFA_C_CANFD_PduR2Com
          LMC_0x18C_C_CANFD_CanIf2Com
            LMC_0x18C_C_CANFD_CanIf2PduR (PduRSrcPdu): PduRSrcPduRef=PduCollection/LMC_0x18C_C_CANFD_CanIf2PduR
            LMC_0x18C_C_CANFD_PduR2Com (PduRDestPdu): PduRTransmissionConfirmation=false, PduRDestPduRef=PduCollection/LMC_0x18C_C_CANFD_PduR2Com
          ADDC_0x83_C_CANFD_CanIf2Com
            ADDC_0x83_C_CANFD_CanIf2PduR (PduRSrcPdu): PduRSrcPduRef=PduCollection/ADDC_0x83_C_CANFD_CanIf2PduR
            ADDC_0x83_C_CANFD_PduR2Com (PduRDestPdu): PduRTransmissionConfirmation=false, PduRDestPduRef=PduCollection/ADDC_0x83_C_CANFD_PduR2Com
          IBC_0x136_C_CANFD_CanIf2Com
            IBC_0x136_C_CANFD_CanIf2PduR (PduRSrcPdu): PduRSrcPduRef=PduCollection/IBC_0x136_C_CANFD_CanIf2PduR
            IBC_0x136_C_CANFD_PduR2Com (PduRDestPdu): PduRTransmissionConfirmation=false, PduRDestPduRef=PduCollection/IBC_0x136_C_CANFD_PduR2Com
          ADDC_0x84_C_CANFD_CanIf2Com
            ADDC_0x84_C_CANFD_CanIf2PduR (PduRSrcPdu): PduRSrcPduRef=PduCollection/ADDC_0x84_C_CANFD_CanIf2PduR
            ADDC_0x84_C_CANFD_PduR2Com (PduRDestPdu): PduRTransmissionConfirmation=false, PduRDestPduRef=PduCollection/ADDC_0x84_C_CANFD_PduR2Com
          IBC_0xB1_C_CANFD_CanIf2Com
            IBC_0xB1_C_CANFD_CanIf2PduR (PduRSrcPdu): PduRSrcPduRef=PduCollection/IBC_0xB1_C_CANFD_CanIf2PduR
            IBC_0xB1_C_CANFD_PduR2Com (PduRDestPdu): PduRTransmissionConfirmation=false, PduRDestPduRef=PduCollection/IBC_0xB1_C_CANFD_PduR2Com
          IBC_0x227_C_CANFD_CanIf2Com
            IBC_0x227_C_CANFD_CanIf2PduR (PduRSrcPdu): PduRSrcPduRef=PduCollection/IBC_0x227_C_CANFD_CanIf2PduR
            IBC_0x227_C_CANFD_PduR2Com (PduRDestPdu): PduRTransmissionConfirmation=false, PduRDestPduRef=PduCollection/IBC_0x227_C_CANFD_PduR2Com
          EPS_0x18D_C_CANFD_CanIf2Com
            EPS_0x18D_C_CANFD_CanIf2PduR (PduRSrcPdu): PduRSrcPduRef=PduCollection/EPS_0x18D_C_CANFD_CanIf2PduR
            EPS_0x18D_C_CANFD_PduR2Com (PduRDestPdu): PduRTransmissionConfirmation=false, PduRDestPduRef=PduCollection/EPS_0x18D_C_CANFD_PduR2Com
          IBC_0x182_C_CANFD_CanIf2Com
            IBC_0x182_C_CANFD_CanIf2PduR (PduRSrcPdu): PduRSrcPduRef=PduCollection/IBC_0x182_C_CANFD_CanIf2PduR
            IBC_0x182_C_CANFD_PduR2Com (PduRDestPdu): PduRTransmissionConfirmation=false, PduRDestPduRef=PduCollection/IBC_0x182_C_CANFD_PduR2Com
          IBC_0x183_C_CANFD_CanIf2Com
            IBC_0x183_C_CANFD_CanIf2PduR (PduRSrcPdu): PduRSrcPduRef=PduCollection/IBC_0x183_C_CANFD_CanIf2PduR
            IBC_0x183_C_CANFD_PduR2Com (PduRDestPdu): PduRTransmissionConfirmation=false, PduRDestPduRef=PduCollection/IBC_0x183_C_CANFD_PduR2Com
          ACU_0x233_C_CANFD_CanIf2Com
            ACU_0x233_C_CANFD_CanIf2PduR (PduRSrcPdu): PduRSrcPduRef=PduCollection/ACU_0x233_C_CANFD_CanIf2PduR
            ACU_0x233_C_CANFD_PduR2Com (PduRDestPdu): PduRTransmissionConfirmation=false, PduRDestPduRef=PduCollection/ACU_0x233_C_CANFD_PduR2Com
          IBC_0x184_C_CANFD_CanIf2Com
            IBC_0x184_C_CANFD_CanIf2PduR (PduRSrcPdu): PduRSrcPduRef=PduCollection/IBC_0x184_C_CANFD_CanIf2PduR
            IBC_0x184_C_CANFD_PduR2Com (PduRDestPdu): PduRTransmissionConfirmation=false, PduRDestPduRef=PduCollection/IBC_0x184_C_CANFD_PduR2Com
          FSC_0x142_C_CANFD_CanIf2Com
            FSC_0x142_C_CANFD_CanIf2PduR (PduRSrcPdu): PduRSrcPduRef=PduCollection/FSC_0x142_C_CANFD_CanIf2PduR
            FSC_0x142_C_CANFD_PduR2Com (PduRDestPdu): PduRTransmissionConfirmation=false, PduRDestPduRef=PduCollection/FSC_0x142_C_CANFD_PduR2Com
          IBC_0x185_C_CANFD_CanIf2Com
            IBC_0x185_C_CANFD_CanIf2PduR (PduRSrcPdu): PduRSrcPduRef=PduCollection/IBC_0x185_C_CANFD_CanIf2PduR
            IBC_0x185_C_CANFD_PduR2Com (PduRDestPdu): PduRTransmissionConfirmation=false, PduRDestPduRef=PduCollection/IBC_0x185_C_CANFD_PduR2Com
          ACU_0x2A3_C_CANFD_CanIf2Com
            ACU_0x2A3_C_CANFD_CanIf2PduR (PduRSrcPdu): PduRSrcPduRef=PduCollection/ACU_0x2A3_C_CANFD_CanIf2PduR
            ACU_0x2A3_C_CANFD_PduR2Com (PduRDestPdu): PduRTransmissionConfirmation=false, PduRDestPduRef=PduCollection/ACU_0x2A3_C_CANFD_PduR2Com
          ICU_0x24D_C_CANFD_CanIf2Com
            ICU_0x24D_C_CANFD_CanIf2PduR (PduRSrcPdu): PduRSrcPduRef=PduCollection/ICU_0x24D_C_CANFD_CanIf2PduR
            ICU_0x24D_C_CANFD_PduR2Com (PduRDestPdu): PduRTransmissionConfirmation=false, PduRDestPduRef=PduCollection/ICU_0x24D_C_CANFD_PduR2Com
          HPCBCM_0x290_C_CANFD_CanIf2Com
            HPCBCM_0x290_C_CANFD_CanIf2PduR (PduRSrcPdu): PduRSrcPduRef=PduCollection/HPCBCM_0x290_C_CANFD_CanIf2PduR
            HPCBCM_0x290_C_CANFD_PduR2Com (PduRDestPdu): PduRTransmissionConfirmation=false, PduRDestPduRef=PduCollection/HPCBCM_0x290_C_CANFD_PduR2Com
          IVI_0x331_C_CANFD_CanIf2Com
            IVI_0x331_C_CANFD_CanIf2PduR (PduRSrcPdu): PduRSrcPduRef=PduCollection/IVI_0x331_C_CANFD_CanIf2PduR
            IVI_0x331_C_CANFD_PduR2Com (PduRDestPdu): PduRTransmissionConfirmation=false, PduRDestPduRef=PduCollection/IVI_0x331_C_CANFD_PduR2Com
          ICU_0x332_C_CANFD_CanIf2Com
            ICU_0x332_C_CANFD_CanIf2PduR (PduRSrcPdu): PduRSrcPduRef=PduCollection/ICU_0x332_C_CANFD_CanIf2PduR
            ICU_0x332_C_CANFD_PduR2Com (PduRDestPdu): PduRTransmissionConfirmation=false, PduRDestPduRef=PduCollection/ICU_0x332_C_CANFD_PduR2Com
          VCU_0xB6_C_CANFD_Com2CanIf
            VCU_0xB6_C_CANFD_Com2PduR (PduRSrcPdu): PduRSrcPduRef=PduCollection/VCU_0xB6_C_CANFD_Com2PduR
            VCU_0xB6_C_CANFD_PduR2CanIf (PduRDestPdu): PduRTransmissionConfirmation=false, PduRDestPduRef=PduCollection/VCU_0xB6_C_CANFD_PduR2CanIf
          VCU_0xB7_C_CANFD_Com2CanIf
            VCU_0xB7_C_CANFD_Com2PduR (PduRSrcPdu): PduRSrcPduRef=PduCollection/VCU_0xB7_C_CANFD_Com2PduR
            VCU_0xB7_C_CANFD_PduR2CanIf (PduRDestPdu): PduRTransmissionConfirmation=false, PduRDestPduRef=PduCollection/VCU_0xB7_C_CANFD_PduR2CanIf
          VCU_0xE6_C_CANFD_Com2CanIf
            VCU_0xE6_C_CANFD_Com2PduR (PduRSrcPdu): PduRSrcPduRef=PduCollection/VCU_0xE6_C_CANFD_Com2PduR
            VCU_0xE6_C_CANFD_PduR2CanIf (PduRDestPdu): PduRTransmissionConfirmation=false, PduRDestPduRef=PduCollection/VCU_0xE6_C_CANFD_PduR2CanIf
          MCUM_0x135_C_CANFD_Com2CanIf
            MCUM_0x135_C_CANFD_Com2PduR (PduRSrcPdu): PduRSrcPduRef=PduCollection/MCUM_0x135_C_CANFD_Com2PduR
            MCUM_0x135_C_CANFD_PduR2CanIf (PduRDestPdu): PduRTransmissionConfirmation=false, PduRDestPduRef=PduCollection/MCUM_0x135_C_CANFD_PduR2CanIf
          MCUS_0x14_VCU_CAN_CanIf2Com
            MCUS_0x14_VCU_CAN_CanIf2PduR (PduRSrcPdu): PduRSrcPduRef=PduCollection/MCUS_0x14_VCU_CAN_CanIf2PduR
            MCUS_0x14_VCU_CAN_PduR2Com (PduRDestPdu): PduRTransmissionConfirmation=false, PduRDestPduRef=PduCollection/MCUS_0x14_VCU_CAN_PduR2Com
          VCU_0x13_VCU_CAN_Com2CanIf
            VCU_0x13_VCU_CAN_Com2PduR (PduRSrcPdu): PduRSrcPduRef=PduCollection/VCU_0x13_VCU_CAN_Com2PduR
            VCU_0x13_VCU_CAN_PduR2CanIf (PduRDestPdu): PduRTransmissionConfirmation=false, PduRDestPduRef=PduCollection/VCU_0x13_VCU_CAN_PduR2CanIf
          MCUM_0x42C_P_CANFD_Com2CanNm
            MCUM_0x42C_P_CANFD_Com2PduR (PduRSrcPdu): PduRSrcPduRef=PduCollection/MCUM_0x42C_P_CANFD_Com2PduR
            MCUM_0x42C_P_CANFD_PduR2CanNm (PduRDestPdu): PduRDestPduRef=PduCollection/MCUM_0x42C_P_CANFD_PduR2CanNm
          MCUM_0x42C_C_CANFD_Com2CanNm
            MCUM_0x42C_C_CANFD_Com2PduR (PduRSrcPdu): PduRSrcPduRef=PduCollection/MCUM_0x42C_C_CANFD_Com2PduR
            MCUM_0x42C_C_CANFD_PduR2CanNm (PduRDestPdu): PduRDestPduRef=PduCollection/MCUM_0x42C_C_CANFD_PduR2CanNm
          HPCBCM_0x401_P_CANFD_CanNm2Com
            HPCBCM_0x401_P_CANFD_CanNm2PduR (PduRSrcPdu): PduRSrcPduRef=PduCollection/HPCBCM_0x401_P_CANFD_CanNm2PduR
            HPCBCM_0x401_P_CANFD_PduR2Com (PduRDestPdu): PduRTransmissionConfirmation=false, PduRDestPduRef=PduCollection/HPCBCM_0x401_P_CANFD_PduR2Com
          ICU_0xDF_P_CANFD_CanIf2Com
            ICU_0xDF_P_CANFD_CanIf2PduR (PduRSrcPdu): PduRSrcPduRef=ICU_0xDF_P_CANFD_CanIf2PduR
            ICU_0xDF_P_CANFD_PduR2Com (PduRDestPdu): PduRTransmissionConfirmation=false, PduRDestPduRef=ICU_0xDF_P_CANFD_PduR2Com
          VCU_0x3_P_CANFD_CanIf2Com
            VCU_0x3_P_CANFD_CanIf2PduR (PduRSrcPdu): PduRSrcPduRef=PduCollection/VCU_0x3_P_CANFD_CanIf2PduR
            VCU_0x3_P_CANFD_PduR2Com (PduRDestPdu): PduRTransmissionConfirmation=false, PduRDestPduRef=PduCollection/VCU_0x3_P_CANFD_PduR2Com
          TMS_0x362_P_CANFD_CanIf2Com
            TMS_0x362_P_CANFD_CanIf2PduR (PduRSrcPdu): PduRSrcPduRef=PduCollection/TMS_0x362_P_CANFD_CanIf2PduR
            TMS_0x362_P_CANFD_PduR2Com (PduRDestPdu): PduRTransmissionConfirmation=false, PduRDestPduRef=PduCollection/TMS_0x362_P_CANFD_PduR2Com
          HPCBCM_0xDA_VCU_CAN_CanIf2Com
            HPCBCM_0xDA_VCU_CAN_CanIf2PduR (PduRSrcPdu): PduRSrcPduRef=PduCollection/HPCBCM_0xDA_VCU_CAN_CanIf2PduR
            HPCBCM_0xDA_VCU_CAN_PduR2Com (PduRDestPdu): PduRTransmissionConfirmation=false, PduRDestPduRef=PduCollection/HPCBCM_0xDA_VCU_CAN_PduR2Com
          ACU_0x15_VCU_CAN_CanIf2Com
            ACU_0x15_VCU_CAN_CanIf2PduR (PduRSrcPdu): PduRSrcPduRef=PduCollection/ACU_0x15_VCU_CAN_CanIf2PduR
            ACU_0x15_VCU_CAN_PduR2Com (PduRDestPdu): PduRTransmissionConfirmation=false, PduRDestPduRef=PduCollection/ACU_0x15_VCU_CAN_PduR2Com
          LMC_0x133_C_CANFD_CanIf2Com
            LMC_0x133_C_CANFD_CanIf2PduR (PduRSrcPdu): PduRSrcPduRef=PduCollection/LMC_0x133_C_CANFD_CanIf2PduR
            LMC_0x133_C_CANFD_PduR2Com (PduRDestPdu): PduRTransmissionConfirmation=false, PduRDestPduRef=PduCollection/LMC_0x133_C_CANFD_PduR2Com
          LMCSSU_0x25A_C_CANFD_CanIf2Com
            LMCSSU_0x25A_C_CANFD_CanIf2PduR (PduRSrcPdu): PduRSrcPduRef=PduCollection/LMCSSU_0x25A_C_CANFD_CanIf2PduR
            LMCSSU_0x25A_C_CANFD_PduR2Com (PduRDestPdu): PduRTransmissionConfirmation=false, PduRDestPduRef=PduCollection/LMCSSU_0x25A_C_CANFD_PduR2Com
          HPCBCM_0x4A_C_CANFD_CanIf2Com
            HPCBCM_0x4A_C_CANFD_CanIf2PduR (PduRSrcPdu): PduRSrcPduRef=PduCollection/HPCBCM_0x4A_C_CANFD_CanIf2PduR
            HPCBCM_0x4A_C_CANFD_PduR2Com (PduRDestPdu): PduRTransmissionConfirmation=false, PduRDestPduRef=PduCollection/HPCBCM_0x4A_C_CANFD_PduR2Com
          ICU_0x5BE_VCU_CAN_CanIf2Com
            ICU_0x5BE_VCU_CAN_CanIf2PduR (PduRSrcPdu): PduRSrcPduRef=PduCollection/ICU_0x5BE_VCU_CAN_CanIf2PduR
            ICU_0x5BE_VCU_CAN_PduR2Com (PduRDestPdu): PduRTransmissionConfirmation=false, PduRDestPduRef=PduCollection/ICU_0x5BE_VCU_CAN_PduR2Com
          UDS_Phy_Rx_721_MCUM_P_CANFD_CanTp2Dcm
            UDS_Phy_Rx_721_MCUM_P_CANFD_CanTp2PduR (PduRSrcPdu): PduRSrcPduRef=PduCollection/UDS_Phy_Rx_721_MCUM_P_CANFD_CanTp2PduR
            UDS_Phy_Rx_721_MCUM_P_CANFD_PduR2Dcm (PduRDestPdu): PduRTransmissionConfirmation=false, PduRDestPduRef=PduCollection/UDS_Phy_Rx_721_MCUM_P_CANFD_PduR2Dcm
          OBD_Phy_Rx_7E3_MCUM_P_CANFD_CanTp2Dcm
            OBD_Phy_Rx_7E3_MCUM_P_CANFD_CanTp2PduR (PduRSrcPdu): PduRSrcPduRef=PduCollection/OBD_Phy_Rx_7E3_MCUM_P_CANFD_CanTp2PduR
            OBD_Phy_Rx_7E3_MCUM_P_CANFD_PduR2Dcm (PduRDestPdu): PduRTransmissionConfirmation=false, PduRDestPduRef=PduCollection/OBD_Phy_Rx_7E3_MCUM_P_CANFD_PduR2Dcm
          UDS_Fun_Rx_7DF_MCUM_P_CANFD_CanTp2Dcm
            UDS_Fun_Rx_7DF_MCUM_P_CANFD_CanTp2PduR (PduRSrcPdu): PduRSrcPduRef=PduCollection/UDS_Fun_Rx_7DF_MCUM_P_CANFD_CanTp2PduR
            UDS_Fun_Rx_7DF_MCUM_P_CANFD_PduR2Dcm (PduRDestPdu): PduRTransmissionConfirmation=false, PduRDestPduRef=PduCollection/UDS_Fun_Rx_7DF_MCUM_P_CANFD_PduR2Dcm
          OBD_Fun_Rx_7DE_MCUM_P_CANFD_CanTp2Dcm
            OBD_Fun_Rx_7DE_MCUM_P_CANFD_CanTp2PduR (PduRSrcPdu): PduRSrcPduRef=PduCollection/OBD_Fun_Rx_7DE_MCUM_P_CANFD_CanTp2PduR
            OBD_Fun_Rx_7DE_MCUM_P_CANFD_PduR2Dcm (PduRDestPdu): PduRTransmissionConfirmation=false, PduRDestPduRef=PduCollection/OBD_Fun_Rx_7DE_MCUM_P_CANFD_PduR2Dcm
          UDS_Phy_Tx_729_MCUM_P_CANFD_Dcm2CanTp
            UDS_Phy_Tx_729_MCUM_P_CANFD_Phys_Dcm2PduR (PduRSrcPdu): PduRSrcPduRef=PduCollection/UDS_Phy_Tx_729_MCUM_P_CANFD_Phys_Dcm2PduR
            UDS_Phy_Tx_729_MCUM_P_CANFD_Phys_PduR2CanTp (PduRDestPdu): PduRTransmissionConfirmation=false, PduRDestPduRef=PduCollection/UDS_Phy_Tx_729_MCUM_P_CANFD_Phys_PduR2CanTp
          OBD_Phy_Tx_7EB_MCUM_P_CANFD_Dcm2CanTp
            OBD_Phy_Tx_7EB_MCUM_P_CANFD_Phys_Dcm2PduR (PduRSrcPdu): PduRSrcPduRef=PduCollection/OBD_Phy_Tx_7EB_MCUM_P_CANFD_Phys_Dcm2PduR
            OBD_Phy_Tx_7EB_MCUM_P_CANFD_Phys_PduR2CanTp (PduRDestPdu): PduRTransmissionConfirmation=false, PduRDestPduRef=PduCollection/OBD_Phy_Tx_7EB_MCUM_P_CANFD_Phys_PduR2CanTp
          UDS_Phy_Rx_721_MCUM_P_CAN_CanTp2Dcm
            UDS_Phy_Rx_721_MCUM_P_CAN_CanTp2PduR (PduRSrcPdu): PduRSrcPduRef=PduCollection/UDS_Phy_Rx_721_MCUM_P_CAN_CanTp2PduR
            UDS_Phy_Rx_721_MCUM_P_CAN_PduR2Dcm (PduRDestPdu): PduRTransmissionConfirmation=false, PduRDestPduRef=PduCollection/UDS_Phy_Rx_721_MCUM_P_CAN_PduR2Dcm
          OBD_Phy_Rx_7E3_MCUM_P_CAN_CanTp2Dcm
            OBD_Phy_Rx_7E3_MCUM_P_CAN_CanTp2PduR (PduRSrcPdu): PduRSrcPduRef=PduCollection/OBD_Phy_Rx_7E3_MCUM_P_CAN_CanTp2PduR
            OBD_Phy_Rx_7E3_MCUM_P_CAN_PduR2Dcm (PduRDestPdu): PduRTransmissionConfirmation=false, PduRDestPduRef=PduCollection/OBD_Phy_Rx_7E3_MCUM_P_CAN_PduR2Dcm
          UDS_Fun_Rx_7DF_MCUM_P_CAN_CanTp2Dcm
            UDS_Fun_Rx_7DF_MCUM_P_CAN_CanTp2PduR (PduRSrcPdu): PduRSrcPduRef=PduCollection/UDS_Fun_Rx_7DF_MCUM_P_CAN_CanTp2PduR
            UDS_Fun_Rx_7DF_MCUM_P_CAN_PduR2Dcm (PduRDestPdu): PduRTransmissionConfirmation=false, PduRDestPduRef=PduCollection/UDS_Fun_Rx_7DF_MCUM_P_CAN_PduR2Dcm
          OBD_Fun_Rx_7DE_MCUM_P_CAN_CanTp2Dcm
            UDS_Fun_Rx_7DE_MCUM_P_CAN_CanTp2PduR (PduRSrcPdu): PduRSrcPduRef=OBD_Fun_Rx_7DE_MCUM_P_CAN_CanTp2PduR
            UDS_Fun_Rx_7DE_MCUM_P_CAN_PduR2Dcm (PduRDestPdu): PduRTransmissionConfirmation=false, PduRDestPduRef=OBD_Fun_Rx_7DE_MCUM_P_CAN_PduR2Dcm
          UDS_Phy_Tx_729_MCUM_P_CAN_Dcm2CanTp
            UDS_Phy_Tx_729_MCUM_P_CAN_Phys_Dcm2PduR (PduRSrcPdu): PduRSrcPduRef=PduCollection/UDS_Phy_Tx_729_MCUM_P_CAN_Phys_Dcm2PduR
            UDS_Phy_Tx_729_MCUM_P_CAN_Phys_PduR2CanTp (PduRDestPdu): PduRTransmissionConfirmation=false, PduRDestPduRef=PduCollection/UDS_Phy_Tx_729_MCUM_P_CAN_Phys_PduR2CanTp
          OBD_Phy_Tx_7EB_MCUM_P_CAN_Dcm2CanTp
            OBD_Phy_Tx_7EB_MCUM_P_CAN_Phys_Dcm2PduR (PduRSrcPdu): PduRSrcPduRef=PduCollection/OBD_Phy_Tx_7EB_MCUM_P_CAN_Phys_Dcm2PduR
            OBD_Phy_Tx_7EB_MCUM_P_CAN_Phys_PduR2CanTp (PduRDestPdu): PduRTransmissionConfirmation=false, PduRDestPduRef=PduCollection/OBD_Phy_Tx_7EB_MCUM_P_CAN_Phys_PduR2CanTp
    5 x PduRBswModules, all with PduRCancelReceive=0, PduRChangeParameterApi=0, PduRRetransmission=0, PduRUseTag=0:
      CanNm: PduRCancelTransmit=0, PduRCommunicationInterface=1, PduRLowerModule=1, PduRTransportProtocol=0, PduRTriggertransmit=1, PduRTxConfirmation=1, PduRUpperModule=0, PduRBswModuleRef=CanNm
      CanIf: PduRCancelTransmit=0, PduRCommunicationInterface=1, PduRLowerModule=1, PduRTransportProtocol=0, PduRTriggertransmit=0, PduRTxConfirmation=1, PduRUpperModule=0, PduRBswModuleRef=CanIf
      Com: PduRCancelTransmit=0, PduRCommunicationInterface=1, PduRLowerModule=0, PduRTransportProtocol=1, PduRTriggertransmit=1, PduRTxConfirmation=0, PduRUpperModule=1, PduRBswModuleRef=Com
      CanTp: PduRCancelTransmit=1, PduRCommunicationInterface=0, PduRLowerModule=1, PduRTransportProtocol=1, PduRTriggertransmit=0, PduRTxConfirmation=1, PduRUpperModule=0
        PduRInvalidHandlers: PduRIHCancelReceive=false, PduRIHCancelTransmit=false
      Dcm: PduRCancelTransmit=1, PduRCommunicationInterface=0, PduRLowerModule=0, PduRTransportProtocol=1, PduRTriggertransmit=0, PduRTxConfirmation=1, PduRUpperModule=1
  module config EcuC: implementation-config-variant=VARIANT-PRE-COMPILE
    EcucConfigSet
      PduCollection (EcucPduCollection): PduIdTypeEnum=uint16, PduLengthTypeEnum=uint16
        246 x Pdu:
          EMS_0xBE_P_CANFD_CanIf2PduR: PduLength=32
          EMS_0xBE_P_CANFD_PduR2Com: PduLength=32
          BMS_0x5B5_P_CANFD_CanIf2PduR: PduLength=64
          BMS_0x5B5_P_CANFD_PduR2Com: PduLength=64
          OBC_0x316_P_CANFD_CanIf2PduR: PduLength=32
          OBC_0x316_P_CANFD_PduR2Com: PduLength=32
          TMS_0x5FF_P_CANFD_CanIf2PduR: PduLength=16
          TMS_0x5FF_P_CANFD_PduR2Com: PduLength=16
          TMS_0x5FE_P_CANFD_CanIf2PduR: PduLength=8
          TMS_0x5FE_P_CANFD_PduR2Com: PduLength=8
          BMS_0x5B1_P_CANFD_CanIf2PduR: PduLength=64
          BMS_0x5B1_P_CANFD_PduR2Com: PduLength=64
          PTC_0x367_P_CANFD_CanIf2PduR: PduLength=16
          PTC_0x367_P_CANFD_PduR2Com: PduLength=16
          MCU_0x5C7_P_CANFD_CanIf2PduR: PduLength=32
          MCU_0x5C7_P_CANFD_PduR2Com: PduLength=32
          MCU_0x5C5_P_CANFD_CanIf2PduR: PduLength=64
          MCU_0x5C5_P_CANFD_PduR2Com: PduLength=64
          CCM_0x36A_P_CANFD_CanIf2PduR: PduLength=16
          CCM_0x36A_P_CANFD_PduR2Com: PduLength=16
          TMS_0x561_P_CANFD_CanIf2PduR: PduLength=32
          TMS_0x561_P_CANFD_PduR2Com: PduLength=32
          HPCGW_0x13A_P_CANFD_CanIf2PduR: PduLength=16
          HPCGW_0x13A_P_CANFD_PduR2Com: PduLength=16
          HPCBCM_0x291_P_CANFD_CanIf2PduR: PduLength=16
          HPCBCM_0x291_P_CANFD_PduR2Com: PduLength=16
          HPCBCM_0x292_P_CANFD_CanIf2PduR: PduLength=8
          HPCBCM_0x292_P_CANFD_PduR2Com: PduLength=8
          HPCGW_0x30B_P_CANFD_CanIf2PduR: PduLength=8
          HPCGW_0x30B_P_CANFD_PduR2Com: PduLength=8
          BMS_0x1A1_P_CANFD_CanIf2PduR: PduLength=32
          BMS_0x1A1_P_CANFD_PduR2Com: PduLength=32
          MCUS_0xDB_P_CANFD_CanIf2PduR: PduLength=32
          MCUS_0xDB_P_CANFD_PduR2Com: PduLength=32
          XCP_Rx_603_VCU_P_CANFD_CanIf2Xcp: PduLength=64
          ECM_0x5EC_P_CANFD_CanIf2PduR: PduLength=32
          ECM_0x5EC_P_CANFD_PduR2Com: PduLength=32
          ECM_0x147_P_CANFD_CanIf2PduR: PduLength=32
          ECM_0x147_P_CANFD_PduR2Com: PduLength=32
          HPCBCM_0x1E4_P_CANFD_CanIf2PduR: PduLength=8
          HPCBCM_0x1E4_P_CANFD_PduR2Com: PduLength=8
          VCU_0x1_P_CANFD_CanIf2PduR: PduLength=32
          VCU_0x1_P_CANFD_PduR2Com: PduLength=32
          OBD_Phy_Rx_7E3_MCUM_P_CANFD_CanIf2CanTp: PduLength=64
          OBD_Phy_Rx_7E3_MCUM_P_CANFD_CanTp2PduR: PduLength=64
          OBD_Phy_Rx_7E3_MCUM_P_CANFD_PduR2Dcm: PduLength=64
          OBD_Phy_Rx_7E3_MCUM_P_CAN_CanIf2CanTp: PduLength=8
          OBD_Phy_Rx_7E3_MCUM_P_CAN_CanTp2PduR: PduLength=8
          OBD_Phy_Rx_7E3_MCUM_P_CAN_PduR2Dcm: PduLength=8
          GCU_0xBD_P_CANFD_CanIf2PduR: PduLength=32
          GCU_0xBD_P_CANFD_PduR2Com: PduLength=32
          RMCU_0x2_P_CANFD_CanIf2PduR: PduLength=32
          RMCU_0x2_P_CANFD_PduR2Com: PduLength=32
          ICU_0x249_P_CANFD_CanIf2PduR: PduLength=64
          ICU_0x249_P_CANFD_PduR2Com: PduLength=64
          HPCBCM_0x1E6_P_CANFD_CanIf2PduR: PduLength=16
          HPCBCM_0x1E6_P_CANFD_PduR2Com: PduLength=16
          BMS_0x310_P_CANFD_CanIf2PduR: PduLength=32
          BMS_0x310_P_CANFD_PduR2Com: PduLength=32
          UDS_Phy_Rx_7E0_ECM_P_CANFD_CanIf2PduR: PduLength=8
          UDS_Phy_Rx_7E0_ECM_P_CANFD_PduR2Com: PduLength=8
          IVI_0x3D8_P_CANFD_CanIf2PduR: PduLength=8
          IVI_0x3D8_P_CANFD_PduR2Com: PduLength=8
          UDS_Fun_Rx_7DF_MCUM_P_CANFD_CanIf2CanTp: PduLength=64
          UDS_Fun_Rx_7DF_MCUM_P_CANFD_CanTp2PduR: PduLength=64
          UDS_Fun_Rx_7DF_MCUM_P_CANFD_PduR2Dcm: PduLength=64
          UDS_Fun_Rx_7DF_MCUM_P_CAN_CanIf2CanTp: PduLength=8
          UDS_Fun_Rx_7DF_MCUM_P_CAN_CanTp2PduR: PduLength=8
          UDS_Fun_Rx_7DF_MCUM_P_CAN_PduR2Dcm: PduLength=8
          OBD_Fun_Rx_7DE_MCUM_P_CANFD_CanIf2CanTp: PduLength=64
          OBD_Fun_Rx_7DE_MCUM_P_CANFD_CanTp2PduR: PduLength=64
          OBD_Fun_Rx_7DE_MCUM_P_CANFD_PduR2Dcm: PduLength=64
          OBD_Fun_Rx_7DE_MCUM_P_CAN_CanIf2CanTp: PduLength=8
          OBD_Fun_Rx_7DE_MCUM_P_CAN_CanTp2PduR: PduLength=8
          OBD_Fun_Rx_7DE_MCUM_P_CAN_PduR2Dcm: PduLength=8
          ICU_0x24C_P_CANFD_CanIf2PduR: PduLength=8
          ICU_0x24C_P_CANFD_PduR2Com: PduLength=8
          IVI_0x34A_P_CANFD_CanIf2PduR: PduLength=8
          IVI_0x34A_P_CANFD_PduR2Com: PduLength=8
          TMS_0x5A2_P_CANFD_CanIf2PduR: PduLength=64
          TMS_0x5A2_P_CANFD_PduR2Com: PduLength=64
          TMS_0x363_P_CANFD_CanIf2PduR: PduLength=16
          TMS_0x363_P_CANFD_PduR2Com: PduLength=16
          ECM_0x148_P_CANFD_CanIf2PduR: PduLength=16
          ECM_0x148_P_CANFD_PduR2Com: PduLength=16
          IBS_0x225_P_CANFD_CanIf2PduR: PduLength=32
          IBS_0x225_P_CANFD_PduR2Com: PduLength=32
          HPCGW_0x3B1_P_CANFD_CanIf2PduR: PduLength=32
          HPCGW_0x3B1_P_CANFD_PduR2Com: PduLength=32
          GCU_0x2C1_P_CANFD_CanIf2PduR: PduLength=8
          GCU_0x2C1_P_CANFD_PduR2Com: PduLength=8
          DCDC_0x324_P_CANFD_CanIf2PduR: PduLength=16
          DCDC_0x324_P_CANFD_PduR2Com: PduLength=16
          UDS_Phy_Rx_721_MCUM_P_CANFD_CanIf2CanTp: PduLength=64
          UDS_Phy_Rx_721_MCUM_P_CANFD_CanTp2PduR: PduLength=64
          UDS_Phy_Rx_721_MCUM_P_CANFD_PduR2Dcm: PduLength=64
          UDS_Phy_Rx_721_MCUM_P_CAN_CanIf2CanTp: PduLength=8
          UDS_Phy_Rx_721_MCUM_P_CAN_CanTp2PduR: PduLength=8
          UDS_Phy_Rx_721_MCUM_P_CAN_PduR2Dcm: PduLength=8
          EVCC_0x260_P_CANFD_CanIf2PduR: PduLength=8
          EVCC_0x260_P_CANFD_PduR2Com: PduLength=8
          IVI_0x5F6_P_CANFD_CanIf2PduR: PduLength=8
          IVI_0x5F6_P_CANFD_PduR2Com: PduLength=8
          MCU_0x5CB_P_CANFD_Com2PduR: PduLength=64
          MCU_0x5CB_P_CANFD_PduR2CanIf: PduLength=64
          MCU_0x5CA_P_CANFD_Com2PduR: PduLength=64
          MCU_0x5CA_P_CANFD_PduR2CanIf: PduLength=64
          MCU_0x5C9_P_CANFD_Com2PduR: PduLength=64
          MCU_0x5C9_P_CANFD_PduR2CanIf: PduLength=64
          MCU_0x5C8_P_CANFD_Com2PduR: PduLength=64
          MCU_0x5C8_P_CANFD_PduR2CanIf: PduLength=64
          UDS_Phy_Tx_729_MCUM_P_CANFD_Phys_Dcm2PduR: PduLength=64
          UDS_Phy_Tx_729_MCUM_P_CANFD_Phys_PduR2CanTp: PduLength=64
          UDS_Phy_Tx_729_MCUM_P_CANFD_Phys_CanTp2CanIf: PduLength=64
          UDS_Phy_Tx_729_MCUM_P_CAN_Phys_Dcm2PduR: PduLength=8
          UDS_Phy_Tx_729_MCUM_P_CAN_Phys_PduR2CanTp: PduLength=8
          UDS_Phy_Tx_729_MCUM_P_CAN_Phys_CanTp2CanIf: PduLength=8
          VCU_0x600_P_CANFD_Com2PduR: PduLength=32
          VCU_0x600_P_CANFD_PduR2CanIf: PduLength=32
          MCU_0x5C6_P_CANFD_Com2PduR: PduLength=64
          MCU_0x5C6_P_CANFD_PduR2CanIf: PduLength=64
          OBD_Phy_Tx_7EB_MCUM_P_CANFD_Phys_Dcm2PduR: PduLength=64
          OBD_Phy_Tx_7EB_MCUM_P_CANFD_Phys_PduR2CanTp: PduLength=64
          OBD_Phy_Tx_7EB_MCUM_P_CANFD_Phys_CanTp2CanIf: PduLength=64
          OBD_Phy_Tx_7EB_MCUM_P_CAN_Phys_Dcm2PduR: PduLength=8
          OBD_Phy_Tx_7EB_MCUM_P_CAN_Phys_PduR2CanTp: PduLength=8
          OBD_Phy_Tx_7EB_MCUM_P_CAN_Phys_CanTp2CanIf: PduLength=8
          MCU_0x5C4_P_CANFD_Com2PduR: PduLength=64
          MCU_0x5C4_P_CANFD_PduR2CanIf: PduLength=64
          VCU_0x13B_P_CANFD_Com2PduR: PduLength=32
          VCU_0x13B_P_CANFD_PduR2CanIf: PduLength=32
          UDS_Phy_Tx_7E8_ECM_P_CANFD_Com2PduR: PduLength=64
          UDS_Phy_Tx_7E8_ECM_P_CANFD_PduR2CanIf: PduLength=64
          VCU_0x358_P_CANFD_Com2PduR: PduLength=8
          VCU_0x358_P_CANFD_PduR2CanIf: PduLength=8
          VCU_0x359_P_CANFD_Com2PduR: PduLength=16
          VCU_0x359_P_CANFD_PduR2CanIf: PduLength=16
          XCP_Tx_602_VCU_P_CANFD_Xcp2CanIf: PduLength=64
          MCUM_0x5D3_P_CANFD_Com2PduR: PduLength=64
          MCUM_0x5D3_P_CANFD_PduR2CanIf: PduLength=64
          VCU_0xBB_P_CANFD_Com2PduR: PduLength=32
          VCU_0xBB_P_CANFD_PduR2CanIf: PduLength=32
          VCU_0xBC_P_CANFD_Com2PduR: PduLength=16
          VCU_0xBC_P_CANFD_PduR2CanIf: PduLength=16
          VCU_0x1E5_P_CANFD_Com2PduR: PduLength=32
          VCU_0x1E5_P_CANFD_PduR2CanIf: PduLength=32
          VCU_0xDE_P_CANFD_Com2PduR: PduLength=32
          VCU_0xDE_P_CANFD_PduR2CanIf: PduLength=32
          VCU_0x3_P_CANFD_PduR2Com: PduLength=32
          VCU_0x3_P_CANFD_CanIf2PduR: PduLength=32
          MCUM_0x5D0_P_CANFD_Com2PduR: PduLength=16
          MCUM_0x5D0_P_CANFD_PduR2CanIf: PduLength=16
          MCUM_0x5D1_P_CANFD_Com2PduR: PduLength=64
          MCUM_0x5D1_P_CANFD_PduR2CanIf: PduLength=64
          MCUM_0x5D2_P_CANFD_Com2PduR: PduLength=64
          MCUM_0x5D2_P_CANFD_PduR2CanIf: PduLength=64
          VCU_0x515_P_CANFD_Com2PduR: PduLength=8
          VCU_0x515_P_CANFD_PduR2CanIf: PduLength=8
          MCUM_0xCA_P_CANFD_Com2PduR: PduLength=32
          MCUM_0xCA_P_CANFD_PduR2CanIf: PduLength=32
          MCUM_0x6F8_P_CANFD_Com2PduR: PduLength=64
          MCUM_0x6F8_P_CANFD_PduR2CanIf: PduLength=64
          VCU_0x514_P_CANFD_Com2PduR: PduLength=8
          VCU_0x514_P_CANFD_PduR2CanIf: PduLength=8
          MCUM_0x605_P_CANFD_Com2PduR: PduLength=64
          MCUM_0x605_P_CANFD_PduR2CanIf: PduLength=64
          MCUM_0x607_P_CANFD_Com2PduR: PduLength=64
          MCUM_0x607_P_CANFD_PduR2CanIf: PduLength=64
          IBC_0x186_C_CANFD_CanIf2PduR: PduLength=32
          IBC_0x186_C_CANFD_PduR2Com: PduLength=32
          LMC_0xFA_C_CANFD_CanIf2PduR: PduLength=32
          LMC_0xFA_C_CANFD_PduR2Com: PduLength=32
          LMC_0x18C_C_CANFD_CanIf2PduR: PduLength=32
          LMC_0x18C_C_CANFD_PduR2Com: PduLength=32
          ADDC_0x83_C_CANFD_CanIf2PduR: PduLength=32
          ADDC_0x83_C_CANFD_PduR2Com: PduLength=32
          IBC_0x136_C_CANFD_CanIf2PduR: PduLength=32
          IBC_0x136_C_CANFD_PduR2Com: PduLength=32
          ADDC_0x84_C_CANFD_CanIf2PduR: PduLength=16
          ADDC_0x84_C_CANFD_PduR2Com: PduLength=16
          IBC_0xB1_C_CANFD_CanIf2PduR: PduLength=16
          IBC_0xB1_C_CANFD_PduR2Com: PduLength=16
          IBC_0x227_C_CANFD_CanIf2PduR: PduLength=8
          IBC_0x227_C_CANFD_PduR2Com: PduLength=8
          EPS_0x18D_C_CANFD_CanIf2PduR: PduLength=32
          EPS_0x18D_C_CANFD_PduR2Com: PduLength=32
          IBC_0x182_C_CANFD_CanIf2PduR: PduLength=8
          IBC_0x182_C_CANFD_PduR2Com: PduLength=8
          IBC_0x183_C_CANFD_CanIf2PduR: PduLength=16
          IBC_0x183_C_CANFD_PduR2Com: PduLength=16
          ACU_0x233_C_CANFD_CanIf2PduR: PduLength=8
          ACU_0x233_C_CANFD_PduR2Com: PduLength=8
          IBC_0x184_C_CANFD_CanIf2PduR: PduLength=32
          IBC_0x184_C_CANFD_PduR2Com: PduLength=32
          FSC_0x142_C_CANFD_CanIf2PduR: PduLength=16
          FSC_0x142_C_CANFD_PduR2Com: PduLength=16
          IBC_0x185_C_CANFD_CanIf2PduR: PduLength=16
          IBC_0x185_C_CANFD_PduR2Com: PduLength=16
          ACU_0x2A3_C_CANFD_CanIf2PduR: PduLength=16
          ACU_0x2A3_C_CANFD_PduR2Com: PduLength=16
          ICU_0x24D_C_CANFD_CanIf2PduR: PduLength=32
          ICU_0x24D_C_CANFD_PduR2Com: PduLength=32
          HPCBCM_0x290_C_CANFD_CanIf2PduR: PduLength=8
          HPCBCM_0x290_C_CANFD_PduR2Com: PduLength=8
          IVI_0x331_C_CANFD_CanIf2PduR: PduLength=16
          IVI_0x331_C_CANFD_PduR2Com: PduLength=16
          ICU_0x332_C_CANFD_CanIf2PduR: PduLength=8
          ICU_0x332_C_CANFD_PduR2Com: PduLength=8
          VCU_0xB6_C_CANFD_Com2PduR: PduLength=32
          VCU_0xB6_C_CANFD_PduR2CanIf: PduLength=32
          VCU_0xB7_C_CANFD_Com2PduR: PduLength=32
          VCU_0xB7_C_CANFD_PduR2CanIf: PduLength=32
          VCU_0xE6_C_CANFD_Com2PduR: PduLength=64
          VCU_0xE6_C_CANFD_PduR2CanIf: PduLength=64
          MCUM_0x135_C_CANFD_Com2PduR: PduLength=16
          MCUM_0x135_C_CANFD_PduR2CanIf: PduLength=16
          MCUS_0x14_VCU_CAN_CanIf2PduR: PduLength=8
          MCUS_0x14_VCU_CAN_PduR2Com: PduLength=8
          VCU_0x13_VCU_CAN_Com2PduR: PduLength=8
          VCU_0x13_VCU_CAN_PduR2CanIf: PduLength=8
          MCUM_0x42C_C_CANFD_Com2PduR: PduLength=6
          MCUM_0x42C_C_CANFD_PduR2CanNm: PduLength=6
          MCUM_0x42C_C_CANFD_CanNm2CanIf: PduLength=8
          HPCBCM_0x402_C_CANFD_CanIf2CanNm: PduLength=8
          HPCBCM_0x402_C_CANFD_CanNm2PduR: PduLength=6
          HPCBCM_0x402_C_CANFD_PduR2Com: PduLength=6
          HPCBCM_0x401_P_CANFD_CanIf2CanNm: PduLength=8
          HPCBCM_0x401_P_CANFD_CanNm2PduR: PduLength=6
          HPCBCM_0x401_P_CANFD_PduR2Com: PduLength=6
          MCUM_0x42C_P_CANFD_Com2PduR: PduLength=6
          MCUM_0x42C_P_CANFD_PduR2CanNm: PduLength=6
          MCUM_0x42C_P_CANFD_CanNm2CanIf: PduLength=8
          TMS_0x362_P_CANFD_CanIf2PduR: PduLength=32
          TMS_0x362_P_CANFD_PduR2Com: PduLength=32
          ACU_0x15_VCU_CAN_CanIf2PduR: PduLength=32
          ACU_0x15_VCU_CAN_PduR2Com: PduLength=32
          HPCBCM_0xDA_VCU_CAN_CanIf2PduR: PduLength=16
          HPCBCM_0xDA_VCU_CAN_PduR2Com: PduLength=16
          LMC_0x133_C_CANFD_CanIf2PduR: PduLength=32
          LMC_0x133_C_CANFD_PduR2Com: PduLength=32
          LMCSSU_0x25A_C_CANFD_CanIf2PduR: PduLength=32
          LMCSSU_0x25A_C_CANFD_PduR2Com: PduLength=32
          HPCBCM_0x4A_C_CANFD_CanIf2PduR: PduLength=64
          HPCBCM_0x4A_C_CANFD_PduR2Com: PduLength=64
          ICU_0x5BE_VCU_CAN_CanIf2PduR: PduLength=128
          ICU_0x5BE_VCU_CAN_PduR2Com: PduLength=128
    EcuCRbSettings: EcuCRbArRelease=AR42_Rev2, EcuCRbRteInUse=true
  module config Com: implementation-config-variant=VARIANT-PRE-COMPILE
    ComConfig_0 (ComConfig)
      ComTimeBase: ComGwTimeBase=0.005, ComRxTimeBase=0.01, ComTxTimeBase=0.01
      ComIPduGroup_Rx (ComIPduGroup)
      EMS_0xBE_P_CANFD (ComIPdu):
        ComIPduSignalProcessing = IMMEDIATE
        ComIPduType = NORMAL
        ComIPduDirection = RECEIVE
        ComIPduCallout = ComCallOut_EMS_0xBE_P_CANFD
        ComIPduErrorNotification = ComCbk_RxTimeOut_EMS_0xBE_P_CANFD
        ComFirstTimeout = 2.3
        ComTimeout = 0.3
        ComIPduGroupRef = ComIPduGroup_Rx
        ComPduIdRef = PduCollection/EMS_0xBE_P_CANFD_PduR2Com
        ComIPduSignalRef = EMS_CRC_BE
        ComIPduSignalRef = EMS_RollingCounter_BE
        ComIPduSignalRef = EMS_EngineSts
        ComIPduSignalRef = ECM_FaultLevel
        ComIPduSignalRef = ECM_ActualEngineTorqueValid
        ComIPduSignalRef = ECM_EngineTorqueLoss
        ComIPduSignalRef = ECM_ActualEngineTorque
        ComIPduSignalRef = ECM_EngineTorqueMax
        ComIPduSignalRef = ECM_EngineTorqueMin
        ComIPduSignalRef = ECM_EngineSpeed
        ComIPduSignalRef = ECM_EngineSpeedValid
        ComIPduSignalRef = ECM_EngineStopAllow
        ComIPduSignalRef = ECM_EngineOilPressureLow
        ComIPduSignalRef = ECM_EngineFuleCutoffSts
        ComIPduSignalRef = ECM_EngineStartedCompleted
        ComIPduSignalRef = ECM_CatalystWarmUpSts
        ComIPduSignalRef = ECM_CatalystWarmUpReq
        ComIPduSignalRef = ECM_IdleTargetSpeed
        ComIPduSignalRef = ECM_IdleActive
        ComIPduSignalRef = ECM_EngineStartReq
        ComIPduSignalRef = ECM_EngineStopInhibit
        ComIPduSignalRef = ECM_GPFRegenlamp
        ComIPduSignalRef = ECM_EngineCoolantTemp
        ComIPduSignalRef = ECM_EngineCoolantTempValid
        ComIPduSignalRef = ECM_FVVSts
        ComIPduSignalRef = ECM_learningReq
        ComIPduSignalRef = ECM_EngineIdleStateRequest
        ComIPduSignalRef = ECM_EngineDFCOConditionRequest
        ComIPduSignalRef = ECM_GPFRegenReq
        ComIPduSignalRef = ECM_SVSLampRequest
        ComIPduSignalRef = ECM_TankPressure
        ComIPduSignalRef = ECM_TankPressureValid
        ComIPduSignalRef = ECM_MilLampRequest
        ComIPduSignalRef = ECM_ToothlearningSucValid
        ComIPduSignalRef = ECM_FuelCloseLoopSts
        ComIPduSignalRef = ECM_RestrictorOpenValue
        ComIPduSignalRef = ECM_FuelLevelSensorValid
        ComIPduSignalRef = ECM_FuelLevel
        ComIPduSignalRef = ECM_SelfCheckSt
        ComIPduSignalRef = ECM_PCVPipeDiagReq
        ComIPduSignalRef = ECM_CalculatedLoad
        ComIPduSignalRef = ECM_AirPressure
        ComIPduSignalRef = ECM_FanSts
        ComIPduSignalRef = ECM_ClearingSparkcarbonedRequest
      43 x ComSignal, all with ComSignalInitValue=0, ComSignalEndianness=LITTLE_ENDIAN, ComUpdateBitPosition=-1, ComTransferProperty=TRIGGERED:
        EMS_CRC_BE: ComSignalType=UINT8, ComBitSize=8, ComBitPosition=0, ComNotification=Rte_COMCbk_EMS_CRC_BE, ComSystemTemplateSystemSignalRef=EMS_CRC_BE
        EMS_RollingCounter_BE: ComSignalType=UINT8, ComBitSize=4, ComBitPosition=8, ComNotification=Rte_COMCbk_EMS_RollingCounter_BE, ComSystemTemplateSystemSignalRef=EMS_RollingCounter_BE
        EMS_EngineSts: ComSignalType=UINT8, ComBitSize=3, ComBitPosition=16, ComNotification=Rte_COMCbk_EMS_EngineSts, ComSystemTemplateSystemSignalRef=EMS_EngineSts
        ECM_FaultLevel: ComSignalType=UINT8, ComBitSize=2, ComBitPosition=19, ComNotification=Rte_COMCbk_ECM_FaultLevel, ComSystemTemplateSystemSignalRef=ECM_FaultLevel
        ECM_ActualEngineTorqueValid: ComSignalType=BOOLEAN, ComBitSize=1, ComBitPosition=21, ComNotification=Rte_COMCbk_ECM_ActualEngineTorqueValid, ComSystemTemplateSystemSignalRef=ECM_ActualEngineTorqueValid
        ECM_EngineTorqueLoss: ComSignalType=UINT16, ComBitSize=10, ComBitPosition=22, ComNotification=Rte_COMCbk_ECM_EngineTorqueLoss, ComSystemTemplateSystemSignalRef=ECM_EngineTorqueLoss
        ECM_ActualEngineTorque: ComSignalType=UINT16, ComBitSize=12, ComBitPosition=32, ComNotification=Rte_COMCbk_ECM_ActualEngineTorque, ComSystemTemplateSystemSignalRef=ECM_ActualEngineTorque
        ECM_EngineTorqueMax: ComSignalType=UINT16, ComBitSize=12, ComBitPosition=44, ComNotification=Rte_COMCbk_ECM_EngineTorqueMax, ComSystemTemplateSystemSignalRef=ECM_EngineTorqueMax
        ECM_EngineTorqueMin: ComSignalType=UINT16, ComBitSize=12, ComBitPosition=56, ComNotification=Rte_COMCbk_ECM_EngineTorqueMin, ComSystemTemplateSystemSignalRef=ECM_EngineTorqueMin
        ECM_EngineSpeed: ComSignalType=UINT16, ComBitSize=13, ComBitPosition=68, ComNotification=Rte_COMCbk_ECM_EngineSpeed, ComSystemTemplateSystemSignalRef=ECM_EngineSpeed
        ECM_EngineSpeedValid: ComSignalType=BOOLEAN, ComBitSize=1, ComBitPosition=81, ComNotification=Rte_COMCbk_ECM_EngineSpeedValid, ComSystemTemplateSystemSignalRef=ECM_EngineSpeedValid
        ECM_EngineStopAllow: ComSignalType=BOOLEAN, ComBitSize=1, ComBitPosition=82, ComNotification=Rte_COMCbk_ECM_EngineStopAllow, ComSystemTemplateSystemSignalRef=ECM_EngineStopAllow
        ECM_EngineOilPressureLow: ComSignalType=BOOLEAN, ComBitSize=1, ComBitPosition=83, ComNotification=Rte_COMCbk_ECM_EngineOilPressureLow, ComSystemTemplateSystemSignalRef=ECM_EngineOilPressureLow
        ECM_EngineFuleCutoffSts: ComSignalType=BOOLEAN, ComBitSize=1, ComBitPosition=84, ComNotification=Rte_COMCbk_ECM_EngineFuleCutoffSts, ComSystemTemplateSystemSignalRef=ECM_EngineFuleCutoffSts
        ECM_EngineStartedCompleted: ComSignalType=BOOLEAN, ComBitSize=1, ComBitPosition=85, ComNotification=Rte_COMCbk_ECM_EngineStartedCompleted, ComSystemTemplateSystemSignalRef=ECM_EngineStartedCompleted
        ECM_CatalystWarmUpSts: ComSignalType=BOOLEAN, ComBitSize=1, ComBitPosition=86, ComNotification=Rte_COMCbk_ECM_CatalystWarmUpSts, ComSystemTemplateSystemSignalRef=ECM_CatalystWarmUpSts
        ECM_CatalystWarmUpReq: ComSignalType=BOOLEAN, ComBitSize=1, ComBitPosition=87, ComNotification=Rte_COMCbk_ECM_CatalystWarmUpReq, ComSystemTemplateSystemSignalRef=ECM_CatalystWarmUpReq
        ECM_IdleTargetSpeed: ComSignalType=UINT16, ComBitSize=12, ComBitPosition=88, ComNotification=Rte_COMCbk_ECM_IdleTargetSpeed, ComSystemTemplateSystemSignalRef=ECM_IdleTargetSpeed
        ECM_IdleActive: ComSignalType=BOOLEAN, ComBitSize=1, ComBitPosition=100, ComNotification=Rte_COMCbk_ECM_IdleActive, ComSystemTemplateSystemSignalRef=ECM_IdleActive
        ECM_EngineStartReq: ComSignalType=UINT8, ComBitSize=3, ComBitPosition=101, ComNotification=Rte_COMCbk_ECM_EngineStartReq, ComSystemTemplateSystemSignalRef=ECM_EngineStartReq
        ECM_EngineStopInhibit: ComSignalType=UINT16, ComBitSize=10, ComBitPosition=104, ComNotification=Rte_COMCbk_ECM_EngineStopInhibit, ComSystemTemplateSystemSignalRef=ECM_EngineStopInhibit
        ECM_GPFRegenlamp: ComSignalType=UINT8, ComBitSize=2, ComBitPosition=114, ComNotification=Rte_COMCbk_ECM_GPFRegenlamp, ComSystemTemplateSystemSignalRef=ECM_GPFRegenlamp
        ECM_EngineCoolantTemp: ComSignalType=UINT8, ComBitSize=8, ComBitPosition=136, ComNotification=Rte_COMCbk_ECM_EngineCoolantTemp, ComSystemTemplateSystemSignalRef=ECM_EngineCoolantTemp
        ECM_EngineCoolantTempValid: ComSignalType=BOOLEAN, ComBitSize=1, ComBitPosition=144, ComNotification=Rte_COMCbk_ECM_EngineCoolantTempValid, ComSystemTemplateSystemSignalRef=ECM_EngineCoolantTempValid
        ECM_FVVSts: ComSignalType=UINT8, ComBitSize=2, ComBitPosition=145, ComNotification=Rte_COMCbk_ECM_FVVSts, ComSystemTemplateSystemSignalRef=ECM_FVVSts
        ECM_learningReq: ComSignalType=BOOLEAN, ComBitSize=1, ComBitPosition=147, ComNotification=Rte_COMCbk_ECM_learningReq, ComSystemTemplateSystemSignalRef=ECM_learningReq
        ECM_EngineIdleStateRequest: ComSignalType=BOOLEAN, ComBitSize=1, ComBitPosition=148, ComNotification=Rte_COMCbk_ECM_EngineIdleStateRequest, ComSystemTemplateSystemSignalRef=ECM_EngineIdleStateRequest
        ECM_EngineDFCOConditionRequest: ComSignalType=BOOLEAN, ComBitSize=1, ComBitPosition=149, ComNotification=Rte_COMCbk_ECM_EngineDFCOConditionRequest, ComSystemTemplateSystemSignalRef=ECM_EngineDFCOConditionRequest
        ECM_GPFRegenReq: ComSignalType=BOOLEAN, ComBitSize=1, ComBitPosition=150, ComNotification=Rte_COMCbk_ECM_GPFRegenReq, ComSystemTemplateSystemSignalRef=ECM_GPFRegenReq
        ECM_SVSLampRequest: ComSignalType=BOOLEAN, ComBitSize=1, ComBitPosition=151, ComNotification=Rte_COMCbk_ECM_SVSLampRequest, ComSystemTemplateSystemSignalRef=ECM_SVSLampRequest
        ECM_TankPressure: ComSignalType=UINT16, ComBitSize=10, ComBitPosition=152, ComNotification=Rte_COMCbk_ECM_TankPressure, ComSystemTemplateSystemSignalRef=ECM_TankPressure
        ECM_TankPressureValid: ComSignalType=BOOLEAN, ComBitSize=1, ComBitPosition=162, ComNotification=Rte_COMCbk_ECM_TankPressureValid, ComSystemTemplateSystemSignalRef=ECM_TankPressureValid
        ECM_MilLampRequest: ComSignalType=UINT8, ComBitSize=2, ComBitPosition=163, ComNotification=Rte_COMCbk_ECM_MilLampRequest, ComSystemTemplateSystemSignalRef=ECM_MilLampRequest
        ECM_ToothlearningSucValid: ComSignalType=UINT8, ComBitSize=2, ComBitPosition=165, ComNotification=Rte_COMCbk_ECM_ToothlearningSucValid, ComSystemTemplateSystemSignalRef=ECM_ToothlearningSucValid
        ECM_FuelCloseLoopSts: ComSignalType=BOOLEAN, ComBitSize=1, ComBitPosition=167, ComNotification=Rte_COMCbk_ECM_FuelCloseLoopSts, ComSystemTemplateSystemSignalRef=ECM_FuelCloseLoopSts
        ECM_RestrictorOpenValue: ComSignalType=UINT8, ComBitSize=7, ComBitPosition=168, ComNotification=Rte_COMCbk_ECM_RestrictorOpenValue, ComSystemTemplateSystemSignalRef=ECM_RestrictorOpenValue
        ECM_FuelLevelSensorValid: ComSignalType=BOOLEAN, ComBitSize=1, ComBitPosition=175, ComNotification=Rte_COMCbk_ECM_FuelLevelSensorValid, ComSystemTemplateSystemSignalRef=ECM_FuelLevelSensorValid
        ECM_FuelLevel: ComSignalType=UINT16, ComBitSize=10, ComBitPosition=176, ComNotification=Rte_COMCbk_ECM_FuelLevel, ComSystemTemplateSystemSignalRef=ECM_FuelLevel
        ECM_SelfCheckSt: ComSignalType=BOOLEAN, ComBitSize=1, ComBitPosition=186, ComNotification=Rte_COMCbk_ECM_SelfCheckSt, ComSystemTemplateSystemSignalRef=ECM_SelfCheckSt
        ECM_PCVPipeDiagReq: ComSignalType=BOOLEAN, ComBitSize=1, ComBitPosition=187, ComNotification=Rte_COMCbk_ECM_PCVPipeDiagReq, ComSystemTemplateSystemSignalRef=ECM_PCVPipeDiagReq
        ECM_CalculatedLoad: ComSignalType=UINT16, ComBitSize=10, ComBitPosition=190, ComNotification=Rte_COMCbk_ECM_CalculatedLoad, ComSystemTemplateSystemSignalRef=ECM_CalculatedLoad
        ECM_AirPressure: ComSignalType=UINT8, ComBitSize=8, ComBitPosition=208, ComNotification=Rte_COMCbk_ECM_AirPressure, ComSystemTemplateSystemSignalRef=ECM_AirPressure
        ECM_FanSts: ComSignalType=UINT8, ComBitSize=8, ComBitPosition=216, ComNotification=Rte_COMCbk_ECM_FanSts, ComSystemTemplateSystemSignalRef=ECM_FanSts
      BMS_0x5B5_P_CANFD (ComIPdu):
        ComIPduSignalProcessing = IMMEDIATE
        ComIPduType = NORMAL
        ComIPduDirection = RECEIVE
        ComIPduGroupRef = ComIPduGroup_Rx
        ComPduIdRef = PduCollection/BMS_0x5B5_P_CANFD_PduR2Com
        ComIPduSignalRef = BMS_WkupVolt_DC12V
        ComIPduSignalRef = BMS_WkupVolt_AC12V
        ComIPduSignalRef = BMS_HVPackPosRelayExternalVolt
        ComIPduSignalRef = BMS_SOC_target
        ComIPduSignalRef = BMS_CorrectSOEPer
        ComIPduSignalRef = BMS_SOCModifyFlag
        ComIPduSignalRef = BMS_BMU_SoftwareVersion
      7 x ComSignal, all with ComSignalInitValue=0, ComSignalEndianness=LITTLE_ENDIAN, ComUpdateBitPosition=-1, ComTransferProperty=TRIGGERED:
        BMS_WkupVolt_DC12V: ComSignalType=UINT8, ComBitSize=8, ComBitPosition=64, ComNotification=Rte_COMCbk_BMS_WkupVolt_DC12V, ComSystemTemplateSystemSignalRef=BMS_WkupVolt_DC12V
        BMS_WkupVolt_AC12V: ComSignalType=UINT8, ComBitSize=8, ComBitPosition=72, ComNotification=Rte_COMCbk_BMS_WkupVolt_AC12V, ComSystemTemplateSystemSignalRef=BMS_WkupVolt_AC12V
        BMS_HVPackPosRelayExternalVolt: ComSignalType=UINT16, ComBitSize=12, ComBitPosition=152, ComNotification=Rte_COMCbk_BMS_HVPackPosRelayExternalVolt, ComSystemTemplateSystemSignalRef=BMS_HVPackPosRelayExternalVolt
        BMS_SOC_target: ComSignalType=UINT16, ComBitSize=10, ComBitPosition=192, ComNotification=Rte_COMCbk_BMS_SOC_target, ComSystemTemplateSystemSignalRef=BMS_SOC_target
        BMS_CorrectSOEPer: ComSignalType=UINT16, ComBitSize=10, ComBitPosition=202, ComNotification=Rte_COMCbk_BMS_CorrectSOEPer, ComSystemTemplateSystemSignalRef=BMS_CorrectSOEPer
        BMS_SOCModifyFlag: ComSignalType=BOOLEAN, ComBitSize=1, ComBitPosition=212, ComNotification=Rte_COMCbk_BMS_SOCModifyFlag, ComSystemTemplateSystemSignalRef=BMS_SOCModifyFlag
        BMS_BMU_SoftwareVersion: ComSignalType=UINT32, ComBitSize=24, ComBitPosition=232, ComNotification=Rte_COMCbk_BMS_BMU_SoftwareVersion, ComSystemTemplateSystemSignalRef=BMS_BMU_SoftwareVersion
      OBC_0x316_P_CANFD (ComIPdu):
        ComIPduSignalProcessing = IMMEDIATE
        ComIPduType = NORMAL
        ComIPduDirection = RECEIVE
        ComIPduCallout = ComCallOut_OBC_0x316_P_CANFD
        ComIPduErrorNotification = ComCbk_RxTimeOut_OBC_0x316_P_CANFD
        ComFirstTimeout = 3.0
        ComTimeout = 1.0
        ComIPduGroupRef = ComIPduGroup_Rx
        ComPduIdRef = PduCollection/OBC_0x316_P_CANFD_PduR2Com
        ComIPduSignalRef = OBC_CRC_316
        ComIPduSignalRef = OBC_RollingCounter_316
        ComIPduSignalRef = OBC_WorkSts
        ComIPduSignalRef = OBC_StartSts
        ComIPduSignalRef = OBC_DCSts
        ComIPduSignalRef = OBC_ACChargeOutputSts
        ComIPduSignalRef = OBC_DCVolt
        ComIPduSignalRef = OBC_HardwareSts
        ComIPduSignalRef = OBC_DCCurr
        ComIPduSignalRef = OBC_ACVolt
        ComIPduSignalRef = OBC_ACCurr
        ComIPduSignalRef = OBC_CCConnectSts
        ComIPduSignalRef = OBC_CPDutyCycleFault
        ComIPduSignalRef = OBC_CPDutyCycleValue
        ComIPduSignalRef = OBC_ACMaxPower
        ComIPduSignalRef = OBC_ACPowerState
      16 x ComSignal, all with ComSignalInitValue=0, ComSignalEndianness=LITTLE_ENDIAN, ComUpdateBitPosition=-1, ComTransferProperty=TRIGGERED:
        OBC_CRC_316: ComSignalType=UINT8, ComBitSize=8, ComBitPosition=0, ComNotification=Rte_COMCbk_OBC_CRC_316, ComSystemTemplateSystemSignalRef=OBC_CRC_316
        OBC_RollingCounter_316: ComSignalType=UINT8, ComBitSize=4, ComBitPosition=8, ComNotification=Rte_COMCbk_OBC_RollingCounter_316, ComSystemTemplateSystemSignalRef=OBC_RollingCounter_316
        OBC_WorkSts: ComSignalType=UINT8, ComBitSize=3, ComBitPosition=16, ComNotification=Rte_COMCbk_OBC_WorkSts, ComSystemTemplateSystemSignalRef=OBC_WorkSts
        OBC_StartSts: ComSignalType=BOOLEAN, ComBitSize=1, ComBitPosition=19, ComNotification=Rte_COMCbk_OBC_StartSts, ComSystemTemplateSystemSignalRef=OBC_StartSts
        OBC_DCSts: ComSignalType=BOOLEAN, ComBitSize=1, ComBitPosition=20, ComNotification=Rte_COMCbk_OBC_DCSts, ComSystemTemplateSystemSignalRef=OBC_DCSts
        OBC_ACChargeOutputSts: ComSignalType=BOOLEAN, ComBitSize=1, ComBitPosition=23, ComNotification=Rte_COMCbk_OBC_ACChargeOutputSts, ComSystemTemplateSystemSignalRef=OBC_ACChargeOutputSts
        OBC_DCVolt: ComSignalType=UINT16, ComBitSize=14, ComBitPosition=24, ComNotification=Rte_COMCbk_OBC_DCVolt, ComSystemTemplateSystemSignalRef=OBC_DCVolt
        OBC_HardwareSts: ComSignalType=BOOLEAN, ComBitSize=1, ComBitPosition=39, ComNotification=Rte_COMCbk_OBC_HardwareSts, ComSystemTemplateSystemSignalRef=OBC_HardwareSts
        OBC_DCCurr: ComSignalType=UINT16, ComBitSize=11, ComBitPosition=40, ComNotification=Rte_COMCbk_OBC_DCCurr, ComSystemTemplateSystemSignalRef=OBC_DCCurr
        OBC_ACVolt: ComSignalType=UINT16, ComBitSize=13, ComBitPosition=51, ComNotification=Rte_COMCbk_OBC_ACVolt, ComSystemTemplateSystemSignalRef=OBC_ACVolt
        OBC_ACCurr: ComSignalType=UINT16, ComBitSize=11, ComBitPosition=64, ComNotification=Rte_COMCbk_OBC_ACCurr, ComSystemTemplateSystemSignalRef=OBC_ACCurr
        OBC_CCConnectSts: ComSignalType=UINT8, ComBitSize=2, ComBitPosition=77, ComNotification=Rte_COMCbk_OBC_CCConnectSts, ComSystemTemplateSystemSignalRef=OBC_CCConnectSts
        OBC_CPDutyCycleFault: ComSignalType=BOOLEAN, ComBitSize=1, ComBitPosition=79, ComNotification=Rte_COMCbk_OBC_CPDutyCycleFault, ComSystemTemplateSystemSignalRef=OBC_CPDutyCycleFault
        OBC_CPDutyCycleValue: ComSignalType=UINT8, ComBitSize=8, ComBitPosition=80, ComNotification=Rte_COMCbk_OBC_CPDutyCycleValue, ComSystemTemplateSystemSignalRef=OBC_CPDutyCycleValue
        OBC_ACMaxPower: ComSignalType=UINT16, ComBitSize=10, ComBitPosition=88, ComNotification=Rte_COMCbk_OBC_ACMaxPower, ComSystemTemplateSystemSignalRef=OBC_ACMaxPower
        OBC_ACPowerState: ComSignalType=UINT8, ComBitSize=2, ComBitPosition=158, ComNotification=Rte_COMCbk_OBC_ACPowerState, ComSystemTemplateSystemSignalRef=OBC_ACPowerState
      TMS_0x5FF_P_CANFD (ComIPdu):
        ComIPduSignalProcessing = IMMEDIATE
        ComIPduType = NORMAL
        ComIPduDirection = RECEIVE
        ComIPduCallout = ComCallOut_TMS_0x5FF_P_CANFD
        ComIPduErrorNotification = ComCbk_RxTimeOut_TMS_0x5FF_P_CANFD
        ComFirstTimeout = 3.0
        ComTimeout = 1.0
        ComIPduGroupRef = ComIPduGroup_Rx
        ComPduIdRef = PduCollection/TMS_0x5FF_P_CANFD_PduR2Com
        ComIPduSignalRef = TMS_MCUMHeatPwrReq
        ComIPduSignalRef = TMS_MCUMHeatModEnad
        ComIPduSignalRef = TMS_VCU_MotSelfHeatEnReq
        ComIPduSignalRef = TMS_VCU_MotSelfHeatLvlReq
      4 x ComSignal, all with ComSignalInitValue=0, ComSignalEndianness=LITTLE_ENDIAN, ComUpdateBitPosition=-1, ComTransferProperty=TRIGGERED:
        TMS_MCUMHeatPwrReq: ComSignalType=UINT8, ComBitSize=8, ComBitPosition=64, ComNotification=Rte_COMCbk_TMS_MCUMHeatPwrReq, ComSystemTemplateSystemSignalRef=TMS_MCUMHeatPwrReq
        TMS_MCUMHeatModEnad: ComSignalType=BOOLEAN, ComBitSize=1, ComBitPosition=72, ComNotification=Rte_COMCbk_TMS_MCUMHeatModEnad, ComSystemTemplateSystemSignalRef=TMS_MCUMHeatModEnad
        TMS_VCU_MotSelfHeatEnReq: ComSignalType=BOOLEAN, ComBitSize=1, ComBitPosition=60, ComNotification=Rte_COMCbk_TMS_VCU_MotSelfHeatEnReq, ComSystemTemplateSystemSignalRef=TMS_VCU_MotSelfHeatEnReq
        TMS_VCU_MotSelfHeatLvlReq: ComSignalType=UINT8, ComBitSize=4, ComBitPosition=73, ComNotification=Rte_COMCbk_TMS_VCU_MotSelfHeatLvlReq, ComSystemTemplateSystemSignalRef=TMS_VCU_MotSelfHeatLvlReq
      TMS_0x5FE_P_CANFD (ComIPdu):
        ComIPduSignalProcessing = IMMEDIATE
        ComIPduType = NORMAL
        ComIPduDirection = RECEIVE
        ComIPduCallout = ComCallOut_TMS_0x5FE_P_CANFD
        ComIPduErrorNotification = ComCbk_RxTimeOut_TMS_0x5FE_P_CANFD
        ComFirstTimeout = 3.0
        ComTimeout = 1.0
        ComIPduGroupRef = ComIPduGroup_Rx
        ComPduIdRef = PduCollection/TMS_0x5FE_P_CANFD_PduR2Com
        ComIPduSignalRef = TMS_MilLampReq
      TMS_MilLampReq (ComSignal):
        ComSignalInitValue = 0
        ComSignalType = UINT8
        ComSignalEndianness = LITTLE_ENDIAN
        ComBitSize = 2
        ComBitPosition = 22
        ComUpdateBitPosition = -1
        ComTransferProperty = TRIGGERED
        ComNotification = Rte_COMCbk_TMS_MilLampReq
        ComSystemTemplateSystemSignalRef = TMS_MilLampReq
      BMS_0x5B1_P_CANFD (ComIPdu):
        ComIPduSignalProcessing = IMMEDIATE
        ComIPduType = NORMAL
        ComIPduDirection = RECEIVE
        ComIPduCallout = ComCallOut_BMS_0x5B1_P_CANFD
        ComIPduErrorNotification = ComCbk_RxTimeOut_BMS_0x5B1_P_CANFD
        ComFirstTimeout = 7.0
        ComTimeout = 5.0
        ComIPduGroupRef = ComIPduGroup_Rx
        ComPduIdRef = PduCollection/BMS_0x5B1_P_CANFD_PduR2Com
        ComIPduSignalRef = BMS_SOC_Real
        ComIPduSignalRef = BMS_MODE_t
        ComIPduSignalRef = BMS_VoltLoDeratLevel_NA
        ComIPduSignalRef = BMS_VoltHiDeratLevel_NA
      4 x ComSignal, all with ComSignalInitValue=0, ComSignalEndianness=LITTLE_ENDIAN, ComUpdateBitPosition=-1, ComTransferProperty=TRIGGERED:
        BMS_SOC_Real: ComSignalType=UINT16, ComBitSize=10, ComBitPosition=320, ComNotification=Rte_COMCbk_BMS_SOC_Real, ComSystemTemplateSystemSignalRef=BMS_SOC_Real
        BMS_MODE_t: ComSignalType=UINT8, ComBitSize=4, ComBitPosition=368, ComNotification=Rte_COMCbk_BMS_MODE_t, ComSystemTemplateSystemSignalRef=BMS_MODE_t
        BMS_VoltLoDeratLevel_NA: ComSignalType=UINT8, ComBitSize=2, ComBitPosition=466, ComNotification=Rte_COMCbk_BMS_VoltLoDeratLevel_NA, ComSystemTemplateSystemSignalRef=BMS_VoltLoDeratLevel_NA
        BMS_VoltHiDeratLevel_NA: ComSignalType=UINT8, ComBitSize=2, ComBitPosition=468, ComNotification=Rte_COMCbk_BMS_VoltHiDeratLevel_NA, ComSystemTemplateSystemSignalRef=BMS_VoltHiDeratLevel_NA
      PTC_0x367_P_CANFD (ComIPdu):
        ComIPduSignalProcessing = IMMEDIATE
        ComIPduType = NORMAL
        ComIPduDirection = RECEIVE
        ComIPduCallout = ComCallOut_PTC_0x367_P_CANFD
        ComIPduErrorNotification = ComCbk_RxTimeOut_PTC_0x367_P_CANFD
        ComTimeout = 1.0
        ComFirstTimeout = 3.0
        ComIPduGroupRef = ComIPduGroup_Rx
        ComPduIdRef = PduCollection/PTC_0x367_P_CANFD_PduR2Com
        ComIPduSignalRef = PTC_BscSts
        ComIPduSignalRef = PTC_RollingCounter_367
        ComIPduSignalRef = PTC_Fault
        ComIPduSignalRef = PTC_Power
        ComIPduSignalRef = PTC_HV_interlock_faultSt
      5 x ComSignal, all with ComSignalInitValue=0, ComSignalEndianness=LITTLE_ENDIAN, ComUpdateBitPosition=-1, ComTransferProperty=TRIGGERED:
        PTC_BscSts: ComSignalType=BOOLEAN, ComBitSize=1, ComBitPosition=16, ComNotification=Rte_COMCbk_PTC_BscSts, ComSystemTemplateSystemSignalRef=PTC_BscSts
        PTC_RollingCounter_367: ComSignalType=UINT8, ComBitSize=4, ComBitPosition=8, ComNotification=Rte_COMCbk_PTC_RollingCounter_367, ComSystemTemplateSystemSignalRef=PTC_RollingCounter_367
        PTC_Fault: ComSignalType=BOOLEAN, ComBitSize=1, ComBitPosition=17, ComNotification=Rte_COMCbk_PTC_Fault, ComSystemTemplateSystemSignalRef=PTC_Fault
        PTC_Power: ComSignalType=UINT8, ComBitSize=8, ComBitPosition=32, ComNotification=Rte_COMCbk_PTC_Power, ComSystemTemplateSystemSignalRef=PTC_Power
        PTC_HV_interlock_faultSt: ComSignalType=BOOLEAN, ComBitSize=1, ComBitPosition=75, ComNotification=Rte_COMCbk_PTC_HV_interlock_faultSt, ComSystemTemplateSystemSignalRef=PTC_HV_interlock_faultSt
      MCU_0x5C7_P_CANFD (ComIPdu):
        ComIPduSignalProcessing = IMMEDIATE
        ComIPduType = NORMAL
        ComIPduDirection = RECEIVE
        ComPduIdRef = PduCollection/MCU_0x5C7_P_CANFD_PduR2Com
        ComIPduSignalRef = U16_CMD{1..4}
        ComIPduSignalRef = S16_CMD{1..4}
        ComIPduSignalRef = R16_CMD{1..4}
        ComIPduSignalRef = U8_CMD{1..8}
        ComIPduGroupRef = ComIPduGroup_DevMCU
      20 x ComSignal, all with ComSignalInitValue=0, ComSignalEndianness=LITTLE_ENDIAN, ComUpdateBitPosition=-1, ComTransferProperty=TRIGGERED:
        U16_CMD1: ComSignalType=UINT16, ComBitSize=16, ComBitPosition=0, ComNotification=Rte_COMCbk_U16_CMD1, ComSystemTemplateSystemSignalRef=U16_CMD1
        U16_CMD2: ComSignalType=UINT16, ComBitSize=16, ComBitPosition=16, ComNotification=Rte_COMCbk_U16_CMD2, ComSystemTemplateSystemSignalRef=U16_CMD2
        U16_CMD3: ComSignalType=UINT16, ComBitSize=16, ComBitPosition=32, ComNotification=Rte_COMCbk_U16_CMD3, ComSystemTemplateSystemSignalRef=U16_CMD3
        U16_CMD4: ComSignalType=UINT16, ComBitSize=16, ComBitPosition=48, ComNotification=Rte_COMCbk_U16_CMD4, ComSystemTemplateSystemSignalRef=U16_CMD4
        S16_CMD1: ComSignalType=UINT16, ComBitSize=16, ComBitPosition=64, ComNotification=Rte_COMCbk_S16_CMD1, ComSystemTemplateSystemSignalRef=S16_CMD1
        S16_CMD2: ComSignalType=UINT16, ComBitSize=16, ComBitPosition=80, ComNotification=Rte_COMCbk_S16_CMD2, ComSystemTemplateSystemSignalRef=S16_CMD2
        S16_CMD3: ComSignalType=UINT16, ComBitSize=16, ComBitPosition=96, ComNotification=Rte_COMCbk_S16_CMD3, ComSystemTemplateSystemSignalRef=S16_CMD3
        S16_CMD4: ComSignalType=UINT16, ComBitSize=16, ComBitPosition=112, ComNotification=Rte_COMCbk_S16_CMD4, ComSystemTemplateSystemSignalRef=S16_CMD4
        R16_CMD1: ComSignalType=UINT16, ComBitSize=16, ComBitPosition=128, ComNotification=Rte_COMCbk_R16_CMD1, ComSystemTemplateSystemSignalRef=R16_CMD1
        R16_CMD2: ComSignalType=UINT16, ComBitSize=16, ComBitPosition=144, ComNotification=Rte_COMCbk_R16_CMD2, ComSystemTemplateSystemSignalRef=R16_CMD2
        R16_CMD3: ComSignalType=UINT16, ComBitSize=16, ComBitPosition=160, ComNotification=Rte_COMCbk_R16_CMD3, ComSystemTemplateSystemSignalRef=R16_CMD3
        R16_CMD4: ComSignalType=UINT16, ComBitSize=16, ComBitPosition=176, ComNotification=Rte_COMCbk_R16_CMD4, ComSystemTemplateSystemSignalRef=R16_CMD4
        U8_CMD1: ComSignalType=UINT8, ComBitSize=8, ComBitPosition=192, ComNotification=Rte_COMCbk_U8_CMD1, ComSystemTemplateSystemSignalRef=U8_CMD1
        U8_CMD2: ComSignalType=UINT8, ComBitSize=8, ComBitPosition=200, ComNotification=Rte_COMCbk_U8_CMD2, ComSystemTemplateSystemSignalRef=U8_CMD2
        U8_CMD3: ComSignalType=UINT8, ComBitSize=8, ComBitPosition=208, ComNotification=Rte_COMCbk_U8_CMD3, ComSystemTemplateSystemSignalRef=U8_CMD3
        U8_CMD4: ComSignalType=UINT8, ComBitSize=8, ComBitPosition=216, ComNotification=Rte_COMCbk_U8_CMD4, ComSystemTemplateSystemSignalRef=U8_CMD4
        U8_CMD5: ComSignalType=UINT8, ComBitSize=8, ComBitPosition=224, ComNotification=Rte_COMCbk_U8_CMD5, ComSystemTemplateSystemSignalRef=U8_CMD5
        U8_CMD6: ComSignalType=UINT8, ComBitSize=8, ComBitPosition=232, ComNotification=Rte_COMCbk_U8_CMD6, ComSystemTemplateSystemSignalRef=U8_CMD6
        U8_CMD7: ComSignalType=UINT8, ComBitSize=8, ComBitPosition=240, ComNotification=Rte_COMCbk_U8_CMD7, ComSystemTemplateSystemSignalRef=U8_CMD7
        U8_CMD8: ComSignalType=UINT8, ComBitSize=8, ComBitPosition=248, ComNotification=Rte_COMCbk_U8_CMD8, ComSystemTemplateSystemSignalRef=U8_CMD8
      MCU_0x5C5_P_CANFD (ComIPdu):
        ComIPduSignalProcessing = IMMEDIATE
        ComIPduType = NORMAL
        ComIPduDirection = RECEIVE
        ComIpduNotificationCallback = COMCbk_RxIPduNotify_MCU_0x5C5_P_CANFD
        ComPduIdRef = PduCollection/MCU_0x5C5_P_CANFD_PduR2Com
        ComIPduSignalRef = EOL_ModeCMD_Data{0..5}
        ComIPduSignalRef = EOL_ModeCMD_Enable
        ComIPduSignalRef = EOL_ModeCMD_Check
        ComIPduSignalRef = EOL_GainIden_UsApply
        ComIPduSignalRef = EOL_MotClb_CtrlMode
        ComIPduSignalRef = MotClb_OfsSet
        ComIPduSignalRef = EOL_MotClb_IsCMD
        ComIPduSignalRef = EOL_MotClb_ThetaCMD
        ComIPduSignalRef = EOL_frqsync
        ComIPduSignalRef = EOL_MotClb_Enable
        ComIPduSignalRef = EOL_ActiveReleaseCmd
        ComIPduSignalRef = MotClb_OfsAdjEn
        ComIPduSignalRef = EOL_Asc_CMD
        ComIPduSignalRef = EOL_PosDly_SnsrSupplier
        ComIPduSignalRef = FstRcrd_Enable
        ComIPduSignalRef = GainIden_CurrRMS_Ref_U
        ComIPduSignalRef = GainIden_CurrRMS_Ref_V
        ComIPduSignalRef = GainIden_CurrRMS_Ref_W
        ComIPduSignalRef = MCUMR_EOL_GainIden_UsApply
        ComIPduSignalRef = MCUMR_EOL_MotClb_CtrlMode
        ComIPduSignalRef = MCUMR_MotClb_OfsSet
        ComIPduSignalRef = MCUMR_EOL_MotClb_IsCMD
        ComIPduSignalRef = MCUMR_EOL_MotClb_ThetaCMD
        ComIPduSignalRef = MCUMR_EOL_frqsync
        ComIPduSignalRef = MCUMR_EOL_MotClb_Enable
        ComIPduSignalRef = MCUMR_EOL_ActiveReleaseCmd
        ComIPduSignalRef = MCUMR_MotClb_OfsAdjEn
        ComIPduSignalRef = MCUMR_EOL_Asc_CMD
        ComIPduSignalRef = MCUMR_EOL_PosDly_SnsrSupplier
        ComIPduSignalRef = MCUMR_FstRcrd_Enable
        ComIPduSignalRef = MCUMR_GainIden_CurrRMS_Ref_U
        ComIPduSignalRef = MCUMR_GainIden_CurrRMS_Ref_V
        ComIPduSignalRef = MCUMR_GainIden_CurrRMS_Ref_W
        ComIPduGroupRef = ComIPduGroup_DevMCU
      38 x ComSignal, all with ComSignalInitValue=0, ComSignalEndianness=LITTLE_ENDIAN, ComUpdateBitPosition=-1, ComTransferProperty=TRIGGERED:
        EOL_ModeCMD_Data0: ComSignalType=UINT8, ComBitSize=8, ComBitPosition=0, ComNotification=Rte_COMCbk_EOL_ModeCMD_Data0, ComSystemTemplateSystemSignalRef=EOL_ModeCMD_Data0
        EOL_ModeCMD_Data1: ComSignalType=UINT8, ComBitSize=8, ComBitPosition=8, ComNotification=Rte_COMCbk_EOL_ModeCMD_Data1, ComSystemTemplateSystemSignalRef=EOL_ModeCMD_Data1
        EOL_ModeCMD_Data2: ComSignalType=UINT8, ComBitSize=8, ComBitPosition=16, ComNotification=Rte_COMCbk_EOL_ModeCMD_Data2, ComSystemTemplateSystemSignalRef=EOL_ModeCMD_Data2
        EOL_ModeCMD_Data3: ComSignalType=UINT8, ComBitSize=8, ComBitPosition=24, ComNotification=Rte_COMCbk_EOL_ModeCMD_Data3, ComSystemTemplateSystemSignalRef=EOL_ModeCMD_Data3
        EOL_ModeCMD_Data4: ComSignalType=UINT8, ComBitSize=8, ComBitPosition=32, ComNotification=Rte_COMCbk_EOL_ModeCMD_Data4, ComSystemTemplateSystemSignalRef=EOL_ModeCMD_Data4
        EOL_ModeCMD_Data5: ComSignalType=UINT8, ComBitSize=8, ComBitPosition=40, ComNotification=Rte_COMCbk_EOL_ModeCMD_Data5, ComSystemTemplateSystemSignalRef=EOL_ModeCMD_Data5
        EOL_ModeCMD_Enable: ComSignalType=UINT8, ComBitSize=8, ComBitPosition=48, ComNotification=Rte_COMCbk_EOL_ModeCMD_Enable, ComSystemTemplateSystemSignalRef=EOL_ModeCMD_Enable
        EOL_ModeCMD_Check: ComSignalType=UINT8, ComBitSize=8, ComBitPosition=56, ComNotification=Rte_COMCbk_EOL_ModeCMD_Check, ComSystemTemplateSystemSignalRef=EOL_ModeCMD_Check
        EOL_GainIden_UsApply: ComSignalType=UINT16, ComBitSize=12, ComBitPosition=64, ComNotification=Rte_COMCbk_EOL_GainIden_UsApply, ComSystemTemplateSystemSignalRef=EOL_GainIden_UsApply
        EOL_MotClb_CtrlMode: ComSignalType=UINT8, ComBitSize=4, ComBitPosition=76, ComNotification=Rte_COMCbk_EOL_MotClb_CtrlMode, ComSystemTemplateSystemSignalRef=EOL_MotClb_CtrlMode
        MotClb_OfsSet: ComSignalType=UINT16, ComBitSize=16, ComBitPosition=80, ComNotification=Rte_COMCbk_MotClb_OfsSet, ComSystemTemplateSystemSignalRef=MotClb_OfsSet
        EOL_MotClb_IsCMD: ComSignalType=UINT16, ComBitSize=16, ComBitPosition=96, ComNotification=Rte_COMCbk_EOL_MotClb_IsCMD, ComSystemTemplateSystemSignalRef=EOL_MotClb_IsCMD
        EOL_MotClb_ThetaCMD: ComSignalType=UINT16, ComBitSize=16, ComBitPosition=112, ComNotification=Rte_COMCbk_EOL_MotClb_ThetaCMD, ComSystemTemplateSystemSignalRef=EOL_MotClb_ThetaCMD
        EOL_frqsync: ComSignalType=UINT16, ComBitSize=16, ComBitPosition=128, ComNotification=Rte_COMCbk_EOL_frqsync, ComSystemTemplateSystemSignalRef=EOL_frqsync
        EOL_MotClb_Enable: ComSignalType=UINT8, ComBitSize=2, ComBitPosition=144, ComNotification=Rte_COMCbk_EOL_MotClb_Enable, ComSystemTemplateSystemSignalRef=EOL_MotClb_Enable
        EOL_ActiveReleaseCmd: ComSignalType=BOOLEAN, ComBitSize=1, ComBitPosition=146, ComNotification=Rte_COMCbk_EOL_ActiveReleaseCmd, ComSystemTemplateSystemSignalRef=EOL_ActiveReleaseCmd
        MotClb_OfsAdjEn: ComSignalType=BOOLEAN, ComBitSize=1, ComBitPosition=147, ComNotification=Rte_COMCbk_MotClb_OfsAdjEn, ComSystemTemplateSystemSignalRef=MotClb_OfsAdjEn
        EOL_Asc_CMD: ComSignalType=UINT8, ComBitSize=2, ComBitPosition=148, ComNotification=Rte_COMCbk_EOL_Asc_CMD, ComSystemTemplateSystemSignalRef=EOL_Asc_CMD
        EOL_PosDly_SnsrSupplier: ComSignalType=BOOLEAN, ComBitSize=1, ComBitPosition=150, ComNotification=Rte_COMCbk_EOL_PosDly_SnsrSupplier, ComSystemTemplateSystemSignalRef=EOL_PosDly_SnsrSupplier
        FstRcrd_Enable: ComSignalType=BOOLEAN, ComBitSize=1, ComBitPosition=151, ComNotification=Rte_COMCbk_FstRcrd_Enable, ComSystemTemplateSystemSignalRef=FstRcrd_Enable
        GainIden_CurrRMS_Ref_U: ComSignalType=UINT16, ComBitSize=13, ComBitPosition=152, ComNotification=Rte_COMCbk_GainIden_CurrRMS_Ref_U, ComSystemTemplateSystemSignalRef=GainIden_CurrRMS_Ref_U
        GainIden_CurrRMS_Ref_V: ComSignalType=UINT16, ComBitSize=13, ComBitPosition=165, ComNotification=Rte_COMCbk_GainIden_CurrRMS_Ref_V, ComSystemTemplateSystemSignalRef=GainIden_CurrRMS_Ref_V
        GainIden_CurrRMS_Ref_W: ComSignalType=UINT16, ComBitSize=13, ComBitPosition=178, ComNotification=Rte_COMCbk_GainIden_CurrRMS_Ref_W, ComSystemTemplateSystemSignalRef=GainIden_CurrRMS_Ref_W
        MCUMR_EOL_GainIden_UsApply: ComSignalType=UINT16, ComBitSize=12, ComBitPosition=192, ComNotification=Rte_COMCbk_MCUMR_EOL_GainIden_UsApply, ComSystemTemplateSystemSignalRef=MCUMR_EOL_GainIden_UsApply
        MCUMR_EOL_MotClb_CtrlMode: ComSignalType=UINT8, ComBitSize=4, ComBitPosition=204, ComNotification=Rte_COMCbk_MCUMR_EOL_MotClb_CtrlMode, ComSystemTemplateSystemSignalRef=MCUMR_EOL_MotClb_CtrlMode
        MCUMR_MotClb_OfsSet: ComSignalType=UINT16, ComBitSize=16, ComBitPosition=208, ComNotification=Rte_COMCbk_MCUMR_MotClb_OfsSet, ComSystemTemplateSystemSignalRef=MCUMR_MotClb_OfsSet
        MCUMR_EOL_MotClb_IsCMD: ComSignalType=UINT16, ComBitSize=16, ComBitPosition=224, ComNotification=Rte_COMCbk_MCUMR_EOL_MotClb_IsCMD, ComSystemTemplateSystemSignalRef=MCUMR_EOL_MotClb_IsCMD
        MCUMR_EOL_MotClb_ThetaCMD: ComSignalType=UINT16, ComBitSize=16, ComBitPosition=240, ComNotification=Rte_COMCbk_MCUMR_EOL_MotClb_ThetaCMD, ComSystemTemplateSystemSignalRef=MCUMR_EOL_MotClb_ThetaCMD
        MCUMR_EOL_frqsync: ComSignalType=UINT16, ComBitSize=16, ComBitPosition=256, ComNotification=Rte_COMCbk_MCUMR_EOL_frqsync, ComSystemTemplateSystemSignalRef=MCUMR_EOL_frqsync
        MCUMR_EOL_MotClb_Enable: ComSignalType=UINT8, ComBitSize=2, ComBitPosition=272, ComNotification=Rte_COMCbk_MCUMR_EOL_MotClb_Enable, ComSystemTemplateSystemSignalRef=MCUMR_EOL_MotClb_Enable
        MCUMR_EOL_ActiveReleaseCmd: ComSignalType=BOOLEAN, ComBitSize=1, ComBitPosition=274, ComNotification=Rte_COMCbk_MCUMR_EOL_ActiveReleaseCmd, ComSystemTemplateSystemSignalRef=MCUMR_EOL_ActiveReleaseCmd
        MCUMR_MotClb_OfsAdjEn: ComSignalType=BOOLEAN, ComBitSize=1, ComBitPosition=275, ComNotification=Rte_COMCbk_MCUMR_MotClb_OfsAdjEn, ComSystemTemplateSystemSignalRef=MCUMR_MotClb_OfsAdjEn
        MCUMR_EOL_Asc_CMD: ComSignalType=UINT8, ComBitSize=2, ComBitPosition=276, ComNotification=Rte_COMCbk_MCUMR_EOL_Asc_CMD, ComSystemTemplateSystemSignalRef=MCUMR_EOL_Asc_CMD
        MCUMR_EOL_PosDly_SnsrSupplier: ComSignalType=BOOLEAN, ComBitSize=1, ComBitPosition=278, ComNotification=Rte_COMCbk_MCUMR_EOL_PosDly_SnsrSupplier, ComSystemTemplateSystemSignalRef=MCUMR_EOL_PosDly_SnsrSupplier
        MCUMR_FstRcrd_Enable: ComSignalType=BOOLEAN, ComBitSize=1, ComBitPosition=279, ComNotification=Rte_COMCbk_MCUMR_FstRcrd_Enable, ComSystemTemplateSystemSignalRef=MCUMR_FstRcrd_Enable
        MCUMR_GainIden_CurrRMS_Ref_U: ComSignalType=UINT16, ComBitSize=13, ComBitPosition=280, ComNotification=Rte_COMCbk_MCUMR_GainIden_CurrRMS_Ref_U, ComSystemTemplateSystemSignalRef=MCUMR_GainIden_CurrRMS_Ref_U
        MCUMR_GainIden_CurrRMS_Ref_V: ComSignalType=UINT16, ComBitSize=13, ComBitPosition=293, ComNotification=Rte_COMCbk_MCUMR_GainIden_CurrRMS_Ref_V, ComSystemTemplateSystemSignalRef=MCUMR_GainIden_CurrRMS_Ref_V
        MCUMR_GainIden_CurrRMS_Ref_W: ComSignalType=UINT16, ComBitSize=13, ComBitPosition=306, ComNotification=Rte_COMCbk_MCUMR_GainIden_CurrRMS_Ref_W, ComSystemTemplateSystemSignalRef=MCUMR_GainIden_CurrRMS_Ref_W
      CCM_0x36A_P_CANFD (ComIPdu):
        ComIPduSignalProcessing = IMMEDIATE
        ComIPduType = NORMAL
        ComIPduDirection = RECEIVE
        ComIPduCallout = ComCallOut_CCM_0x36A_P_CANFD
        ComIPduErrorNotification = ComCbk_RxTimeOut_CCM_0x36A_P_CANFD
        ComFirstTimeout = 3.0
        ComTimeout = 1.0
        ComIPduGroupRef = ComIPduGroup_Rx
        ComPduIdRef = PduCollection/CCM_0x36A_P_CANFD_PduR2Com
        ComIPduSignalRef = CCM_Volt
        ComIPduSignalRef = CCM_RollingCounter_36A
        ComIPduSignalRef = CCM_BaseState
        ComIPduSignalRef = CCM_Power
        ComIPduSignalRef = CCM_APTC_BscSts
        ComIPduSignalRef = CCM_APTC_Power
      6 x ComSignal, all with ComSignalInitValue=0, ComSignalEndianness=LITTLE_ENDIAN, ComUpdateBitPosition=-1, ComTransferProperty=TRIGGERED:
        CCM_Volt: ComSignalType=UINT16, ComBitSize=10, ComBitPosition=24, ComNotification=Rte_COMCbk_CCM_Volt, ComSystemTemplateSystemSignalRef=CCM_Volt
        CCM_RollingCounter_36A: ComSignalType=UINT8, ComBitSize=4, ComBitPosition=8, ComNotification=Rte_COMCbk_CCM_RollingCounter_36A, ComSystemTemplateSystemSignalRef=CCM_RollingCounter_36A
        CCM_BaseState: ComSignalType=UINT8, ComBitSize=3, ComBitPosition=34, ComNotification=Rte_COMCbk_CCM_BaseState, ComSystemTemplateSystemSignalRef=CCM_BaseState
        CCM_Power: ComSignalType=UINT8, ComBitSize=8, ComBitPosition=56, ComNotification=Rte_COMCbk_CCM_Power, ComSystemTemplateSystemSignalRef=CCM_Power
        CCM_APTC_BscSts: ComSignalType=UINT8, ComBitSize=1, ComBitPosition=102, ComNotification=Rte_COMCbk_CCM_APTC_BscSts, ComSystemTemplateSystemSignalRef=CCM_APTC_BscSts
        CCM_APTC_Power: ComSignalType=UINT8, ComBitSize=8, ComBitPosition=112, ComNotification=Rte_COMCbk_CCM_APTC_Power, ComSystemTemplateSystemSignalRef=CCM_APTC_Power
      TMS_0x561_P_CANFD (ComIPdu):
        ComIPduSignalProcessing = IMMEDIATE
        ComIPduType = NORMAL
        ComIPduDirection = RECEIVE
        ComIPduCallout = ComCallOut_TMS_0x561_P_CANFD
        ComIPduErrorNotification = ComCbk_RxTimeOut_TMS_0x561_P_CANFD
        ComFirstTimeout = 3.0
        ComTimeout = 1.0
        ComIPduGroupRef = ComIPduGroup_Rx
        ComPduIdRef = PduCollection/TMS_0x561_P_CANFD_PduR2Com
        ComIPduSignalRef = TMS_MCUOutTemp
        ComIPduSignalRef = TMS_MCUMIntelTemp
        ComIPduSignalRef = TMS_MCUSIntelTemp
      3 x ComSignal, all with ComSignalInitValue=0, ComSignalType=UINT8, ComSignalEndianness=LITTLE_ENDIAN, ComBitSize=8, ComUpdateBitPosition=-1, ComTransferProperty=TRIGGERED:
        TMS_MCUOutTemp: ComBitPosition=16, ComNotification=Rte_COMCbk_TMS_MCUOutTemp, ComSystemTemplateSystemSignalRef=TMS_MCUOutTemp
        TMS_MCUMIntelTemp: ComBitPosition=48, ComNotification=Rte_COMCbk_TMS_MCUMIntelTemp, ComSystemTemplateSystemSignalRef=TMS_MCUMIntelTemp
        TMS_MCUSIntelTemp: ComBitPosition=56, ComNotification=Rte_COMCbk_TMS_MCUSIntelTemp, ComSystemTemplateSystemSignalRef=TMS_MCUSIntelTemp
      HPCGW_0x13A_P_CANFD (ComIPdu):
        ComIPduSignalProcessing = IMMEDIATE
        ComIPduType = NORMAL
        ComIPduDirection = RECEIVE
        ComIPduCallout = ComCallOut_HPCGW_0x13A_P_CANFD
        ComIPduErrorNotification = ComCbk_RxTimeOut_HPCGW_0x13A_P_CANFD
        ComFirstTimeout = 2.2
        ComTimeout = 0.2
        ComIPduGroupRef = ComIPduGroup_Rx
        ComPduIdRef = PduCollection/HPCGW_0x13A_P_CANFD_PduR2Com
        ComIPduSignalRef = GW_CRC_13A
        ComIPduSignalRef = GW_RollingCounter_13A
        ComIPduSignalRef = GW_IBC_VehicleSpeed
        ComIPduSignalRef = GW_IBC_VehicleSpeedVD
        ComIPduSignalRef = GW_IBC_AVHStatus
        ComIPduSignalRef = GW_IBC_RAB_Avatiable
        ComIPduSignalRef = GW_IBC_RAB_Active
        ComIPduSignalRef = GW_IBC_FLWheelSpeedKPH
        ComIPduSignalRef = GW_IBC_FRWheelSpeedKPH
        ComIPduSignalRef = GW_IBC_RLWheelSpeedKPH
        ComIPduSignalRef = GW_IBC_RRWheelSpeedKPH
        ComIPduSignalRef = GW_IBC_FLWheelDirection
        ComIPduSignalRef = GW_IBC_FRWheelDirection
        ComIPduSignalRef = GW_IBC_RLWheelDirection
        ComIPduSignalRef = GW_IBC_RRWheelDirection
        ComIPduSignalRef = GW_IBC_FLWheelSpeedVD
        ComIPduSignalRef = GW_IBC_FRWheelSpeedVD
        ComIPduSignalRef = GW_IBC_RLWheelSpeedVD
        ComIPduSignalRef = GW_IBC_RRWheelSpeedVD
        ComIPduSignalRef = GW_IBC_PlungerPressure_Q
        ComIPduSignalRef = GW_IBC_PlungerPressure
      21 x ComSignal, all with ComSignalInitValue=0, ComSignalEndianness=LITTLE_ENDIAN, ComUpdateBitPosition=-1, ComTransferProperty=TRIGGERED:
        GW_CRC_13A: ComSignalType=UINT8, ComBitSize=8, ComBitPosition=0, ComNotification=Rte_COMCbk_GW_CRC_13A, ComSystemTemplateSystemSignalRef=GW_CRC_13A
        GW_RollingCounter_13A: ComSignalType=UINT8, ComBitSize=4, ComBitPosition=8, ComNotification=Rte_COMCbk_GW_RollingCounter_13A, ComSystemTemplateSystemSignalRef=GW_RollingCounter_13A
        GW_IBC_VehicleSpeed: ComSignalType=UINT16, ComBitSize=16, ComBitPosition=16, ComNotification=Rte_COMCbk_GW_IBC_VehicleSpeed, ComSystemTemplateSystemSignalRef=GW_IBC_VehicleSpeed
        GW_IBC_VehicleSpeedVD: ComSignalType=BOOLEAN, ComBitSize=1, ComBitPosition=32, ComNotification=Rte_COMCbk_GW_IBC_VehicleSpeedVD, ComSystemTemplateSystemSignalRef=GW_IBC_VehicleSpeedVD
        GW_IBC_AVHStatus: ComSignalType=UINT8, ComBitSize=2, ComBitPosition=33, ComNotification=Rte_COMCbk_GW_IBC_AVHStatus, ComSystemTemplateSystemSignalRef=GW_IBC_AVHStatus
        GW_IBC_RAB_Avatiable: ComSignalType=BOOLEAN, ComBitSize=1, ComBitPosition=35, ComNotification=Rte_COMCbk_GW_IBC_RAB_Avatiable, ComSystemTemplateSystemSignalRef=GW_IBC_RAB_Avatiable
        GW_IBC_RAB_Active: ComSignalType=BOOLEAN, ComBitSize=1, ComBitPosition=36, ComNotification=Rte_COMCbk_GW_IBC_RAB_Active, ComSystemTemplateSystemSignalRef=GW_IBC_RAB_Active
        GW_IBC_FLWheelSpeedKPH: ComSignalType=UINT16, ComBitSize=16, ComBitPosition=40, ComNotification=Rte_COMCbk_GW_IBC_FLWheelSpeedKPH, ComSystemTemplateSystemSignalRef=GW_IBC_FLWheelSpeedKPH
        GW_IBC_FRWheelSpeedKPH: ComSignalType=UINT16, ComBitSize=16, ComBitPosition=56, ComNotification=Rte_COMCbk_GW_IBC_FRWheelSpeedKPH, ComSystemTemplateSystemSignalRef=GW_IBC_FRWheelSpeedKPH
        GW_IBC_RLWheelSpeedKPH: ComSignalType=UINT16, ComBitSize=16, ComBitPosition=72, ComNotification=Rte_COMCbk_GW_IBC_RLWheelSpeedKPH, ComSystemTemplateSystemSignalRef=GW_IBC_RLWheelSpeedKPH
        GW_IBC_RRWheelSpeedKPH: ComSignalType=UINT16, ComBitSize=16, ComBitPosition=88, ComNotification=Rte_COMCbk_GW_IBC_RRWheelSpeedKPH, ComSystemTemplateSystemSignalRef=GW_IBC_RRWheelSpeedKPH
        GW_IBC_FLWheelDirection: ComSignalType=UINT8, ComBitSize=2, ComBitPosition=104, ComNotification=Rte_COMCbk_GW_IBC_FLWheelDirection, ComSystemTemplateSystemSignalRef=GW_IBC_FLWheelDirection
        GW_IBC_FRWheelDirection: ComSignalType=UINT8, ComBitSize=2, ComBitPosition=106, ComNotification=Rte_COMCbk_GW_IBC_FRWheelDirection, ComSystemTemplateSystemSignalRef=GW_IBC_FRWheelDirection
        GW_IBC_RLWheelDirection: ComSignalType=UINT8, ComBitSize=2, ComBitPosition=108, ComNotification=Rte_COMCbk_GW_IBC_RLWheelDirection, ComSystemTemplateSystemSignalRef=GW_IBC_RLWheelDirection
        GW_IBC_RRWheelDirection: ComSignalType=UINT8, ComBitSize=2, ComBitPosition=110, ComNotification=Rte_COMCbk_GW_IBC_RRWheelDirection, ComSystemTemplateSystemSignalRef=GW_IBC_RRWheelDirection
        GW_IBC_FLWheelSpeedVD: ComSignalType=BOOLEAN, ComBitSize=1, ComBitPosition=112, ComNotification=Rte_COMCbk_GW_IBC_FLWheelSpeedVD, ComSystemTemplateSystemSignalRef=GW_IBC_FLWheelSpeedVD
        GW_IBC_FRWheelSpeedVD: ComSignalType=BOOLEAN, ComBitSize=1, ComBitPosition=113, ComNotification=Rte_COMCbk_GW_IBC_FRWheelSpeedVD, ComSystemTemplateSystemSignalRef=GW_IBC_FRWheelSpeedVD
        GW_IBC_RLWheelSpeedVD: ComSignalType=BOOLEAN, ComBitSize=1, ComBitPosition=114, ComNotification=Rte_COMCbk_GW_IBC_RLWheelSpeedVD, ComSystemTemplateSystemSignalRef=GW_IBC_RLWheelSpeedVD
        GW_IBC_RRWheelSpeedVD: ComSignalType=BOOLEAN, ComBitSize=1, ComBitPosition=115, ComNotification=Rte_COMCbk_GW_IBC_RRWheelSpeedVD, ComSystemTemplateSystemSignalRef=GW_IBC_RRWheelSpeedVD
        GW_IBC_PlungerPressure_Q: ComSignalType=BOOLEAN, ComBitSize=1, ComBitPosition=116, ComNotification=Rte_COMCbk_GW_IBC_PlungerPressure_Q, ComSystemTemplateSystemSignalRef=GW_IBC_PlungerPressure_Q
        GW_IBC_PlungerPressure: ComSignalType=UINT16, ComBitSize=11, ComBitPosition=117, ComNotification=Rte_COMCbk_GW_IBC_PlungerPressure, ComSystemTemplateSystemSignalRef=GW_IBC_PlungerPressure
      HPCBCM_0x291_P_CANFD (ComIPdu):
        ComIPduSignalProcessing = IMMEDIATE
        ComIPduType = NORMAL
        ComIPduDirection = RECEIVE
        ComIPduCallout = ComCallOut_BCM_0x291_P_CANFD
        ComIPduErrorNotification = ComCbk_RxTimeOut_BCM_0x291_P_CANFD
        ComFirstTimeout = 3.0
        ComTimeout = 1.0
        ComIPduGroupRef = ComIPduGroup_Rx
        ComPduIdRef = PduCollection/HPCBCM_0x291_P_CANFD_PduR2Com
        ComIPduSignalRef = BCM_CRC_291
        ComIPduSignalRef = BCM_ShutdownMode
        ComIPduSignalRef = BCM_NM_PNC_ON_1ADr_Sts
        ComIPduSignalRef = BCM_RollingCounter_291
        ComIPduSignalRef = BCM_KeyPosition_ON2A
        ComIPduSignalRef = BCM_CcmHvilSts_ID291
        ComIPduSignalRef = BCM_DriverDoorSts
        ComIPduSignalRef = BCM_FLDoorSts
        ComIPduSignalRef = BCM_FRDoorSts
        ComIPduSignalRef = BCM_RLDoorSts
        ComIPduSignalRef = BCM_RRDoorSts
        ComIPduSignalRef = BCM_BackDoorSts
        ComIPduSignalRef = BCM_ON2BRelaySts
        ComIPduSignalRef = BCM_ON2CRelaySts
        ComIPduSignalRef = BCM_ON2InitiativeSts
        ComIPduSignalRef = BCM_VehicleRepairMode
        ComIPduSignalRef = BCM_VehlockCtrl
        ComIPduSignalRef = BCM_VehLockSts
        ComIPduSignalRef = BCM_FuelTankLockReq
        ComIPduSignalRef = BCM_ACChgLockCtrl
        ComIPduSignalRef = BCM_ChargeLockCtrl
        ComIPduSignalRef = BCM_DCChrgPwr_Sts_ID291
        ComIPduSignalRef = BCM_ACChrgPwr_Sts_ID291
        ComIPduSignalRef = BCM_DCChrgPwr_Volt_ID291
        ComIPduSignalRef = BCM_ACChrgPwr_Volt_ID291
        ComIPduSignalRef = BCM_KeyPosition_ON2B
        ComIPduSignalRef = BCM_NM_PNC_ON_3Ch_Sts
        ComIPduSignalRef = BCM_HighVoltageReq
      28 x ComSignal, all with ComSignalInitValue=0, ComSignalEndianness=LITTLE_ENDIAN, ComUpdateBitPosition=-1, ComTransferProperty=TRIGGERED:
        BCM_CRC_291: ComSignalType=UINT8, ComBitSize=8, ComBitPosition=0, ComNotification=Rte_COMCbk_BCM_CRC_291, ComSystemTemplateSystemSignalRef=BCM_CRC_291
        BCM_ShutdownMode: ComSignalType=BOOLEAN, ComBitSize=1, ComBitPosition=15, ComNotification=Rte_COMCbk_BCM_ShutdownMode, ComSystemTemplateSystemSignalRef=BCM_ShutdownMode
        BCM_NM_PNC_ON_1ADr_Sts: ComSignalType=BOOLEAN, ComBitSize=1, ComBitPosition=67, ComNotification=Rte_COMCbk_BCM_NM_PNC_ON_1ADr_Sts, ComSystemTemplateSystemSignalRef=BCM_NM_PNC_ON_1ADr_Sts
        BCM_RollingCounter_291: ComSignalType=UINT8, ComBitSize=4, ComBitPosition=8, ComNotification=Rte_COMCbk_BCM_RollingCounter_291, ComSystemTemplateSystemSignalRef=BCM_RollingCounter_291
        BCM_KeyPosition_ON2A: ComSignalType=UINT8, ComBitSize=1, ComBitPosition=18, ComNotification=Rte_COMCbk_BCM_KeyPosition_ON2A, ComSystemTemplateSystemSignalRef=BCM_KeyPosition_ON2A
        BCM_CcmHvilSts_ID291: ComSignalType=BOOLEAN, ComBitSize=1, ComBitPosition=22, ComNotification=Rte_COMCbk_BCM_CcmHvilSts_ID291, ComSystemTemplateSystemSignalRef=BCM_CcmHvilSts_ID291
        BCM_DriverDoorSts: ComSignalType=BOOLEAN, ComBitSize=1, ComBitPosition=23, ComNotification=Rte_COMCbk_BCM_DriverDoorSts, ComSystemTemplateSystemSignalRef=BCM_DriverDoorSts
        BCM_FLDoorSts: ComSignalType=BOOLEAN, ComBitSize=1, ComBitPosition=24, ComNotification=Rte_COMCbk_BCM_FLDoorSts, ComSystemTemplateSystemSignalRef=BCM_FLDoorSts
        BCM_FRDoorSts: ComSignalType=BOOLEAN, ComBitSize=1, ComBitPosition=25, ComNotification=Rte_COMCbk_BCM_FRDoorSts, ComSystemTemplateSystemSignalRef=BCM_FRDoorSts
        BCM_RLDoorSts: ComSignalType=BOOLEAN, ComBitSize=1, ComBitPosition=26, ComNotification=Rte_COMCbk_BCM_RLDoorSts, ComSystemTemplateSystemSignalRef=BCM_RLDoorSts
        BCM_RRDoorSts: ComSignalType=BOOLEAN, ComBitSize=1, ComBitPosition=27, ComNotification=Rte_COMCbk_BCM_RRDoorSts, ComSystemTemplateSystemSignalRef=BCM_RRDoorSts
        BCM_BackDoorSts: ComSignalType=BOOLEAN, ComBitSize=1, ComBitPosition=28, ComNotification=Rte_COMCbk_BCM_BackDoorSts, ComSystemTemplateSystemSignalRef=BCM_BackDoorSts
        BCM_ON2BRelaySts: ComSignalType=BOOLEAN, ComBitSize=1, ComBitPosition=30, ComNotification=Rte_COMCbk_BCM_ON2BRelaySts, ComSystemTemplateSystemSignalRef=BCM_ON2BRelaySts
        BCM_ON2CRelaySts: ComSignalType=BOOLEAN, ComBitSize=1, ComBitPosition=31, ComNotification=Rte_COMCbk_BCM_ON2CRelaySts, ComSystemTemplateSystemSignalRef=BCM_ON2CRelaySts
        BCM_ON2InitiativeSts: ComSignalType=BOOLEAN, ComBitSize=1, ComBitPosition=35, ComNotification=Rte_COMCbk_BCM_ON2InitiativeSts, ComSystemTemplateSystemSignalRef=BCM_ON2InitiativeSts
        BCM_VehicleRepairMode: ComSignalType=BOOLEAN, ComBitSize=1, ComBitPosition=36, ComNotification=Rte_COMCbk_BCM_VehicleRepairMode, ComSystemTemplateSystemSignalRef=BCM_VehicleRepairMode
        BCM_VehlockCtrl: ComSignalType=UINT8, ComBitSize=2, ComBitPosition=37, ComNotification=Rte_COMCbk_BCM_VehlockCtrl, ComSystemTemplateSystemSignalRef=BCM_VehlockCtrl
        BCM_VehLockSts: ComSignalType=BOOLEAN, ComBitSize=1, ComBitPosition=39, ComNotification=Rte_COMCbk_BCM_VehLockSts, ComSystemTemplateSystemSignalRef=BCM_VehLockSts
        BCM_FuelTankLockReq: ComSignalType=UINT8, ComBitSize=2, ComBitPosition=40, ComNotification=Rte_COMCbk_BCM_FuelTankLockReq, ComSystemTemplateSystemSignalRef=BCM_FuelTankLockReq
        BCM_ACChgLockCtrl: ComSignalType=UINT8, ComBitSize=2, ComBitPosition=42, ComNotification=Rte_COMCbk_BCM_ACChgLockCtrl, ComSystemTemplateSystemSignalRef=BCM_ACChgLockCtrl
        BCM_ChargeLockCtrl: ComSignalType=UINT8, ComBitSize=2, ComBitPosition=44, ComNotification=Rte_COMCbk_BCM_ChargeLockCtrl, ComSystemTemplateSystemSignalRef=BCM_ChargeLockCtrl
        BCM_DCChrgPwr_Sts_ID291: ComSignalType=BOOLEAN, ComBitSize=1, ComBitPosition=46, ComNotification=Rte_COMCbk_BCM_DCChrgPwr_Sts_ID291, ComSystemTemplateSystemSignalRef=BCM_DCChrgPwr_Sts_ID291
        BCM_ACChrgPwr_Sts_ID291: ComSignalType=BOOLEAN, ComBitSize=1, ComBitPosition=47, ComNotification=Rte_COMCbk_BCM_ACChrgPwr_Sts_ID291, ComSystemTemplateSystemSignalRef=BCM_ACChrgPwr_Sts_ID291
        BCM_DCChrgPwr_Volt_ID291: ComSignalType=UINT8, ComBitSize=8, ComBitPosition=48, ComNotification=Rte_COMCbk_BCM_DCChrgPwr_Volt_ID291, ComSystemTemplateSystemSignalRef=BCM_DCChrgPwr_Volt_ID291
        BCM_ACChrgPwr_Volt_ID291: ComSignalType=UINT8, ComBitSize=8, ComBitPosition=56, ComNotification=Rte_COMCbk_BCM_ACChrgPwr_Volt_ID291, ComSystemTemplateSystemSignalRef=BCM_ACChrgPwr_Volt_ID291
        BCM_KeyPosition_ON2B: ComSignalType=BOOLEAN, ComBitSize=1, ComBitPosition=64, ComNotification=Rte_COMCbk_BCM_KeyPosition_ON2B, ComSystemTemplateSystemSignalRef=BCM_KeyPosition_ON2B
        BCM_NM_PNC_ON_3Ch_Sts: ComSignalType=BOOLEAN, ComBitSize=1, ComBitPosition=73, ComNotification=Rte_COMCbk_BCM_NM_PNC_ON_3Ch_Sts, ComSystemTemplateSystemSignalRef=BCM_NM_PNC_ON_3Ch_Sts
        BCM_HighVoltageReq: ComSignalType=UINT8, ComBitSize=2, ComBitPosition=114, ComNotification=Rte_COMCbk_BCM_HighVoltageReq, ComSystemTemplateSystemSignalRef=BCM_HighVoltageReq
