[part 3 of 6: packages /MVCU_AutoGenPkg/MVCU/Pck_AutoGen_Sw/Components to /MVCU_AutoGenPkg/MVCU/Pck_AutoGen_Sw/DataConstraints]
AUTOSAR XML (schema 4-2-2)
package /MVCU_AutoGenPkg/MVCU/Pck_AutoGen_Sw/Components  (continued)
  sender receiver interface IF_MCUM_0x42C_PCANFD
    data MCUM_NMControlRMR_Sts_P: type=DT_DT_MCUM_NMControlRMR_Sts_P
    data MCUM_WakeUpReason_P: type=DT_DT_MCUM_WakeUpReason_P
package /MVCU_AutoGenPkg/MVCU/Pck_AutoGen_Sw/DataConstraints
  range DataConstr_MCUM_CRC_135: raw 0..255
  range DataConstr_MCUM_RollingCounter_135: raw 0..15
  range DataConstr_MCUM_LDC_SWInfo: raw 0..65535
  range DataConstr_MCUM_LDC_MTarOut_FA: raw 0..65535
  range DataConstr_MCUM_LDC_MTarOut_RA: raw 0..65535
  range DataConstr_MCUM_LDC_Available_FA: raw 0..1
  range DataConstr_MCUM_LDC_OperationMode_FA: raw 0..7
  range DataConstr_MCUM_LDC_Available_RA: raw 0..1
  range DataConstr_MCUM_LDC_OperationMode_RA: raw 0..7
  range DataConstr_MCUM_RTE_Exchange_Signal_Status: raw 0..255
  range DataConstr_MCUM_MTarIn_FA: raw 0..65535
  range DataConstr_MCUM_MTarIn_RA: raw 0..65535
  range DataConstr_MCUM_InputQF_FA: raw 0..1
  range DataConstr_MCUM_InputQF_RA: raw 0..1
  range DataConstr_IBC_CRC_136: raw 0..255
  range DataConstr_IBC_RollingCounter_136: raw 0..15
  range DataConstr_IBC_ModeMinEDrvTar_FA: raw 0..3
  range DataConstr_IBC_ModeMinEDrvTar_RA: raw 0..3
  range DataConstr_IBC_ModeMaxEDrvTar_FA: raw 0..3
  range DataConstr_IBC_ModeMaxEDrvTar_RA: raw 0..3
  range DataConstr_IBC_torque_distribution_RA_Vaild: raw 0..1
  range DataConstr_IBC_torque_distribution_RA: raw 0..255
  range DataConstr_IBC_mTar_FA: raw 0..65535
  range DataConstr_IBC_mTar_RA: raw 0..65535
  range DataConstr_IBC_iLDC_SWInfo: raw 0..255
  range DataConstr_IBC_Variant_Signal: raw 0..255
  range DataConstr_IBC_nTarMax_FA: raw 0..65535
  range DataConstr_IBC_nTarMax_RA: raw 0..65535
  range DataConstr_IBC_nTarMin_FA: raw 0..65535
  range DataConstr_IBC_nTarMin_RA: raw 0..65535
  range DataConstr_EVCC_DCAC_ChgMode: raw 0..15
  range DataConstr_EVCC_CP_status: raw 0..15
  range DataConstr_EVCC_CPDutyCycleValue: raw 0..255
  range DataConstr_EVCC_EVSEMaximumCurrentLimit: raw 0..255
  range DataConstr_EVCC_EVSEMaximumPowerLimit: raw 0..65535
  range DataConstr_ICU_CRC_24C: raw 0..255
  range DataConstr_ICU_PHEVMode: raw 0..7
  range DataConstr_ICU_RollingCounter_24C: raw 0..15
  range DataConstr_ICU_TotalOdometerkm: raw 0..1048575
  range DataConstr_ICU_AccelerationMode: raw 0..7
  range DataConstr_ICU_REMode: raw 0..7
  range DataConstr_ICU_CreepMode: raw 0..3
  range DataConstr_ICU_EnergyRecoveryMode: raw 0..3
  range DataConstr_MCUS_CRC_DB: raw 0..255
  range DataConstr_MCUS_Clutch_2_Fault: raw 0..1023
  range DataConstr_MCUS_Clutch_1_Fault: raw 0..1023
  range DataConstr_MCUS_Clutch_2_WarningLevel: raw 0..3
  range DataConstr_MCUS_Clutch_1_WarningLevel: raw 0..3
  range DataConstr_MCUS_Clutch_2_Pos: raw 0..7
  range DataConstr_MCUS_Clutch_1_Pos: raw 0..7
  range DataConstr_MCUS_RollingCounter_DB: raw 0..15
  range DataConstr_MCUS_WarningLevel: raw 0..3
  range DataConstr_MCUS_SelfCheckSts: raw 0..3
  range DataConstr_MCUS_DrvMotorWorkSts: raw 0..3
  range DataConstr_MCUS_PowerReduceSts: raw 0..1
  range DataConstr_MCUS_SystemError: raw 0..1
  range DataConstr_MCUS_LVSystemError: raw 0..1
  range DataConstr_MCUS_MotorTempAlarm: raw 0..1
  range DataConstr_MCUS_HVSystemError: raw 0..1
  range DataConstr_MCUS_SeriousWarning_Level: raw 0..3
  range DataConstr_MCUS_CtrlModeVD: raw 0..1
  range DataConstr_MCUS_WaterPumpLevlReq: raw 0..15
  range DataConstr_MCUS_MotorTemp: raw 0..255
  range DataConstr_MCUS_IGBTTemp: raw 0..255
  range DataConstr_MCUS_InletTemp: raw 0..255
  range DataConstr_MCUS_DrvMotorRPM: raw 0..65535
  range DataConstr_MCUS_ActualTorqueFB: raw 0..65535
  range DataConstr_MCUS_HWRdcFault: raw 0..1
  range DataConstr_MCUS_HighVoltPowerOffReq: raw 0..1
  range DataConstr_MCUS_HVILSts: raw 0..1
  range DataConstr_MCUS_DragSts: raw 0..3
  range DataConstr_MCUS_CtrlMode: raw 0..1
  range DataConstr_MCUS_MILlampReq: raw 0..1
  range DataConstr_MCUS_DrvMotorRPMVD: raw 0..1
  range DataConstr_MCUS_ActualTorqueFBVD: raw 0..1
  range DataConstr_MCUS_MaxTorqueAllow: raw 0..65535
  range DataConstr_MCUS_MaxSpeedAllow: raw 0..65535
  range DataConstr_MCUS_ActiveReleaseSts: raw 0..3
  range DataConstr_MCUS_MinTorqueAllow: raw 0..65535
  range DataConstr_MCUS_MainWireVolt: raw 0..65535
  range DataConstr_MCUS_MainWireCurr: raw 0..65535
  range DataConstr_MCUS_Clutch_Pos: raw 0..7
  range DataConstr_MCUS_Clutch_Fault: raw 0..15
  range DataConstr_MCUS_TMS_FrMotSelfHeatEnSts: raw 0..1
  range DataConstr_MCUS_TMS_FrMotSelfHeatLvlFb: raw 0..7
  range DataConstr_MCUS_HeatPwrAval: raw 0..31
  range DataConstr_DelayIden_Rslt_Avg: raw 0..8191
  range DataConstr_DelayIden_OverRange: raw 0..1
  range DataConstr_DelayIden_Iden_Finish: raw 0..1
  range DataConstr_DelayIden_Write_Finish: raw 0..1
  range DataConstr_DelayIden_Rslt_U: raw 0..8191
  range DataConstr_DelayIden_Rslt_V: raw 0..8191
  range DataConstr_DelayIden_Rslt_W: raw 0..8191
  range DataConstr_GainIden_Is_Samp_U: raw 0..16383
  range DataConstr_GainIden_Rslt_U: raw 0..511
  range DataConstr_GainIden_OverRange: raw 0..1
  range DataConstr_GainIden_Is_Samp_V: raw 0..16383
  range DataConstr_GainIden_Rslt_V: raw 0..511
  range DataConstr_GainIden_Iden_Finish: raw 0..1
  range DataConstr_GainIden_Is_Samp_W: raw 0..16383
  range DataConstr_GainIden_Rslt_W: raw 0..511
  range DataConstr_GainIden_Write_Finish: raw 0..1
  range DataConstr_GainIden_Curr_Peak_U: raw 0..2047
  range DataConstr_GainIden_Curr_Peak_V: raw 0..2047
  range DataConstr_GainIden_Curr_Peak_W: raw 0..2047
  range DataConstr_CurrLoad_CurExt_U: raw 0..4095
  range DataConstr_CurrLoad_CurExt_V: raw 0..4095
  range DataConstr_CurrLoad_CurExt_W: raw 0..4095
  range DataConstr_CurrLoad_offset_Iu: raw 0..4095
  range DataConstr_CurrLoad_offset_Iv: raw 0..4095
  range DataConstr_CurrLoad_offset_Iw: raw 0..4095
  range DataConstr_MCUMR_DelayIden_Rslt_Avg: raw 0..8191
  range DataConstr_MCUMR_DelayIden_OverRange: raw 0..1
  range DataConstr_MCUMR_DelayIden_Iden_Finish: raw 0..1
  range DataConstr_MCUMR_MCUMR_DelayIden_Write_Finish: raw 0..1
  range DataConstr_MCUMR_DelayIden_Rslt_U: raw 0..8191
  range DataConstr_MCUMR_DelayIden_Rslt_V: raw 0..8191
  range DataConstr_MCUMR_DelayIden_Rslt_W: raw 0..8191
  range DataConstr_MCUMR_GainIden_Is_Samp_U: raw 0..16383
  range DataConstr_MCUMR_GainIden_Rslt_U: raw 0..511
  range DataConstr_MCUMR_GainIden_OverRange: raw 0..1
  range DataConstr_MCUMR_GainIden_Is_Samp_V: raw 0..16383
  range DataConstr_MCUMR_GainIden_Rslt_V: raw 0..511
  range DataConstr_MCUMR_GainIden_Iden_Finish: raw 0..1
  range DataConstr_MCUMR_GainIden_Is_Samp_W: raw 0..16383
  range DataConstr_MCUMR_GainIden_Rslt_W: raw 0..511
  range DataConstr_MCUMR_GainIden_Write_Finish: raw 0..1
  range DataConstr_MCUMR_GainIden_Curr_Peak_U: raw 0..2047
  range DataConstr_MCUMR_GainIden_Curr_Peak_V: raw 0..2047
  range DataConstr_MCUMR_GainIden_Curr_Peak_W: raw 0..2047
  range DataConstr_MCUMR_CurrLoad_CurExt_U: raw 0..4095
  range DataConstr_MCUMR_CurrLoad_CurExt_V: raw 0..4095
  range DataConstr_MCUMR_CurrLoad_CurExt_W: raw 0..4095
  range DataConstr_MCUMR_CurrLoad_offset_Iu: raw 0..4095
  range DataConstr_MCUMR_CurrLoad_offset_Iv: raw 0..4095
  range DataConstr_MCUMR_CurrLoad_offset_Iw: raw 0..4095
  range DataConstr_BCM_VCU_Authentication_MAC_B{0..15}: raw 0..255
  range DataConstr_ECM_UDS_PhyReq_Byte{0..7}: raw 0..255
  range DataConstr_MCUM_Id_Ref: raw 0..2047
  range DataConstr_MCUM_Iq_Ref: raw 0..2047
  range DataConstr_MCUM_Id_Fb: raw 0..2047
  range DataConstr_MCUM_Iq_Fb: raw 0..2047
  range DataConstr_MCUM_Torque_Ref: raw 0..1023
  range DataConstr_MCUM_R_Id_Ref: raw 0..2047
  range DataConstr_MCUM_R_Iq_Ref: raw 0..2047
  range DataConstr_MCUM_R_Id_Fb: raw 0..2047
  range DataConstr_MCUM_R_Iq_Fb: raw 0..2047
  range DataConstr_MCUM_R_Torque_Ref: raw 0..1023
  range DataConstr_MCUM_Vd_Ref: raw 0..1023
  range DataConstr_MCUM_Vq_Ref: raw 0..1023
  range DataConstr_MCUM_Id_LookUp: raw 0..2047
  range DataConstr_MCUM_Iq_LookUp: raw 0..2047
  range DataConstr_MCUM_Spd_Delta: raw 0..4095
  range DataConstr_MCUM_Us_Out: raw 0..2047
  range DataConstr_MCUM_Torque_PwrEst: raw 0..127
  range DataConstr_MCUM_UserDefine_50ms: raw 0..1023
  range DataConstr_MCUM_Torque_ExtChar: raw 0..511
  range DataConstr_MCUM_Damp_CompTorque: raw 0..1023
  range DataConstr_MCUM_Damp_CompCoeff: raw 0..127
  range DataConstr_MCUM_Damp_State: raw 0..1
  range DataConstr_MCUM_PWM_State: raw 0..3
  range DataConstr_MCUM_JuncTemp_Max: raw 0..4095
  range DataConstr_MCUM_JuncLoss_Max: raw 0..8191
  range DataConstr_MCUM_CurrAmp_Comp: raw 0..255
  range DataConstr_MCUM_CurrTheta_Comp: raw 0..511
  range DataConstr_MCUM_RawSinCorr: raw 0..4095
  range DataConstr_MCUM_RawCosCorr: raw 0..4095
  range DataConstr_MCUM_LUT_Spd: raw 0..32767
  range DataConstr_MCUM_R_HighVoltPowerOffReq: raw 0..1
  range DataConstr_MCUM_R_MaxTorqueAllow: raw 0..65535
  range DataConstr_MCUM_R_MaxSpeedAllow: raw 0..65535
  range DataConstr_MCUM_R_MinTorqueAllow: raw 0..65535
  range DataConstr_MCUM_R_MotorTemp: raw 0..255
  range DataConstr_MCUM_R_IGBTTemp: raw 0..255
  range DataConstr_MCUM_R_InletTemp: raw 0..255
  range DataConstr_MCUM_R_HeatPwrAllwd: raw 0..1
  range DataConstr_MCUM_R_HeatFdBck: raw 0..3
  range DataConstr_MCUM_R_HeatPwrAct: raw 0..255
  range DataConstr_MCUM_R_HeatPwrMax: raw 0..255
  range DataConstr_MCUM_R_HeatPwrAval: raw 0..31
  range DataConstr_MCUM_R_Vd_Ref: raw 0..1023
  range DataConstr_MCUM_R_Vq_Ref: raw 0..1023
  range DataConstr_MCUM_R_Id_LookUp: raw 0..2047
  range DataConstr_MCUM_R_Iq_LookUp: raw 0..2047
  range DataConstr_MCUM_R_Spd_Delta: raw 0..4095
  range DataConstr_MCUM_R_Us_Out: raw 0..2047
  range DataConstr_MCUM_R_Torque_PwrEst: raw 0..1023
  range DataConstr_MCUM_R_UserDefine_50ms: raw 0..1023
  range DataConstr_MCUM_R_Torque_ExtChar: raw 0..511
  range DataConstr_MCUM_R_Damp_CompTorque: raw 0..1023
  range DataConstr_MCUM_R_Damp_CompCoeff: raw 0..127
  range DataConstr_MCUM_R_Damp_State: raw 0..1
  range DataConstr_MCUM_R_PWM_State: raw 0..3
  range DataConstr_MCUM_R_JuncTemp_Max: raw 0..4095
  range DataConstr_MCUM_R_JuncLoss_Max: raw 0..8191
  range DataConstr_MCUM_R_CurrAmp_Comp: raw 0..255
  range DataConstr_MCUM_R_CurrTheta_Comp: raw 0..511
  range DataConstr_MCUM_R_RawSinCorr: raw 0..4095
  range DataConstr_MCUM_R_RawCosCorr: raw 0..4095
  range DataConstr_MCUM_R_LUT_Spd: raw 0..32767
  range DataConstr_MCUM_R_StatorTemp_1: raw 0..255
  range DataConstr_MCUM_R_L2TqAct: raw 0..1023
  range DataConstr_MCUM_R_EOPSw: raw 0..131071
  range DataConstr_MCUM_R_StatorTemp_2: raw 0..255
  range DataConstr_MCUM_R_IGBTTemp_U: raw 0..255
  range DataConstr_MCUM_R_IGBTTemp_V: raw 0..255
  range DataConstr_MCUM_R_IGBTTemp_W: raw 0..255
  range DataConstr_MCUM_R_Power_15V: raw 0..255
  range DataConstr_MCUM_R_Offset_IU: raw 0..8191
  range DataConstr_MCUM_R_Offset_IV: raw 0..8191
  range DataConstr_MCUM_R_Offset_IW: raw 0..8191
  range DataConstr_MCUM_R_MainSt_State: raw 0..15
  range DataConstr_MCUM_R_Derate_Reason: raw 0..15
  range DataConstr_MCUM_R_PWM_Freq_kHz: raw 0..255
  range DataConstr_MCUM_R_PWMEn_State: raw 0..1
  range DataConstr_MCUM_R_DrvPwrEn_Out_State: raw 0..1
  range DataConstr_MCUM_R_NVM_RslvrZeroRFault: raw 0..1
  range DataConstr_MCUM_R_Rotor_Position: raw 0..8191
  range DataConstr_MCUM_R_PosTransduserFaultCode: raw 0..255
  range DataConstr_MCUM_R_NVM_RslvrDirRFault: raw 0..1
  range DataConstr_MCUM_R_NVM_RslvrDelayRFault: raw 0..1
  range DataConstr_MCUM_R_NVM_RslvrParamRFault: raw 0..1
  range DataConstr_MCUM_R_NVM_HallGainRFault: raw 0..1
  range DataConstr_MCUM_R_NVM_HallDelayRFault: raw 0..1
  range DataConstr_MCUM_R_NVM_IGBTTypeRFault: raw 0..1
  range DataConstr_MCUM_R_ASC_EntryCount: raw 0..31
  range DataConstr_MCUM_R_Spd_Turn: raw 0..32767
  range DataConstr_MCUM_R_LUT_Spd_Max: raw 0..32767
  range DataConstr_MCUM_R_EOP_Speed: raw 0..8191
  range DataConstr_MCUM_R_EOP_IqFb: raw 0..511
  range DataConstr_MCUM_R_EOP_IqRef: raw 0..511
  range DataConstr_MCUM_R_EOP_DCVolt: raw 0..511
  range DataConstr_MCUM_R_EOP_DCCurr: raw 0..511
  range DataConstr_MCUM_R_EOP_Temp: raw 0..255
  range DataConstr_MCUM_R_EOP_State: raw 0..15
  range DataConstr_MCUM_R_EOP_FaultCode: raw 0..7
  range DataConstr_MCUM_R_HWFault_RstCnt: raw 0..15
  range DataConstr_MCUM_R_HWFoB_RstCnt: raw 0..15
  range DataConstr_MCUM_R_HWFoT_RstCnt: raw 0..15
  range DataConstr_MCUM_R_HWDrvUV_RstCnt: raw 0..15
  range DataConstr_MCUM_R_HWRdc_RstCnt: raw 0..15
  range DataConstr_MCUM_R_HWOC_RstCnt: raw 0..15
  range DataConstr_MCUM_R_HWOV_RstCnt: raw 0..15
  range DataConstr_MCUM_R_L2agRtrElecDiff: raw 0..15
  range DataConstr_MCUM_R_500usOverTime_Cnt: raw 0..15
  range DataConstr_MCUM_R_5msOverTime_Cnt: raw 0..15
  range DataConstr_MCUM_R_CpldRest_TimeOut_flag: raw 0..3
  range DataConstr_MCUM_R_DrvPCBCurr: raw 0..31
  range DataConstr_MCUM_R_EOL_StateMachine: raw 0..255
  range DataConstr_MCUM_R_CpldRest_ASC_Flag: raw 0..1
  range DataConstr_MCUM_R_LimSpdTorFlag: raw 0..1
  range DataConstr_MCUM_R_PWM_Err_Count: raw 0..31
  range DataConstr_MCUM_R_RDC_Reset_Count: raw 0..255
  range DataConstr_MCUM_R_ASC_Stop_Flag: raw 0..1
  range DataConstr_MCUM_R_ASC_Soft_Exiting_Flag: raw 0..1
  range DataConstr_MCUM_R_Vbus_ServeLowChkEn: raw 0..1
  range DataConstr_MCUM_R_EOP_BlockErr_IsLim_Flag: raw 0..1
  range DataConstr_MCUM_R_IdqErrCount: raw 0..2047
  range DataConstr_MCUM_R_MotSelfHeat_EnSts: raw 0..3
  range DataConstr_MCUM_R_MotBlockHeat_LvlFb: raw 0..7
  range DataConstr_MCUM_R_MotRotaryHeat_LvlFb: raw 0..7
  range DataConstr_MCUM_R_MotSelfHeat_DropLvlFb: raw 0..1
  range DataConstr_MCUM_R_MotSelfHeat_DropLvlRsn: raw 0..3
  range DataConstr_MCUM_R_MotBlockHeat_CurAngle: raw 0..511
  range DataConstr_MCUM_R_MotBlockHeat_CurMag: raw 0..511
  range DataConstr_MCUM_R_UserDefine_Byte{1..4}: raw 0..255
  range DataConstr_MCUM_R_UserDefine_Word{1..3}: raw 0..65535
  range DataConstr_VCU_MotSelfHeatPwrFb: raw 0..31
  range DataConstr_VCU_MotSelfHeatLvlFb: raw 0..7
  range DataConstr_VCU_MCUMWaterPumpLevlReq: raw 0..15
  range DataConstr_VCU_MCUSWaterPumpLevlReq: raw 0..15
  range DataConstr_VCU_HeatPwrAval: raw 0..31
  range DataConstr_VCU_MotSelfHeatAllwd: raw 0..1
  range DataConstr_VCU_MMotSelfHeatEnReq: raw 0..1
  range DataConstr_VCU_MMotSelfHeatLvlReq: raw 0..7
  range DataConstr_VCU_SMotSelfHeatEnReq: raw 0..1
  range DataConstr_VCU_SMotSelfHeatLvlReq: raw 0..7
  range DataConstr_Debug_MCU_CRC_CA: raw 0..255
  range DataConstr_Debug_MCU_RollingCounter_CA: raw 0..15
  range DataConstr_Debug_MCU_WarningLevel: raw 0..3
  range DataConstr_Debug_MCU_SelfCheckSts: raw 0..3
  range DataConstr_Debug_MCU_DrvMotorWorkSts: raw 0..3
  range DataConstr_Debug_MCU_PowerReduceSts: raw 0..1
  range DataConstr_Debug_MCU_DrvMotorRPM: raw 0..65535
  range DataConstr_Debug_MCU_ActualTorqueFB: raw 0..65535
  range DataConstr_Debug_MCU_HWRdcFault: raw 0..1
  range DataConstr_Debug_MCU_HighVoltPowerOffReq: raw 0..1
  range DataConstr_Debug_MCU_HVILSts: raw 0..1
  range DataConstr_Debug_MCU_DragSts: raw 0..3
  range DataConstr_Debug_MCU_CtrlMode: raw 0..1
  range DataConstr_Debug_MCU_MILlampReq: raw 0..1
  range DataConstr_Debug_MCU_DrvMotorRPMVD: raw 0..1
  range DataConstr_Debug_MCU_ActualTorqueFBVD: raw 0..1
  range DataConstr_Debug_MCU_MaxTorqueAllow: raw 0..65535
  range DataConstr_Debug_MCU_MaxSpeedAllow: raw 0..65535
  range DataConstr_Debug_MCU_ActiveReleaseSts: raw 0..3
  range DataConstr_Debug_MCU_DCChargRelaySts: raw 0..1
  range DataConstr_Debug_MCUM_MinTorqueAllow: raw 0..65535
  range DataConstr_Debug_MCU_MainWireVolt: raw 0..65535
  range DataConstr_Debug_MCU_MainWireCurr: raw 0..65535
  range DataConstr_Debug_MCUM_TMS_MotSelfHeatEnSts: raw 0..1
  range DataConstr_Debug_MCUM_TMS_MotSelfHeatLvlFb: raw 0..7
  range DataConstr_Debug_MCUM_RPowerReduceSts: raw 0..1
  range DataConstr_Debug_MCUM_HeatPwrAval: raw 0..15
  range DataConstr_Debug_MCUM_RCtrlMode: raw 0..1
  range DataConstr_Debug_MCUM_RWarningLevel: raw 0..3
  range DataConstr_Debug_MCUM_RSelfCheckSts: raw 0..3
  range DataConstr_Debug_MCUM_RDrvMotorWorkSts: raw 0..3
  range DataConstr_Debug_MCUM_RCtrlModeVD: raw 0..1
  range DataConstr_Debug_MCUM_RHWRdcFault: raw 0..1
  range DataConstr_Debug_MCUM_RDrvMotorRPMVD: raw 0..1
  range DataConstr_Debug_MCUM_RActualTorqueFBVD: raw 0..1
  range DataConstr_Debug_MCUM_RDrvMotorRPM: raw 0..65535
  range DataConstr_Debug_MCUM_RActualTorqueFB: raw 0..65535
  range DataConstr_IBS_CRC_225: raw 0..255
  range DataConstr_IBS_RollingCounter_225: raw 0..15
  range DataConstr_IBS_Warning_Level: raw 0..3
  range DataConstr_ADDC_CRC_84: raw 0..255
  range DataConstr_ADDC_APS_AVHReq: raw 0..1
  range DataConstr_ADDC_APS_HoldSts: raw 0..1
  range DataConstr_ADDC_APSTargetTrqBrkVD: raw 0..1
  range DataConstr_ADDC_APSTargetTrqBrk: raw 0..8191
  range DataConstr_ADDC_APSTargetTrqVD: raw 0..1
  range DataConstr_ADDC_APSTargetTrq: raw 0..16383
  range DataConstr_ADDC_safety_valid: raw 0..1
  range DataConstr_ADDC_rearsafety_level: raw 0..7
  range DataConstr_ADDC_frontsafety_level: raw 0..7
  range DataConstr_ADDC_rightsafety_level: raw 0..7
  range DataConstr_ADDC_leftsafety_level: raw 0..7
  range DataConstr_ADDC_RollingCounter_84: raw 0..15
  range DataConstr_ADDC_APS_EnableReq: raw 0..1
  range DataConstr_ADDC_APS_WorkSts: raw 0..1
  range DataConstr_ADDC_APS_PDCVehicleDirectCtlVD: raw 0..1
  range DataConstr_ADDC_APS_VehicleSpeedCtlVD: raw 0..1
  range DataConstr_ADDC_APS_PDC_VehicleDirectCtl: raw 0..3
  range DataConstr_ADDC_APS_PDC_SWAngCtl: raw 0..65535
  range DataConstr_ADDC_APS_ParkingReq: raw 0..3
  range DataConstr_ADDC_APS_EmergenceBrake: raw 0..1
  range DataConstr_ADDC_APS_TargetAccVD: raw 0..1
  range DataConstr_ADDC_APS_TargetAcc: raw 0..255
  range DataConstr_ADDC_APS_VehicleSpeedCtl: raw 0..63
  range DataConstr_ADDC_APS_DecToStop: raw 0..1
  range DataConstr_ADDC_APS_Driveoff_Request: raw 0..1
  range DataConstr_ADDC_APS_FuncType: raw 0..7
  range DataConstr_ADDC_APS_Available: raw 0..1
  range DataConstr_IVI_Year: raw 0..4095
  range DataConstr_IVI_Month: raw 0..15
  range DataConstr_IVI_Data: raw 0..31
  range DataConstr_IVI_Hour: raw 0..31
  range DataConstr_IVI_Minute: raw 0..63
  range DataConstr_IVI_Second: raw 0..63
  range DataConstr_DCDC_CRC_324: raw 0..255
  range DataConstr_DCDC_RollingCounter_324: raw 0..15
  range DataConstr_DCDC_WorkSts: raw 0..7
  range DataConstr_DCDC_Under_Output_Voltage: raw 0..1
  range DataConstr_DCDC_Over_Output_Voltage: raw 0..1
  range DataConstr_DCDC_Under_Input_Voltage: raw 0..1
  range DataConstr_DCDC_Over_Input_Voltage: raw 0..1
  range DataConstr_DCDC_Over_Input_Current: raw 0..1
  range DataConstr_DCDC_Real_Output_Current: raw 0..4095
  range DataConstr_DCDC_Real_Output_Voltage: raw 0..4095
  range DataConstr_DCDC_Real_Input_Current: raw 0..255
  range DataConstr_DCDC_Real_Input_Voltage: raw 0..8191
  range DataConstr_DCDC_Derating: raw 0..1
  range DataConstr_DCDC_Hardware_Fault_Flag: raw 0..1
  range DataConstr_CDU_ACChg_HIVSts: raw 0..1
  range DataConstr_CDU_OBC_OverTemp: raw 0..1
  range DataConstr_CDU_SelfCheckSt: raw 0..1
  range DataConstr_CDU_HV_HIVSts: raw 0..1
  range DataConstr_FSC_CRC_142: raw 0..255
  range DataConstr_FSC_RollingCounter_142: raw 0..15
  range DataConstr_FSC_LCC_Mode: raw 0..7
  range DataConstr_MotClb_FaultCode{1..8}: raw 0..255
  range DataConstr_MotClb_OfsApply: raw 0..65535
  range DataConstr_MCUMR_MotClb_FaultCode{1..8}: raw 0..255
  range DataConstr_MCUMR_MotClb_OfsApply: raw 0..65535
  range DataConstr_EOL_ModeCMD_Data{0..5}: raw 0..255
  range DataConstr_EOL_ModeCMD_Enable: raw 0..255
  range DataConstr_EOL_ModeCMD_Check: raw 0..255
  range DataConstr_EOL_GainIden_UsApply: raw 0..4095
  range DataConstr_EOL_MotClb_CtrlMode: raw 0..15
  range DataConstr_MotClb_OfsSet: raw 0..65535
  range DataConstr_EOL_MotClb_IsCMD: raw 0..65535
  range DataConstr_EOL_MotClb_ThetaCMD: raw 0..65535
  range DataConstr_EOL_frqsync: raw 0..65535
  range DataConstr_EOL_MotClb_Enable: raw 0..3
  range DataConstr_EOL_ActiveReleaseCmd: raw 0..1
  range DataConstr_MotClb_OfsAdjEn: raw 0..1
  range DataConstr_EOL_Asc_CMD: raw 0..3
  range DataConstr_EOL_PosDly_SnsrSupplier: raw 0..1
  range DataConstr_FstRcrd_Enable: raw 0..1
  range DataConstr_GainIden_CurrRMS_Ref_U: raw 0..8191
  range DataConstr_GainIden_CurrRMS_Ref_V: raw 0..8191
  range DataConstr_GainIden_CurrRMS_Ref_W: raw 0..8191
  range DataConstr_MCUMR_EOL_GainIden_UsApply: raw 0..4095
  range DataConstr_MCUMR_EOL_MotClb_CtrlMode: raw 0..15
  range DataConstr_MCUMR_MotClb_OfsSet: raw 0..65535
  range DataConstr_MCUMR_EOL_MotClb_IsCMD: raw 0..65535
  range DataConstr_MCUMR_EOL_MotClb_ThetaCMD: raw 0..65535
  range DataConstr_MCUMR_EOL_frqsync: raw 0..65535
  range DataConstr_MCUMR_EOL_MotClb_Enable: raw 0..3
  range DataConstr_MCUMR_EOL_ActiveReleaseCmd: raw 0..1
  range DataConstr_MCUMR_MotClb_OfsAdjEn: raw 0..1
  range DataConstr_MCUMR_EOL_Asc_CMD: raw 0..3
  range DataConstr_MCUMR_EOL_PosDly_SnsrSupplier: raw 0..1
  range DataConstr_MCUMR_FstRcrd_Enable: raw 0..1
  range DataConstr_MCUMR_GainIden_CurrRMS_Ref_U: raw 0..8191
  range DataConstr_MCUMR_GainIden_CurrRMS_Ref_V: raw 0..8191
  range DataConstr_MCUMR_GainIden_CurrRMS_Ref_W: raw 0..8191
  range DataConstr_MCUS_CRC_14: raw 0..255
  range DataConstr_MCUS_RollingCounter_14: raw 0..15
  range DataConstr_MCUS_DrvMotorRPM_prvt: raw 0..65535
  range DataConstr_MCUS_ActualTorqueFB_prvt: raw 0..65535
  range DataConstr_MCUS_DrvMotorRPMVD_prvt: raw 0..1
  range DataConstr_MCUS_ActualTorqueFBVD_prvt: raw 0..1
  range DataConstr_U16_CMD{1..4}: raw 0..65535
  range DataConstr_S16_CMD{1..4}: raw 0..65535
  range DataConstr_R16_CMD{1..4}: raw 0..65535
  range DataConstr_U8_CMD{1..8}: raw 0..255
  range DataConstr_OBC_CRC_316: raw 0..255
  range DataConstr_OBC_RollingCounter_316: raw 0..15
  range DataConstr_OBC_WorkSts: raw 0..7
  range DataConstr_OBC_StartSts: raw 0..1
  range DataConstr_OBC_DCSts: raw 0..1
  range DataConstr_OBC_ACChargeOutputSts: raw 0..1
  range DataConstr_OBC_DCVolt: raw 0..16383
  range DataConstr_OBC_HardwareSts: raw 0..1
  range DataConstr_OBC_DCCurr: raw 0..2047
  range DataConstr_OBC_ACVolt: raw 0..8191
  range DataConstr_OBC_ACCurr: raw 0..2047
  range DataConstr_OBC_CCConnectSts: raw 0..3
  range DataConstr_OBC_CPDutyCycleFault: raw 0..1
  range DataConstr_OBC_CPDutyCycleValue: raw 0..255
  range DataConstr_OBC_ACMaxPower: raw 0..1023
  range DataConstr_OBC_ACPowerState: raw 0..3
  range DataConstr_LMC_CRC_FA: raw 0..255
  range DataConstr_LMC_RollingCounter_FA: raw 0..15
  range DataConstr_LMC_EngTorqDec_Main: raw 0..1023
  range DataConstr_LMC_EngTorqDecActive_Main: raw 0..1
  range DataConstr_LMC_AMM_St: raw 0..3
  range DataConstr_LMC_EngTorqInc_Main: raw 0..1023
  range DataConstr_LMC_EngTorqIncActive_Main: raw 0..1
  range DataConstr_LMC_EngTorqDec_Sub: raw 0..1023
  range DataConstr_LMC_EngTorqDecActive_Sub: raw 0..1
  range DataConstr_LMC_EngTorqInc_Sub: raw 0..1023
  range DataConstr_LMC_EngTorqIncActive_Sub: raw 0..1
  range DataConstr_LMC_CRC_18C: raw 0..255
  range DataConstr_LMC_RollingCounter_18C: raw 0..15
  range DataConstr_LMC_TqTotalBrakeTorque: raw 0..32767
  range DataConstr_LMC_TqTotalBrakeTorque_Valid: raw 0..1
  range DataConstr_LMC_CmpUTurnLockwhists: raw 0..7
  range DataConstr_GW_CRC_3B1: raw 0..255
  range DataConstr_GW_RollingCounter_3B1: raw 0..15
  range DataConstr_GW_ACU_FLSeatBeltRSt: raw 0..3
  range DataConstr_GW_ACU_FRSeatBeltRSt: raw 0..3
  range DataConstr_GW_IBC_EPB_Status: raw 0..7
  range DataConstr_GW_ACU_TotalCrashOutputSts: raw 0..1
  range DataConstr_GW_BZCU_DCChgExitTemp_Pos: raw 0..255
  range DataConstr_GW_BZCU_DCChgExitTemp_Neg: raw 0..255
  range DataConstr_GW_BZCU_ACChgExitTemp_Pos: raw 0..255
  range DataConstr_GW_BZCU_FuelTankSts: raw 0..1
  range DataConstr_GW_BZCU_LBMS_VoltA: raw 0..255
  range DataConstr_GW_BZCU_ACChgExitTemp_Neg: raw 0..255
  range DataConstr_GW_BZCU_FuelTankStsLockSts: raw 0..3
  range DataConstr_GW_BZCU_FuelTankLockCtrl: raw 0..3
  range DataConstr_GW_BZCU_ACChgLockSts: raw 0..3
  range DataConstr_GW_RZCU_Cabin_220Vconnect_Sts: raw 0..1
  range DataConstr_GW_BZCU_Cab_220VRelay_CtrlSts: raw 0..1
  range DataConstr_GW_BZCU_Cab_PDU220VRelay_CtrlSts: raw 0..1
  range DataConstr_GW_BZCU_Cabin_220VRelay_CtrlSts: raw 0..1
  range DataConstr_GW_BZCU_Cab_220Vconnect_Sts: raw 0..1
  range DataConstr_GW_TBOXSOC_Altitude: raw 0..16383
  range DataConstr_VCU_EolCfg_ESC: raw 0..1
  range DataConstr_VCU_IMMOKeyWriteCnt: raw 0..7
  range DataConstr_VCU_AbStartupFlag: raw 0..1
  range DataConstr_VCU_AbResetFlag: raw 0..1
  range DataConstr_VCU_AbResetlnitFinish: raw 0..1
  range DataConstr_VCU_EolCfg_EPB: raw 0..1
  range DataConstr_VCU_EolCfg_AEB: raw 0..1
  range DataConstr_VCU_EolCfg_InverterFunc: raw 0..1
  range DataConstr_VCU_EolCfg_APS: raw 0..1
  range DataConstr_VCU_EolCfg_VehiModels: raw 0..7
  range DataConstr_VCU_EolCfg_SpdLmtVal: raw 0..15
  range DataConstr_VCU_EolCfg_WheelType: raw 0..15
  range DataConstr_VCU_EolCfg_Curise: raw 0..3
  range DataConstr_VCU_REStartReq: raw 0..1
  range DataConstr_VCU_REStopReq: raw 0..1
  range DataConstr_VCU_EolCfg_VehiType: raw 0..1
  range DataConstr_VCU_EolCfg_MotPwr: raw 0..7
  range DataConstr_VCU_Vehicle_NVHPwrLimitVal: raw 0..255
  range DataConstr_VCU_EolCfg_MotDrvStructure: raw 0..3
  range DataConstr_VCU_WLTCModeFlag: raw 0..1
  range DataConstr_VCU_EolCfg_RudderDir: raw 0..1
  range DataConstr_VCU_EolCfg_DCChgRelayPos: raw 0..3
  range DataConstr_VCU_EolCfg_FPTCIL: raw 0..1
  range DataConstr_VCU_PWakeupSt: raw 0..1
  range DataConstr_VCU_SpdLimitReason: raw 0..7
  range DataConstr_BSW_VertifySts: raw 0..3
  range DataConstr_VCU_InterAllowEngStart: raw 0..1
  range DataConstr_VCU_EngineOff_Flag: raw 0..1
  range DataConstr_VCU_EngineStopAllow: raw 0..1
  range DataConstr_VCU_EmergencyStopReq: raw 0..1
  range DataConstr_VCU_EngineAllowStop: raw 0..1
  range DataConstr_VCU_REVehiWheelTrqReq: raw 0..255
  range DataConstr_REHighPerformVehiPwr: raw 0..255
  range DataConstr_VCU_AdditionalPwrVal: raw 0..255
  range DataConstr_VCU_VehichRealPwDown: raw 0..255
  range DataConstr_VCU_IMMOStsResult: raw 0..15
  range DataConstr_VCU_IMMOStateMachine: raw 0..7
  range DataConstr_VCU_ShowCarModeNvmResult: raw 0..1
  range DataConstr_VCU_DeliveryModeNvmData: raw 0..1
  range DataConstr_VCU_AccPedFaultLvNvmResult: raw 0..1
  range DataConstr_VCU_VehicleConfigNvmResult: raw 0..1
  range DataConstr_VCU_EngRunTimeNvmResult: raw 0..1
  range DataConstr_VCU_FuelConsumption: raw 0..255
  range DataConstr_VCU_SVSLamp: raw 0..1
  range DataConstr_VCU_MilLamp: raw 0..1
  range DataConstr_VCU_SinglePedalSts_ID514: raw 0..1
  range DataConstr_VCU_GearLevelPosFault_ID514: raw 0..1
  range DataConstr_VCU_EngineStartFailure_ID514: raw 0..1
  range DataConstr_VCU_ParkBeforeFuelup: raw 0..1
  range DataConstr_VCU_REsystemFaultSts_ID514: raw 0..1
  range DataConstr_VCU_EngineRunAllowFlg_ID514: raw 0..1
  range DataConstr_VCU_InverterTip: raw 0..7
  range DataConstr_VCU_EMSRepairModeSts: raw 0..3
  range DataConstr_VCU_FuelTankFlapSts: raw 0..1
  range DataConstr_VCU_REsystemSts_ID514: raw 0..1
  range DataConstr_VCU_PowerModeAllow: raw 0..3
  range DataConstr_VCU_PowerModeSwitchMsg: raw 0..1
  range DataConstr_VCU_HighVoltFailed_M: raw 0..1
  range DataConstr_VCU_HighVoltFailed_S: raw 0..1
  range DataConstr_VCU_BrakeBeforeGear: raw 0..1
  range DataConstr_VCU_ParkBeforeGear: raw 0..1
  range DataConstr_VCU_GearBeforDriving: raw 0..1
  range DataConstr_VCU_UnlockBeforeDriving: raw 0..1
  range DataConstr_VCU_PreventSliding: raw 0..1
  range DataConstr_VCU_MMErrorSts: raw 0..1
  range DataConstr_VCU_ShowCarModeSts: raw 0..1
  range DataConstr_VCU_PGearFlashSts: raw 0..1
  range DataConstr_VCU_ACConnectSts: raw 0..1
  range DataConstr_VCU_DcChgPwrSts: raw 0..1
  range DataConstr_VCU_DriverAssistProhibitSts_ID514: raw 0..1
  range DataConstr_VCU_MilLampRequest_ID514: raw 0..1
  range DataConstr_VCU_CcmHvilInSigFreq_FB: raw 0..255
  range DataConstr_VCU_CcmHvilInSigDuty_FB: raw 0..255
  range DataConstr_VCU_FuelDectionModeSts: raw 0..3
  range DataConstr_VCU_EnergyCtrlMode: raw 0..1
  range DataConstr_VCU_VehSpdLimtRemind_ID514: raw 0..1
  range DataConstr_VCU_TurtleLamp: raw 0..1
  range DataConstr_VCU_EngLongTimeStartReq: raw 0..1
  range DataConstr_GW_CRC_13A: raw 0..255
  range DataConstr_GW_RollingCounter_13A: raw 0..15
  range DataConstr_GW_IBC_VehicleSpeed: raw 0..65535
  range DataConstr_GW_IBC_VehicleSpeedVD: raw 0..1
  range DataConstr_GW_IBC_AVHStatus: raw 0..3
  range DataConstr_GW_IBC_RAB_Avatiable: raw 0..1
  range DataConstr_GW_IBC_RAB_Active: raw 0..1
  range DataConstr_GW_IBC_FLWheelSpeedKPH: raw 0..65535
  range DataConstr_GW_IBC_FRWheelSpeedKPH: raw 0..65535
  range DataConstr_GW_IBC_RLWheelSpeedKPH: raw 0..65535
  range DataConstr_GW_IBC_RRWheelSpeedKPH: raw 0..65535
  range DataConstr_GW_IBC_FLWheelDirection: raw 0..3
  range DataConstr_GW_IBC_FRWheelDirection: raw 0..3
  range DataConstr_GW_IBC_RLWheelDirection: raw 0..3
  range DataConstr_GW_IBC_RRWheelDirection: raw 0..3
  range DataConstr_GW_IBC_FLWheelSpeedVD: raw 0..1
  range DataConstr_GW_IBC_FRWheelSpeedVD: raw 0..1
  range DataConstr_GW_IBC_RLWheelSpeedVD: raw 0..1
  range DataConstr_GW_IBC_RRWheelSpeedVD: raw 0..1
  range DataConstr_GW_IBC_PlungerPressure_Q: raw 0..1
  range DataConstr_GW_IBC_PlungerPressure: raw 0..2047
  range DataConstr_CCM_Volt: raw 0..1023
  range DataConstr_CCM_RollingCounter_36A: raw 0..15
  range DataConstr_CCM_BaseState: raw 0..7
  range DataConstr_CCM_Power: raw 0..255
  range DataConstr_CCM_APTC_BscSts: raw 0..1
  range DataConstr_CCM_APTC_Power: raw 0..255
  range DataConstr_IBC_CRC_227: raw 0..255
  range DataConstr_IBC_RollingCounter_227: raw 0..15
  range DataConstr_IBC_EPB_FailStatus: raw 0..3
  range DataConstr_IBC_EPB_Status: raw 0..7
  range DataConstr_IBC_EPB_DrumMode: raw 0..1
  range DataConstr_IBC_EPB_AchievedClampForce: raw 0..255
  range DataConstr_IBC_EPB_FailureLamp: raw 0..3
  range DataConstr_IBC_EPB_ActuatorStateLeft: raw 0..3
  range DataConstr_IBC_EPB_ActuatorStateRight: raw 0..3
  range DataConstr_IBC_EPB_HostAvailabilityLeft: raw 0..3
  range DataConstr_IBC_EPB_HostAvailabilityRight: raw 0..3
  range DataConstr_Harness_igbt_temp{1..3}: raw 0..255
  range DataConstr_Harness_CoolWaterTemp: raw 0..255
  range DataConstr_Harness_V_DC: raw 0..65535
  range DataConstr_Harness_PWM_DIR: raw 0..255
  range DataConstr_Harness_HVIL_State: raw 0..1
  range DataConstr_Harness_crash_err_flag: raw 0..1
  range DataConstr_Harness_KeyON: raw 0..1
  range DataConstr_Harness_HWRdc: raw 0..1
  range DataConstr_Harness_HWFoT: raw 0..1
  range DataConstr_Harness_HWVoltLower: raw 0..1
  range DataConstr_Harness_HWFoB: raw 0..1
  range DataConstr_Harness_MotorTemp1: raw 0..65535
  range DataConstr_Harness_MotorTemp2: raw 0..65535
  range DataConstr_Harness_I_U: raw 0..255
  range DataConstr_Harness_I_W: raw 0..255
  range DataConstr_Harness_I_V: raw 0..255
  range DataConstr_Harness_HVRelayPosVolt: raw 0..255
  range DataConstr_MCUMR_Harness_igbt_temp{1..3}: raw 0..255
  range DataConstr_MCUMR_Harness_CoolWaterTemp: raw 0..255
  range DataConstr_MCUMR_Harness_V_DC: raw 0..65535
  range DataConstr_MCUMR_Harness_PWM_DIR: raw 0..255
  range DataConstr_MCUMR_Harness_HWRdc: raw 0..1
  range DataConstr_MCUMR_Harness_HWFoT: raw 0..1
  range DataConstr_MCUMR_Harness_HWVoltLower: raw 0..1
  range DataConstr_MCUMR_Harness_HWFoB: raw 0..1
  range DataConstr_MCUMR_Harness_MotorTemp1: raw 0..65535
  range DataConstr_MCUMR_Harness_MotorTemp2: raw 0..65535
  range DataConstr_MCUMR_Harness_I_U: raw 0..255
  range DataConstr_MCUMR_Harness_I_W: raw 0..255
  range DataConstr_MCUMR_Harness_I_V: raw 0..255
  range DataConstr_BCM_CRC_290: raw 0..255
  range DataConstr_BCM_RRDoorSts_ID290_CCAN: raw 0..1
  range DataConstr_BCM_RLDoorSts_ID290_CCAN: raw 0..1
  range DataConstr_BCM_RollingCounter_290: raw 0..15
  range DataConstr_BCM_HazardSwtSts: raw 0..1
  range DataConstr_BCM_DrOC_PPD_Status: raw 0..3
  range DataConstr_BCM_FLOC_PPD_Status: raw 0..3
  range DataConstr_BCM_FROC_PPD_Status: raw 0..3
  range DataConstr_BCM_DriverDoorSts_ID290_CCAN: raw 0..1
  range DataConstr_BCM_DriverDoorSts_VD: raw 0..1
  range DataConstr_BCM_FLDoorSts_ID290_CCAN: raw 0..1
  range DataConstr_BCM_FRDoorSts_ID290_CCAN: raw 0..1
  range DataConstr_BCM_BackDoorSts_ID290_CCAN: raw 0..1
  range DataConstr_BCM_FrontCoverSts: raw 0..1
  range DataConstr_BCM_HazardSwtOpenSts: raw 0..1
  range DataConstr_BCM_BrakeFluidLevel: raw 0..3
  range DataConstr_BCM_ON2BRelaySts_ID290_CCAN: raw 0..1
  range DataConstr_BCM_ON2CRelaySts_ID290_CCAN: raw 0..1
  range DataConstr_BCM_AlarmMode_C: raw 0..3
  range DataConstr_VCU_CRC_13: raw 0..255
  range DataConstr_VCU_RollingCounter_13: raw 0..15
  range DataConstr_VCU_SDrvRequestTorque_prvt: raw 0..65535
  range DataConstr_VCU_SDrvRequestTorqueVD_prvt: raw 0..1
  range DataConstr_VCU_MCUSDampgLmtFactor_prvt: raw 0..127
  range DataConstr_VCU_VehicleDirectS_prvt: raw 0..1
  range DataConstr_VCU_VehicleDirectS_VD_prvt: raw 0..1
  range DataConstr_VCU_MCUSMaxPosDampgTrq_prvt: raw 0..63
  range DataConstr_VCU_MCUSMaxNegDampgTrq_prvt: raw 0..63
  range DataConstr_EOL_CRC_13B: raw 0..255
  range DataConstr_EOL_RollingCounter_13B: raw 0..15
  range DataConstr_EOL_VehicleSts: raw 0..1
  range DataConstr_EOL_GearLevelPosSts: raw 0..3
  range DataConstr_EOL_GearLeverValid: raw 0..1
  range DataConstr_EOL_AccPedalValid: raw 0..1
  range DataConstr_EOL_ThrottlePosition: raw 0..255
  range DataConstr_EOL_RMCUActiveReleaseCmd: raw 0..1
  range DataConstr_EOL_VehicleDirect: raw 0..1
  range DataConstr_EOL_SuppressJitterRMCURequest: raw 0..1
  range DataConstr_EOL_RDrvControlMode: raw 0..1
  range DataConstr_EOL_BrakePedalValue: raw 0..255
  range DataConstr_EOL_RMCUMaxDischargePower: raw 0..511
  range DataConstr_EOL_RMCUMaxChargePower: raw 0..511
  range DataConstr_EOL_RDrvRequestTorque: raw 0..65535
  range DataConstr_EOL_RDrvRequesSpeed: raw 0..65535
  range DataConstr_EOL_FDrvRequestTorque: raw 0..65535
  range DataConstr_EOL_FDrvRequesSpeed: raw 0..65535
  range DataConstr_EOL_FVehicleSts: raw 0..1
  range DataConstr_EOL_FDrvControlMode: raw 0..1
  range DataConstr_EOL_ON2BRelayReq: raw 0..3
  range DataConstr_EOL_VehicleDirectVD: raw 0..1
  range DataConstr_EOL_RDrvControlModeVD: raw 0..1
  range DataConstr_EOL_RDrvRequestTorqueVD: raw 0..1
  range DataConstr_EOL_RDrvRequesSpeedVD: raw 0..1
  range DataConstr_EOL_FDrvRequestTorqueVD: raw 0..1
  range DataConstr_EOL_FDrvRequesSpeedVD: raw 0..1
  range DataConstr_EOL_FDrvControlModeVD: raw 0..1
  range DataConstr_EOL_MCUMDampgLmtFactor: raw 0..127
  range DataConstr_EOL_VCU_BoostMode_Fail: raw 0..7
  range DataConstr_EOL_VCU_BoostModeSts: raw 0..3
  range DataConstr_EOL_MCUMMaxPosDampgTrq: raw 0..63
  range DataConstr_EOL_MCUMMaxNegDampgTrq: raw 0..63
  range DataConstr_TMS_MilLampReq: raw 0..3
  range DataConstr_EMS_CRC_BE: raw 0..255
  range DataConstr_EMS_RollingCounter_BE: raw 0..15
  range DataConstr_EMS_EngineSts: raw 0..7
  range DataConstr_ECM_FaultLevel: raw 0..3
  range DataConstr_ECM_ActualEngineTorqueValid: raw 0..1
  range DataConstr_ECM_EngineTorqueLoss: raw 0..1023
  range DataConstr_ECM_ActualEngineTorque: raw 0..4095
  range DataConstr_ECM_EngineTorqueMax: raw 0..4095
  range DataConstr_ECM_EngineTorqueMin: raw 0..4095
  range DataConstr_ECM_EngineSpeed: raw 0..8191
  range DataConstr_ECM_EngineSpeedValid: raw 0..1
  range DataConstr_ECM_EngineStopAllow: raw 0..1
  range DataConstr_ECM_EngineOilPressureLow: raw 0..1
  range DataConstr_ECM_EngineFuleCutoffSts: raw 0..1
  range DataConstr_ECM_EngineStartedCompleted: raw 0..1
  range DataConstr_ECM_CatalystWarmUpSts: raw 0..1
  range DataConstr_ECM_CatalystWarmUpReq: raw 0..1
  range DataConstr_ECM_IdleTargetSpeed: raw 0..4095
  range DataConstr_ECM_IdleActive: raw 0..1
  range DataConstr_ECM_EngineStartReq: raw 0..7
  range DataConstr_ECM_EngineStopInhibit: raw 0..1023
  range DataConstr_ECM_GPFRegenlamp: raw 0..3
  range DataConstr_ECM_EngineCoolantTemp: raw 0..255
  range DataConstr_ECM_EngineCoolantTempValid: raw 0..1
  range DataConstr_ECM_FVVSts: raw 0..3
  range DataConstr_ECM_learningReq: raw 0..1
  range DataConstr_ECM_EngineIdleStateRequest: raw 0..1
  range DataConstr_ECM_EngineDFCOConditionRequest: raw 0..1
  range DataConstr_ECM_GPFRegenReq: raw 0..1
  range DataConstr_ECM_SVSLampRequest: raw 0..1
  range DataConstr_ECM_TankPressure: raw 0..1023
  range DataConstr_ECM_TankPressureValid: raw 0..1
  range DataConstr_ECM_MilLampRequest: raw 0..3
  range DataConstr_ECM_ToothlearningSucValid: raw 0..3
  range DataConstr_ECM_FuelCloseLoopSts: raw 0..1
  range DataConstr_ECM_RestrictorOpenValue: raw 0..127
  range DataConstr_ECM_FuelLevelSensorValid: raw 0..1
  range DataConstr_ECM_FuelLevel: raw 0..1023
  range DataConstr_ECM_SelfCheckSt: raw 0..1
  range DataConstr_ECM_PCVPipeDiagReq: raw 0..1
  range DataConstr_ECM_CalculatedLoad: raw 0..1023
  range DataConstr_ECM_FuelConsumption: raw 0..255
  range DataConstr_ECM_AirPressure: raw 0..255
  range DataConstr_ECM_FanSts: raw 0..255
  range DataConstr_EPS_CRC_18D: raw 0..255
  range DataConstr_EPS_RollingCounter_18D: raw 0..15
  range DataConstr_EPS_Fault: raw 0..1
  range DataConstr_EPS_CalibrationSts: raw 0..1
  range DataConstr_EPS_FailureSts: raw 0..1
  range DataConstr_EPS_SteeringAngleValidData: raw 0..1
  range DataConstr_EPS_SteeringAngleSpeedValidData: raw 0..1
  range DataConstr_EPS_SteerWheelAngle: raw 0..65535
  range DataConstr_EPS_SteerWheelRotSpd: raw 0..255
  range DataConstr_EPS_SelfCheckSt: raw 0..1
  range DataConstr_EPS_AssistanceSts: raw 0..3
  range DataConstr_GCU_CRC_BD: raw 0..255
  range DataConstr_GCU_EngineCylinderDeactivationStatus: raw 0..3
  range DataConstr_GCU_EngineFuelInhibitReq: raw 0..1
  range DataConstr_GCU_RollingCounter_BD: raw 0..15
  range DataConstr_GCU_MainWireCurr: raw 0..65535
  range DataConstr_GCU_MainWireVolt: raw 0..8191
  range DataConstr_GCU_SystemWarning: raw 0..1
  range DataConstr_GCU_MILlampReq: raw 0..1
  range DataConstr_GCU_MoterTemp: raw 0..255
  range DataConstr_GCU_Temp: raw 0..255
  range DataConstr_GCU_SelfCheck: raw 0..3
  range DataConstr_GCU_Warning_Level: raw 0..3
  range DataConstr_GCU_HVILSts: raw 0..1
  range DataConstr_GCU__PowerReduceSts: raw 0..1
  range DataConstr_GCU_ActualMotorRPM_VD: raw 0..1
  range DataConstr_GCU_ActualMotorTorque_VD: raw 0..1
  range DataConstr_GCU_ActualMotorTorque: raw 0..4095
  range DataConstr_GCU_MaxTorque: raw 0..4095
  range DataConstr_GCU_ActiveReleaseFB: raw 0..3
  range DataConstr_GCU_MAXPower: raw 0..255
  range DataConstr_GCU_TransientPower: raw 0..4095
  range DataConstr_GCU_HVOffReq: raw 0..1
  range DataConstr_GCU_ControlMode: raw 0..7
  range DataConstr_GCU_Operating_Mode: raw 0..15
  range DataConstr_GCU_ActualMotorRPM: raw 0..65535
  range DataConstr_BMS_WkupVolt_DC12V: raw 0..255
  range DataConstr_BMS_WkupVolt_AC12V: raw 0..255
  range DataConstr_BMS_HVPackPosRelayExternalVolt: raw 0..4095
  range DataConstr_BMS_SOC_target: raw 0..1023
  range DataConstr_BMS_CorrectSOEPer: raw 0..1023
  range DataConstr_BMS_SOCModifyFlag: raw 0..1
  range DataConstr_BMS_BMU_SoftwareVersion: raw 0..16777215
  range DataConstr_VCU_VehicleSpdDirect: raw 0..511
  range DataConstr_VCU_ADM_ActualMode: raw 0..3
  range DataConstr_VCU_ADM_MainMode: raw 0..3
  range DataConstr_VCU_DeliveryModeSts: raw 0..1
  range DataConstr_VCU_VehSpdLimtRemind: raw 0..1
  range DataConstr_VCU_SinglePedalSts: raw 0..1
  range DataConstr_VCU_GearLvrChangeSts: raw 0..15
  range DataConstr_VCU_HighVoltSysSts: raw 0..15
  range DataConstr_VCU_ChrgDischrgFunSts: raw 0..15
  range DataConstr_VCU_CalibrationVersion: raw 0..15
  range DataConstr_VCU_CalibrationNumber: raw 0..7
  range DataConstr_VCU_VehicleNegTrqRspdSts: raw 0..1
  range DataConstr_VCU_SlopeEst: raw 0..1023
  range DataConstr_VCU_SlopeEst_Valid: raw 0..1
  range DataConstr_VCU_WheelTrqType: raw 0..15
  range DataConstr_VCU_DriverAssistProhibitSts: raw 0..1
  range DataConstr_VCU_VacumRlySts: raw 0..1
  range DataConstr_VCU_DriveSHVILSts: raw 0..1
  range DataConstr_VCU_DriveMHVILSts: raw 0..1
  range DataConstr_VCU_DCChgHVILSts: raw 0..1
  range DataConstr_VCU_ACChgHVILSts: raw 0..1
  range DataConstr_VCU_CCMHVILSts: raw 0..1
  range DataConstr_VCU_SystemError: raw 0..1
  range DataConstr_VCU_AccPedalFaultLV: raw 0..7
  range DataConstr_VCU_HVILSysSts: raw 0..15
  range DataConstr_VCU_VacuumDegree: raw 0..255
  range DataConstr_VCU_LPedalModeSts: raw 0..3
  range DataConstr_VCU_LVSystemError: raw 0..1
  range DataConstr_VCU_HVSystemError: raw 0..1
  range DataConstr_VCU_OpeartingMode: raw 0..3
  range DataConstr_VCU_EnergyMode: raw 0..7
  range DataConstr_VCU_GearLevelPosFault: raw 0..1
  range DataConstr_VCU_BrakeSwitchSts: raw 0..3
  range DataConstr_VCU_SpdLimModeSts: raw 0..3
  range DataConstr_VCU_TrqDstrbutnPrio: raw 0..7
  range DataConstr_VCU_TrqDstrbutnTransferSts: raw 0..7
  range DataConstr_VCU_MCUMDiffProtectSts: raw 0..1
  range DataConstr_VCU_MCUSDiffProtectSts: raw 0..1
  range DataConstr_ICU_CRC_332: raw 0..255
  range DataConstr_ICU_RollingCounter_332: raw 0..15
  range DataConstr_ICU_AEB_SW: raw 0..1
  range DataConstr_ICU_ISA_controlSW: raw 0..1
  range DataConstr_ICU_SLIF_SW: raw 0..1
  range DataConstr_ICU_SLWF_SW: raw 0..1
  range DataConstr_TMS_MainMotPumpSpdResp: raw 0..255
  range DataConstr_TMS_MainMotPump_Operation_Temp: raw 0..255
  range DataConstr_TMS_MainMotPump_Operation_Current: raw 0..255
  range DataConstr_TMS_MainMotPump_Supplied_Voltage: raw 0..255
  range DataConstr_TMS_MainMotPumpErrSts: raw 0..15
  range DataConstr_IBC_CRC_184: raw 0..255
  range DataConstr_IBC_RollingCounter_184: raw 0..15
  range DataConstr_IBC_FLWheelSpeedKPH: raw 0..65535
  range DataConstr_IBC_FRWheelSpeedKPH: raw 0..65535
  range DataConstr_IBC_RLWheelSpeedKPH: raw 0..65535
  range DataConstr_IBC_RRWheelSpeedKPH: raw 0..65535
  range DataConstr_IBC_FLWheelDirection: raw 0..3
  range DataConstr_IBC_FRWheelDirection: raw 0..3
  range DataConstr_IBC_RLWheelDirection: raw 0..3
  range DataConstr_IBC_RRWheelDirection: raw 0..3
  range DataConstr_IBC_FLWheelSpeedVD: raw 0..1
  range DataConstr_IBC_FRWheelSpeedVD: raw 0..1
  range DataConstr_IBC_RLWheelSpeedVD: raw 0..1
  range DataConstr_IBC_RRWheelSpeedVD: raw 0..1
  range DataConstr_IBC_FLWheelSpeedRC: raw 0..4095
  range DataConstr_IBC_FRWheelSpeedRC: raw 0..4095
  range DataConstr_IBC_RLWheelSpeedRC: raw 0..4095
  range DataConstr_IBC_RRWheelSpeedRC: raw 0..4095
  range DataConstr_IBC_DiscTemperatureFL: raw 0..7
  range DataConstr_IBC_DiscTemperatureFLVD: raw 0..1
  range DataConstr_IBC_DiscTemperatureFR: raw 0..7
  range DataConstr_IBC_DiscTemperatureFRVD: raw 0..1
  range DataConstr_IBC_DiscTemperatureRL: raw 0..7
  range DataConstr_IBC_DiscTemperatureRLVD: raw 0..1
  range DataConstr_IBC_DiscTemperatureRR: raw 0..7
  range DataConstr_IBC_DiscTemperatureRRVD: raw 0..1
  range DataConstr_IBC_CRC_183: raw 0..255
  range DataConstr_IBC_RollingCounter_183: raw 0..15
  range DataConstr_IBC_RecuBrakeTorqueRequest: raw 0..32767
  range DataConstr_IBC_RecuBrakeTorqueRequest_Q: raw 0..3
  range DataConstr_IBC_sOutputRodDriverPer_Q: raw 0..3
  range DataConstr_IBC_BrakePedalApplied_Q: raw 0..3
  range DataConstr_IBC_HydraTorqTgtAct_Q: raw 0..3
  range DataConstr_IBC_HydraTorqTgtAct: raw 0..32767
  range DataConstr_IBC_BrakePedalApplied: raw 0..1
  range DataConstr_IBC_sOutputRodDriverPer: raw 0..127
  range DataConstr_IBC_HydraTorqAvailable: raw 0..1
  range DataConstr_IBC_CtrlMode: raw 0..7
  range DataConstr_IBC_QDC_HydraTorqTgt: raw 0..1
  range DataConstr_IBC_InPutRodDriver: raw 0..4095
  range DataConstr_IBC_InPutRodDriver_Q: raw 0..3
  range DataConstr_IBC_SystemAssistedStatus: raw 0..7
  range DataConstr_IBC_EngTorq_VLC_Vaild: raw 0..1
  range DataConstr_IBC_EngTorq_VLC: raw 0..16383
  range DataConstr_IBC_BrkTorq_VLC: raw 0..32767
  range DataConstr_IBC_BrkTorq_VLC_Vaild: raw 0..1
  range DataConstr_IBC_CRC_186: raw 0..255
  range DataConstr_IBC_RollingCounter_186: raw 0..15
  range DataConstr_IBC_WheelPressureReliabilityFL: raw 0..1
  range DataConstr_IBC_WheelPressureReliabilityFR: raw 0..1
  range DataConstr_IBC_WheelPressureReliabilityRL: raw 0..1
  range DataConstr_IBC_WheelPressureReliabilityRR: raw 0..1
  range DataConstr_IBC_WheelCylinderPressure_FL: raw 0..255
  range DataConstr_IBC_WheelCylinderPressure_FR: raw 0..255
  range DataConstr_IBC_WheelCylinderPressure_RL: raw 0..255
  range DataConstr_IBC_WheelCylinderPressure_RR: raw 0..255
  range DataConstr_IBC_WheelSlipFLVD: raw 0..1
  range DataConstr_IBC_WheelSlipFRVD: raw 0..1
  range DataConstr_IBC_WheelSlipRLVD: raw 0..1
  range DataConstr_IBC_WheelSlipRRVD: raw 0..1
  range DataConstr_IBC_WheelSlipFL: raw 0..255
  range DataConstr_IBC_WheelSlipFR: raw 0..255
  range DataConstr_IBC_WheelSlipRL: raw 0..255
  range DataConstr_IBC_WheelSlipRR: raw 0..255
  range DataConstr_IBC_Slop_Pencent: raw 0..255
  range DataConstr_PTC_BscSts: raw 0..1
  range DataConstr_PTC_RollingCounter_367: raw 0..15
  range DataConstr_PTC_Fault: raw 0..1
  range DataConstr_PTC_Power: raw 0..255
  range DataConstr_PTC_HV_interlock_faultSt: raw 0..1
  range DataConstr_VCU_FaultData{0..31}: raw 0..255
  range DataConstr_GW_TCM_CRC_30B: raw 0..255
  range DataConstr_GW_TCM_RollingCounter_30B: raw 0..15
  range DataConstr_GW_TCM_ParkingSwSts: raw 0..3
  range DataConstr_GW_TCM_STATUS_Park: raw 0..1
  range DataConstr_GW_TCM_Counter_Park: raw 0..15
  range DataConstr_GW_TCM_CRC_Park: raw 0..255
  range DataConstr_GW_TCM_GearLevelSwitchSts: raw 0..7
  range DataConstr_GW_TCM_STATUS_RND: raw 0..1
  range DataConstr_GW_TCM_Counter_RND: raw 0..15
  range DataConstr_GW_TCM_CRC_RND: raw 0..255
  range DataConstr_GW_TCM_SelfCheckSt: raw 0..1
  range DataConstr_VCU_CRC_B7: raw 0..255
  range DataConstr_VCU_KeepWorkModeFlag: raw 0..1
  range DataConstr_VCU_MAI_Active: raw 0..1
  range DataConstr_VCU_MAI_Available: raw 0..1
  range DataConstr_VCU_GetCrashStsReq: raw 0..1
  range DataConstr_VCU_ADASPosTorqueCap_VD: raw 0..1
  range DataConstr_VCU_ADASPosTorqueCap: raw 0..16383
  range DataConstr_VCU_RollingCounter_B7: raw 0..15
  range DataConstr_VCU_Vehicle_Warning_IDB7_CCAN: raw 0..3
  range DataConstr_VCU_VehicleSts_IDB7_CCAN: raw 0..1
  range DataConstr_VCU_PowerReduceReq: raw 0..3
  range DataConstr_VCU_ParkingReqToEPB_VD: raw 0..3
  range DataConstr_VCU_ParkingReqToEPB: raw 0..3
  range DataConstr_VCU_ACCAvailable: raw 0..3
  range DataConstr_VCU_ACCActiveSts: raw 0..1
  range DataConstr_VCU_Active_APS: raw 0..1
  range DataConstr_VCU_Available_APS: raw 0..1
  range DataConstr_VCU_ESCActive: raw 0..1
  range DataConstr_VCU_ESCTorqReqAvailability_Rear: raw 0..1
  range DataConstr_VCU_AutoHold_ibit: raw 0..1
  range DataConstr_VCU_VehicleSpeedVD: raw 0..3
  range DataConstr_VCU_CCSStatus: raw 0..3
  range DataConstr_VCU_AutoDriveRequest: raw 0..3
  range DataConstr_VCU_CCSAllow: raw 0..1
  range DataConstr_VCU_VlcHoldSts: raw 0..1
  range DataConstr_VCU_HoldReqSts: raw 0..3
  range DataConstr_VCU_HoldReqStsValid: raw 0..1
  range DataConstr_VCU_DriverAssistProhibitSts_IDB7_CCAN: raw 0..1
  range DataConstr_VCU_SpeedLimitedSts: raw 0..1
  range DataConstr_VCU_SpeedLimitedValue: raw 0..255
  range DataConstr_VCU_TheoAccePedalPercent: raw 0..255
  range DataConstr_VCU_RecuBrakeTorqueCap: raw 0..32767
  range DataConstr_VCU_RecuBrakeTorqueAct: raw 0..32767
  range DataConstr_VCU_TheoAccePedalValid: raw 0..1
  range DataConstr_VCU_HydraTorqTgt: raw 0..32767
  range DataConstr_VCU_RecuBrakeTorqueActDrag: raw 0..32767
  range DataConstr_VCU_ESCTorqReqAvailability_Frnt: raw 0..1
  range DataConstr_VCU_RecuBrakeTorqueCap_Q: raw 0..3
  range DataConstr_VCU_RecuBrakeTorqueAct_Q: raw 0..3
  range DataConstr_VCU_HydraTorqTgt_Q: raw 0..3
  range DataConstr_VCU_RecuBrakeTorqueActDrag_Q: raw 0..3
  range DataConstr_VCU_RecuBrakeTorqueTarget_Drag: raw 0..32767
  range DataConstr_VCU_PreventVehSlipSts: raw 0..1
  range DataConstr_VCU_RecuBrakeTorqueTarget_Drag_Q: raw 0..3
  range DataConstr_VCU_AllMotWhlTrqFB: raw 0..16383
  range DataConstr_VCU_AllMotWhlTrqFB_VD: raw 0..1
  range DataConstr_VCU_LSFC_Allow: raw 0..1
  range DataConstr_VCU_LSFC_Active: raw 0..1
  range DataConstr_VCU_MGCUWorkMode_C: raw 0..3
  range DataConstr_VCU_AllRoadSts: raw 0..7
  range DataConstr_VCU_CmpUTurnAllow: raw 0..1
  range DataConstr_VCU_CmpUTurnSts: raw 0..3
  range DataConstr_VCU_AllowCmpUTurnStartFlag: raw 0..1
  range DataConstr_VCU_CmpUTurnLockWhl: raw 0..7
  range DataConstr_VCU_CmpUTurnActAngle: raw 0..511
  range DataConstr_VCU_CmpUTurnActSpinSpd: raw 0..15
  range DataConstr_VCU_CmpUTurnFltHMI: raw 0..15
  range DataConstr_VCU_EscapeModeSts: raw 0..1
  range DataConstr_VCU_MCUSWorkFailMsg: raw 0..7
  range DataConstr_VCU_EscapeWorkFailMsg: raw 0..7
  range DataConstr_VCU_REClutchFltMsg: raw 0..3
  range DataConstr_ECM_UDS_Res_Byte{0..7}: raw 0..255
  range DataConstr_VCU_BCM_Authentication_MAC_A{0..15}: raw 0..255
  range DataConstr_VCU_BCM_Authentication_Challenge_B{0..3}: raw 0..255
  range DataConstr_TMS_MCUMHeatPwrReq: raw 0..255
  range DataConstr_TMS_MCUMHeatModEnad: raw 0..1
  range DataConstr_TMS_VCU_MotSelfHeatEnReq: raw 0..1
  range DataConstr_TMS_VCU_MotSelfHeatLvlReq: raw 0..15
  range DataConstr_ECM_SWVersionC: raw 0..255
  range DataConstr_ECM_SWVersionB: raw 0..255
  range DataConstr_ECM_SWVersionA: raw 0..15
  range DataConstr_ECM_Total_fuel_consumed: raw 0..4294967295
  range DataConstr_IVI_CRC_331: raw 0..255
  range DataConstr_IVI_RollingCounter_331: raw 0..15
  range DataConstr_IVI_EPBRequst: raw 0..3
  range DataConstr_IVI_TerrainMatchMode: raw 0..7
  range DataConstr_IVI_LPedalModeSW: raw 0..1
  range DataConstr_IVI_AVHSw_X: raw 0..3
  range DataConstr_IVI_ESCSw_X: raw 0..3
  range DataConstr_IVI_HDCSw_X: raw 0..3
  range DataConstr_IVI_CSTSw_X: raw 0..3
  range DataConstr_IVI_AutoAllRoad: raw 0..7
  range DataConstr_IVI_CampingMode_SW: raw 0..1
  range DataConstr_IVI_BraPedMod: raw 0..3
  range DataConstr_IVI_SlowspeedSmartCtrl: raw 0..1
  range DataConstr_IVI_TrailerModeCtrl: raw 0..1
  range DataConstr_IVI_EscapeMode_SW: raw 0..1
  range DataConstr_IVI_PowerSavingModeReq: raw 0..3
  range DataConstr_IVI_SelfAdaptionDriveSW: raw 0..1
  range DataConstr_IVI_CmpUTurnStartUI: raw 0..1
  range DataConstr_IVI_CmpUTurnLockWhlUI: raw 0..7
  range DataConstr_IVI_CmpUTurnTarDirUI: raw 0..3
  range DataConstr_IVI_CmpUTurnTarAngleUI: raw 0..511
  range DataConstr_IVI_CmpUTurnReq: raw 0..3
  range DataConstr_IVI_InventerLimitOdometerkm: raw 0..4095
  range DataConstr_IVI_FuelDetMode: raw 0..1
  range DataConstr_IVI_EngineIdlingMode: raw 0..1
  range DataConstr_IVI_CarWashMode: raw 0..1
  range DataConstr_IVI_CampingModeSW: raw 0..1
  range DataConstr_IVI_SpeedLimitModeSW: raw 0..1
  range DataConstr_IVI_FuelupReq: raw 0..1
  range DataConstr_IVI_FuelChgLevel: raw 0..3
  range DataConstr_IVI_FuelChgMode: raw 0..1
  range DataConstr_IVI_InventerLimitOdometerkmVD: raw 0..1
  range DataConstr_IVI_EMSRepairModeReq: raw 0..1
  range DataConstr_IVI_ForceChgModeReq: raw 0..1
  range DataConstr_IVI_ForceChgTargetSOCVD: raw 0..1
  range DataConstr_IVI_SpeedLimitModeSpeed: raw 0..255
  range DataConstr_IVI_AWDModeSW: raw 0..1
  range DataConstr_IVI_ForceChgTargetSOC: raw 0..255
  range DataConstr_BCM_VCU_Authentication_Sts: raw 0..3
  range DataConstr_BCM_PTCLossMissErr: raw 0..1
  range DataConstr_BCM_PTCRollCntErr: raw 0..1
  range DataConstr_BCM_PTCChksumErr: raw 0..1
  range DataConstr_BCM_PDUHVIL_STs: raw 0..1
  range DataConstr_BCM_Cab220VHVIL_STs: raw 0..1
  range DataConstr_BCM_Cabin220VHVIL_STs: raw 0..1
  range DataConstr_IBC_CRC_185: raw 0..255
  range DataConstr_IBC_RollingCounter_185: raw 0..15
  range DataConstr_IBC_PlungerPressure: raw 0..2047
  range DataConstr_IBC_PlungerPressure_Q: raw 0..1
  range DataConstr_IBC_SimulatorPressure: raw 0..2047
  range DataConstr_IBC_SimulatorPressure_Q: raw 0..1
  range DataConstr_IBC_HMI_WarningOn: raw 0..3
  range DataConstr_IBC_MIL_WarningOn: raw 0..1
  range DataConstr_IBC_LongitAcceAct: raw 0..1023
  range DataConstr_IBC_LongitAcceActValid: raw 0..1
  range DataConstr_IBC_brakeFluidWarning: raw 0..3
  range DataConstr_IBC_SCM_Active: raw 0..1
  range DataConstr_IBC_SCM_Failed: raw 0..1
  range DataConstr_IBC_CDPAvailable: raw 0..1
  range DataConstr_IBC_CDPIntervention: raw 0..1
  range DataConstr_IBC_AEB_active: raw 0..1
  range DataConstr_IBC_AEBdecAvailable: raw 0..1
  range DataConstr_IBC_AVHStatus: raw 0..3
  range DataConstr_IBC_AVHAvailable: raw 0..1
  range DataConstr_IBC_HHCActive: raw 0..1
  range DataConstr_IBC_HHCFailed: raw 0..1
  range DataConstr_IBC_CDD_Available_APA: raw 0..1
  range DataConstr_IBC_CDD_Active_APA: raw 0..1
  range DataConstr_IBC_CDD_Available_ACC: raw 0..1
  range DataConstr_IBC_CDD_Active_ACC: raw 0..1
  range DataConstr_IBC_HDCStatus: raw 0..3
  range DataConstr_IBC_HDCAvailable: raw 0..1
  range DataConstr_IBC_CSTStatus: raw 0..3
  range DataConstr_IBC_CSTAvailable: raw 0..1
  range DataConstr_IBC_VLC_Available_ACC: raw 0..1
  range DataConstr_IBC_VLC_Active_ACC: raw 0..1
  range DataConstr_IBC_VLC_Available_APA: raw 0..1
  range DataConstr_IBC_VLC_Active_APA: raw 0..1
  range DataConstr_IBC_VehicleHoldStatus: raw 0..3
  range DataConstr_IBC_DrvrBrkTqAtWhlsReqd: raw 0..32767
  range DataConstr_TMS_RollingCounter_363: raw 0..15
  range DataConstr_TMS_AC_Command: raw 0..1
  range DataConstr_TMS_PTCHeatingReq: raw 0..1
  range DataConstr_TMS_PTCPowerSet: raw 0..255
  range DataConstr_TMS_OutsideTempVD: raw 0..1
  range DataConstr_TMS_OutsideTemp_Corrected: raw 0..255
  range DataConstr_BMS_SOC_Real: raw 0..1023
  range DataConstr_BMS_MODE_t: raw 0..15
  range DataConstr_BMS_VoltLoDeratLevel_NA: raw 0..3
  range DataConstr_BMS_VoltHiDeratLevel_NA: raw 0..3
  range DataConstr_TMS_MCUOutTemp: raw 0..255
  range DataConstr_TMS_MCUMIntelTemp: raw 0..255
  range DataConstr_TMS_MCUSIntelTemp: raw 0..255
  range DataConstr_BCM_VCU_Authentication_Challenge_A{0..3}: raw 0..255
  range DataConstr_ICU_CRC_DF: raw 0..255
  range DataConstr_ICU_RollingCounter_DF: raw 0..15
  range DataConstr_ICU_IMU_ACC_x: raw 0..65535
  range DataConstr_ICU_IMU_ACC_y: raw 0..65535
  range DataConstr_ICU_IMU_ACC_z: raw 0..65535
  range DataConstr_ICU_IMU_ACC_Roll_Rate: raw 0..65535
  range DataConstr_ICU_IMU_ACC_Pitch_Rate: raw 0..65535
  range DataConstr_ICU_IMU_ACC_Yaw_Rate: raw 0..65535
  range DataConstr_ICU_IMU_Calibrated: raw 0..3
  range DataConstr_ICU_IMU_Valid: raw 0..1
  range DataConstr_EddyCur_Para_Cos_m: raw 0..4095
  range DataConstr_EddyCur_Stage: raw 0..7
  range DataConstr_EddyCur_IdenFinish_Flag: raw 0..1
  range DataConstr_EddyCur_Para_Sin_m: raw 0..4095
  range DataConstr_EddyCur_Write_Flag: raw 0..1
  range DataConstr_EddyCur_FauPro_IDEL_OTime_Flag: raw 0..1
  range DataConstr_EddyCur_FauPro_SpdInstab_Flag: raw 0..1
  range DataConstr_EddyCur_FauPro_IDPara_OVal_Flag: raw 0..1
  range DataConstr_EddyCur_Para_Cos_k: raw 0..32767
  range DataConstr_EddyCur_Enable: raw 0..1
  range DataConstr_EddyCur_Para_Sin_k: raw 0..32767
  range DataConstr_EddyCur_IdenFail_Flag: raw 0..1
  range DataConstr_EddyCur_Para_Cos_Pha: raw 0..65535
  range DataConstr_EddyCur_Para_Sin_Pha: raw 0..65535
  range DataConstr_EddyCur_ReadSuccess_Flag: raw 0..1
  range DataConstr_OfsIden_ReadSuccess_Flag: raw 0..1
  range DataConstr_OfsIden_SpdUp_Overtime: raw 0..1
  range DataConstr_OfsIden_SpdUp_OverSpd: raw 0..1
  range DataConstr_OfsIden_IdenDiverge: raw 0..1
  range DataConstr_OfsIden_IdenCntOver: raw 0..1
  range DataConstr_OfsIden_MtrLock: raw 0..1
  range DataConstr_OfsIden_OfsRslt: raw 0..4095
  range DataConstr_OfsIden_Sts: raw 0..7
  range DataConstr_OfsIden_Finish: raw 0..1
  range DataConstr_OfsIden_OfsWrite_Finish: raw 0..1
  range DataConstr_OfsIden_DirWrite_Finish: raw 0..1
  range DataConstr_OfsIden_DirIden_Rslt: raw 0..3
  range DataConstr_OfsIden_ZeroAlign_OverTime: raw 0..1
  range DataConstr_OfsIden_ZeroAlign_Fail: raw 0..1
  range DataConstr_OfsIden_IFStart_Overtime: raw 0..1
  range DataConstr_OfsIden_IFStart_Fail: raw 0..1
  range DataConstr_PosDly_Cal_RslvDelayTime: raw 0..65535
  range DataConstr_PosDly_Theta_k_Std: raw 0..32767
  range DataConstr_PosDly_Supplier: raw 0..1
  range DataConstr_PosDly_FauPro_Ident_OTm_Flag: raw 0..1
  range DataConstr_PosDly_FauPro_SpdDn_OTm_Flag: raw 0..1
  range DataConstr_PosDly_RslvOffsetComp: raw 0..63
  range DataConstr_PosDly_Enable: raw 0..1
  range DataConstr_PosDly_IdentFail_Flag: raw 0..1
  range DataConstr_PosDly_IdentFinish_Flag: raw 0..1
  range DataConstr_PosDly_Write_Flag: raw 0..1
  range DataConstr_PosDly_FauPro_Chk_DlyTime_OVal: raw 0..1
  range DataConstr_PosDly_FauPro_Chk_RslvOfst_OVal: raw 0..1
  range DataConstr_PosDly_FauPro_Check_Divergence: raw 0..1
  range DataConstr_PosDly_FauPro_SpdUp_OTm_Flag: raw 0..1
  range DataConstr_PosDly_Stage: raw 0..7
  range DataConstr_IMParaIdent_ParEstMainStep: raw 0..15
  range DataConstr_IMParaIdent_Rs: raw 0..1023
  range DataConstr_IMParaIdent_Rr: raw 0..1023
  range DataConstr_IMParaIdent_Ll: raw 0..16383
  range DataConstr_IMParaIdent_Lm: raw 0..16383
  range DataConstr_IMParaIdent_TotalLo: raw 0..16383
  range DataConstr_IMParaIdent_IdentSubStep: raw 0..31
  range DataConstr_MCUMR_EddyCur_Para_Cos_m: raw 0..4095
  range DataConstr_MCUMR_EddyCur_Stage: raw 0..7
  range DataConstr_MCUMR_EddyCur_IdenFinish_Flag: raw 0..1
  range DataConstr_MCUMR_EddyCur_Para_Sin_m: raw 0..4095
  range DataConstr_MCUMR_EddyCur_Write_Flag: raw 0..1
  range DataConstr_MCUMR_EddyCur_FauPro_IDEL_OTime_Flag: raw 0..1
  range DataConstr_MCUMR_EddyCur_FauPro_SpdInstab_Flag: raw 0..1
  range DataConstr_MCUMR_EddyCur_FauPro_IDPara_OVal_Flag: raw 0..1
  range DataConstr_MCUMR_EddyCur_Para_Cos_k: raw 0..32767
  range DataConstr_MCUMR_EddyCur_Enable: raw 0..1
  range DataConstr_MCUMR_EddyCur_Para_Sin_k: raw 0..32767
  range DataConstr_MCUMR_EddyCur_IdenFail_Flag: raw 0..1
  range DataConstr_MCUMR_EddyCur_Para_Cos_Pha: raw 0..65535
  range DataConstr_MCUMR_EddyCur_Para_Sin_Pha: raw 0..65535
  range DataConstr_MCUMR_EddyCur_ReadSuccess_Flag: raw 0..1
  range DataConstr_MCUMR_OfsIden_ReadSuccess_Flag: raw 0..1
  range DataConstr_MCUMR_OfsIden_SpdUp_Overtime: raw 0..1
  range DataConstr_MCUMR_OfsIden_SpdUp_OverSpd: raw 0..1
  range DataConstr_MCUMR_OfsIden_IdenDiverge: raw 0..1
  range DataConstr_MCUMR_OfsIden_IdenCntOver: raw 0..1
  range DataConstr_MCUMR_OfsIden_MtrLock: raw 0..1
  range DataConstr_MCUMR_OfsIden_OfsRslt: raw 0..4095
  range DataConstr_MCUMR_OfsIden_Sts: raw 0..7
  range DataConstr_MCUMR_OfsIden_Finish: raw 0..1
  range DataConstr_MCUMR_OfsIden_OfsWrite_Finish: raw 0..1
  range DataConstr_MCUMR_OfsIden_DirWrite_Finish: raw 0..1
  range DataConstr_MCUMR_OfsIden_DirIden_Rslt: raw 0..3
  range DataConstr_MCUMR_OfsIden_ZeroAlign_OverTime: raw 0..1
  range DataConstr_MCUMR_OfsIden_ZeroAlign_Fail: raw 0..1
  range DataConstr_MCUMR_OfsIden_IFStart_Overtime: raw 0..1
  range DataConstr_MCUMR_OfsIden_IFStart_Fail: raw 0..1
  range DataConstr_MCUM_StatorTemp_1: raw 0..255
  range DataConstr_MCUM_L2TqAct: raw 0..1023
  range DataConstr_MCUM_EOPSw: raw 0..131071
  range DataConstr_MCUM_StatorTemp_2: raw 0..255
  range DataConstr_MCUM_IGBTTemp_U: raw 0..255
  range DataConstr_MCUM_IGBTTemp_V: raw 0..255
  range DataConstr_MCUM_IGBTTemp_W: raw 0..255
  range DataConstr_MCUM_PCBTemp: raw 0..255
  range DataConstr_MCUM_Power_12V: raw 0..255
  range DataConstr_MCUM_Power_15V: raw 0..255
  range DataConstr_MCUM_Offset_IU: raw 0..8191
  range DataConstr_MCUM_Offset_IV: raw 0..8191
  range DataConstr_MCUM_Offset_IW: raw 0..8191
  range DataConstr_MCUM_MainSt_State: raw 0..15
  range DataConstr_MCUM_Derate_Reason: raw 0..15
  range DataConstr_MCUM_PWM_Freq_kHz: raw 0..255
  range DataConstr_MCUM_PWMEn_State: raw 0..1
  range DataConstr_MCUM_DrvPwrEn_Out_State: raw 0..1
  range DataConstr_MCUM_SBC_SelfCheckFault: raw 0..1
  range DataConstr_MCUM_SBC_TempOverFault: raw 0..1
  range DataConstr_MCUM_SBC_SPIFault: raw 0..1
  range DataConstr_MCUM_SBC_InsideVotageFault: raw 0..1
  range DataConstr_MCUM_SBC_OutPutVotageFault: raw 0..1
  range DataConstr_MCUM_SBC_FeedDogFault: raw 0..1
  range DataConstr_MCUM_NVM_RslvrZeroRFault: raw 0..1
  range DataConstr_MCUM_Rotor_Position: raw 0..8191
  range DataConstr_MCUM_PosTransduserFaultCode: raw 0..255
  range DataConstr_MCUM_NVM_RslvrDirRFault: raw 0..1
  range DataConstr_MCUM_NVM_RslvrDelayRFault: raw 0..1
  range DataConstr_MCUM_NVM_RslvrParamRFault: raw 0..1
  range DataConstr_MCUM_NVM_HallGainRFault: raw 0..1
  range DataConstr_MCUM_NVM_HallDelayRFault: raw 0..1
  range DataConstr_MCUM_NVM_IGBTTypeRFault: raw 0..1
  range DataConstr_MCUM_NVM_MotorTypeRFault: raw 0..1
  range DataConstr_MCUM_NVM_VehicleTypeRFault: raw 0..1
  range DataConstr_MCUM_ASC_EntryCount: raw 0..31
  range DataConstr_MCUM_Spd_Turn: raw 0..32767
  range DataConstr_MCUM_LUT_Spd_Max: raw 0..32767
  range DataConstr_MCUM_EOP_Speed: raw 0..8191
  range DataConstr_MCUM_EOP_IqFb: raw 0..511
  range DataConstr_MCUM_EOP_IqRef: raw 0..511
  range DataConstr_MCUM_EOP_DCVolt: raw 0..511
  range DataConstr_MCUM_EOP_DCCurr: raw 0..511
  range DataConstr_MCUM_EOP_Temp: raw 0..255
  range DataConstr_MCUM_EOP_State: raw 0..15
  range DataConstr_MCUM_EOP_FaultCode: raw 0..7
  range DataConstr_MCUM_HWFault_RstCnt: raw 0..15
  range DataConstr_MCUM_HWFoB_RstCnt: raw 0..15
  range DataConstr_MCUM_HWFoT_RstCnt: raw 0..15
  range DataConstr_MCUM_HWDrvUV_RstCnt: raw 0..15
  range DataConstr_MCUM_HWRdc_RstCnt: raw 0..15
  range DataConstr_MCUM_HWOC_RstCnt: raw 0..15
  range DataConstr_MCUM_HWOV_RstCnt: raw 0..15
  range DataConstr_MCUM_L2agRtrElecDiff: raw 0..15
  range DataConstr_MCUM_500usOverTime_Cnt: raw 0..15
  range DataConstr_MCUM_5msOverTime_Cnt: raw 0..15
  range DataConstr_MCUM_12VHop_Cnt: raw 0..15
  range DataConstr_MCUM_12V_Max: raw 0..255
  range DataConstr_MCUM_12V_Min: raw 0..255
  range DataConstr_MCUM_NVMFail_Cnt: raw 0..15
  range DataConstr_MCUM_EOL_CANCommReq: raw 0..1
  range DataConstr_MCUM_ResetReason: raw 0..255
  range DataConstr_MCUM_CpldRest_TimeOut_flag: raw 0..3
  range DataConstr_MCUM_DrvPCBCurr: raw 0..31
  range DataConstr_MCUM_EOL_StateMachine: raw 0..255
  range DataConstr_MCUM_CpldRest_ASC_Flag: raw 0..1
  range DataConstr_MCUM_LimSpdTorFlag: raw 0..1
  range DataConstr_MCUM_PWM_Err_Count: raw 0..31
  range DataConstr_MCUM_RDC_Reset_Count: raw 0..255
  range DataConstr_MCUM_ASC_Stop_Flag: raw 0..1
  range DataConstr_MCUM_ASC_Soft_Exiting_Flag: raw 0..1
  range DataConstr_MCUM_Vbus_ServeLowChkEn: raw 0..1
  range DataConstr_MCUM_EOP_BlockErr_IsLim_Flag: raw 0..1
  range DataConstr_MCUM_MotSelfHeat_EnSts: raw 0..3
  range DataConstr_MCUM_MotBlockHeat_LvlFb: raw 0..7
  range DataConstr_MCUM_MotRotaryHeat_LvlFb: raw 0..7
  range DataConstr_MCUM_MotSelfHeat_DropLvlFb: raw 0..1
  range DataConstr_MCUM_MotSelfHeat_DropLvlRsn: raw 0..3
  range DataConstr_MCUM_MotBlockHeat_CurAngle: raw 0..511
  range DataConstr_MCUM_MotBlockHeat_CurMag: raw 0..511
  range DataConstr_MCUM_FaultDataRec_State: raw 0..15
  range DataConstr_MCUM_UserDefine_Byte{1..4}: raw 0..255
  range DataConstr_MCUM_UserDefine_Word{1..3}: raw 0..65535
  range DataConstr_ECM_EngineWorktime: raw 0..65535
  range DataConstr_GTC_TestSts: raw 0..255
  range DataConstr_GTC_ThetaPos: raw 0..65535
  range DataConstr_GTC_ThetaNeg: raw 0..65535
  range DataConstr_GTC_ThetaDelt: raw 0..65535
  range DataConstr_GTC_TestRslt: raw 0..255
  range DataConstr_MCUMR_GTC_TestSts: raw 0..255
  range DataConstr_MCUMR_GTC_ThetaPos: raw 0..65535
  range DataConstr_MCUMR_GTC_ThetaNeg: raw 0..65535
  range DataConstr_MCUMR_GTC_ThetaDelt: raw 0..65535
  range DataConstr_MCUMR_GTC_TestRslt: raw 0..255
  range DataConstr_MCUM_CRC_CA: raw 0..255
  range DataConstr_MCUM_RollingCounter_CA: raw 0..15
  range DataConstr_MCUM_WarningLevel: raw 0..3
  range DataConstr_MCUM_SelfCheckSts: raw 0..3
  range DataConstr_MCUM_DrvMotorWorkSts: raw 0..3
  range DataConstr_MCUM_PowerReduceSts: raw 0..1
  range DataConstr_MCUM_SystemError: raw 0..1
  range DataConstr_MCUM_DrvMotorRPM: raw 0..65535
  range DataConstr_MCUM_ActualTorqueFB: raw 0..65535
  range DataConstr_MCUM_HWRdcFault: raw 0..1
  range DataConstr_MCUM_LVSystemError: raw 0..1
  range DataConstr_MCUM_HighVoltPowerOffReq: raw 0..1
  range DataConstr_MCUM_HVILSts: raw 0..1
  range DataConstr_MCUM_DragSts: raw 0..3
  range DataConstr_MCUM_CtrlMode: raw 0..1
  range DataConstr_MCUM_MotorTempAlarm: raw 0..1
  range DataConstr_MCUM_HVSystemError: raw 0..1
  range DataConstr_MCUM_MILlampReq: raw 0..1
  range DataConstr_MCUM_SeriousWarning_Level: raw 0..3
  range DataConstr_MCUM_DrvMotorRPMVD: raw 0..1
  range DataConstr_MCUM_ActualTorqueFBVD: raw 0..1
  range DataConstr_MCUM_CtrlModeVD: raw 0..1
  range DataConstr_MCUM_MaxTorqueAllow: raw 0..65535
  range DataConstr_MCUM_MaxSpeedAllow: raw 0..65535
  range DataConstr_MCUM_WaterPumpLevlReq: raw 0..15
  range DataConstr_MCUM_ActiveReleaseSts: raw 0..3
  range DataConstr_MCUM_DCChargRelaySts: raw 0..1
  range DataConstr_MCUM_Fault_DCChargRelay: raw 0..1
  range DataConstr_MCUM_MinTorqueAllow: raw 0..65535
  range DataConstr_MCUM_MainWireVolt: raw 0..65535
  range DataConstr_MCUM_MotorTemp: raw 0..255
  range DataConstr_MCUM_IGBTTemp: raw 0..255
  range DataConstr_MCUM_InletTemp: raw 0..255
  range DataConstr_MCUM_MainWireCurr: raw 0..65535
  range DataConstr_MCUM_TMS_MotSelfHeatEnSts: raw 0..1
  range DataConstr_MCUM_TMS_MotSelfHeatLvlFb: raw 0..7
  range DataConstr_MCUM_HeatPwrAllwd: raw 0..1
  range DataConstr_MCUM_HeatFdBck: raw 0..3
  range DataConstr_MCUM_RPowerReduceSts: raw 0..1
  range DataConstr_MCUM_HeatPwrAct: raw 0..255
  range DataConstr_MCUM_HeatPwrMax: raw 0..255
  range DataConstr_MCUM_HeatPwrAval: raw 0..31
  range DataConstr_MCUM_RCtrlMode: raw 0..1
  range DataConstr_MCUM_RWarningLevel: raw 0..3
  range DataConstr_MCUM_RSelfCheckSts: raw 0..3
  range DataConstr_MCUM_RDrvMotorWorkSts: raw 0..3
  range DataConstr_MCUM_RCtrlModeVD: raw 0..1
  range DataConstr_MCUM_RHWRdcFault: raw 0..1
  range DataConstr_MCUM_RDrvMotorRPMVD: raw 0..1
  range DataConstr_MCUM_RActualTorqueFBVD: raw 0..1
  range DataConstr_MCUM_RDrvMotorRPM: raw 0..65535
  range DataConstr_MCUM_RActualTorqueFB: raw 0..65535
  range DataConstr_IBC_CRC_182: raw 0..255
  range DataConstr_IBC_RollingCounter_182: raw 0..15
  range DataConstr_IBC_VehicleSpeed: raw 0..65535
  range DataConstr_IBC_VehicleSpeedVD: raw 0..1
  range DataConstr_IBC_ABSActive: raw 0..1
  range DataConstr_IBC_ABSFailed: raw 0..1
  range DataConstr_IBC_TCSActive: raw 0..1
  range DataConstr_IBC_TCSFailed: raw 0..1
  range DataConstr_IBC_ESCFunctionStatus: raw 0..1
  range DataConstr_IBC_BrakeForce: raw 0..1
  range DataConstr_IBC_Vehiclestandstill: raw 0..1
  range DataConstr_IBC_EBDFailed: raw 0..1
  range DataConstr_IBC_EBDActive: raw 0..1
  range DataConstr_IBC_VDCActive: raw 0..1
  range DataConstr_IBC_VDCFailed: raw 0..1
  range DataConstr_IBC_EDCActive: raw 0..1
  range DataConstr_IBC_EDCFailed: raw 0..1
  range DataConstr_IBC_SystemInitializeStatus: raw 0..1
  range DataConstr_IBC_BTCSActive: raw 0..1
  range DataConstr_IBC_ETCSActive: raw 0..1
  range DataConstr_IBC_ARPActive: raw 0..1
  range DataConstr_IBC_VCU_DrumMode: raw 0..1
  range DataConstr_IBC_EscapeModeSts: raw 0..1
  range DataConstr_IBC_TSAActive: raw 0..1
  range DataConstr_IBC_TSAStatus: raw 0..3
  range DataConstr_MCUM_FaultData{0..7}: raw 0..255
  range DataConstr_MCUM_FaultData{8..14}: raw 0..18446744073709551615
  range DataConstr_MCUM_R_FaultData{0..7}: raw 0..255
  range DataConstr_MCUM_R_FaultData{8..14}: raw 0..18446744073709551615
  range DataConstr_ICU_CRC_24D: raw 0..255
  range DataConstr_ICU_SpeedConversionCoefficient: raw 0..3
  range DataConstr_ICU_RollingCounter_24D: raw 0..15
  range DataConstr_ICU_CCSFunctionStatus: raw 0..1
  range DataConstr_ICU_CruiseVehicleSpeedCtl: raw 0..65535
  range DataConstr_ICU_VehicleScreenSpeed: raw 0..511
  range DataConstr_ICU_VehicleSpeedUnit: raw 0..1
  range DataConstr_ICU_ACCFunctionStatus: raw 0..1
  range DataConstr_ICU_LCCFunctionStatus: raw 0..1
  range DataConstr_IVI_LPedalMode: raw 0..1
  range DataConstr_ICU_TotalOilmeterkm: raw 0..1048575
  range DataConstr_ICU_CLTCoilMileage: raw 0..2047
  range DataConstr_ICU_WLTC_oilMileage: raw 0..2047
  range DataConstr_ICU_CLTC_ElectticityMileage: raw 0..2047
  range DataConstr_ICU_WLTC_ElectticityMileage: raw 0..2047
  range DataConstr_ICU_Switch_CLTCOrWLTC: raw 0..7
  range DataConstr_ICU_FuelPercent: raw 0..1023
  range DataConstr_ACU_CRC_233: raw 0..255
  range DataConstr_ACU_RollingCounter_233: raw 0..15
  range DataConstr_ACU_LateralAcce: raw 0..1023
  range DataConstr_ACU_LongitAcce: raw 0..1023
  range DataConstr_ACU_LateralAcceValid: raw 0..1
  range DataConstr_ACU_LongitAcceValid: raw 0..1
  range DataConstr_ACU_SensorCalSt: raw 0..1
  range DataConstr_ACU_YawRate: raw 0..16383
  range DataConstr_ACU_YawRateValid: raw 0..1
  range DataConstr_MotClb_UdFb: raw 0..65535
  range DataConstr_MotClb_UqFb: raw 0..65535
  range DataConstr_MotClb_IdSet: raw 0..65535
  range DataConstr_MotClb_IqSet: raw 0..65535
  range DataConstr_MotClb_IsCMD_Fb: raw 0..65535
  range DataConstr_MotClb_ThetaCMD_Fb: raw 0..65535
  range DataConstr_MotClb_Id_Fb: raw 0..65535
  range DataConstr_MotClb_Iq_Fb: raw 0..65535
  range DataConstr_MotClb_Spd_rpm_Flt: raw 0..65535
  range DataConstr_MotClb_ThtSetReal: raw 0..65535
  range DataConstr_MotClb_Power_Inverter: raw 0..65535
  range DataConstr_MotClb_Volt_DC: raw 0..65535
  range DataConstr_MotClb_UsOutFlt: raw 0..65535
  range DataConstr_MotClb_CoolWater_Temp: raw 0..65535
  range DataConstr_MotClb_Motor_Temp1_Flt: raw 0..255
  range DataConstr_MotClb_IGBT_Temp1: raw 0..255
  range DataConstr_MotClb_ErrLevel: raw 0..255
  range DataConstr_MCUMR_MotClb_UdFb: raw 0..65535
  range DataConstr_MCUMR_MotClb_UqFb: raw 0..65535
  range DataConstr_MCUMR_MotClb_IdSet: raw 0..65535
  range DataConstr_MCUMR_MotClb_IqSet: raw 0..65535
  range DataConstr_MCUMR_MotClb_IsCMD_Fb: raw 0..65535
  range DataConstr_MCUMR_MotClb_ThetaCMD_Fb: raw 0..65535
  range DataConstr_MCUMR_MotClb_Id_Fb: raw 0..65535
  range DataConstr_MCUMR_MotClb_Iq_Fb: raw 0..65535
  range DataConstr_MCUMR_MotClb_Spd_rpm_Flt: raw 0..65535
  range DataConstr_MCUMR_MotClb_ThtSetReal: raw 0..65535
  range DataConstr_MCUMR_MotClb_Power_Inverter: raw 0..65535
  range DataConstr_MCUMR_MotClb_Volt_DC: raw 0..65535
  range DataConstr_MCUMR_MotClb_UsOutFlt: raw 0..65535
  range DataConstr_MCUMR_MotClb_CoolWater_Temp: raw 0..65535
  range DataConstr_MCUMR_MotClb_Motor_Temp1_Flt: raw 0..255
  range DataConstr_MCUMR_MotClb_IGBT_Temp1: raw 0..255
  range DataConstr_MCUMR_MotClb_ErrLevel: raw 0..255
  range DataConstr_BMS_CRC_1A1: raw 0..255
  range DataConstr_BMS_RollingCounter_1A1: raw 0..15
  range DataConstr_BMS_Warning_Level: raw 0..3
  range DataConstr_BMS_SelfCheck: raw 0..3
  range DataConstr_BMS_BattChargerSts: raw 0..7
  range DataConstr_BMS_RHighVolSts: raw 0..1
  range DataConstr_BMS_RPreChargeRelayFB: raw 0..1
  range DataConstr_BMS_RPositiveRelayFB: raw 0..1
  range DataConstr_BMS_RNegativeRelayFB: raw 0..1
  range DataConstr_BMS_RPositiveRelay_F: raw 0..1
  range DataConstr_BMS_RNegativeRelay_F: raw 0..1
  range DataConstr_BMS_RPreChargeFinishSts: raw 0..3
  range DataConstr_BMS_MCUMHVILSts: raw 0..1
  range DataConstr_BMS_ACPTCHVILSts: raw 0..1
  range DataConstr_BMS_PTCHVILSts: raw 0..1
  range DataConstr_BMS_CCMHVILSts: raw 0..1
  range DataConstr_BMS_CDUHVILSts: raw 0..1
  range DataConstr_BMS_DCChgHVILSts: raw 0..1
  range DataConstr_BMS_MCUSHVILSts: raw 0..1
  range DataConstr_BMS_HVOffSts: raw 0..1
  range DataConstr_BMS_SeriousWarning_Level: raw 0..3
  range DataConstr_BMS_DCChgRelayCloseReq: raw 0..1
  range DataConstr_BMS_DCChgRelayFB: raw 0..1
  range DataConstr_BMS_ChgStopReason: raw 0..63
  range DataConstr_BMS_GCUHVILSts: raw 0..1
  range DataConstr_BMS_MILlampReq: raw 0..1
  range DataConstr_BMS_IsoRessistanceSts: raw 0..1
  range DataConstr_BMS_Integrity_Check: raw 0..1
  range DataConstr_BMS_BattVolt: raw 0..65535
  range DataConstr_BMS_BattCurr: raw 0..65535
  range DataConstr_BMS_BatDyn_Dchgpwr: raw 0..8191
  range DataConstr_BMS_BatDyn_Chgpwr: raw 0..8191
  range DataConstr_BMS_Precharge_CoolingSts: raw 0..3
  range DataConstr_IBC_CRC_B1: raw 0..255
  range DataConstr_IBC_RollingCounter_B1: raw 0..15
  range DataConstr_IBC_EngTorqDec_Main: raw 0..1023
  range DataConstr_IBC_EngTorqDecActive_Main: raw 0..1
  range DataConstr_IBC_EngTorqInc_Main: raw 0..1023
  range DataConstr_IBC_EngTorqIncActive_Main: raw 0..1
  range DataConstr_IBC_EngTorqDec_Sub: raw 0..1023
  range DataConstr_IBC_EngTorqDecActive_Sub: raw 0..1
  range DataConstr_IBC_EngTorqInc_Sub: raw 0..1023
  range DataConstr_IBC_EngTorqIncActive_Sub: raw 0..1
  range DataConstr_IBC_EngTorqDec_MainR: raw 0..1023
  range DataConstr_IBC_EngTorqDecActive_MainR: raw 0..1
  range DataConstr_IBC_EngTorqInc_MainR: raw 0..1023
  range DataConstr_IBC_EngTorqIncActive_MainR: raw 0..1
  range DataConstr_ADDC_CRC_83: raw 0..255
  range DataConstr_ADDC_ACC_AVHReq: raw 0..1
  range DataConstr_ADDC_ACC_HoldSts: raw 0..1
  range DataConstr_ADDC_ACCTargetTrq: raw 0..16383
  range DataConstr_ADDC_ACCTargetTrqVD: raw 0..1
  range DataConstr_ADDC_ACCTargetTrqBrkVD: raw 0..1
  range DataConstr_ADDC_ACCTargetTrqBrk: raw 0..8191
  range DataConstr_ADDC_MAIWarnTrqCtrlFlg: raw 0..7
  range DataConstr_ADDC_RollingCounter_83: raw 0..15
  range DataConstr_ADDC_ACC_FunType: raw 0..3
  range DataConstr_ADDC_ACCMode: raw 0..7
  range DataConstr_ADDC_Driveoff_Request: raw 0..1
  range DataConstr_ADDC_DecToStop: raw 0..1
  range DataConstr_ADDC_ACCAvailable: raw 0..1
  range DataConstr_ADDC_ACCTargetAcc: raw 0..255
  range DataConstr_ADDC_ACCTargetAccVD: raw 0..1
  range DataConstr_ADDC_ACC_RecordingPulse: raw 0..3
  range DataConstr_ADDC_VehicleSpeedCtlVD: raw 0..1
  range DataConstr_ADDC_VehicleSpeedCtl: raw 0..2047
  range DataConstr_ADDC_ACC_EPBReq: raw 0..3
  range DataConstr_ADDC_ACC_VehicleDirectCtl: raw 0..3
  range DataConstr_ADDC_ACC_VehicleDirectCtlVD: raw 0..1
  range DataConstr_ADDC_AEBTargetDec: raw 0..65535
  range DataConstr_ADDC_AEBDecCtrl: raw 0..1
  range DataConstr_ADDC_AEBMode: raw 0..7
  range DataConstr_ADDC_AEBAvailable: raw 0..1
  range DataConstr_ADDC_ACC_VLCCtlReq: raw 0..1
  range DataConstr_ADDC_ACC_OvrdSts: raw 0..1
  range DataConstr_ADDC_RCTB_DecReq: raw 0..1
  range DataConstr_ADDC_RAEB_DecReq: raw 0..1
  range DataConstr_ADDC_MEB_DecReq: raw 0..1
  range DataConstr_VCU_CRC_13B: raw 0..255
  range DataConstr_VCU_RollingCounter_13B: raw 0..15
  range DataConstr_VCU_Vehicle_Warning: raw 0..3
  range DataConstr_VCU_VehicleSts: raw 0..1
  range DataConstr_VCU_GearLevelPosSts: raw 0..3
  range DataConstr_VCU_GearLeverValid: raw 0..1
  range DataConstr_VCU_AccPedalValid: raw 0..1
  range DataConstr_VCU_ThrottlePosition: raw 0..255
  range DataConstr_VCU_BMSMainRelayR_Cmd: raw 0..1
  range DataConstr_VCU_BMSMainRelayF_Cmd: raw 0..1
  range DataConstr_VCU_BMSEmergencyCmd: raw 0..1
  range DataConstr_VCU_MCUMActiveReleaseCmd: raw 0..1
  range DataConstr_VCU_MCUSActiveReleaseCmd: raw 0..1
  range DataConstr_VCU_AlwACChargeInventerSts: raw 0..1
  range DataConstr_VCU_AlwDCChargeSts: raw 0..1
  range DataConstr_VCU_ChargePauseReq: raw 0..1
  range DataConstr_VCU_SuppressJitterMCUSRequest: raw 0..1
  range DataConstr_VCU_DCDCEnableCmd: raw 0..1
  range DataConstr_VCU_ACOffReq: raw 0..3
  range DataConstr_VCU_VehicleDirect: raw 0..1
  range DataConstr_VCU_BrakeSysFault: raw 0..1
  range DataConstr_VCU_SuppressJitterMCUMRequest: raw 0..1
  range DataConstr_VCU_MDrvControlMode: raw 0..1
  range DataConstr_VCU_BrakePedalValue: raw 0..255
  range DataConstr_VCU_MCUMMaxDischargePower: raw 0..511
  range DataConstr_VCU_MCUMMaxChargePower: raw 0..511
  range DataConstr_VCU_MDrvRequestTorque: raw 0..65535
  range DataConstr_VCU_MDrvRequesSpeed: raw 0..65535
  range DataConstr_VCU_SDrvRequestTorque: raw 0..65535
  range DataConstr_VCU_SDrvRequesSpeed: raw 0..65535
  range DataConstr_VCU_SVehicleSts: raw 0..1
  range DataConstr_VCU_VehicleHighVoltModeF: raw 0..7
  range DataConstr_VCU_SDrvControlMode: raw 0..1
  range DataConstr_VCU_ON2BRelayReq: raw 0..3
  range DataConstr_VCU_VehPreHVPwrOffCmd: raw 0..1
  range DataConstr_VCU_FuelTankLockReq: raw 0..3
  range DataConstr_VCU_VehicleDirectS: raw 0..1
  range DataConstr_VCU_VehicleDirectS_VD: raw 0..1
  range DataConstr_VCU_ACPwrLimited: raw 0..255
  range DataConstr_VCU_MCUSMaxDischargePower: raw 0..511
  range DataConstr_VCU_VehicleDirectVD: raw 0..1
  range DataConstr_VCU_MDrvControlModeVD: raw 0..1
  range DataConstr_VCU_MDrvRequestTorqueVD: raw 0..1
  range DataConstr_VCU_MDrvRequesSpeedVD: raw 0..1
  range DataConstr_VCU_SDrvRequestTorqueVD: raw 0..1
  range DataConstr_VCU_SDrvRequesSpeedVD: raw 0..1
  range DataConstr_VCU_SDrvControlModeVD: raw 0..1
  range DataConstr_VCU_MCUSMaxChargePower: raw 0..511
  range DataConstr_VCU_VehicleHighVoltMode: raw 0..7
  range DataConstr_VCU_PDUHVIL_Sts: raw 0..1
  range DataConstr_VCU_PDU220VRelay_Req: raw 0..1
  range DataConstr_VCU_Cab220VRelay_Req: raw 0..1
  range DataConstr_VCU_Cabin220VRelay_Req: raw 0..1
  range DataConstr_VCU_Alw_Cab220VInverter_Sts: raw 0..1
  range DataConstr_VCU_Alw_Cabin220VInverter_Sts: raw 0..1
  range DataConstr_VCU_MCUMDampgLmtFactor: raw 0..127
  range DataConstr_VCU_MCUSDampgLmtFactor: raw 0..127
  range DataConstr_VCU_BCM_Authentication_Sts: raw 0..3
  range DataConstr_VCU_AuthenticationKey_WSts: raw 0..1
  range DataConstr_VCU_BrakePedalSts_P: raw 0..1
  range DataConstr_VCU_BrakePedalStsValid_P: raw 0..1
  range DataConstr_VCU_BoostMode_Fail: raw 0..7
  range DataConstr_VCU_BoostModeSts: raw 0..3
  range DataConstr_VCU_MCUSMaxPosDampgTrq: raw 0..63
  range DataConstr_VCU_MCUSMaxNegDampgTrq: raw 0..63
  range DataConstr_VCU_MCUMMaxPosDampgTrq: raw 0..63
  range DataConstr_VCU_MCUMMaxNegDampgTrq: raw 0..63
  range DataConstr_BMS_InverterPower: raw 0..255
  range DataConstr_BMS_MaxChargeVolt: raw 0..65535
  range DataConstr_BMS_MaxChargeCurr: raw 0..4095
  range DataConstr_BMS_OBCWorkModeCtrl: raw 0..7
  range DataConstr_BMS_MaxPower: raw 0..511
  range DataConstr_BMS_ChargerACInput: raw 0..1
  range DataConstr_BMS_ChargerDCInput: raw 0..1
  range DataConstr_BMS_ChargeRequest: raw 0..1
  range DataConstr_BMS_InverterRequest: raw 0..1
  range DataConstr_BMS_ChargeQuantity: raw 0..1023
  range DataConstr_BMS_BattMaxTemp: raw 0..255
  range DataConstr_BMS_BattMinTemp: raw 0..255
  range DataConstr_BMS_BattIntakeTemp: raw 0..255
  range DataConstr_BMS_BattIOutletTemp: raw 0..255
  range DataConstr_BMS_BattSOC_Display: raw 0..1023
  range DataConstr_BMS_Req_Cab220VInverter_Sts: raw 0..1
  range DataConstr_BMS_Req_Cabin220VInverter_Sts: raw 0..1
  range DataConstr_BMS_RemainEnergy: raw 0..65535
  range DataConstr_BMS_StateOfEngeryMax: raw 0..65535
  range DataConstr_BMS_ThermalManageRequest: raw 0..7
  range DataConstr_BMS_PreHeatingState: raw 0..3
  range DataConstr_LMC_CRC_FD: raw 0..255
  range DataConstr_LMC_RollingCounter_FD: raw 0..15
  range DataConstr_LMC_SysSt: raw 0..3
  range DataConstr_LMC_HSPC_ActiveSt: raw 0..1
  range DataConstr_LMC_FTSC_ActiveSt: raw 0..1
  range DataConstr_LMC_SDRM_ActiveSt: raw 0..1
  range DataConstr_LMC_NSPC_ActiveSt: raw 0..1
  range DataConstr_LMC_EAF_ActiveSt: raw 0..1
  range DataConstr_LMC_SelfCheckSt: raw 0..1
  range DataConstr_LMC_WBDC_ActiveSt: raw 0..3
  range DataConstr_MCUM_UDS_SW{1..10}: raw 0..255
  range DataConstr_MCUM_UDS_HW{1..10}: raw 0..255
  range DataConstr_MCUM_UDS_Boot{1..10}: raw 0..255
  range DataConstr_MCUM_UDS_ProductModel{1..16}: raw 0..255
  range DataConstr_MCUM_UDS_Supplier{1..6}: raw 0..255
  range DataConstr_VCU_BrkPedOpen: raw 0..1
  range DataConstr_VCU_BrkPedClose: raw 0..1
  range DataConstr_VCU_ColumnShiftP: raw 0..1
  range DataConstr_VCU_VehiCrashSts: raw 0..1
  range DataConstr_VCU_SleepSatisfiedSts: raw 0..1
  range DataConstr_VCU_VehiHvCmd: raw 0..1
  range DataConstr_VCU_GearQuitAps: raw 0..1
  range DataConstr_VCU_REOverChgPwrFlag: raw 0..1
  range DataConstr_VCU_VehiAccnFilt: raw 0..255
  range DataConstr_VCU_HvOffSts: raw 0..15
  range DataConstr_VCU_ElecPwrBalanceReq: raw 0..1
  range DataConstr_VCU_CDU_RecvTr: raw 0..1
  range DataConstr_VCU_BMS_RecvTr: raw 0..1
  range DataConstr_VCU_IVI_RecvTr: raw 0..1
  range DataConstr_VCU_WheelMaxDrvTrq: raw 0..1023
  range DataConstr_VCU_WheelMaxRecTrq: raw 0..1023
  range DataConstr_VCU_GCU_RecvTr: raw 0..1
  range DataConstr_VCU_TCM_RecvTr: raw 0..1
  range DataConstr_VCU_PTC_RecvTr: raw 0..1
  range DataConstr_VCU_LossFctorFlgFL: raw 0..1
  range DataConstr_VCU_LowBattVolt: raw 0..127
  range DataConstr_VCU_HighPerforDisable: raw 0..1
  range DataConstr_VCU_AccPedHSigVolt: raw 0..127
  range DataConstr_VCU_LossFctorFlgFR: raw 0..1
  range DataConstr_VCU_AccPedLSigVolt: raw 0..127
  range DataConstr_VCU_LossFctorFlgRL: raw 0..1
  range DataConstr_VCU_AccPedHPwrVolt: raw 0..127
  range DataConstr_VCU_LossFctorFlgRR: raw 0..1
  range DataConstr_VCU_AccPedLPwrVolt: raw 0..127
  range DataConstr_VCU_PreReqChgPwr: raw 0..255
  range DataConstr_VCU_VehPwrChageLimit: raw 0..255
  range DataConstr_VCU_FastPwrRequest: raw 0..255
  range DataConstr_VCU_On2KL15_Volt: raw 0..255
  range DataConstr_VCU_ClutchWrkModDebug: raw 0..31
  range DataConstr_VCU_HighPerforSwtFlg: raw 0..1
  range DataConstr_VCU_VehiPowrConsumption: raw 0..8191
  range DataConstr_VCU_MDrvFilterTrqRange: raw 0..7
  range DataConstr_VCU_WheelPwrOvrLimitflgRE: raw 0..3
  range DataConstr_VCU_MRDrvControlMode: raw 0..1
  range DataConstr_VCU_MRDrvControlModeVD: raw 0..1
  range DataConstr_VCU_VehicleDirectMR: raw 0..1
  range DataConstr_VCU_VehicleDirectMRVD: raw 0..1
  range DataConstr_VCU_MRDrvRequestTorque: raw 0..65535
  range DataConstr_VCU_MRDrvRequesSpeed: raw 0..65535
  range DataConstr_VCU_MCUMRMaxDischargePower: raw 0..511
  range DataConstr_VCU_MCUMRMaxPosDampgTrq: raw 0..63
  range DataConstr_VCU_MRDrvRequestTorqueVD: raw 0..1
  range DataConstr_VCU_MCUMRMaxChargePower: raw 0..511
  range DataConstr_VCU_MCUMRMaxNegDampgTrq: raw 0..63
  range DataConstr_VCU_MRDrvRequesSpeedVD: raw 0..1
  range DataConstr_VCU_MCUMRDampgLmtFactor: raw 0..127
  range DataConstr_VCU_SuppressJitterMCUMRRequest: raw 0..1
  range DataConstr_GCU_SWVersionC: raw 0..255
  range DataConstr_GCU_SWVersionB: raw 0..255
  range DataConstr_GCU_SWVersionA: raw 0..15
  range DataConstr_VCU_CRC_B6: raw 0..255
  range DataConstr_VCU_TVTest2: raw 0..1048575
  range DataConstr_VCU_VPE_Test1: raw 0..4095
  range DataConstr_VCU_VPE_Test2: raw 0..127
  range DataConstr_VCU_TVTest1: raw 0..32767
  range DataConstr_VCU_RollingCounter_B6: raw 0..15
  range DataConstr_VCU_MDrvRequestTorque_IDB6_CCAN: raw 0..65535
  range DataConstr_VCU_MDriverRequireTorque: raw 0..65535
  range DataConstr_VCU_SDrvRequestTorque_IDB6_CCAN: raw 0..65535
  range DataConstr_VCU_SDriverRequireTorque: raw 0..65535
  range DataConstr_VCU_ThrottlePosition_IDB6_CCAN: raw 0..255
  range DataConstr_VCU_AccPedalValid_IDB6_CCAN: raw 0..1
  range DataConstr_VCU_BrakeSysFault_IDB6_CCAN: raw 0..1
  range DataConstr_VCU_BrakeLightReq: raw 0..1
  range DataConstr_VCU_BrakePedalSts: raw 0..1
  range DataConstr_VCU_BrakePedalStsValid: raw 0..1
  range DataConstr_VCU_GearLevelPosSts_IDB6_CCAN: raw 0..3
  range DataConstr_VCU_GearLeverValid_IDB6_CCAN: raw 0..1
  range DataConstr_VCU_BrakeFirstSts: raw 0..1
  range DataConstr_VCU_DeliveryModeSts_IDB6_CCAN: raw 0..1
  range DataConstr_VCU_MRDrvRequestTorque_IDB6_CCAN: raw 0..65535
  range DataConstr_VCU_MRDriverRequireTorque: raw 0..65535
  range DataConstr_BCM_CRC_291: raw 0..255
  range DataConstr_BCM_ShutdownMode: raw 0..1
  range DataConstr_BCM_NM_PNC_ON_1ADr_Sts: raw 0..1
  range DataConstr_BCM_RollingCounter_291: raw 0..15
  range DataConstr_BCM_KeyPosition_ON2A: raw 0..1
  range DataConstr_BCM_CcmHvilSts_ID291: raw 0..1
  range DataConstr_BCM_DriverDoorSts: raw 0..1
  range DataConstr_BCM_FLDoorSts: raw 0..1
  range DataConstr_BCM_FRDoorSts: raw 0..1
  range DataConstr_BCM_RLDoorSts: raw 0..1
  range DataConstr_BCM_RRDoorSts: raw 0..1
  range DataConstr_BCM_BackDoorSts: raw 0..1
  range DataConstr_BCM_ON2BRelaySts: raw 0..1
  range DataConstr_BCM_ON2CRelaySts: raw 0..1
  range DataConstr_BCM_ON2InitiativeSts: raw 0..1
  range DataConstr_BCM_VehicleRepairMode: raw 0..1
  range DataConstr_BCM_VehlockCtrl: raw 0..3
  range DataConstr_BCM_VehLockSts: raw 0..1
  range DataConstr_BCM_FuelTankLockReq: raw 0..3
  range DataConstr_BCM_ACChgLockCtrl: raw 0..3
  range DataConstr_BCM_ChargeLockCtrl: raw 0..3
  range DataConstr_BCM_DCChrgPwr_Sts_ID291: raw 0..1
  range DataConstr_BCM_ACChrgPwr_Sts_ID291: raw 0..1
  range DataConstr_BCM_DCChrgPwr_Volt_ID291: raw 0..255
  range DataConstr_BCM_ACChrgPwr_Volt_ID291: raw 0..255
  range DataConstr_BCM_KeyPosition_ON2B: raw 0..1
  range DataConstr_BCM_NM_PNC_ON_3Ch_Sts: raw 0..1
  range DataConstr_BCM_HighVoltageReq: raw 0..3
  range DataConstr_LMC_CRC_25A: raw 0..255
  range DataConstr_LMC_ECAS_DriveModeFb: raw 0..15
  range DataConstr_LMC_CDC_DriveModeFb: raw 0..7
  range DataConstr_LMC_RollingCounter_25A: raw 0..15
  range DataConstr_LMC_LSFCActiveSt: raw 0..3
  range DataConstr_LMC_EngTorqDec_Main_R: raw 0..1023
  range DataConstr_LMC_EngTorqDecActive_Main_R: raw 0..1
  range DataConstr_LMC_EngTorqInc_Main_R: raw 0..1023
  range DataConstr_LMC_EngTorqIncActive_Main_R: raw 0..1
  range DataConstr_ACU_CRC_2A3: raw 0..255
  range DataConstr_ACU_Trigger: raw 0..1
  range DataConstr_ACU_RollingCounter_2A3: raw 0..15
  range DataConstr_ACU_TotalCrashOutputSts: raw 0..1
  range DataConstr_ACU_SelfCheckSt: raw 0..1
  range DataConstr_ACU_FLSeatBeltRSt: raw 0..3
  range DataConstr_ACU_FRSeatBeltRSt: raw 0..3
  range DataConstr_IVI_DeliveryModeReq: raw 0..3
  range DataConstr_IVI_ShowCarModeReq: raw 0..3
  range DataConstr_VCU_CheckSum_BB: raw 0..255
  range DataConstr_VCU_WorkModeReq_PHEV: raw 0..7
  range DataConstr_VCU_WorkMode_PHEV: raw 0..7
  range DataConstr_VCU_HEVAllow_PHEV: raw 0..1
  range DataConstr_VCU_REAllow_PHEV: raw 0..1
  range DataConstr_VCU_EVDualAllow_PHEV: raw 0..1
  range DataConstr_VCU_EVSingleAllow_PHEV: raw 0..1
  range DataConstr_VCU_Clutch_2_RequesSpeed: raw 0..65535
  range DataConstr_VCU_Clutch_1_RequesSpeed: raw 0..65535
  range DataConstr_VCU_Clutch2Position: raw 0..3
  range DataConstr_VCU_Clutch1Position: raw 0..3
  range DataConstr_VCU_RollingCounter_BB: raw 0..15
  range DataConstr_VCU_EngPreStartFlg: raw 0..1
  range DataConstr_VCU_FuelChgModeMsg: raw 0..3
  range DataConstr_VCU_FuelChgModeSts: raw 0..3
  range DataConstr_VCU_RoughRoadDetectionFlag: raw 0..1
  range DataConstr_VCU_Clutch_2_RequesSpeedValid: raw 0..1
  range DataConstr_VCU_Clutch_1_RequesSpeedValid: raw 0..1
  range DataConstr_VCU_GCURequestTorque: raw 0..4095
  range DataConstr_VCU_PowerReducetSts: raw 0..1
  range DataConstr_VCU_GCUAassistFB: raw 0..1
  range DataConstr_VCU_GCUActiveReleaseCmd: raw 0..1
  range DataConstr_VCU_PowerOverSts: raw 0..1
  range DataConstr_VCU_GCURequesSpeed: raw 0..16383
  range DataConstr_VCU_GCUControlMode: raw 0..1
  range DataConstr_VCU_MotChargePower: raw 0..255
  range DataConstr_VCU_APS1Position: raw 0..255
  range DataConstr_VCU_EngineStartReq: raw 0..1
  range DataConstr_VCU_EngineFuelInhibitReq: raw 0..1
  range DataConstr_VCU_EngineOffRequest: raw 0..1
  range DataConstr_VCU_STorqueReqValid: raw 0..1
  range DataConstr_VCU_STorqueReq: raw 0..4095
  range DataConstr_VCU_FTorqueSwFb: raw 0..1
  range DataConstr_VCU_FVVOpenReq: raw 0..1
  range DataConstr_VCU_WarmUpCycleIndicator: raw 0..1
  range DataConstr_VCU_EngineResetSts: raw 0..1
  range DataConstr_VCU_EngineSts: raw 0..15
  range DataConstr_VCU_FTorqueReq: raw 0..4095
  range DataConstr_VCU_FTorqueReqValid: raw 0..1
  range DataConstr_VCU_EngineIdleReq: raw 0..1
  range DataConstr_VCU_REsystemSts: raw 0..1
  range DataConstr_VCU_REsystemFaultSts: raw 0..1
  range DataConstr_VCU_APS2Position: raw 0..255
  range DataConstr_VCU_EngineRunAllowFlg: raw 0..1
  range DataConstr_VCU_EngineIdleSpeed: raw 0..3
  range DataConstr_VCU_EngineFuleCutoffReq: raw 0..1
  range DataConstr_VCU_MCUSClutchPosition: raw 0..3
  range DataConstr_VCU_MGCUWorkMode: raw 0..3
  range DataConstr_VCU_REChgTarget: raw 0..255
  range DataConstr_VCU_MotStartStopPowerUP: raw 0..255
  range DataConstr_VCU_MotStartStopPowerLOW: raw 0..255
  range DataConstr_VCU_GCURequesSpeed_MGCU: raw 0..65535
  range DataConstr_VCU_DynamicChgPwr: raw 0..31
  range DataConstr_VCU_ForceChgPwr: raw 0..31
  range DataConstr_VCU_REStartType: raw 0..63
  range DataConstr_VCU_Pending_DTC: raw 0..255
  range DataConstr_VCU_Comfirmed_DTC: raw 0..255
  range DataConstr_VCU_Permanent_DTC: raw 0..255
  range DataConstr_VCU_MilReq_DTC: raw 0..255
  range DataConstr_MCUM_NMControlRMR_Sts: raw 0..1
  range DataConstr_MCUM_WakeUpReason: raw 0..127
  range DataConstr_ECM_ClearingSparkcarbonedRequest: raw 0..3
  range DataConstr_VCU_REHighPerformVehiPwr: raw 0..255
  range DataConstr_VCU_REPwrDampingFactor: raw 0..127
  range DataConstr_VCU_REDrvTarPwrFit: raw 0..511
  range DataConstr_TMS_RAPTC_ModOprtgStsFrt: raw 0..3
  range DataConstr_TMS_RAPTC_ModOpEnblCmd: raw 0..1
  range DataConstr_TMS_RAPTC_MsrdPwrFrt: raw 0..1023
  range DataConstr_BCM_CRC_DA: raw 0..255
  range DataConstr_BCM_RollingCounter_DA: raw 0..15
  range DataConstr_BCM_IMU_ACC_x: raw 0..65535
  range DataConstr_BCM_IMU_ACC_y: raw 0..65535
  range DataConstr_BCM_IMU_ACC_z: raw 0..65535
  range DataConstr_BCM_IMU_ACC_Roll_Rate: raw 0..65535
  range DataConstr_BCM_IMU_ACC_Pitch_Rate: raw 0..65535
  range DataConstr_BCM_IMU_ACC_Yaw_Rate: raw 0..65535
  range DataConstr_BCM_IMU_Valid: raw 0..1
  range DataConstr_ACU_IMU_CRC_15: raw 0..255
  range DataConstr_ACU_IMU_RollingCounter_15: raw 0..255
  range DataConstr_ACU_IMU_ACC_x: raw 0..65535
  range DataConstr_ACU_IMU_ACC_y: raw 0..65535
  range DataConstr_ACU_IMU_ACC_z: raw 0..65535
  range DataConstr_ACU_IMU_Roll_Rate: raw 0..65535
  range DataConstr_ACU_IMU_Pitch_Rate: raw 0..65535
  range DataConstr_ACU_IMU_Yaw_Rate: raw 0..65535
  range DataConstr_ACU_IMU_Calibrated: raw 0..3
  range DataConstr_ACU_IMU_Valid: raw 0..1
  range DataConstr_ACU_IMU_Fault_Status: raw 0..1
  range DataConstr_ACU_IMU_MessageStatus: raw 0..7
  range DataConstr_ACU_IMU_FunctionSafetyStatus: raw 0..15
  range DataConstr_ACU_IMU_Temperature: raw 0..65535
  range DataConstr_LMC_CRC_133: raw 0..255
  range DataConstr_LMC_DrvReqTorque: raw 0..32767
  range DataConstr_LMC_RollingCounter_133: raw 0..15
  range DataConstr_BCM_CRC_4A: raw 0..255
  range DataConstr_BCM_IBCLimphomeSts: raw 0..1
  range DataConstr_BCM_EOLAutomaticActiveSts_C: raw 0..1
  range DataConstr_BCM_TorqueLimte: raw 0..65535
  range DataConstr_BCM_RollingCounter_4A: raw 0..15
  range DataConstr_ICU_RollingCounter_5BE: raw 0..15
  range DataConstr_ICU_Imu_Cal_Staus: raw 0..3
  range DataConstr_ICU_Imu_Cal_Gyro: raw 0..255
  range DataConstr_ICU_Imu_Cal_Pitch: raw 0..255
  range DataConstr_ICU_Imu_Cal_Roll: raw 0..255
