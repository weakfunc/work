[part 5 of 6: package /MVCU_AutoGenPkg/MVCU/Pck_AutoGen_Sw/PortInterface]
AUTOSAR XML (schema 4-2-2)
package /MVCU_AutoGenPkg/MVCU/Pck_AutoGen_Sw/PortInterface
  96 x sender receiver interface:
    IF_MCUM_0x135
      14 x data:
        MCUM_CRC_135: type=DT_DT_MCUM_CRC_135
        MCUM_RollingCounter_135: type=DT_DT_MCUM_RollingCounter_135
        MCUM_LDC_SWInfo: type=DT_DT_MCUM_LDC_SWInfo
        MCUM_LDC_MTarOut_FA: type=DT_DT_MCUM_LDC_MTarOut_FA
        MCUM_LDC_MTarOut_RA: type=DT_DT_MCUM_LDC_MTarOut_RA
        MCUM_LDC_Available_FA: type=DT_DT_MCUM_LDC_Available_FA
        MCUM_LDC_OperationMode_FA: type=DT_DT_MCUM_LDC_OperationMode_FA
        MCUM_LDC_Available_RA: type=DT_DT_MCUM_LDC_Available_RA
        MCUM_LDC_OperationMode_RA: type=DT_DT_MCUM_LDC_OperationMode_RA
        MCUM_RTE_Exchange_Signal_Status: type=DT_DT_MCUM_RTE_Exchange_Signal_Status
        MCUM_MTarIn_FA: type=DT_DT_MCUM_MTarIn_FA
        MCUM_MTarIn_RA: type=DT_DT_MCUM_MTarIn_RA
        MCUM_InputQF_FA: type=DT_DT_MCUM_InputQF_FA
        MCUM_InputQF_RA: type=DT_DT_MCUM_InputQF_RA
    IF_IBC_0x136
      16 x data:
        IBC_CRC_136: type=DT_DT_IBC_CRC_136
        IBC_RollingCounter_136: type=DT_DT_IBC_RollingCounter_136
        IBC_ModeMinEDrvTar_FA: type=DT_DT_IBC_ModeMinEDrvTar_FA
        IBC_ModeMinEDrvTar_RA: type=DT_DT_IBC_ModeMinEDrvTar_RA
        IBC_ModeMaxEDrvTar_FA: type=DT_DT_IBC_ModeMaxEDrvTar_FA
        IBC_ModeMaxEDrvTar_RA: type=DT_DT_IBC_ModeMaxEDrvTar_RA
        IBC_torque_distribution_RA_Vaild: type=DT_DT_IBC_torque_distribution_RA_Vaild
        IBC_torque_distribution_RA: type=DT_DT_IBC_torque_distribution_RA
        IBC_mTar_FA: type=DT_DT_IBC_mTar_FA
        IBC_mTar_RA: type=DT_DT_IBC_mTar_RA
        IBC_iLDC_SWInfo: type=DT_DT_IBC_iLDC_SWInfo
        IBC_Variant_Signal: type=DT_DT_IBC_Variant_Signal
        IBC_nTarMax_FA: type=DT_DT_IBC_nTarMax_FA
        IBC_nTarMax_RA: type=DT_DT_IBC_nTarMax_RA
        IBC_nTarMin_FA: type=DT_DT_IBC_nTarMin_FA
        IBC_nTarMin_RA: type=DT_DT_IBC_nTarMin_RA
    IF_EVCC_0x260
      5 x data:
        EVCC_DCAC_ChgMode: type=DT_DT_EVCC_DCAC_ChgMode
        EVCC_CP_status: type=DT_DT_EVCC_CP_status
        EVCC_CPDutyCycleValue: type=DT_DT_EVCC_CPDutyCycleValue
        EVCC_EVSEMaximumCurrentLimit: type=DT_DT_EVCC_EVSEMaximumCurrentLimit
        EVCC_EVSEMaximumPowerLimit: type=DT_DT_EVCC_EVSEMaximumPowerLimit
    IF_ICU_0x24C
      8 x data:
        ICU_CRC_24C: type=DT_DT_ICU_CRC_24C
        ICU_PHEVMode: type=DT_DT_ICU_PHEVMode
        ICU_RollingCounter_24C: type=DT_DT_ICU_RollingCounter_24C
        ICU_TotalOdometerkm: type=DT_DT_ICU_TotalOdometerkm
        ICU_AccelerationMode: type=DT_DT_ICU_AccelerationMode
        ICU_REMode: type=DT_DT_ICU_REMode
        ICU_CreepMode: type=DT_DT_ICU_CreepMode
        ICU_EnergyRecoveryMode: type=DT_DT_ICU_EnergyRecoveryMode
    IF_MCUS_0xDB
      43 x data:
        MCUS_CRC_DB: type=DT_DT_MCUS_CRC_DB
        MCUS_Clutch_2_Fault: type=DT_DT_MCUS_Clutch_2_Fault
        MCUS_Clutch_1_Fault: type=DT_DT_MCUS_Clutch_1_Fault
        MCUS_Clutch_2_WarningLevel: type=DT_DT_MCUS_Clutch_2_WarningLevel
        MCUS_Clutch_1_WarningLevel: type=DT_DT_MCUS_Clutch_1_WarningLevel
        MCUS_Clutch_2_Pos: type=DT_DT_MCUS_Clutch_2_Pos
        MCUS_Clutch_1_Pos: type=DT_DT_MCUS_Clutch_1_Pos
        MCUS_RollingCounter_DB: type=DT_DT_MCUS_RollingCounter_DB
        MCUS_WarningLevel: type=DT_DT_MCUS_WarningLevel
        MCUS_SelfCheckSts: type=DT_DT_MCUS_SelfCheckSts
        MCUS_DrvMotorWorkSts: type=DT_DT_MCUS_DrvMotorWorkSts
        MCUS_PowerReduceSts: type=DT_DT_MCUS_PowerReduceSts
        MCUS_SystemError: type=DT_DT_MCUS_SystemError
        MCUS_LVSystemError: type=DT_DT_MCUS_LVSystemError
        MCUS_MotorTempAlarm: type=DT_DT_MCUS_MotorTempAlarm
        MCUS_HVSystemError: type=DT_DT_MCUS_HVSystemError
        MCUS_SeriousWarning_Level: type=DT_DT_MCUS_SeriousWarning_Level
        MCUS_CtrlModeVD: type=DT_DT_MCUS_CtrlModeVD
        MCUS_WaterPumpLevlReq: type=DT_DT_MCUS_WaterPumpLevlReq
        MCUS_MotorTemp: type=DT_DT_MCUS_MotorTemp
        MCUS_IGBTTemp: type=DT_DT_MCUS_IGBTTemp
        MCUS_InletTemp: type=DT_DT_MCUS_InletTemp
        MCUS_DrvMotorRPM: type=DT_DT_MCUS_DrvMotorRPM
        MCUS_ActualTorqueFB: type=DT_DT_MCUS_ActualTorqueFB
        MCUS_HWRdcFault: type=DT_DT_MCUS_HWRdcFault
        MCUS_HighVoltPowerOffReq: type=DT_DT_MCUS_HighVoltPowerOffReq
        MCUS_HVILSts: type=DT_DT_MCUS_HVILSts
        MCUS_DragSts: type=DT_DT_MCUS_DragSts
        MCUS_CtrlMode: type=DT_DT_MCUS_CtrlMode
        MCUS_MILlampReq: type=DT_DT_MCUS_MILlampReq
        MCUS_DrvMotorRPMVD: type=DT_DT_MCUS_DrvMotorRPMVD
        MCUS_ActualTorqueFBVD: type=DT_DT_MCUS_ActualTorqueFBVD
        MCUS_MaxTorqueAllow: type=DT_DT_MCUS_MaxTorqueAllow
        MCUS_MaxSpeedAllow: type=DT_DT_MCUS_MaxSpeedAllow
        MCUS_ActiveReleaseSts: type=DT_DT_MCUS_ActiveReleaseSts
        MCUS_MinTorqueAllow: type=DT_DT_MCUS_MinTorqueAllow
        MCUS_MainWireVolt: type=DT_DT_MCUS_MainWireVolt
        MCUS_MainWireCurr: type=DT_DT_MCUS_MainWireCurr
        MCUS_Clutch_Pos: type=DT_DT_MCUS_Clutch_Pos
        MCUS_Clutch_Fault: type=DT_DT_MCUS_Clutch_Fault
        MCUS_TMS_FrMotSelfHeatEnSts: type=DT_DT_MCUS_TMS_FrMotSelfHeatEnSts
        MCUS_TMS_FrMotSelfHeatLvlFb: type=DT_DT_MCUS_TMS_FrMotSelfHeatLvlFb
        MCUS_HeatPwrAval: type=DT_DT_MCUS_HeatPwrAval
    IF_MCU_0x5C9
      50 x data:
        DelayIden_Rslt_Avg: type=DT_DT_DelayIden_Rslt_Avg
        DelayIden_OverRange: type=DT_DT_DelayIden_OverRange
        DelayIden_Iden_Finish: type=DT_DT_DelayIden_Iden_Finish
        DelayIden_Write_Finish: type=DT_DT_DelayIden_Write_Finish
        DelayIden_Rslt_U: type=DT_DT_DelayIden_Rslt_U
        DelayIden_Rslt_V: type=DT_DT_DelayIden_Rslt_V
        DelayIden_Rslt_W: type=DT_DT_DelayIden_Rslt_W
        GainIden_Is_Samp_U: type=DT_DT_GainIden_Is_Samp_U
        GainIden_Rslt_U: type=DT_DT_GainIden_Rslt_U
        GainIden_OverRange: type=DT_DT_GainIden_OverRange
        GainIden_Is_Samp_V: type=DT_DT_GainIden_Is_Samp_V
        GainIden_Rslt_V: type=DT_DT_GainIden_Rslt_V
        GainIden_Iden_Finish: type=DT_DT_GainIden_Iden_Finish
        GainIden_Is_Samp_W: type=DT_DT_GainIden_Is_Samp_W
        GainIden_Rslt_W: type=DT_DT_GainIden_Rslt_W
        GainIden_Write_Finish: type=DT_DT_GainIden_Write_Finish
        GainIden_Curr_Peak_U: type=DT_DT_GainIden_Curr_Peak_U
        GainIden_Curr_Peak_V: type=DT_DT_GainIden_Curr_Peak_V
        GainIden_Curr_Peak_W: type=DT_DT_GainIden_Curr_Peak_W
        CurrLoad_CurExt_U: type=DT_DT_CurrLoad_CurExt_U
        CurrLoad_CurExt_V: type=DT_DT_CurrLoad_CurExt_V
        CurrLoad_CurExt_W: type=DT_DT_CurrLoad_CurExt_W
        CurrLoad_offset_Iu: type=DT_DT_CurrLoad_offset_Iu
        CurrLoad_offset_Iv: type=DT_DT_CurrLoad_offset_Iv
        CurrLoad_offset_Iw: type=DT_DT_CurrLoad_offset_Iw
        MCUMR_DelayIden_Rslt_Avg: type=DT_DT_MCUMR_DelayIden_Rslt_Avg
        MCUMR_DelayIden_OverRange: type=DT_DT_MCUMR_DelayIden_OverRange
        MCUMR_DelayIden_Iden_Finish: type=DT_DT_MCUMR_DelayIden_Iden_Finish
        MCUMR_DelayIden_Write_Finish: type=DT_DT_MCUMR_DelayIden_Write_Finish
        MCUMR_DelayIden_Rslt_U: type=DT_DT_MCUMR_DelayIden_Rslt_U
        MCUMR_DelayIden_Rslt_V: type=DT_DT_MCUMR_DelayIden_Rslt_V
        MCUMR_DelayIden_Rslt_W: type=DT_DT_MCUMR_DelayIden_Rslt_W
        MCUMR_GainIden_Is_Samp_U: type=DT_DT_MCUMR_GainIden_Is_Samp_U
        MCUMR_GainIden_Rslt_U: type=DT_DT_MCUMR_GainIden_Rslt_U
        MCUMR_GainIden_OverRange: type=DT_DT_MCUMR_GainIden_OverRange
        MCUMR_GainIden_Is_Samp_V: type=DT_DT_MCUMR_GainIden_Is_Samp_V
        MCUMR_GainIden_Rslt_V: type=DT_DT_MCUMR_GainIden_Rslt_V
        MCUMR_GainIden_Iden_Finish: type=DT_DT_MCUMR_GainIden_Iden_Finish
        MCUMR_GainIden_Is_Samp_W: type=DT_DT_MCUMR_GainIden_Is_Samp_W
        MCUMR_GainIden_Rslt_W: type=DT_DT_MCUMR_GainIden_Rslt_W
        MCUMR_GainIden_Write_Finish: type=DT_DT_MCUMR_GainIden_Write_Finish
        MCUMR_GainIden_Curr_Peak_U: type=DT_DT_MCUMR_GainIden_Curr_Peak_U
        MCUMR_GainIden_Curr_Peak_V: type=DT_DT_MCUMR_GainIden_Curr_Peak_V
        MCUMR_GainIden_Curr_Peak_W: type=DT_DT_MCUMR_GainIden_Curr_Peak_W
        MCUMR_CurrLoad_CurExt_U: type=DT_DT_MCUMR_CurrLoad_CurExt_U
        MCUMR_CurrLoad_CurExt_V: type=DT_DT_MCUMR_CurrLoad_CurExt_V
        MCUMR_CurrLoad_CurExt_W: type=DT_DT_MCUMR_CurrLoad_CurExt_W
        MCUMR_CurrLoad_offset_Iu: type=DT_DT_MCUMR_CurrLoad_offset_Iu
        MCUMR_CurrLoad_offset_Iv: type=DT_DT_MCUMR_CurrLoad_offset_Iv
        MCUMR_CurrLoad_offset_Iw: type=DT_DT_MCUMR_CurrLoad_offset_Iw
    IF_HPCBCM_0x1E6
      16 x data:
        BCM_VCU_Authentication_MAC_B{0..15}: type=DT_DT_BCM_VCU_Authentication_MAC_B{0..15}
    IF_UDS_Phy_Rx_7E0_ECM
      8 x data:
        ECM_UDS_PhyReq_Byte{0..7}: type=DT_DT_ECM_UDS_PhyReq_Byte{0..7}
    IF_MCUM_0x5D0
      10 x data:
        MCUM_Id_Ref: type=DT_DT_MCUM_Id_Ref
        MCUM_Iq_Ref: type=DT_DT_MCUM_Iq_Ref
        MCUM_Id_Fb: type=DT_DT_MCUM_Id_Fb
        MCUM_Iq_Fb: type=DT_DT_MCUM_Iq_Fb
        MCUM_Torque_Ref: type=DT_DT_MCUM_Torque_Ref
        MCUM_R_Id_Ref: type=DT_DT_MCUM_R_Id_Ref
        MCUM_R_Iq_Ref: type=DT_DT_MCUM_R_Iq_Ref
        MCUM_R_Id_Fb: type=DT_DT_MCUM_R_Id_Fb
        MCUM_R_Iq_Fb: type=DT_DT_MCUM_R_Iq_Fb
        MCUM_R_Torque_Ref: type=DT_DT_MCUM_R_Torque_Ref
    IF_MCUM_0x5D1
      52 x data:
        MCUM_Vd_Ref: type=DT_DT_MCUM_Vd_Ref
        MCUM_Vq_Ref: type=DT_DT_MCUM_Vq_Ref
        MCUM_Id_LookUp: type=DT_DT_MCUM_Id_LookUp
        MCUM_Iq_LookUp: type=DT_DT_MCUM_Iq_LookUp
        MCUM_Spd_Delta: type=DT_DT_MCUM_Spd_Delta
        MCUM_Us_Out: type=DT_DT_MCUM_Us_Out
        MCUM_Torque_PwrEst: type=DT_DT_MCUM_Torque_PwrEst
        MCUM_UserDefine_50ms: type=DT_DT_MCUM_UserDefine_50ms
        MCUM_Torque_ExtChar: type=DT_DT_MCUM_Torque_ExtChar
        MCUM_Damp_CompTorque: type=DT_DT_MCUM_Damp_CompTorque
        MCUM_Damp_CompCoeff: type=DT_DT_MCUM_Damp_CompCoeff
        MCUM_Damp_State: type=DT_DT_MCUM_Damp_State
        MCUM_PWM_State: type=DT_DT_MCUM_PWM_State
        MCUM_JuncTemp_Max: type=DT_DT_MCUM_JuncTemp_Max
        MCUM_JuncLoss_Max: type=DT_DT_MCUM_JuncLoss_Max
        MCUM_CurrAmp_Comp: type=DT_DT_MCUM_CurrAmp_Comp
        MCUM_CurrTheta_Comp: type=DT_DT_MCUM_CurrTheta_Comp
        MCUM_RawSinCorr: type=DT_DT_MCUM_RawSinCorr
        MCUM_RawCosCorr: type=DT_DT_MCUM_RawCosCorr
        MCUM_LUT_Spd: type=DT_DT_MCUM_LUT_Spd
        MCUM_R_HighVoltPowerOffReq: type=DT_DT_MCUM_R_HighVoltPowerOffReq
        MCUM_R_MaxTorqueAllow: type=DT_DT_MCUM_R_MaxTorqueAllow
        MCUM_R_MaxSpeedAllow: type=DT_DT_MCUM_R_MaxSpeedAllow
        MCUM_R_MinTorqueAllow: type=DT_DT_MCUM_R_MinTorqueAllow
        MCUM_R_MotorTemp: type=DT_DT_MCUM_R_MotorTemp
        MCUM_R_IGBTTemp: type=DT_DT_MCUM_R_IGBTTemp
        MCUM_R_InletTemp: type=DT_DT_MCUM_R_InletTemp
        MCUM_R_HeatPwrAllwd: type=DT_DT_MCUM_R_HeatPwrAllwd
        MCUM_R_HeatFdBck: type=DT_DT_MCUM_R_HeatFdBck
        MCUM_R_HeatPwrAct: type=DT_DT_MCUM_R_HeatPwrAct
        MCUM_R_HeatPwrMax: type=DT_DT_MCUM_R_HeatPwrMax
        MCUM_R_HeatPwrAval: type=DT_DT_MCUM_R_HeatPwrAval
        MCUM_R_Vd_Ref: type=DT_DT_MCUM_R_Vd_Ref
        MCUM_R_Vq_Ref: type=DT_DT_MCUM_R_Vq_Ref
        MCUM_R_Id_LookUp: type=DT_DT_MCUM_R_Id_LookUp
        MCUM_R_Iq_LookUp: type=DT_DT_MCUM_R_Iq_LookUp
        MCUM_R_Spd_Delta: type=DT_DT_MCUM_R_Spd_Delta
        MCUM_R_Us_Out: type=DT_DT_MCUM_R_Us_Out
        MCUM_R_Torque_PwrEst: type=DT_DT_MCUM_R_Torque_PwrEst
        MCUM_R_UserDefine_50ms: type=DT_DT_MCUM_R_UserDefine_50ms
        MCUM_R_Torque_ExtChar: type=DT_DT_MCUM_R_Torque_ExtChar
        MCUM_R_Damp_CompTorque: type=DT_DT_MCUM_R_Damp_CompTorque
        MCUM_R_Damp_CompCoeff: type=DT_DT_MCUM_R_Damp_CompCoeff
        MCUM_R_Damp_State: type=DT_DT_MCUM_R_Damp_State
        MCUM_R_PWM_State: type=DT_DT_MCUM_R_PWM_State
        MCUM_R_JuncTemp_Max: type=DT_DT_MCUM_R_JuncTemp_Max
        MCUM_R_JuncLoss_Max: type=DT_DT_MCUM_R_JuncLoss_Max
        MCUM_R_CurrAmp_Comp: type=DT_DT_MCUM_R_CurrAmp_Comp
        MCUM_R_CurrTheta_Comp: type=DT_DT_MCUM_R_CurrTheta_Comp
        MCUM_R_RawSinCorr: type=DT_DT_MCUM_R_RawSinCorr
        MCUM_R_RawCosCorr: type=DT_DT_MCUM_R_RawCosCorr
        MCUM_R_LUT_Spd: type=DT_DT_MCUM_R_LUT_Spd
    IF_MCUM_0x5D2
      72 x data:
        MCUM_R_StatorTemp_1: type=DT_DT_MCUM_R_StatorTemp_1
        MCUM_R_L2TqAct: type=DT_DT_MCUM_R_L2TqAct
        MCUM_R_EOPSw: type=DT_DT_MCUM_R_EOPSw
        MCUM_R_StatorTemp_2: type=DT_DT_MCUM_R_StatorTemp_2
        MCUM_R_IGBTTemp_U: type=DT_DT_MCUM_R_IGBTTemp_U
        MCUM_R_IGBTTemp_V: type=DT_DT_MCUM_R_IGBTTemp_V
        MCUM_R_IGBTTemp_W: type=DT_DT_MCUM_R_IGBTTemp_W
        MCUM_R_Power_15V: type=DT_DT_MCUM_R_Power_15V
        MCUM_R_Offset_IU: type=DT_DT_MCUM_R_Offset_IU
        MCUM_R_Offset_IV: type=DT_DT_MCUM_R_Offset_IV
        MCUM_R_Offset_IW: type=DT_DT_MCUM_R_Offset_IW
        MCUM_R_MainSt_State: type=DT_DT_MCUM_R_MainSt_State
        MCUM_R_Derate_Reason: type=DT_DT_MCUM_R_Derate_Reason
        MCUM_R_PWM_Freq_kHz: type=DT_DT_MCUM_R_PWM_Freq_kHz
        MCUM_R_PWMEn_State: type=DT_DT_MCUM_R_PWMEn_State
        MCUM_R_DrvPwrEn_Out_State: type=DT_DT_MCUM_R_DrvPwrEn_Out_State
        MCUM_R_NVM_RslvrZeroRFault: type=DT_DT_MCUM_R_NVM_RslvrZeroRFault
        MCUM_R_Rotor_Position: type=DT_DT_MCUM_R_Rotor_Position
        MCUM_R_PosTransduserFaultCode: type=DT_DT_MCUM_R_PosTransduserFaultCode
        MCUM_R_NVM_RslvrDirRFault: type=DT_DT_MCUM_R_NVM_RslvrDirRFault
        MCUM_R_NVM_RslvrDelayRFault: type=DT_DT_MCUM_R_NVM_RslvrDelayRFault
        MCUM_R_NVM_RslvrParamRFault: type=DT_DT_MCUM_R_NVM_RslvrParamRFault
        MCUM_R_NVM_HallGainRFault: type=DT_DT_MCUM_R_NVM_HallGainRFault
        MCUM_R_NVM_HallDelayRFault: type=DT_DT_MCUM_R_NVM_HallDelayRFault
        MCUM_R_NVM_IGBTTypeRFault: type=DT_DT_MCUM_R_NVM_IGBTTypeRFault
        MCUM_R_ASC_EntryCount: type=DT_DT_MCUM_R_ASC_EntryCount
        MCUM_R_Spd_Turn: type=DT_DT_MCUM_R_Spd_Turn
        MCUM_R_LUT_Spd_Max: type=DT_DT_MCUM_R_LUT_Spd_Max
        MCUM_R_EOP_Speed: type=DT_DT_MCUM_R_EOP_Speed
        MCUM_R_EOP_IqFb: type=DT_DT_MCUM_R_EOP_IqFb
        MCUM_R_EOP_IqRef: type=DT_DT_MCUM_R_EOP_IqRef
        MCUM_R_EOP_DCVolt: type=DT_DT_MCUM_R_EOP_DCVolt
        MCUM_R_EOP_DCCurr: type=DT_DT_MCUM_R_EOP_DCCurr
        MCUM_R_EOP_Temp: type=DT_DT_MCUM_R_EOP_Temp
        MCUM_R_EOP_State: type=DT_DT_MCUM_R_EOP_State
        MCUM_R_EOP_FaultCode: type=DT_DT_MCUM_R_EOP_FaultCode
        MCUM_R_HWFault_RstCnt: type=DT_DT_MCUM_R_HWFault_RstCnt
        MCUM_R_HWFoB_RstCnt: type=DT_DT_MCUM_R_HWFoB_RstCnt
        MCUM_R_HWFoT_RstCnt: type=DT_DT_MCUM_R_HWFoT_RstCnt
        MCUM_R_HWDrvUV_RstCnt: type=DT_DT_MCUM_R_HWDrvUV_RstCnt
        MCUM_R_HWRdc_RstCnt: type=DT_DT_MCUM_R_HWRdc_RstCnt
        MCUM_R_HWOC_RstCnt: type=DT_DT_MCUM_R_HWOC_RstCnt
        MCUM_R_HWOV_RstCnt: type=DT_DT_MCUM_R_HWOV_RstCnt
        MCUM_R_L2agRtrElecDiff: type=DT_DT_MCUM_R_L2agRtrElecDiff
        MCUM_R_500usOverTime_Cnt: type=DT_DT_MCUM_R_500usOverTime_Cnt
        MCUM_R_5msOverTime_Cnt: type=DT_DT_MCUM_R_5msOverTime_Cnt
        MCUM_R_CpldRest_TimeOut_flag: type=DT_DT_MCUM_R_CpldRest_TimeOut_flag
        MCUM_R_DrvPCBCurr: type=DT_DT_MCUM_R_DrvPCBCurr
        MCUM_R_EOL_StateMachine: type=DT_DT_MCUM_R_EOL_StateMachine
        MCUM_R_CpldRest_ASC_Flag: type=DT_DT_MCUM_R_CpldRest_ASC_Flag
        MCUM_R_LimSpdTorFlag: type=DT_DT_MCUM_R_LimSpdTorFlag
        MCUM_R_PWM_Err_Count: type=DT_DT_MCUM_R_PWM_Err_Count
        MCUM_R_RDC_Reset_Count: type=DT_DT_MCUM_R_RDC_Reset_Count
        MCUM_R_ASC_Stop_Flag: type=DT_DT_MCUM_R_ASC_Stop_Flag
        MCUM_R_ASC_Soft_Exiting_Flag: type=DT_DT_MCUM_R_ASC_Soft_Exiting_Flag
        MCUM_R_Vbus_ServeLowChkEn: type=DT_DT_MCUM_R_Vbus_ServeLowChkEn
        MCUM_R_EOP_BlockErr_IsLim_Flag: type=DT_DT_MCUM_R_EOP_BlockErr_IsLim_Flag
        MCUM_R_IdqErrCount: type=DT_DT_MCUM_R_IdqErrCount
        MCUM_R_MotSelfHeat_EnSts: type=DT_DT_MCUM_R_MotSelfHeat_EnSts
        MCUM_R_MotBlockHeat_LvlFb: type=DT_DT_MCUM_R_MotBlockHeat_LvlFb
        MCUM_R_MotRotaryHeat_LvlFb: type=DT_DT_MCUM_R_MotRotaryHeat_LvlFb
        MCUM_R_MotSelfHeat_DropLvlFb: type=DT_DT_MCUM_R_MotSelfHeat_DropLvlFb
        MCUM_R_MotSelfHeat_DropLvlRsn: type=DT_DT_MCUM_R_MotSelfHeat_DropLvlRsn
        MCUM_R_MotBlockHeat_CurAngle: type=DT_DT_MCUM_R_MotBlockHeat_CurAngle
        MCUM_R_MotBlockHeat_CurMag: type=DT_DT_MCUM_R_MotBlockHeat_CurMag
        MCUM_R_UserDefine_Byte{1..4}: type=DT_DT_MCUM_R_UserDefine_Byte{1..4}
        MCUM_R_UserDefine_Word{1..3}: type=DT_DT_MCUM_R_UserDefine_Word{1..3}
    IF_VCU_0x358
      10 x data:
        VCU_MotSelfHeatPwrFb: type=DT_DT_VCU_MotSelfHeatPwrFb
        VCU_MotSelfHeatLvlFb: type=DT_DT_VCU_MotSelfHeatLvlFb
        VCU_MCUMWaterPumpLevlReq: type=DT_DT_VCU_MCUMWaterPumpLevlReq
        VCU_MCUSWaterPumpLevlReq: type=DT_DT_VCU_MCUSWaterPumpLevlReq
        VCU_HeatPwrAval: type=DT_DT_VCU_HeatPwrAval
        VCU_MotSelfHeatAllwd: type=DT_DT_VCU_MotSelfHeatAllwd
        VCU_MMotSelfHeatEnReq: type=DT_DT_VCU_MMotSelfHeatEnReq
        VCU_MMotSelfHeatLvlReq: type=DT_DT_VCU_MMotSelfHeatLvlReq
        VCU_SMotSelfHeatEnReq: type=DT_DT_VCU_SMotSelfHeatEnReq
        VCU_SMotSelfHeatLvlReq: type=DT_DT_VCU_SMotSelfHeatLvlReq
    IF_RMCU_0x2
      37 x data:
        Debug_MCU_CRC_CA: type=DT_DT_Debug_MCU_CRC_CA
        Debug_MCU_RollingCounter_CA: type=DT_DT_Debug_MCU_RollingCounter_CA
        Debug_MCU_WarningLevel: type=DT_DT_Debug_MCU_WarningLevel
        Debug_MCU_SelfCheckSts: type=DT_DT_Debug_MCU_SelfCheckSts
        Debug_MCU_DrvMotorWorkSts: type=DT_DT_Debug_MCU_DrvMotorWorkSts
        Debug_MCU_PowerReduceSts: type=DT_DT_Debug_MCU_PowerReduceSts
        Debug_MCU_DrvMotorRPM: type=DT_DT_Debug_MCU_DrvMotorRPM
        Debug_MCU_ActualTorqueFB: type=DT_DT_Debug_MCU_ActualTorqueFB
        Debug_MCU_HWRdcFault: type=DT_DT_Debug_MCU_HWRdcFault
        Debug_MCU_HighVoltPowerOffReq: type=DT_DT_Debug_MCU_HighVoltPowerOffReq
        Debug_MCU_HVILSts: type=DT_DT_Debug_MCU_HVILSts
        Debug_MCU_DragSts: type=DT_DT_Debug_MCU_DragSts
        Debug_MCU_CtrlMode: type=DT_DT_Debug_MCU_CtrlMode
        Debug_MCU_MILlampReq: type=DT_DT_Debug_MCU_MILlampReq
        Debug_MCU_DrvMotorRPMVD: type=DT_DT_Debug_MCU_DrvMotorRPMVD
        Debug_MCU_ActualTorqueFBVD: type=DT_DT_Debug_MCU_ActualTorqueFBVD
        Debug_MCU_MaxTorqueAllow: type=DT_DT_Debug_MCU_MaxTorqueAllow
        Debug_MCU_MaxSpeedAllow: type=DT_DT_Debug_MCU_MaxSpeedAllow
        Debug_MCU_ActiveReleaseSts: type=DT_DT_Debug_MCU_ActiveReleaseSts
        Debug_MCU_DCChargRelaySts: type=DT_DT_Debug_MCU_DCChargRelaySts
        Debug_MCUM_MinTorqueAllow: type=DT_DT_Debug_MCUM_MinTorqueAllow
        Debug_MCU_MainWireVolt: type=DT_DT_Debug_MCU_MainWireVolt
        Debug_MCU_MainWireCurr: type=DT_DT_Debug_MCU_MainWireCurr
        Debug_MCUM_TMS_MotSelfHeatEnSts: type=DT_DT_Debug_MCUM_TMS_MotSelfHeatEnSts
        Debug_MCUM_TMS_MotSelfHeatLvlFb: type=DT_DT_Debug_MCUM_TMS_MotSelfHeatLvlFb
        Debug_MCUM_RPowerReduceSts: type=DT_DT_Debug_MCUM_RPowerReduceSts
        Debug_MCUM_HeatPwrAval: type=DT_DT_Debug_MCUM_HeatPwrAval
        Debug_MCUM_RCtrlMode: type=DT_DT_Debug_MCUM_RCtrlMode
        Debug_MCUM_RWarningLevel: type=DT_DT_Debug_MCUM_RWarningLevel
        Debug_MCUM_RSelfCheckSts: type=DT_DT_Debug_MCUM_RSelfCheckSts
        Debug_MCUM_RDrvMotorWorkSts: type=DT_DT_Debug_MCUM_RDrvMotorWorkSts
        Debug_MCUM_RCtrlModeVD: type=DT_DT_Debug_MCUM_RCtrlModeVD
        Debug_MCUM_RHWRdcFault: type=DT_DT_Debug_MCUM_RHWRdcFault
        Debug_MCUM_RDrvMotorRPMVD: type=DT_DT_Debug_MCUM_RDrvMotorRPMVD
        Debug_MCUM_RActualTorqueFBVD: type=DT_DT_Debug_MCUM_RActualTorqueFBVD
        Debug_MCUM_RDrvMotorRPM: type=DT_DT_Debug_MCUM_RDrvMotorRPM
        Debug_MCUM_RActualTorqueFB: type=DT_DT_Debug_MCUM_RActualTorqueFB
    IF_IBS_0x225
      data IBS_CRC_225: type=DT_DT_IBS_CRC_225
      data IBS_RollingCounter_225: type=DT_DT_IBS_RollingCounter_225
      data IBS_Warning_Level: type=DT_DT_IBS_Warning_Level
    IF_ADDC_0x84
      28 x data:
        ADDC_CRC_84: type=DT_DT_ADDC_CRC_84
        ADDC_APS_AVHReq: type=DT_DT_ADDC_APS_AVHReq
        ADDC_APS_HoldSts: type=DT_DT_ADDC_APS_HoldSts
        ADDC_APSTargetTrqBrkVD: type=DT_DT_ADDC_APSTargetTrqBrkVD
        ADDC_APSTargetTrqBrk: type=DT_DT_ADDC_APSTargetTrqBrk
        ADDC_APSTargetTrqVD: type=DT_DT_ADDC_APSTargetTrqVD
        ADDC_APSTargetTrq: type=DT_DT_ADDC_APSTargetTrq
        ADDC_safety_valid: type=DT_DT_ADDC_safety_valid
        ADDC_rearsafety_level: type=DT_DT_ADDC_rearsafety_level
        ADDC_frontsafety_level: type=DT_DT_ADDC_frontsafety_level
        ADDC_rightsafety_level: type=DT_DT_ADDC_rightsafety_level
        ADDC_leftsafety_level: type=DT_DT_ADDC_leftsafety_level
        ADDC_RollingCounter_84: type=DT_DT_ADDC_RollingCounter_84
        ADDC_APS_EnableReq: type=DT_DT_ADDC_APS_EnableReq
        ADDC_APS_WorkSts: type=DT_DT_ADDC_APS_WorkSts
        ADDC_APS_PDCVehicleDirectCtlVD: type=DT_DT_ADDC_APS_PDCVehicleDirectCtlVD
        ADDC_APS_VehicleSpeedCtlVD: type=DT_DT_ADDC_APS_VehicleSpeedCtlVD
        ADDC_APS_PDC_VehicleDirectCtl: type=DT_DT_ADDC_APS_PDC_VehicleDirectCtl
        ADDC_APS_PDC_SWAngCtl: type=DT_DT_ADDC_APS_PDC_SWAngCtl
        ADDC_APS_ParkingReq: type=DT_DT_ADDC_APS_ParkingReq
        ADDC_APS_EmergenceBrake: type=DT_DT_ADDC_APS_EmergenceBrake
        ADDC_APS_TargetAccVD: type=DT_DT_ADDC_APS_TargetAccVD
        ADDC_APS_TargetAcc: type=DT_DT_ADDC_APS_TargetAcc
        ADDC_APS_VehicleSpeedCtl: type=DT_DT_ADDC_APS_VehicleSpeedCtl
        ADDC_APS_DecToStop: type=DT_DT_ADDC_APS_DecToStop
        ADDC_APS_Driveoff_Request: type=DT_DT_ADDC_APS_Driveoff_Request
        ADDC_APS_FuncType: type=DT_DT_ADDC_APS_FuncType
        ADDC_APS_Available: type=DT_DT_ADDC_APS_Available
    IF_IVI_0x5F6
      6 x data:
        IVI_Year: type=DT_DT_IVI_Year
        IVI_Month: type=DT_DT_IVI_Month
        IVI_Data: type=DT_DT_IVI_Data
        IVI_Hour: type=DT_DT_IVI_Hour
        IVI_Minute: type=DT_DT_IVI_Minute
        IVI_Second: type=DT_DT_IVI_Second
    IF_DCDC_0x324
      18 x data:
        DCDC_CRC_324: type=DT_DT_DCDC_CRC_324
        DCDC_RollingCounter_324: type=DT_DT_DCDC_RollingCounter_324
        DCDC_WorkSts: type=DT_DT_DCDC_WorkSts
        DCDC_Under_Output_Voltage: type=DT_DT_DCDC_Under_Output_Voltage
        DCDC_Over_Output_Voltage: type=DT_DT_DCDC_Over_Output_Voltage
        DCDC_Under_Input_Voltage: type=DT_DT_DCDC_Under_Input_Voltage
        DCDC_Over_Input_Voltage: type=DT_DT_DCDC_Over_Input_Voltage
        DCDC_Over_Input_Current: type=DT_DT_DCDC_Over_Input_Current
        DCDC_Real_Output_Current: type=DT_DT_DCDC_Real_Output_Current
        DCDC_Real_Output_Voltage: type=DT_DT_DCDC_Real_Output_Voltage
        DCDC_Real_Input_Current: type=DT_DT_DCDC_Real_Input_Current
        DCDC_Real_Input_Voltage: type=DT_DT_DCDC_Real_Input_Voltage
        DCDC_Derating: type=DT_DT_DCDC_Derating
        DCDC_Hardware_Fault_Flag: type=DT_DT_DCDC_Hardware_Fault_Flag
        CDU_ACChg_HIVSts: type=DT_DT_CDU_ACChg_HIVSts
        CDU_OBC_OverTemp: type=DT_DT_CDU_OBC_OverTemp
        CDU_SelfCheckSt: type=DT_DT_CDU_SelfCheckSt
        CDU_HV_HIVSts: type=DT_DT_CDU_HV_HIVSts
    IF_FSC_0x142
      data FSC_CRC_142: type=DT_DT_FSC_CRC_142
      data FSC_RollingCounter_142: type=DT_DT_FSC_RollingCounter_142
      data FSC_LCC_Mode: type=DT_DT_FSC_LCC_Mode
    IF_MCU_0x5C6
      18 x data:
        MotClb_FaultCode{1..8}: type=DT_DT_MotClb_FaultCode{1..8}
        MotClb_OfsApply: type=DT_DT_MotClb_OfsApply
        MCUMR_MotClb_FaultCode{1..8}: type=DT_DT_MCUMR_MotClb_FaultCode{1..8}
        MCUMR_MotClb_OfsApply: type=DT_DT_MCUMR_MotClb_OfsApply
    IF_MCU_0x5C5
      38 x data:
        EOL_ModeCMD_Data{0..5}: type=DT_DT_EOL_ModeCMD_Data{0..5}
        EOL_ModeCMD_Enable: type=DT_DT_EOL_ModeCMD_Enable
        EOL_ModeCMD_Check: type=DT_DT_EOL_ModeCMD_Check
        EOL_GainIden_UsApply: type=DT_DT_EOL_GainIden_UsApply
        EOL_MotClb_CtrlMode: type=DT_DT_EOL_MotClb_CtrlMode
        MotClb_OfsSet: type=DT_DT_MotClb_OfsSet
        EOL_MotClb_IsCMD: type=DT_DT_EOL_MotClb_IsCMD
        EOL_MotClb_ThetaCMD: type=DT_DT_EOL_MotClb_ThetaCMD
        EOL_frqsync: type=DT_DT_EOL_frqsync
        EOL_MotClb_Enable: type=DT_DT_EOL_MotClb_Enable
        EOL_ActiveReleaseCmd: type=DT_DT_EOL_ActiveReleaseCmd
        MotClb_OfsAdjEn: type=DT_DT_MotClb_OfsAdjEn
        EOL_Asc_CMD: type=DT_DT_EOL_Asc_CMD
        EOL_PosDly_SnsrSupplier: type=DT_DT_EOL_PosDly_SnsrSupplier
        FstRcrd_Enable: type=DT_DT_FstRcrd_Enable
        GainIden_CurrRMS_Ref_U: type=DT_DT_GainIden_CurrRMS_Ref_U
        GainIden_CurrRMS_Ref_V: type=DT_DT_GainIden_CurrRMS_Ref_V
        GainIden_CurrRMS_Ref_W: type=DT_DT_GainIden_CurrRMS_Ref_W
        MCUMR_EOL_GainIden_UsApply: type=DT_DT_MCUMR_EOL_GainIden_UsApply
        MCUMR_EOL_MotClb_CtrlMode: type=DT_DT_MCUMR_EOL_MotClb_CtrlMode
        MCUMR_MotClb_OfsSet: type=DT_DT_MCUMR_MotClb_OfsSet
        MCUMR_EOL_MotClb_IsCMD: type=DT_DT_MCUMR_EOL_MotClb_IsCMD
        MCUMR_EOL_MotClb_ThetaCMD: type=DT_DT_MCUMR_EOL_MotClb_ThetaCMD
        MCUMR_EOL_frqsync: type=DT_DT_MCUMR_EOL_frqsync
        MCUMR_EOL_MotClb_Enable: type=DT_DT_MCUMR_EOL_MotClb_Enable
        MCUMR_EOL_ActiveReleaseCmd: type=DT_DT_MCUMR_EOL_ActiveReleaseCmd
        MCUMR_MotClb_OfsAdjEn: type=DT_DT_MCUMR_MotClb_OfsAdjEn
        MCUMR_EOL_Asc_CMD: type=DT_DT_MCUMR_EOL_Asc_CMD
        MCUMR_EOL_PosDly_SnsrSupplier: type=DT_DT_MCUMR_EOL_PosDly_SnsrSupplier
        MCUMR_FstRcrd_Enable: type=DT_DT_MCUMR_FstRcrd_Enable
        MCUMR_GainIden_CurrRMS_Ref_U: type=DT_DT_MCUMR_GainIden_CurrRMS_Ref_U
        MCUMR_GainIden_CurrRMS_Ref_V: type=DT_DT_MCUMR_GainIden_CurrRMS_Ref_V
        MCUMR_GainIden_CurrRMS_Ref_W: type=DT_DT_MCUMR_GainIden_CurrRMS_Ref_W
    IF_MCUS_0x14
      6 x data:
        MCUS_CRC_14: type=DT_DT_MCUS_CRC_14
        MCUS_RollingCounter_14: type=DT_DT_MCUS_RollingCounter_14
        MCUS_DrvMotorRPM_prvt: type=DT_DT_MCUS_DrvMotorRPM_prvt
        MCUS_ActualTorqueFB_prvt: type=DT_DT_MCUS_ActualTorqueFB_prvt
        MCUS_DrvMotorRPMVD_prvt: type=DT_DT_MCUS_DrvMotorRPMVD_prvt
        MCUS_ActualTorqueFBVD_prvt: type=DT_DT_MCUS_ActualTorqueFBVD_prvt
    IF_MCU_0x5C7
      20 x data:
        U16_CMD{1..4}: type=DT_DT_U16_CMD{1..4}
        S16_CMD{1..4}: type=DT_DT_S16_CMD{1..4}
        R16_CMD{1..4}: type=DT_DT_R16_CMD{1..4}
        U8_CMD{1..8}: type=DT_DT_U8_CMD{1..8}
    IF_OBC_0x316
      16 x data:
        OBC_CRC_316: type=DT_DT_OBC_CRC_316
        OBC_RollingCounter_316: type=DT_DT_OBC_RollingCounter_316
        OBC_WorkSts: type=DT_DT_OBC_WorkSts
        OBC_StartSts: type=DT_DT_OBC_StartSts
        OBC_DCSts: type=DT_DT_OBC_DCSts
        OBC_ACChargeOutputSts: type=DT_DT_OBC_ACChargeOutputSts
        OBC_DCVolt: type=DT_DT_OBC_DCVolt
        OBC_HardwareSts: type=DT_DT_OBC_HardwareSts
        OBC_DCCurr: type=DT_DT_OBC_DCCurr
        OBC_ACVolt: type=DT_DT_OBC_ACVolt
        OBC_ACCurr: type=DT_DT_OBC_ACCurr
        OBC_CCConnectSts: type=DT_DT_OBC_CCConnectSts
        OBC_CPDutyCycleFault: type=DT_DT_OBC_CPDutyCycleFault
        OBC_CPDutyCycleValue: type=DT_DT_OBC_CPDutyCycleValue
        OBC_ACMaxPower: type=DT_DT_OBC_ACMaxPower
        OBC_ACPowerState: type=DT_DT_OBC_ACPowerState
    IF_LMC_0xFA
      24 x data:
        LMC_CRC_FA: type=DT_DT_LMC_CRC_FA
        LMC_RollingCounter_FA: type=DT_DT_LMC_RollingCounter_FA
        LMC_EngTorqDec_Main: type=DT_DT_LMC_EngTorqDec_Main
        LMC_EngTorqDecActive_Main: type=DT_DT_LMC_EngTorqDecActive_Main
        LMC_AMM_St: type=DT_DT_LMC_AMM_St
        LMC_EngTorqInc_Main: type=DT_DT_LMC_EngTorqInc_Main
        LMC_EngTorqIncActive_Main: type=DT_DT_LMC_EngTorqIncActive_Main
        LMC_EngTorqDec_Sub: type=DT_DT_LMC_EngTorqDec_Sub
        LMC_EngTorqDecActive_Sub: type=DT_DT_LMC_EngTorqDecActive_Sub
        LMC_EngTorqInc_Sub: type=DT_DT_LMC_EngTorqInc_Sub
        LMC_EngTorqIncActive_Sub: type=DT_DT_LMC_EngTorqIncActive_Sub
        LMC_SysSt: type=DT_DT_LMC_SysSt
        LMC_HSPC_ActiveSt: type=DT_DT_LMC_HSPC_ActiveSt
        LMC_FTSC_ActiveSt: type=DT_DT_LMC_FTSC_ActiveSt
        LMC_SDRM_ActiveSt: type=DT_DT_LMC_SDRM_ActiveSt
        LMC_NSPC_ActiveSt: type=DT_DT_LMC_NSPC_ActiveSt
        LMC_EAF_ActiveSt: type=DT_DT_LMC_EAF_ActiveSt
        LMC_SelfCheckSt: type=DT_DT_LMC_SelfCheckSt
        LMC_WBDC_ActiveSt: type=DT_DT_LMC_WBDC_ActiveSt
        LMC_LSFCActiveSt: type=DT_DT_LMC_LSFCActiveSt
        LMC_EngTorqDec_Main_R: type=DT_DT_LMC_EngTorqDec_Main_R
        LMC_EngTorqDecActive_Main_R: type=DT_DT_LMC_EngTorqDecActive_Main_R
        LMC_EngTorqInc_Main_R: type=DT_DT_LMC_EngTorqInc_Main_R
        LMC_EngTorqIncActive_Main_R: type=DT_DT_LMC_EngTorqIncActive_Main_R
    IF_LMC_0x18C
      5 x data:
        LMC_CRC_18C: type=DT_DT_LMC_CRC_18C
        LMC_RollingCounter_18C: type=DT_DT_LMC_RollingCounter_18C
        LMC_TqTotalBrakeTorque: type=DT_DT_LMC_TqTotalBrakeTorque
        LMC_TqTotalBrakeTorque_Valid: type=DT_DT_LMC_TqTotalBrakeTorque_Valid
        LMC_CmpUTurnLockwhists: type=DT_DT_LMC_CmpUTurnLockwhists
    IF_HPCGW_0x3B1
      21 x data:
        GW_CRC_3B1: type=DT_DT_GW_CRC_3B1
        GW_RollingCounter_3B1: type=DT_DT_GW_RollingCounter_3B1
        GW_ACU_FLSeatBeltRSt: type=DT_DT_GW_ACU_FLSeatBeltRSt
        GW_ACU_FRSeatBeltRSt: type=DT_DT_GW_ACU_FRSeatBeltRSt
        GW_IBC_EPB_Status: type=DT_DT_GW_IBC_EPB_Status
        GW_ACU_TotalCrashOutputSts: type=DT_DT_GW_ACU_TotalCrashOutputSts
        GW_BZCU_DCChgExitTemp_Pos: type=DT_DT_GW_BZCU_DCChgExitTemp_Pos
        GW_BZCU_DCChgExitTemp_Neg: type=DT_DT_GW_BZCU_DCChgExitTemp_Neg
        GW_BZCU_ACChgExitTemp_Pos: type=DT_DT_GW_BZCU_ACChgExitTemp_Pos
        GW_BZCU_FuelTankSts: type=DT_DT_GW_BZCU_FuelTankSts
        GW_BZCU_LBMS_VoltA: type=DT_DT_GW_BZCU_LBMS_VoltA
        GW_BZCU_ACChgExitTemp_Neg: type=DT_DT_GW_BZCU_ACChgExitTemp_Neg
        GW_BZCU_FuelTankStsLockSts: type=DT_DT_GW_BZCU_FuelTankStsLockSts
        GW_BZCU_FuelTankLockCtrl: type=DT_DT_GW_BZCU_FuelTankLockCtrl
        GW_BZCU_ACChgLockSts: type=DT_DT_GW_BZCU_ACChgLockSts
        GW_RZCU_Cabin_220Vconnect_Sts: type=DT_DT_GW_RZCU_Cabin_220Vconnect_Sts
        GW_BZCU_Cab_220VRelay_CtrlSts: type=DT_DT_GW_BZCU_Cab_220VRelay_CtrlSts
        GW_BZCU_Cab_PDU220VRelay_CtrlSts: type=DT_DT_GW_BZCU_Cab_PDU220VRelay_CtrlSts
        GW_BZCU_Cabin_220VRelay_CtrlSts: type=DT_DT_GW_BZCU_Cabin_220VRelay_CtrlSts
        GW_BZCU_Cab_220Vconnect_Sts: type=DT_DT_GW_BZCU_Cab_220Vconnect_Sts
        GW_TBOXSOC_Altitude: type=DT_DT_GW_TBOXSOC_Altitude
    IF_VCU_0x359
      44 x data:
        VCU_EolCfg_ESC: type=DT_DT_VCU_EolCfg_ESC
        VCU_IMMOKeyWriteCnt: type=DT_DT_VCU_IMMOKeyWriteCnt
        VCU_AbStartupFlag: type=DT_DT_VCU_AbStartupFlag
        VCU_AbResetFlag: type=DT_DT_VCU_AbResetFlag
        VCU_AbResetlnitFinish: type=DT_DT_VCU_AbResetlnitFinish
        VCU_EolCfg_EPB: type=DT_DT_VCU_EolCfg_EPB
        VCU_EolCfg_AEB: type=DT_DT_VCU_EolCfg_AEB
        VCU_EolCfg_InverterFunc: type=DT_DT_VCU_EolCfg_InverterFunc
        VCU_EolCfg_APS: type=DT_DT_VCU_EolCfg_APS
        VCU_EolCfg_VehiModels: type=DT_DT_VCU_EolCfg_VehiModels
        VCU_EolCfg_SpdLmtVal: type=DT_DT_VCU_EolCfg_SpdLmtVal
        VCU_EolCfg_WheelType: type=DT_DT_VCU_EolCfg_WheelType
        VCU_EolCfg_Curise: type=DT_DT_VCU_EolCfg_Curise
        VCU_REStartReq: type=DT_DT_VCU_REStartReq
        VCU_REStopReq: type=DT_DT_VCU_REStopReq
        VCU_EolCfg_VehiType: type=DT_DT_VCU_EolCfg_VehiType
        VCU_EolCfg_MotPwr: type=DT_DT_VCU_EolCfg_MotPwr
        VCU_Vehicle_NVHPwrLimitVal: type=DT_DT_VCU_Vehicle_NVHPwrLimitVal
        VCU_EolCfg_MotDrvStructure: type=DT_DT_VCU_EolCfg_MotDrvStructure
        VCU_WLTCModeFlag: type=DT_DT_VCU_WLTCModeFlag
        VCU_EolCfg_RudderDir: type=DT_DT_VCU_EolCfg_RudderDir
        VCU_EolCfg_DCChgRelayPos: type=DT_DT_VCU_EolCfg_DCChgRelayPos
        VCU_EolCfg_FPTCIL: type=DT_DT_VCU_EolCfg_FPTCIL
        VCU_PWakeupSt: type=DT_DT_VCU_PWakeupSt
        VCU_SpdLimitReason: type=DT_DT_VCU_SpdLimitReason
        BSW_VertifySts: type=DT_DT_BSW_VertifySts
        VCU_InterAllowEngStart: type=DT_DT_VCU_InterAllowEngStart
        VCU_EngineOff_Flag: type=DT_DT_VCU_EngineOff_Flag
        VCU_EngineStopAllow: type=DT_DT_VCU_EngineStopAllow
        VCU_EmergencyStopReq: type=DT_DT_VCU_EmergencyStopReq
        VCU_EngineAllowStop: type=DT_DT_VCU_EngineAllowStop
        VCU_REVehiWheelTrqReq: type=DT_DT_VCU_REVehiWheelTrqReq
        VCU_REHighPerformVehiPwr: type=DT_DT_VCU_REHighPerformVehiPwr
        VCU_REPwrDampingFactor: type=DT_DT_VCU_REPwrDampingFactor
        VCU_REDrvTarPwrFit: type=DT_DT_VCU_REDrvTarPwrFit
        VCU_AdditionalPwrVal: type=DT_DT_VCU_AdditionalPwrVal
        VCU_VehichRealPwDown: type=DT_DT_VCU_VehichRealPwDown
        VCU_IMMOStsResult: type=DT_DT_VCU_IMMOStsResult
        VCU_IMMOStateMachine: type=DT_DT_VCU_IMMOStateMachine
        VCU_ShowCarModeNvmResult: type=DT_DT_VCU_ShowCarModeNvmResult
        VCU_DeliveryModeNvmData: type=DT_DT_VCU_DeliveryModeNvmData
        VCU_AccPedFaultLvNvmResult: type=DT_DT_VCU_AccPedFaultLvNvmResult
        VCU_VehicleConfigNvmResult: type=DT_DT_VCU_VehicleConfigNvmResult
        VCU_EngRunTimeNvmResult: type=DT_DT_VCU_EngRunTimeNvmResult
    IF_VCU_0x514
      36 x data:
        VCU_FuelConsumption: type=DT_DT_VCU_FuelConsumption
        VCU_SVSLamp: type=DT_DT_VCU_SVSLamp
        VCU_MilLamp: type=DT_DT_VCU_MilLamp
        VCU_SinglePedalSts_ID514: type=DT_DT_VCU_SinglePedalSts_ID514
        VCU_GearLevelPosFault_ID514: type=DT_DT_VCU_GearLevelPosFault_ID514
        VCU_EngineStartFailure_ID514: type=DT_DT_VCU_EngineStartFailure_ID514
        VCU_ParkBeforeFuelup: type=DT_DT_VCU_ParkBeforeFuelup
        VCU_REsystemFaultSts_ID514: type=DT_DT_VCU_REsystemFaultSts_ID514
        VCU_EngineRunAllowFlg_ID514: type=DT_DT_VCU_EngineRunAllowFlg_ID514
        VCU_InverterTip: type=DT_DT_VCU_InverterTip
        VCU_EMSRepairModeSts: type=DT_DT_VCU_EMSRepairModeSts
        VCU_FuelTankFlapSts: type=DT_DT_VCU_FuelTankFlapSts
        VCU_REsystemSts_ID514: type=DT_DT_VCU_REsystemSts_ID514
        VCU_PowerModeAllow: type=DT_DT_VCU_PowerModeAllow
        VCU_PowerModeSwitchMsg: type=DT_DT_VCU_PowerModeSwitchMsg
        VCU_HighVoltFailed_M: type=DT_DT_VCU_HighVoltFailed_M
        VCU_HighVoltFailed_S: type=DT_DT_VCU_HighVoltFailed_S
        VCU_BrakeBeforeGear: type=DT_DT_VCU_BrakeBeforeGear
        VCU_ParkBeforeGear: type=DT_DT_VCU_ParkBeforeGear
        VCU_GearBeforDriving: type=DT_DT_VCU_GearBeforDriving
        VCU_UnlockBeforeDriving: type=DT_DT_VCU_UnlockBeforeDriving
        VCU_PreventSliding: type=DT_DT_VCU_PreventSliding
        VCU_MMErrorSts: type=DT_DT_VCU_MMErrorSts
        VCU_ShowCarModeSts: type=DT_DT_VCU_ShowCarModeSts
        VCU_PGearFlashSts: type=DT_DT_VCU_PGearFlashSts
        VCU_ACConnectSts: type=DT_DT_VCU_ACConnectSts
        VCU_DcChgPwrSts: type=DT_DT_VCU_DcChgPwrSts
        VCU_DriverAssistProhibitSts_ID514: type=DT_DT_VCU_DriverAssistProhibitSts_ID514
        VCU_MilLampRequest_ID514: type=DT_DT_VCU_MilLampRequest_ID514
        VCU_CcmHvilInSigFreq_FB: type=DT_DT_VCU_CcmHvilInSigFreq_FB
        VCU_CcmHvilInSigDuty_FB: type=DT_DT_VCU_CcmHvilInSigDuty_FB
        VCU_FuelDectionModeSts: type=DT_DT_VCU_FuelDectionModeSts
        VCU_EnergyCtrlMode: type=DT_DT_VCU_EnergyCtrlMode
        VCU_VehSpdLimtRemind_ID514: type=DT_DT_VCU_VehSpdLimtRemind_ID514
        VCU_TurtleLamp: type=DT_DT_VCU_TurtleLamp
        VCU_EngLongTimeStartReq: type=DT_DT_VCU_EngLongTimeStartReq
    IF_HPCGW_0x13A
      21 x data:
        GW_CRC_13A: type=DT_DT_GW_CRC_13A
        GW_RollingCounter_13A: type=DT_DT_GW_RollingCounter_13A
        GW_IBC_VehicleSpeed: type=DT_DT_GW_IBC_VehicleSpeed
        GW_IBC_VehicleSpeedVD: type=DT_DT_GW_IBC_VehicleSpeedVD
        GW_IBC_AVHStatus: type=DT_DT_GW_IBC_AVHStatus
        GW_IBC_RAB_Avatiable: type=DT_DT_GW_IBC_RAB_Avatiable
        GW_IBC_RAB_Active: type=DT_DT_GW_IBC_RAB_Active
        GW_IBC_FLWheelSpeedKPH: type=DT_DT_GW_IBC_FLWheelSpeedKPH
        GW_IBC_FRWheelSpeedKPH: type=DT_DT_GW_IBC_FRWheelSpeedKPH
        GW_IBC_RLWheelSpeedKPH: type=DT_DT_GW_IBC_RLWheelSpeedKPH
        GW_IBC_RRWheelSpeedKPH: type=DT_DT_GW_IBC_RRWheelSpeedKPH
        GW_IBC_FLWheelDirection: type=DT_DT_GW_IBC_FLWheelDirection
        GW_IBC_FRWheelDirection: type=DT_DT_GW_IBC_FRWheelDirection
        GW_IBC_RLWheelDirection: type=DT_DT_GW_IBC_RLWheelDirection
        GW_IBC_RRWheelDirection: type=DT_DT_GW_IBC_RRWheelDirection
        GW_IBC_FLWheelSpeedVD: type=DT_DT_GW_IBC_FLWheelSpeedVD
        GW_IBC_FRWheelSpeedVD: type=DT_DT_GW_IBC_FRWheelSpeedVD
        GW_IBC_RLWheelSpeedVD: type=DT_DT_GW_IBC_RLWheelSpeedVD
        GW_IBC_RRWheelSpeedVD: type=DT_DT_GW_IBC_RRWheelSpeedVD
        GW_IBC_PlungerPressure_Q: type=DT_DT_GW_IBC_PlungerPressure_Q
        GW_IBC_PlungerPressure: type=DT_DT_GW_IBC_PlungerPressure
    IF_CCM_0x36A
      6 x data:
        CCM_Volt: type=DT_DT_CCM_Volt
        CCM_RollingCounter_36A: type=DT_DT_CCM_RollingCounter_36A
        CCM_BaseState: type=DT_DT_CCM_BaseState
        CCM_Power: type=DT_DT_CCM_Power
        CCM_APTC_BscSts: type=DT_DT_CCM_APTC_BscSts
        CCM_APTC_Power: type=DT_DT_CCM_APTC_Power
    IF_IBC_0x227
      11 x data:
        IBC_CRC_227: type=DT_DT_IBC_CRC_227
        IBC_RollingCounter_227: type=DT_DT_IBC_RollingCounter_227
        IBC_EPB_FailStatus: type=DT_DT_IBC_EPB_FailStatus
        IBC_EPB_Status: type=DT_DT_IBC_EPB_Status
        IBC_EPB_DrumMode: type=DT_DT_IBC_EPB_DrumMode
        IBC_EPB_AchievedClampForce: type=DT_DT_IBC_EPB_AchievedClampForce
        IBC_EPB_FailureLamp: type=DT_DT_IBC_EPB_FailureLamp
        IBC_EPB_ActuatorStateLeft: type=DT_DT_IBC_EPB_ActuatorStateLeft
        IBC_EPB_ActuatorStateRight: type=DT_DT_IBC_EPB_ActuatorStateRight
        IBC_EPB_HostAvailabilityLeft: type=DT_DT_IBC_EPB_HostAvailabilityLeft
        IBC_EPB_HostAvailabilityRight: type=DT_DT_IBC_EPB_HostAvailabilityRight
    IF_MCU_0x5C8
      34 x data:
        Harness_igbt_temp{1..3}: type=DT_DT_Harness_igbt_temp{1..3}
        Harness_CoolWaterTemp: type=DT_DT_Harness_CoolWaterTemp
        Harness_V_DC: type=DT_DT_Harness_V_DC
        Harness_PWM_DIR: type=DT_DT_Harness_PWM_DIR
        Harness_HVIL_State: type=DT_DT_Harness_HVIL_State
        Harness_crash_err_flag: type=DT_DT_Harness_crash_err_flag
        Harness_KeyON: type=DT_DT_Harness_KeyON
        Harness_HWRdc: type=DT_DT_Harness_HWRdc
        Harness_HWFoT: type=DT_DT_Harness_HWFoT
        Harness_HWVoltLower: type=DT_DT_Harness_HWVoltLower
        Harness_HWFoB: type=DT_DT_Harness_HWFoB
        Harness_MotorTemp1: type=DT_DT_Harness_MotorTemp1
        Harness_MotorTemp2: type=DT_DT_Harness_MotorTemp2
        Harness_I_U: type=DT_DT_Harness_I_U
        Harness_I_W: type=DT_DT_Harness_I_W
        Harness_I_V: type=DT_DT_Harness_I_V
        Harness_HVRelayPosVolt: type=DT_DT_Harness_HVRelayPosVolt
        MCUMR_Harness_igbt_temp{1..3}: type=DT_DT_MCUMR_Harness_igbt_temp{1..3}
        MCUMR_Harness_CoolWaterTemp: type=DT_DT_MCUMR_Harness_CoolWaterTemp
        MCUMR_Harness_V_DC: type=DT_DT_MCUMR_Harness_V_DC
        MCUMR_Harness_PWM_DIR: type=DT_DT_MCUMR_Harness_PWM_DIR
        MCUMR_Harness_HWRdc: type=DT_DT_MCUMR_Harness_HWRdc
        MCUMR_Harness_HWFoT: type=DT_DT_MCUMR_Harness_HWFoT
        MCUMR_Harness_HWVoltLower: type=DT_DT_MCUMR_Harness_HWVoltLower
        MCUMR_Harness_HWFoB: type=DT_DT_MCUMR_Harness_HWFoB
        MCUMR_Harness_MotorTemp1: type=DT_DT_MCUMR_Harness_MotorTemp1
        MCUMR_Harness_MotorTemp2: type=DT_DT_MCUMR_Harness_MotorTemp2
        MCUMR_Harness_I_U: type=DT_DT_MCUMR_Harness_I_U
        MCUMR_Harness_I_W: type=DT_DT_MCUMR_Harness_I_W
        MCUMR_Harness_I_V: type=DT_DT_MCUMR_Harness_I_V
    IF_HPCBCM_0x290
      19 x data:
        BCM_CRC_290: type=DT_DT_BCM_CRC_290
        BCM_RRDoorSts_ID290_CCAN: type=DT_DT_BCM_RRDoorSts_ID290_CCAN
        BCM_RLDoorSts_ID290_CCAN: type=DT_DT_BCM_RLDoorSts_ID290_CCAN
        BCM_RollingCounter_290: type=DT_DT_BCM_RollingCounter_290
        BCM_HazardSwtSts: type=DT_DT_BCM_HazardSwtSts
        BCM_DrOC_PPD_Status: type=DT_DT_BCM_DrOC_PPD_Status
        BCM_FLOC_PPD_Status: type=DT_DT_BCM_FLOC_PPD_Status
        BCM_FROC_PPD_Status: type=DT_DT_BCM_FROC_PPD_Status
        BCM_DriverDoorSts_ID290_CCAN: type=DT_DT_BCM_DriverDoorSts_ID290_CCAN
        BCM_DriverDoorSts_VD: type=DT_DT_BCM_DriverDoorSts_VD
        BCM_FLDoorSts_ID290_CCAN: type=DT_DT_BCM_FLDoorSts_ID290_CCAN
        BCM_FRDoorSts_ID290_CCAN: type=DT_DT_BCM_FRDoorSts_ID290_CCAN
        BCM_BackDoorSts_ID290_CCAN: type=DT_DT_BCM_BackDoorSts_ID290_CCAN
        BCM_FrontCoverSts: type=DT_DT_BCM_FrontCoverSts
        BCM_HazardSwtOpenSts: type=DT_DT_BCM_HazardSwtOpenSts
        BCM_BrakeFluidLevel: type=DT_DT_BCM_BrakeFluidLevel
        BCM_ON2BRelaySts_ID290_CCAN: type=DT_DT_BCM_ON2BRelaySts_ID290_CCAN
        BCM_ON2CRelaySts_ID290_CCAN: type=DT_DT_BCM_ON2CRelaySts_ID290_CCAN
        BCM_AlarmMode_C: type=DT_DT_BCM_AlarmMode_C
    IF_VCU_0x13
      9 x data:
        VCU_CRC_13: type=DT_DT_VCU_CRC_13
        VCU_RollingCounter_13: type=DT_DT_VCU_RollingCounter_13
        VCU_SDrvRequestTorque_prvt: type=DT_DT_VCU_SDrvRequestTorque_prvt
        VCU_SDrvRequestTorqueVD_prvt: type=DT_DT_VCU_SDrvRequestTorqueVD_prvt
        VCU_MCUSDampgLmtFactor_prvt: type=DT_DT_VCU_MCUSDampgLmtFactor_prvt
        VCU_VehicleDirectS_prvt: type=DT_DT_VCU_VehicleDirectS_prvt
        VCU_VehicleDirectS_VD_prvt: type=DT_DT_VCU_VehicleDirectS_VD_prvt
        VCU_MCUSMaxPosDampgTrq_prvt: type=DT_DT_VCU_MCUSMaxPosDampgTrq_prvt
        VCU_MCUSMaxNegDampgTrq_prvt: type=DT_DT_VCU_MCUSMaxNegDampgTrq_prvt
    IF_VCU_0x1
      33 x data:
        EOL_CRC_13B: type=DT_DT_EOL_CRC_13B
        EOL_RollingCounter_13B: type=DT_DT_EOL_RollingCounter_13B
        EOL_VehicleSts: type=DT_DT_EOL_VehicleSts
        EOL_GearLevelPosSts: type=DT_DT_EOL_GearLevelPosSts
        EOL_GearLeverValid: type=DT_DT_EOL_GearLeverValid
        EOL_AccPedalValid: type=DT_DT_EOL_AccPedalValid
        EOL_ThrottlePosition: type=DT_DT_EOL_ThrottlePosition
        EOL_RMCUActiveReleaseCmd: type=DT_DT_EOL_RMCUActiveReleaseCmd
        EOL_VehicleDirect: type=DT_DT_EOL_VehicleDirect
        EOL_SuppressJitterRMCURequest: type=DT_DT_EOL_SuppressJitterRMCURequest
        EOL_RDrvControlMode: type=DT_DT_EOL_RDrvControlMode
        EOL_BrakePedalValue: type=DT_DT_EOL_BrakePedalValue
        EOL_RMCUMaxDischargePower: type=DT_DT_EOL_RMCUMaxDischargePower
        EOL_RMCUMaxChargePower: type=DT_DT_EOL_RMCUMaxChargePower
        EOL_RDrvRequestTorque: type=DT_DT_EOL_RDrvRequestTorque
        EOL_RDrvRequesSpeed: type=DT_DT_EOL_RDrvRequesSpeed
        EOL_FDrvRequestTorque: type=DT_DT_EOL_FDrvRequestTorque
        EOL_FDrvRequesSpeed: type=DT_DT_EOL_FDrvRequesSpeed
        EOL_FVehicleSts: type=DT_DT_EOL_FVehicleSts
        EOL_FDrvControlMode: type=DT_DT_EOL_FDrvControlMode
        EOL_ON2BRelayReq: type=DT_DT_EOL_ON2BRelayReq
        EOL_VehicleDirectVD: type=DT_DT_EOL_VehicleDirectVD
        EOL_RDrvControlModeVD: type=DT_DT_EOL_RDrvControlModeVD
        EOL_RDrvRequestTorqueVD: type=DT_DT_EOL_RDrvRequestTorqueVD
        EOL_RDrvRequesSpeedVD: type=DT_DT_EOL_RDrvRequesSpeedVD
        EOL_FDrvRequestTorqueVD: type=DT_DT_EOL_FDrvRequestTorqueVD
        EOL_FDrvRequesSpeedVD: type=DT_DT_EOL_FDrvRequesSpeedVD
        EOL_FDrvControlModeVD: type=DT_DT_EOL_FDrvControlModeVD
        EOL_MCUMDampgLmtFactor: type=DT_DT_EOL_MCUMDampgLmtFactor
        EOL_VCU_BoostMode_Fail: type=DT_DT_EOL_VCU_BoostMode_Fail
        EOL_VCU_BoostModeSts: type=DT_DT_EOL_VCU_BoostModeSts
        EOL_MCUMMaxPosDampgTrq: type=DT_DT_EOL_MCUMMaxPosDampgTrq
        EOL_MCUMMaxNegDampgTrq: type=DT_DT_EOL_MCUMMaxNegDampgTrq
    IF_TMS_0x5FE
      data TMS_MilLampReq: type=DT_DT_TMS_MilLampReq
    IF_EMS_0xBE
      44 x data:
        EMS_CRC_BE: type=DT_DT_EMS_CRC_BE
        EMS_RollingCounter_BE: type=DT_DT_EMS_RollingCounter_BE
        EMS_EngineSts: type=DT_DT_EMS_EngineSts
        ECM_FaultLevel: type=DT_DT_ECM_FaultLevel
        ECM_ActualEngineTorqueValid: type=DT_DT_ECM_ActualEngineTorqueValid
        ECM_EngineTorqueLoss: type=DT_DT_ECM_EngineTorqueLoss
        ECM_ActualEngineTorque: type=DT_DT_ECM_ActualEngineTorque
        ECM_EngineTorqueMax: type=DT_DT_ECM_EngineTorqueMax
        ECM_EngineTorqueMin: type=DT_DT_ECM_EngineTorqueMin
        ECM_EngineSpeed: type=DT_DT_ECM_EngineSpeed
        ECM_EngineSpeedValid: type=DT_DT_ECM_EngineSpeedValid
        ECM_EngineStopAllow: type=DT_DT_ECM_EngineStopAllow
        ECM_EngineOilPressureLow: type=DT_DT_ECM_EngineOilPressureLow
        ECM_EngineFuleCutoffSts: type=DT_DT_ECM_EngineFuleCutoffSts
        ECM_EngineStartedCompleted: type=DT_DT_ECM_EngineStartedCompleted
        ECM_CatalystWarmUpSts: type=DT_DT_ECM_CatalystWarmUpSts
        ECM_CatalystWarmUpReq: type=DT_DT_ECM_CatalystWarmUpReq
        ECM_IdleTargetSpeed: type=DT_DT_ECM_IdleTargetSpeed
        ECM_IdleActive: type=DT_DT_ECM_IdleActive
        ECM_EngineStartReq: type=DT_DT_ECM_EngineStartReq
        ECM_EngineStopInhibit: type=DT_DT_ECM_EngineStopInhibit
        ECM_GPFRegenlamp: type=DT_DT_ECM_GPFRegenlamp
        ECM_EngineCoolantTemp: type=DT_DT_ECM_EngineCoolantTemp
        ECM_EngineCoolantTempValid: type=DT_DT_ECM_EngineCoolantTempValid
        ECM_FVVSts: type=DT_DT_ECM_FVVSts
        ECM_learningReq: type=DT_DT_ECM_learningReq
        ECM_EngineIdleStateRequest: type=DT_DT_ECM_EngineIdleStateRequest
        ECM_EngineDFCOConditionRequest: type=DT_DT_ECM_EngineDFCOConditionRequest
        ECM_GPFRegenReq: type=DT_DT_ECM_GPFRegenReq
        ECM_SVSLampRequest: type=DT_DT_ECM_SVSLampRequest
        ECM_TankPressure: type=DT_DT_ECM_TankPressure
        ECM_TankPressureValid: type=DT_DT_ECM_TankPressureValid
        ECM_MilLampRequest: type=DT_DT_ECM_MilLampRequest
        ECM_ToothlearningSucValid: type=DT_DT_ECM_ToothlearningSucValid
        ECM_FuelCloseLoopSts: type=DT_DT_ECM_FuelCloseLoopSts
        ECM_RestrictorOpenValue: type=DT_DT_ECM_RestrictorOpenValue
        ECM_FuelLevelSensorValid: type=DT_DT_ECM_FuelLevelSensorValid
        ECM_FuelLevel: type=DT_DT_ECM_FuelLevel
        ECM_SelfCheckSt: type=DT_DT_ECM_SelfCheckSt
        ECM_PCVPipeDiagReq: type=DT_DT_ECM_PCVPipeDiagReq
        ECM_CalculatedLoad: type=DT_DT_ECM_CalculatedLoad
        ECM_AirPressure: type=DT_DT_ECM_AirPressure
        ECM_FanSts: type=DT_DT_ECM_FanSts
        ECM_ClearingSparkcarbonedRequest: type=DT_DT_ECM_ClearingSparkcarbonedRequest
    IF_EPS_0x18D
      11 x data:
        EPS_CRC_18D: type=DT_DT_EPS_CRC_18D
        EPS_RollingCounter_18D: type=DT_DT_EPS_RollingCounter_18D
        EPS_Fault: type=DT_DT_EPS_Fault
        EPS_CalibrationSts: type=DT_DT_EPS_CalibrationSts
        EPS_FailureSts: type=DT_DT_EPS_FailureSts
        EPS_SteeringAngleValidData: type=DT_DT_EPS_SteeringAngleValidData
        EPS_SteeringAngleSpeedValidData: type=DT_DT_EPS_SteeringAngleSpeedValidData
        EPS_SteerWheelAngle: type=DT_DT_EPS_SteerWheelAngle
        EPS_SteerWheelRotSpd: type=DT_DT_EPS_SteerWheelRotSpd
        EPS_SelfCheckSt: type=DT_DT_EPS_SelfCheckSt
        EPS_AssistanceSts: type=DT_DT_EPS_AssistanceSts
    IF_GCU_0xBD
      25 x data:
        GCU_CRC_BD: type=DT_DT_GCU_CRC_BD
        GCU_EngineCylinderDeactivationStatus: type=DT_DT_GCU_EngineCylinderDeactivationStatus
        GCU_EngineFuelInhibitReq: type=DT_DT_GCU_EngineFuelInhibitReq
        GCU_RollingCounter_BD: type=DT_DT_GCU_RollingCounter_BD
        GCU_MainWireCurr: type=DT_DT_GCU_MainWireCurr
        GCU_MainWireVolt: type=DT_DT_GCU_MainWireVolt
        GCU_SystemWarning: type=DT_DT_GCU_SystemWarning
        GCU_MILlampReq: type=DT_DT_GCU_MILlampReq
        GCU_MoterTemp: type=DT_DT_GCU_MoterTemp
        GCU_Temp: type=DT_DT_GCU_Temp
        GCU_SelfCheck: type=DT_DT_GCU_SelfCheck
        GCU_Warning_Level: type=DT_DT_GCU_Warning_Level
        GCU_HVILSts: type=DT_DT_GCU_HVILSts
        GCU__PowerReduceSts: type=DT_DT_GCU__PowerReduceSts
        GCU_ActualMotorRPM_VD: type=DT_DT_GCU_ActualMotorRPM_VD
        GCU_ActualMotorTorque_VD: type=DT_DT_GCU_ActualMotorTorque_VD
        GCU_ActualMotorTorque: type=DT_DT_GCU_ActualMotorTorque
        GCU_MaxTorque: type=DT_DT_GCU_MaxTorque
        GCU_ActiveReleaseFB: type=DT_DT_GCU_ActiveReleaseFB
        GCU_MAXPower: type=DT_DT_GCU_MAXPower
        GCU_TransientPower: type=DT_DT_GCU_TransientPower
        GCU_HVOffReq: type=DT_DT_GCU_HVOffReq
        GCU_ControlMode: type=DT_DT_GCU_ControlMode
        GCU_Operating_Mode: type=DT_DT_GCU_Operating_Mode
        GCU_ActualMotorRPM: type=DT_DT_GCU_ActualMotorRPM
    IF_BMS_0x5B5
      7 x data:
        BMS_WkupVolt_DC12V: type=DT_DT_BMS_WkupVolt_DC12V
        BMS_WkupVolt_AC12V: type=DT_DT_BMS_WkupVolt_AC12V
        BMS_HVPackPosRelayExternalVolt: type=DT_DT_BMS_HVPackPosRelayExternalVolt
        BMS_SOC_target: type=DT_DT_BMS_SOC_target
        BMS_CorrectSOEPer: type=DT_DT_BMS_CorrectSOEPer
        BMS_SOCModifyFlag: type=DT_DT_BMS_SOCModifyFlag
        BMS_BMU_SoftwareVersion: type=DT_DT_BMS_BMU_SoftwareVersion
    IF_VCU_0xBC
      38 x data:
        VCU_VehicleSpdDirect: type=DT_DT_VCU_VehicleSpdDirect
        VCU_ADM_ActualMode: type=DT_DT_VCU_ADM_ActualMode
        VCU_ADM_MainMode: type=DT_DT_VCU_ADM_MainMode
        VCU_DeliveryModeSts: type=DT_DT_VCU_DeliveryModeSts
        VCU_VehSpdLimtRemind: type=DT_DT_VCU_VehSpdLimtRemind
        VCU_SinglePedalSts: type=DT_DT_VCU_SinglePedalSts
        VCU_GearLvrChangeSts: type=DT_DT_VCU_GearLvrChangeSts
        VCU_HighVoltSysSts: type=DT_DT_VCU_HighVoltSysSts
        VCU_ChrgDischrgFunSts: type=DT_DT_VCU_ChrgDischrgFunSts
        VCU_CalibrationVersion: type=DT_DT_VCU_CalibrationVersion
        VCU_CalibrationNumber: type=DT_DT_VCU_CalibrationNumber
        VCU_VehicleNegTrqRspdSts: type=DT_DT_VCU_VehicleNegTrqRspdSts
        VCU_SlopeEst: type=DT_DT_VCU_SlopeEst
        VCU_SlopeEst_Valid: type=DT_DT_VCU_SlopeEst_Valid
        VCU_WheelTrqType: type=DT_DT_VCU_WheelTrqType
        VCU_DriverAssistProhibitSts: type=DT_DT_VCU_DriverAssistProhibitSts
        VCU_VacumRlySts: type=DT_DT_VCU_VacumRlySts
        VCU_DriveSHVILSts: type=DT_DT_VCU_DriveSHVILSts
        VCU_DriveMHVILSts: type=DT_DT_VCU_DriveMHVILSts
        VCU_DCChgHVILSts: type=DT_DT_VCU_DCChgHVILSts
        VCU_ACChgHVILSts: type=DT_DT_VCU_ACChgHVILSts
        VCU_CCMHVILSts: type=DT_DT_VCU_CCMHVILSts
        VCU_SystemError: type=DT_DT_VCU_SystemError
        VCU_AccPedalFaultLV: type=DT_DT_VCU_AccPedalFaultLV
        VCU_HVILSysSts: type=DT_DT_VCU_HVILSysSts
        VCU_VacuumDegree: type=DT_DT_VCU_VacuumDegree
        VCU_LPedalModeSts: type=DT_DT_VCU_LPedalModeSts
        VCU_LVSystemError: type=DT_DT_VCU_LVSystemError
        VCU_HVSystemError: type=DT_DT_VCU_HVSystemError
        VCU_OpeartingMode: type=DT_DT_VCU_OpeartingMode
        VCU_EnergyMode: type=DT_DT_VCU_EnergyMode
        VCU_GearLevelPosFault: type=DT_DT_VCU_GearLevelPosFault
        VCU_BrakeSwitchSts: type=DT_DT_VCU_BrakeSwitchSts
        VCU_SpdLimModeSts: type=DT_DT_VCU_SpdLimModeSts
        VCU_TrqDstrbutnPrio: type=DT_DT_VCU_TrqDstrbutnPrio
        VCU_TrqDstrbutnTransferSts: type=DT_DT_VCU_TrqDstrbutnTransferSts
        VCU_MCUMDiffProtectSts: type=DT_DT_VCU_MCUMDiffProtectSts
        VCU_MCUSDiffProtectSts: type=DT_DT_VCU_MCUSDiffProtectSts
    IF_ICU_0x332
      6 x data:
        ICU_CRC_332: type=DT_DT_ICU_CRC_332
        ICU_RollingCounter_332: type=DT_DT_ICU_RollingCounter_332
        ICU_AEB_SW: type=DT_DT_ICU_AEB_SW
        ICU_ISA_controlSW: type=DT_DT_ICU_ISA_controlSW
        ICU_SLIF_SW: type=DT_DT_ICU_SLIF_SW
        ICU_SLWF_SW: type=DT_DT_ICU_SLWF_SW
    IF_TMS_0x5A2
      5 x data:
        TMS_MainMotPumpSpdResp: type=DT_DT_TMS_MainMotPumpSpdResp
        TMS_MainMotPump_Operation_Temp: type=DT_DT_TMS_MainMotPump_Operation_Temp
        TMS_MainMotPump_Operation_Current: type=DT_DT_TMS_MainMotPump_Operation_Current
        TMS_MainMotPump_Supplied_Voltage: type=DT_DT_TMS_MainMotPump_Supplied_Voltage
        TMS_MainMotPumpErrSts: type=DT_DT_TMS_MainMotPumpErrSts
    IF_IBC_0x184
      26 x data:
        IBC_CRC_184: type=DT_DT_IBC_CRC_184
        IBC_RollingCounter_184: type=DT_DT_IBC_RollingCounter_184
        IBC_FLWheelSpeedKPH: type=DT_DT_IBC_FLWheelSpeedKPH
        IBC_FRWheelSpeedKPH: type=DT_DT_IBC_FRWheelSpeedKPH
        IBC_RLWheelSpeedKPH: type=DT_DT_IBC_RLWheelSpeedKPH
        IBC_RRWheelSpeedKPH: type=DT_DT_IBC_RRWheelSpeedKPH
        IBC_FLWheelDirection: type=DT_DT_IBC_FLWheelDirection
        IBC_FRWheelDirection: type=DT_DT_IBC_FRWheelDirection
        IBC_RLWheelDirection: type=DT_DT_IBC_RLWheelDirection
        IBC_RRWheelDirection: type=DT_DT_IBC_RRWheelDirection
        IBC_FLWheelSpeedVD: type=DT_DT_IBC_FLWheelSpeedVD
        IBC_FRWheelSpeedVD: type=DT_DT_IBC_FRWheelSpeedVD
        IBC_RLWheelSpeedVD: type=DT_DT_IBC_RLWheelSpeedVD
        IBC_RRWheelSpeedVD: type=DT_DT_IBC_RRWheelSpeedVD
        IBC_FLWheelSpeedRC: type=DT_DT_IBC_FLWheelSpeedRC
        IBC_FRWheelSpeedRC: type=DT_DT_IBC_FRWheelSpeedRC
        IBC_RLWheelSpeedRC: type=DT_DT_IBC_RLWheelSpeedRC
        IBC_RRWheelSpeedRC: type=DT_DT_IBC_RRWheelSpeedRC
        IBC_DiscTemperatureFL: type=DT_DT_IBC_DiscTemperatureFL
        IBC_DiscTemperatureFLVD: type=DT_DT_IBC_DiscTemperatureFLVD
        IBC_DiscTemperatureFR: type=DT_DT_IBC_DiscTemperatureFR
        IBC_DiscTemperatureFRVD: type=DT_DT_IBC_DiscTemperatureFRVD
        IBC_DiscTemperatureRL: type=DT_DT_IBC_DiscTemperatureRL
        IBC_DiscTemperatureRLVD: type=DT_DT_IBC_DiscTemperatureRLVD
        IBC_DiscTemperatureRR: type=DT_DT_IBC_DiscTemperatureRR
        IBC_DiscTemperatureRRVD: type=DT_DT_IBC_DiscTemperatureRRVD
    IF_IBC_0x183
      20 x data:
        IBC_CRC_183: type=DT_DT_IBC_CRC_183
        IBC_RollingCounter_183: type=DT_DT_IBC_RollingCounter_183
        IBC_RecuBrakeTorqueRequest: type=DT_DT_IBC_RecuBrakeTorqueRequest
        IBC_RecuBrakeTorqueRequest_Q: type=DT_DT_IBC_RecuBrakeTorqueRequest_Q
        IBC_sOutputRodDriverPer_Q: type=DT_DT_IBC_sOutputRodDriverPer_Q
        IBC_BrakePedalApplied_Q: type=DT_DT_IBC_BrakePedalApplied_Q
        IBC_HydraTorqTgtAct_Q: type=DT_DT_IBC_HydraTorqTgtAct_Q
        IBC_HydraTorqTgtAct: type=DT_DT_IBC_HydraTorqTgtAct
        IBC_BrakePedalApplied: type=DT_DT_IBC_BrakePedalApplied
        IBC_sOutputRodDriverPer: type=DT_DT_IBC_sOutputRodDriverPer
        IBC_HydraTorqAvailable: type=DT_DT_IBC_HydraTorqAvailable
        IBC_CtrlMode: type=DT_DT_IBC_CtrlMode
        IBC_QDC_HydraTorqTgt: type=DT_DT_IBC_QDC_HydraTorqTgt
        IBC_InPutRodDriver: type=DT_DT_IBC_InPutRodDriver
        IBC_InPutRodDriver_Q: type=DT_DT_IBC_InPutRodDriver_Q
        IBC_SystemAssistedStatus: type=DT_DT_IBC_SystemAssistedStatus
        IBC_EngTorq_VLC_Vaild: type=DT_DT_IBC_EngTorq_VLC_Vaild
        IBC_EngTorq_VLC: type=DT_DT_IBC_EngTorq_VLC
        IBC_BrkTorq_VLC: type=DT_DT_IBC_BrkTorq_VLC
        IBC_BrkTorq_VLC_Vaild: type=DT_DT_IBC_BrkTorq_VLC_Vaild
    IF_IBC_0x186
      19 x data:
        IBC_CRC_186: type=DT_DT_IBC_CRC_186
        IBC_RollingCounter_186: type=DT_DT_IBC_RollingCounter_186
        IBC_WheelPressureReliabilityFL: type=DT_DT_IBC_WheelPressureReliabilityFL
        IBC_WheelPressureReliabilityFR: type=DT_DT_IBC_WheelPressureReliabilityFR
        IBC_WheelPressureReliabilityRL: type=DT_DT_IBC_WheelPressureReliabilityRL
        IBC_WheelPressureReliabilityRR: type=DT_DT_IBC_WheelPressureReliabilityRR
        IBC_WheelCylinderPressure_FL: type=DT_DT_IBC_WheelCylinderPressure_FL
        IBC_WheelCylinderPressure_FR: type=DT_DT_IBC_WheelCylinderPressure_FR
        IBC_WheelCylinderPressure_RL: type=DT_DT_IBC_WheelCylinderPressure_RL
        IBC_WheelCylinderPressure_RR: type=DT_DT_IBC_WheelCylinderPressure_RR
        IBC_WheelSlipFLVD: type=DT_DT_IBC_WheelSlipFLVD
        IBC_WheelSlipFRVD: type=DT_DT_IBC_WheelSlipFRVD
        IBC_WheelSlipRLVD: type=DT_DT_IBC_WheelSlipRLVD
        IBC_WheelSlipRRVD: type=DT_DT_IBC_WheelSlipRRVD
        IBC_WheelSlipFL: type=DT_DT_IBC_WheelSlipFL
        IBC_WheelSlipFR: type=DT_DT_IBC_WheelSlipFR
        IBC_WheelSlipRL: type=DT_DT_IBC_WheelSlipRL
        IBC_WheelSlipRR: type=DT_DT_IBC_WheelSlipRR
        IBC_Slop_Pencent: type=DT_DT_IBC_Slop_Pencent
    IF_PTC_0x367
      5 x data:
        PTC_BscSts: type=DT_DT_PTC_BscSts
        PTC_RollingCounter_367: type=DT_DT_PTC_RollingCounter_367
        PTC_Fault: type=DT_DT_PTC_Fault
        PTC_Power: type=DT_DT_PTC_Power
        PTC_HV_interlock_faultSt: type=DT_DT_PTC_HV_interlock_faultSt
    IF_VCU_0x600
      32 x data:
        VCU_FaultData{0..31}: type=DT_DT_VCU_FaultData{0..31}
    IF_HPCGW_0x30B
      11 x data:
        GW_TCM_CRC_30B: type=DT_DT_GW_TCM_CRC_30B
        GW_TCM_RollingCounter_30B: type=DT_DT_GW_TCM_RollingCounter_30B
        GW_TCM_ParkingSwSts: type=DT_DT_GW_TCM_ParkingSwSts
        GW_TCM_STATUS_Park: type=DT_DT_GW_TCM_STATUS_Park
        GW_TCM_Counter_Park: type=DT_DT_GW_TCM_Counter_Park
        GW_TCM_CRC_Park: type=DT_DT_GW_TCM_CRC_Park
        GW_TCM_GearLevelSwitchSts: type=DT_DT_GW_TCM_GearLevelSwitchSts
        GW_TCM_STATUS_RND: type=DT_DT_GW_TCM_STATUS_RND
        GW_TCM_Counter_RND: type=DT_DT_GW_TCM_Counter_RND
        GW_TCM_CRC_RND: type=DT_DT_GW_TCM_CRC_RND
        GW_TCM_SelfCheckSt: type=DT_DT_GW_TCM_SelfCheckSt
    IF_VCU_0xB7
      63 x data:
        VCU_CRC_B7: type=DT_DT_VCU_CRC_B7
        VCU_KeepWorkModeFlag: type=DT_DT_VCU_KeepWorkModeFlag
        VCU_MAI_Active: type=DT_DT_VCU_MAI_Active
        VCU_MAI_Available: type=DT_DT_VCU_MAI_Available
        VCU_GetCrashStsReq: type=DT_DT_VCU_GetCrashStsReq
        VCU_ADASPosTorqueCap_VD: type=DT_DT_VCU_ADASPosTorqueCap_VD
        VCU_ADASPosTorqueCap: type=DT_DT_VCU_ADASPosTorqueCap
        VCU_RollingCounter_B7: type=DT_DT_VCU_RollingCounter_B7
        VCU_Vehicle_Warning_IDB7_CCAN: type=DT_DT_VCU_Vehicle_Warning_IDB7_CCAN
        VCU_VehicleSts_IDB7_CCAN: type=DT_DT_VCU_VehicleSts_IDB7_CCAN
        VCU_PowerReduceReq: type=DT_DT_VCU_PowerReduceReq
        VCU_ParkingReqToEPB_VD: type=DT_DT_VCU_ParkingReqToEPB_VD
        VCU_ParkingReqToEPB: type=DT_DT_VCU_ParkingReqToEPB
        VCU_ACCAvailable: type=DT_DT_VCU_ACCAvailable
        VCU_ACCActiveSts: type=DT_DT_VCU_ACCActiveSts
        VCU_Active_APS: type=DT_DT_VCU_Active_APS
        VCU_Available_APS: type=DT_DT_VCU_Available_APS
        VCU_ESCActive: type=DT_DT_VCU_ESCActive
        VCU_ESCTorqReqAvailability_Rear: type=DT_DT_VCU_ESCTorqReqAvailability_Rear
        VCU_AutoHold_ibit: type=DT_DT_VCU_AutoHold_ibit
        VCU_VehicleSpeedVD: type=DT_DT_VCU_VehicleSpeedVD
        VCU_CCSStatus: type=DT_DT_VCU_CCSStatus
        VCU_AutoDriveRequest: type=DT_DT_VCU_AutoDriveRequest
        VCU_CCSAllow: type=DT_DT_VCU_CCSAllow
        VCU_VlcHoldSts: type=DT_DT_VCU_VlcHoldSts
        VCU_HoldReqSts: type=DT_DT_VCU_HoldReqSts
        VCU_HoldReqStsValid: type=DT_DT_VCU_HoldReqStsValid
        VCU_DriverAssistProhibitSts_IDB7_CCAN: type=DT_DT_VCU_DriverAssistProhibitSts_IDB7_CCAN
        VCU_SpeedLimitedSts: type=DT_DT_VCU_SpeedLimitedSts
        VCU_SpeedLimitedValue: type=DT_DT_VCU_SpeedLimitedValue
        VCU_TheoAccePedalPercent: type=DT_DT_VCU_TheoAccePedalPercent
        VCU_RecuBrakeTorqueCap: type=DT_DT_VCU_RecuBrakeTorqueCap
        VCU_RecuBrakeTorqueAct: type=DT_DT_VCU_RecuBrakeTorqueAct
        VCU_TheoAccePedalValid: type=DT_DT_VCU_TheoAccePedalValid
        VCU_HydraTorqTgt: type=DT_DT_VCU_HydraTorqTgt
        VCU_RecuBrakeTorqueActDrag: type=DT_DT_VCU_RecuBrakeTorqueActDrag
        VCU_ESCTorqReqAvailability_Frnt: type=DT_DT_VCU_ESCTorqReqAvailability_Frnt
        VCU_RecuBrakeTorqueCap_Q: type=DT_DT_VCU_RecuBrakeTorqueCap_Q
        VCU_RecuBrakeTorqueAct_Q: type=DT_DT_VCU_RecuBrakeTorqueAct_Q
        VCU_HydraTorqTgt_Q: type=DT_DT_VCU_HydraTorqTgt_Q
        VCU_RecuBrakeTorqueActDrag_Q: type=DT_DT_VCU_RecuBrakeTorqueActDrag_Q
        VCU_RecuBrakeTorqueTarget_Drag: type=DT_DT_VCU_RecuBrakeTorqueTarget_Drag
        VCU_PreventVehSlipSts: type=DT_DT_VCU_PreventVehSlipSts
        VCU_RecuBrakeTorqueTarget_Drag_Q: type=DT_DT_VCU_RecuBrakeTorqueTarget_Drag_Q
        VCU_AllMotWhlTrqFB: type=DT_DT_VCU_AllMotWhlTrqFB
        VCU_AllMotWhlTrqFB_VD: type=DT_DT_VCU_AllMotWhlTrqFB_VD
        VCU_LSFC_Allow: type=DT_DT_VCU_LSFC_Allow
        VCU_LSFC_Active: type=DT_DT_VCU_LSFC_Active
        VCU_MGCUWorkMode_C: type=DT_DT_VCU_MGCUWorkMode_C
        VCU_AllRoadSts: type=DT_DT_VCU_AllRoadSts
        VCU_CmpUTurnAllow: type=DT_DT_VCU_CmpUTurnAllow
        VCU_CmpUTurnSts: type=DT_DT_VCU_CmpUTurnSts
        VCU_AllowCmpUTurnStartFlag: type=DT_DT_VCU_AllowCmpUTurnStartFlag
        VCU_CmpUTurnLockWhl: type=DT_DT_VCU_CmpUTurnLockWhl
        VCU_CmpUTurnActAngle: type=DT_DT_VCU_CmpUTurnActAngle
        VCU_CmpUTurnActSpinSpd: type=DT_DT_VCU_CmpUTurnActSpinSpd
        VCU_CmpUTurnFltHMI: type=DT_DT_VCU_CmpUTurnFltHMI
        VCU_EscapeModeSts: type=DT_DT_VCU_EscapeModeSts
        VCU_MCUSWorkFailMsg: type=DT_DT_VCU_MCUSWorkFailMsg
        VCU_EscapeWorkFailMsg: type=DT_DT_VCU_EscapeWorkFailMsg
        VCU_REClutchFltMsg: type=DT_DT_VCU_REClutchFltMsg
        VCU_BoostMode_Fail_C: type=DT_DT_VCU_BoostMode_Fail_C
        VCU_BoostModeSts_C: type=DT_DT_VCU_BoostModeSts_C
    IF_VCU_0xE6
      24 x data:
        DbgSignal{1..12}_FA: type=DT_DT_DbgSignal{1..12}_FA
        DbgSignal{1..12}_RA: type=DT_DT_DbgSignal{1..12}_RA
    IF_UDS_Phy_Tx_7E8_ECM
      8 x data:
        ECM_UDS_Res_Byte{0..7}: type=DT_DT_ECM_UDS_Res_Byte{0..7}
    IF_VCU_0x1E5
      20 x data:
        VCU_BCM_Authentication_MAC_A{0..15}: type=DT_DT_VCU_BCM_Authentication_MAC_A{0..15}
        VCU_BCM_Authentication_Challenge_B{0..3}: type=DT_DT_VCU_BCM_Authentication_Challenge_B{0..3}
    IF_TMS_0x5FF
      4 x data:
        TMS_MCUMHeatPwrReq: type=DT_DT_TMS_MCUMHeatPwrReq
        TMS_MCUMHeatModEnad: type=DT_DT_TMS_MCUMHeatModEnad
        TMS_VCU_MotSelfHeatEnReq: type=DT_DT_TMS_VCU_MotSelfHeatEnReq
        TMS_VCU_MotSelfHeatLvlReq: type=DT_DT_TMS_VCU_MotSelfHeatLvlReq
    IF_ECM_0x148
      4 x data:
        ECM_SWVersionC: type=DT_DT_ECM_SWVersionC
        ECM_SWVersionB: type=DT_DT_ECM_SWVersionB
        ECM_SWVersionA: type=DT_DT_ECM_SWVersionA
        ECM_Total_fuel_consumed: type=DT_DT_ECM_Total_fuel_consumed
    IF_IVI_0x331
      22 x data:
        IVI_CRC_331: type=DT_DT_IVI_CRC_331
        IVI_RollingCounter_331: type=DT_DT_IVI_RollingCounter_331
        IVI_EPBRequst: type=DT_DT_IVI_EPBRequst
        IVI_TerrainMatchMode: type=DT_DT_IVI_TerrainMatchMode
        IVI_LPedalModeSW: type=DT_DT_IVI_LPedalModeSW
        IVI_AVHSw_X: type=DT_DT_IVI_AVHSw_X
        IVI_ESCSw_X: type=DT_DT_IVI_ESCSw_X
        IVI_HDCSw_X: type=DT_DT_IVI_HDCSw_X
        IVI_CSTSw_X: type=DT_DT_IVI_CSTSw_X
        IVI_AutoAllRoad: type=DT_DT_IVI_AutoAllRoad
        IVI_CampingMode_SW: type=DT_DT_IVI_CampingMode_SW
        IVI_BraPedMod: type=DT_DT_IVI_BraPedMod
        IVI_SlowspeedSmartCtrl: type=DT_DT_IVI_SlowspeedSmartCtrl
        IVI_TrailerModeCtrl: type=DT_DT_IVI_TrailerModeCtrl
        IVI_EscapeMode_SW: type=DT_DT_IVI_EscapeMode_SW
        IVI_PowerSavingModeReq: type=DT_DT_IVI_PowerSavingModeReq
        IVI_SelfAdaptionDriveSW: type=DT_DT_IVI_SelfAdaptionDriveSW
        IVI_CmpUTurnStartUI: type=DT_DT_IVI_CmpUTurnStartUI
        IVI_CmpUTurnLockWhlUI: type=DT_DT_IVI_CmpUTurnLockWhlUI
        IVI_CmpUTurnTarDirUI: type=DT_DT_IVI_CmpUTurnTarDirUI
        IVI_CmpUTurnTarAngleUI: type=DT_DT_IVI_CmpUTurnTarAngleUI
        IVI_CmpUTurnReq: type=DT_DT_IVI_CmpUTurnReq
    IF_IVI_0x3D8
      16 x data:
        IVI_InventerLimitOdometerkm: type=DT_DT_IVI_InventerLimitOdometerkm
        IVI_FuelDetMode: type=DT_DT_IVI_FuelDetMode
        IVI_EngineIdlingMode: type=DT_DT_IVI_EngineIdlingMode
        IVI_CarWashMode: type=DT_DT_IVI_CarWashMode
        IVI_CampingModeSW: type=DT_DT_IVI_CampingModeSW
        IVI_SpeedLimitModeSW: type=DT_DT_IVI_SpeedLimitModeSW
        IVI_FuelupReq: type=DT_DT_IVI_FuelupReq
        IVI_FuelChgLevel: type=DT_DT_IVI_FuelChgLevel
        IVI_FuelChgMode: type=DT_DT_IVI_FuelChgMode
        IVI_InventerLimitOdometerkmVD: type=DT_DT_IVI_InventerLimitOdometerkmVD
        IVI_EMSRepairModeReq: type=DT_DT_IVI_EMSRepairModeReq
        IVI_ForceChgModeReq: type=DT_DT_IVI_ForceChgModeReq
        IVI_ForceChgTargetSOCVD: type=DT_DT_IVI_ForceChgTargetSOCVD
        IVI_SpeedLimitModeSpeed: type=DT_DT_IVI_SpeedLimitModeSpeed
        IVI_AWDModeSW: type=DT_DT_IVI_AWDModeSW
        IVI_ForceChgTargetSOC: type=DT_DT_IVI_ForceChgTargetSOC
    IF_HPCBCM_0x292
      7 x data:
        BCM_VCU_Authentication_Sts: type=DT_DT_BCM_VCU_Authentication_Sts
        BCM_PTCLossMissErr: type=DT_DT_BCM_PTCLossMissErr
        BCM_PTCRollCntErr: type=DT_DT_BCM_PTCRollCntErr
        BCM_PTCChksumErr: type=DT_DT_BCM_PTCChksumErr
        BCM_PDUHVIL_STs: type=DT_DT_BCM_PDUHVIL_STs
        BCM_Cab220VHVIL_STs: type=DT_DT_BCM_Cab220VHVIL_STs
        BCM_Cabin220VHVIL_STs: type=DT_DT_BCM_Cabin220VHVIL_STs
    IF_IBC_0x185
      35 x data:
        IBC_CRC_185: type=DT_DT_IBC_CRC_185
        IBC_RollingCounter_185: type=DT_DT_IBC_RollingCounter_185
        IBC_PlungerPressure: type=DT_DT_IBC_PlungerPressure
        IBC_PlungerPressure_Q: type=DT_DT_IBC_PlungerPressure_Q
        IBC_SimulatorPressure: type=DT_DT_IBC_SimulatorPressure
        IBC_SimulatorPressure_Q: type=DT_DT_IBC_SimulatorPressure_Q
        IBC_HMI_WarningOn: type=DT_DT_IBC_HMI_WarningOn
        IBC_MIL_WarningOn: type=DT_DT_IBC_MIL_WarningOn
        IBC_LongitAcceAct: type=DT_DT_IBC_LongitAcceAct
        IBC_LongitAcceActValid: type=DT_DT_IBC_LongitAcceActValid
        IBC_brakeFluidWarning: type=DT_DT_IBC_brakeFluidWarning
        IBC_SCM_Active: type=DT_DT_IBC_SCM_Active
        IBC_SCM_Failed: type=DT_DT_IBC_SCM_Failed
        IBC_CDPAvailable: type=DT_DT_IBC_CDPAvailable
        IBC_CDPIntervention: type=DT_DT_IBC_CDPIntervention
        IBC_AEB_active: type=DT_DT_IBC_AEB_active
        IBC_AEBdecAvailable: type=DT_DT_IBC_AEBdecAvailable
        IBC_AVHStatus: type=DT_DT_IBC_AVHStatus
        IBC_AVHAvailable: type=DT_DT_IBC_AVHAvailable
        IBC_HHCActive: type=DT_DT_IBC_HHCActive
        IBC_HHCFailed: type=DT_DT_IBC_HHCFailed
        IBC_CDD_Available_APA: type=DT_DT_IBC_CDD_Available_APA
        IBC_CDD_Active_APA: type=DT_DT_IBC_CDD_Active_APA
        IBC_CDD_Available_ACC: type=DT_DT_IBC_CDD_Available_ACC
        IBC_CDD_Active_ACC: type=DT_DT_IBC_CDD_Active_ACC
        IBC_HDCStatus: type=DT_DT_IBC_HDCStatus
        IBC_HDCAvailable: type=DT_DT_IBC_HDCAvailable
        IBC_CSTStatus: type=DT_DT_IBC_CSTStatus
        IBC_CSTAvailable: type=DT_DT_IBC_CSTAvailable
        IBC_VLC_Available_ACC: type=DT_DT_IBC_VLC_Available_ACC
        IBC_VLC_Active_ACC: type=DT_DT_IBC_VLC_Active_ACC
        IBC_VLC_Available_APA: type=DT_DT_IBC_VLC_Available_APA
        IBC_VLC_Active_APA: type=DT_DT_IBC_VLC_Active_APA
        IBC_VehicleHoldStatus: type=DT_DT_IBC_VehicleHoldStatus
        IBC_DrvrBrkTqAtWhlsReqd: type=DT_DT_IBC_DrvrBrkTqAtWhlsReqd
    IF_TMS_0x363
      6 x data:
        TMS_RollingCounter_363: type=DT_DT_TMS_RollingCounter_363
        TMS_AC_Command: type=DT_DT_TMS_AC_Command
        TMS_PTCHeatingReq: type=DT_DT_TMS_PTCHeatingReq
        TMS_PTCPowerSet: type=DT_DT_TMS_PTCPowerSet
        TMS_OutsideTempVD: type=DT_DT_TMS_OutsideTempVD
        TMS_OutsideTemp_Corrected: type=DT_DT_TMS_OutsideTemp_Corrected
    IF_BMS_0x5B1
      4 x data:
        BMS_SOC_Real: type=DT_DT_BMS_SOC_Real
        BMS_MODE_t: type=DT_DT_BMS_MODE_t
        BMS_VoltLoDeratLevel_NA: type=DT_DT_BMS_VoltLoDeratLevel_NA
        BMS_VoltHiDeratLevel_NA: type=DT_DT_BMS_VoltHiDeratLevel_NA
    IF_TMS_0x561
      data TMS_MCUOutTemp: type=DT_DT_TMS_MCUOutTemp
      data TMS_MCUMIntelTemp: type=DT_DT_TMS_MCUMIntelTemp
      data TMS_MCUSIntelTemp: type=DT_DT_TMS_MCUSIntelTemp
    IF_HPCBCM_0x1E4
      4 x data:
        BCM_VCU_Authentication_Challenge_A{0..3}: type=DT_DT_BCM_VCU_Authentication_Challenge_A{0..3}
    IF_MCU_0x5CA
      84 x data:
        EddyCur_Para_Cos_m: type=DT_DT_EddyCur_Para_Cos_m
        EddyCur_Stage: type=DT_DT_EddyCur_Stage
        EddyCur_IdenFinish_Flag: type=DT_DT_EddyCur_IdenFinish_Flag
        EddyCur_Para_Sin_m: type=DT_DT_EddyCur_Para_Sin_m
        EddyCur_Write_Flag: type=DT_DT_EddyCur_Write_Flag
        EddyCur_FauPro_IDEL_OTime_Flag: type=DT_DT_EddyCur_FauPro_IDEL_OTime_Flag
        EddyCur_FauPro_SpdInstab_Flag: type=DT_DT_EddyCur_FauPro_SpdInstab_Flag
        EddyCur_FauPro_IDPara_OVal_Flag: type=DT_DT_EddyCur_FauPro_IDPara_OVal_Flag
        EddyCur_Para_Cos_k: type=DT_DT_EddyCur_Para_Cos_k
        EddyCur_Enable: type=DT_DT_EddyCur_Enable
        EddyCur_Para_Sin_k: type=DT_DT_EddyCur_Para_Sin_k
        EddyCur_IdenFail_Flag: type=DT_DT_EddyCur_IdenFail_Flag
        EddyCur_Para_Cos_Pha: type=DT_DT_EddyCur_Para_Cos_Pha
        EddyCur_Para_Sin_Pha: type=DT_DT_EddyCur_Para_Sin_Pha
        EddyCur_ReadSuccess_Flag: type=DT_DT_EddyCur_ReadSuccess_Flag
        OfsIden_ReadSuccess_Flag: type=DT_DT_OfsIden_ReadSuccess_Flag
        OfsIden_SpdUp_Overtime: type=DT_DT_OfsIden_SpdUp_Overtime
        OfsIden_SpdUp_OverSpd: type=DT_DT_OfsIden_SpdUp_OverSpd
        OfsIden_IdenDiverge: type=DT_DT_OfsIden_IdenDiverge
        OfsIden_IdenCntOver: type=DT_DT_OfsIden_IdenCntOver
        OfsIden_MtrLock: type=DT_DT_OfsIden_MtrLock
        OfsIden_OfsRslt: type=DT_DT_OfsIden_OfsRslt
        OfsIden_Sts: type=DT_DT_OfsIden_Sts
        OfsIden_Finish: type=DT_DT_OfsIden_Finish
        OfsIden_OfsWrite_Finish: type=DT_DT_OfsIden_OfsWrite_Finish
        OfsIden_DirWrite_Finish: type=DT_DT_OfsIden_DirWrite_Finish
        OfsIden_DirIden_Rslt: type=DT_DT_OfsIden_DirIden_Rslt
        OfsIden_ZeroAlign_OverTime: type=DT_DT_OfsIden_ZeroAlign_OverTime
        OfsIden_ZeroAlign_Fail: type=DT_DT_OfsIden_ZeroAlign_Fail
        OfsIden_IFStart_Overtime: type=DT_DT_OfsIden_IFStart_Overtime
        OfsIden_IFStart_Fail: type=DT_DT_OfsIden_IFStart_Fail
        PosDly_Cal_RslvDelayTime: type=DT_DT_PosDly_Cal_RslvDelayTime
        PosDly_Theta_k_Std: type=DT_DT_PosDly_Theta_k_Std
        PosDly_Supplier: type=DT_DT_PosDly_Supplier
        PosDly_FauPro_Ident_OTm_Flag: type=DT_DT_PosDly_FauPro_Ident_OTm_Flag
        PosDly_FauPro_SpdDn_OTm_Flag: type=DT_DT_PosDly_FauPro_SpdDn_OTm_Flag
        PosDly_RslvOffsetComp: type=DT_DT_PosDly_RslvOffsetComp
        PosDly_Enable: type=DT_DT_PosDly_Enable
        PosDly_IdentFail_Flag: type=DT_DT_PosDly_IdentFail_Flag
        PosDly_IdentFinish_Flag: type=DT_DT_PosDly_IdentFinish_Flag
        PosDly_Write_Flag: type=DT_DT_PosDly_Write_Flag
        PosDly_FauPro_Chk_DlyTime_OVal: type=DT_DT_PosDly_FauPro_Chk_DlyTime_OVal
        PosDly_FauPro_Chk_RslvOfst_OVal: type=DT_DT_PosDly_FauPro_Chk_RslvOfst_OVal
        PosDly_FauPro_Check_Divergence: type=DT_DT_PosDly_FauPro_Check_Divergence
        PosDly_FauPro_SpdUp_OTm_Flag: type=DT_DT_PosDly_FauPro_SpdUp_OTm_Flag
        PosDly_Stage: type=DT_DT_PosDly_Stage
        IMParaIdent_ParEstMainStep: type=DT_DT_IMParaIdent_ParEstMainStep
        IMParaIdent_Rs: type=DT_DT_IMParaIdent_Rs
        IMParaIdent_Rr: type=DT_DT_IMParaIdent_Rr
        IMParaIdent_Ll: type=DT_DT_IMParaIdent_Ll
        IMParaIdent_Lm: type=DT_DT_IMParaIdent_Lm
        IMParaIdent_TotalLo: type=DT_DT_IMParaIdent_TotalLo
        IMParaIdent_IdentSubStep: type=DT_DT_IMParaIdent_IdentSubStep
        MCUMR_EddyCur_Para_Cos_m: type=DT_DT_MCUMR_EddyCur_Para_Cos_m
        MCUMR_EddyCur_Stage: type=DT_DT_MCUMR_EddyCur_Stage
        MCUMR_EddyCur_IdenFinish_Flag: type=DT_DT_MCUMR_EddyCur_IdenFinish_Flag
        MCUMR_EddyCur_Para_Sin_m: type=DT_DT_MCUMR_EddyCur_Para_Sin_m
        MCUMR_EddyCur_Write_Flag: type=DT_DT_MCUMR_EddyCur_Write_Flag
        MCUMR_EddyCur_FauPro_IDEL_OTime_Flag: type=DT_DT_MCUMR_EddyCur_FauPro_IDEL_OTime_Flag
        MCUMR_EddyCur_FauPro_SpdInstab_Flag: type=DT_DT_MCUMR_EddyCur_FauPro_SpdInstab_Flag
        MCUMR_EddyCur_FauPro_IDPara_OVal_Flag: type=DT_DT_MCUMR_EddyCur_FauPro_IDPara_OVal_Flag
        MCUMR_EddyCur_Para_Cos_k: type=DT_DT_MCUMR_EddyCur_Para_Cos_k
        MCUMR_EddyCur_Enable: type=DT_DT_MCUMR_EddyCur_Enable
        MCUMR_EddyCur_Para_Sin_k: type=DT_DT_MCUMR_EddyCur_Para_Sin_k
        MCUMR_EddyCur_IdenFail_Flag: type=DT_DT_MCUMR_EddyCur_IdenFail_Flag
        MCUMR_EddyCur_Para_Cos_Pha: type=DT_DT_MCUMR_EddyCur_Para_Cos_Pha
        MCUMR_EddyCur_Para_Sin_Pha: type=DT_DT_MCUMR_EddyCur_Para_Sin_Pha
        MCUMR_EddyCur_ReadSuccess_Flag: type=DT_DT_MCUMR_EddyCur_ReadSuccess_Flag
        MCUMR_OfsIden_ReadSuccess_Flag: type=DT_DT_MCUMR_OfsIden_ReadSuccess_Flag
        MCUMR_OfsIden_SpdUp_Overtime: type=DT_DT_MCUMR_OfsIden_SpdUp_Overtime
        MCUMR_OfsIden_SpdUp_OverSpd: type=DT_DT_MCUMR_OfsIden_SpdUp_OverSpd
        MCUMR_OfsIden_IdenDiverge: type=DT_DT_MCUMR_OfsIden_IdenDiverge
        MCUMR_OfsIden_IdenCntOver: type=DT_DT_MCUMR_OfsIden_IdenCntOver
        MCUMR_OfsIden_MtrLock: type=DT_DT_MCUMR_OfsIden_MtrLock
        MCUMR_OfsIden_OfsRslt: type=DT_DT_MCUMR_OfsIden_OfsRslt
        MCUMR_OfsIden_Sts: type=DT_DT_MCUMR_OfsIden_Sts
        MCUMR_OfsIden_Finish: type=DT_DT_MCUMR_OfsIden_Finish
        MCUMR_OfsIden_OfsWrite_Finish: type=DT_DT_MCUMR_OfsIden_OfsWrite_Finish
        MCUMR_OfsIden_DirWrite_Finish: type=DT_DT_MCUMR_OfsIden_DirWrite_Finish
        MCUMR_OfsIden_DirIden_Rslt: type=DT_DT_MCUMR_OfsIden_DirIden_Rslt
        MCUMR_OfsIden_ZeroAlign_OverTime: type=DT_DT_MCUMR_OfsIden_ZeroAlign_OverTime
        MCUMR_OfsIden_ZeroAlign_Fail: type=DT_DT_MCUMR_OfsIden_ZeroAlign_Fail
        MCUMR_OfsIden_IFStart_Overtime: type=DT_DT_MCUMR_OfsIden_IFStart_Overtime
        MCUMR_OfsIden_IFStart_Fail: type=DT_DT_MCUMR_OfsIden_IFStart_Fail
    IF_MCUM_0x5D3
      88 x data:
        MCUM_StatorTemp_1: type=DT_DT_MCUM_StatorTemp_1
        MCUM_L2TqAct: type=DT_DT_MCUM_L2TqAct
        MCUM_EOPSw: type=DT_DT_MCUM_EOPSw
        MCUM_StatorTemp_2: type=DT_DT_MCUM_StatorTemp_2
        MCUM_IGBTTemp_U: type=DT_DT_MCUM_IGBTTemp_U
        MCUM_IGBTTemp_V: type=DT_DT_MCUM_IGBTTemp_V
        MCUM_IGBTTemp_W: type=DT_DT_MCUM_IGBTTemp_W
        MCUM_PCBTemp: type=DT_DT_MCUM_PCBTemp
        MCUM_Power_12V: type=DT_DT_MCUM_Power_12V
        MCUM_Power_15V: type=DT_DT_MCUM_Power_15V
        MCUM_Offset_IU: type=DT_DT_MCUM_Offset_IU
        MCUM_Offset_IV: type=DT_DT_MCUM_Offset_IV
        MCUM_Offset_IW: type=DT_DT_MCUM_Offset_IW
        MCUM_MainSt_State: type=DT_DT_MCUM_MainSt_State
        MCUM_Derate_Reason: type=DT_DT_MCUM_Derate_Reason
        MCUM_PWM_Freq_kHz: type=DT_DT_MCUM_PWM_Freq_kHz
        MCUM_PWMEn_State: type=DT_DT_MCUM_PWMEn_State
        MCUM_DrvPwrEn_Out_State: type=DT_DT_MCUM_DrvPwrEn_Out_State
        MCUM_SBC_SelfCheckFault: type=DT_DT_MCUM_SBC_SelfCheckFault
        MCUM_SBC_TempOverFault: type=DT_DT_MCUM_SBC_TempOverFault
        MCUM_SBC_SPIFault: type=DT_DT_MCUM_SBC_SPIFault
        MCUM_SBC_InsideVotageFault: type=DT_DT_MCUM_SBC_InsideVotageFault
        MCUM_SBC_OutPutVotageFault: type=DT_DT_MCUM_SBC_OutPutVotageFault
        MCUM_SBC_FeedDogFault: type=DT_DT_MCUM_SBC_FeedDogFault
        MCUM_NVM_RslvrZeroRFault: type=DT_DT_MCUM_NVM_RslvrZeroRFault
        MCUM_Rotor_Position: type=DT_DT_MCUM_Rotor_Position
        MCUM_PosTransduserFaultCode: type=DT_DT_MCUM_PosTransduserFaultCode
        MCUM_NVM_RslvrDirRFault: type=DT_DT_MCUM_NVM_RslvrDirRFault
        MCUM_NVM_RslvrDelayRFault: type=DT_DT_MCUM_NVM_RslvrDelayRFault
        MCUM_NVM_RslvrParamRFault: type=DT_DT_MCUM_NVM_RslvrParamRFault
        MCUM_NVM_HallGainRFault: type=DT_DT_MCUM_NVM_HallGainRFault
        MCUM_NVM_HallDelayRFault: type=DT_DT_MCUM_NVM_HallDelayRFault
        MCUM_NVM_IGBTTypeRFault: type=DT_DT_MCUM_NVM_IGBTTypeRFault
        MCUM_NVM_MotorTypeRFault: type=DT_DT_MCUM_NVM_MotorTypeRFault
        MCUM_NVM_VehicleTypeRFault: type=DT_DT_MCUM_NVM_VehicleTypeRFault
        MCUM_ASC_EntryCount: type=DT_DT_MCUM_ASC_EntryCount
        MCUM_Spd_Turn: type=DT_DT_MCUM_Spd_Turn
        MCUM_LUT_Spd_Max: type=DT_DT_MCUM_LUT_Spd_Max
        MCUM_EOP_Speed: type=DT_DT_MCUM_EOP_Speed
        MCUM_EOP_IqFb: type=DT_DT_MCUM_EOP_IqFb
        MCUM_EOP_IqRef: type=DT_DT_MCUM_EOP_IqRef
        MCUM_EOP_DCVolt: type=DT_DT_MCUM_EOP_DCVolt
        MCUM_EOP_DCCurr: type=DT_DT_MCUM_EOP_DCCurr
        MCUM_EOP_Temp: type=DT_DT_MCUM_EOP_Temp
        MCUM_EOP_State: type=DT_DT_MCUM_EOP_State
        MCUM_EOP_FaultCode: type=DT_DT_MCUM_EOP_FaultCode
        MCUM_HWFault_RstCnt: type=DT_DT_MCUM_HWFault_RstCnt
        MCUM_HWFoB_RstCnt: type=DT_DT_MCUM_HWFoB_RstCnt
        MCUM_HWFoT_RstCnt: type=DT_DT_MCUM_HWFoT_RstCnt
        MCUM_HWDrvUV_RstCnt: type=DT_DT_MCUM_HWDrvUV_RstCnt
        MCUM_HWRdc_RstCnt: type=DT_DT_MCUM_HWRdc_RstCnt
        MCUM_HWOC_RstCnt: type=DT_DT_MCUM_HWOC_RstCnt
        MCUM_HWOV_RstCnt: type=DT_DT_MCUM_HWOV_RstCnt
        MCUM_L2agRtrElecDiff: type=DT_DT_MCUM_L2agRtrElecDiff
        MCUM_500usOverTime_Cnt: type=DT_DT_MCUM_500usOverTime_Cnt
        MCUM_5msOverTime_Cnt: type=DT_DT_MCUM_5msOverTime_Cnt
        MCUM_12VHop_Cnt: type=DT_DT_MCUM_12VHop_Cnt
        MCUM_12V_Max: type=DT_DT_MCUM_12V_Max
        MCUM_12V_Min: type=DT_DT_MCUM_12V_Min
        MCUM_NVMFail_Cnt: type=DT_DT_MCUM_NVMFail_Cnt
        MCUM_EOL_CANCommReq: type=DT_DT_MCUM_EOL_CANCommReq
        MCUM_ResetReason: type=DT_DT_MCUM_ResetReason
        MCUM_CpldRest_TimeOut_flag: type=DT_DT_MCUM_CpldRest_TimeOut_flag
        MCUM_DrvPCBCurr: type=DT_DT_MCUM_DrvPCBCurr
        MCUM_EOL_StateMachine: type=DT_DT_MCUM_EOL_StateMachine
        MCUM_CpldRest_ASC_Flag: type=DT_DT_MCUM_CpldRest_ASC_Flag
        MCUM_LimSpdTorFlag: type=DT_DT_MCUM_LimSpdTorFlag
        MCUM_PWM_Err_Count: type=DT_DT_MCUM_PWM_Err_Count
        MCUM_RDC_Reset_Count: type=DT_DT_MCUM_RDC_Reset_Count
        MCUM_ASC_Stop_Flag: type=DT_DT_MCUM_ASC_Stop_Flag
        MCUM_ASC_Soft_Exiting_Flag: type=DT_DT_MCUM_ASC_Soft_Exiting_Flag
        MCUM_Vbus_ServeLowChkEn: type=DT_DT_MCUM_Vbus_ServeLowChkEn
        MCUM_EOP_BlockErr_IsLim_Flag: type=DT_DT_MCUM_EOP_BlockErr_IsLim_Flag
        MCUM_MotSelfHeat_EnSts: type=DT_DT_MCUM_MotSelfHeat_EnSts
        MCUM_MotBlockHeat_LvlFb: type=DT_DT_MCUM_MotBlockHeat_LvlFb
        MCUM_MotRotaryHeat_LvlFb: type=DT_DT_MCUM_MotRotaryHeat_LvlFb
        MCUM_MotSelfHeat_DropLvlFb: type=DT_DT_MCUM_MotSelfHeat_DropLvlFb
        MCUM_MotSelfHeat_DropLvlRsn: type=DT_DT_MCUM_MotSelfHeat_DropLvlRsn
        MCUM_MotBlockHeat_CurAngle: type=DT_DT_MCUM_MotBlockHeat_CurAngle
        MCUM_MotBlockHeat_CurMag: type=DT_DT_MCUM_MotBlockHeat_CurMag
        MCUM_FaultDataRec_State: type=DT_DT_MCUM_FaultDataRec_State
        MCUM_UserDefine_Byte{1..4}: type=DT_DT_MCUM_UserDefine_Byte{1..4}
        MCUM_UserDefine_Word{1..3}: type=DT_DT_MCUM_UserDefine_Word{1..3}
    IF_ECM_0x5EC
      data ECM_EngineWorktime: type=DT_DT_ECM_EngineWorktime
    IF_ECM_0x147
      data ECM_FuelConsumption: type=DT_DT_ECM_FuelConsumption
    IF_MCU_0x5CB
      10 x data:
        GTC_TestSts: type=DT_DT_GTC_TestSts
        GTC_ThetaPos: type=DT_DT_GTC_ThetaPos
        GTC_ThetaNeg: type=DT_DT_GTC_ThetaNeg
        GTC_ThetaDelt: type=DT_DT_GTC_ThetaDelt
        GTC_TestRslt: type=DT_DT_GTC_TestRslt
        MCUMR_GTC_TestSts: type=DT_DT_MCUMR_GTC_TestSts
        MCUMR_GTC_ThetaPos: type=DT_DT_MCUMR_GTC_ThetaPos
        MCUMR_GTC_ThetaNeg: type=DT_DT_MCUMR_GTC_ThetaNeg
        MCUMR_GTC_ThetaDelt: type=DT_DT_MCUMR_GTC_ThetaDelt
        MCUMR_GTC_TestRslt: type=DT_DT_MCUMR_GTC_TestRslt
    IF_MCUM_0xCA
      52 x data:
        MCUM_CRC_CA: type=DT_DT_MCUM_CRC_CA
        MCUM_RollingCounter_CA: type=DT_DT_MCUM_RollingCounter_CA
        MCUM_WarningLevel: type=DT_DT_MCUM_WarningLevel
        MCUM_SelfCheckSts: type=DT_DT_MCUM_SelfCheckSts
        MCUM_DrvMotorWorkSts: type=DT_DT_MCUM_DrvMotorWorkSts
        MCUM_PowerReduceSts: type=DT_DT_MCUM_PowerReduceSts
        MCUM_SystemError: type=DT_DT_MCUM_SystemError
        MCUM_DrvMotorRPM: type=DT_DT_MCUM_DrvMotorRPM
        MCUM_ActualTorqueFB: type=DT_DT_MCUM_ActualTorqueFB
        MCUM_HWRdcFault: type=DT_DT_MCUM_HWRdcFault
        MCUM_LVSystemError: type=DT_DT_MCUM_LVSystemError
        MCUM_HighVoltPowerOffReq: type=DT_DT_MCUM_HighVoltPowerOffReq
        MCUM_HVILSts: type=DT_DT_MCUM_HVILSts
        MCUM_DragSts: type=DT_DT_MCUM_DragSts
        MCUM_CtrlMode: type=DT_DT_MCUM_CtrlMode
        MCUM_MotorTempAlarm: type=DT_DT_MCUM_MotorTempAlarm
        MCUM_HVSystemError: type=DT_DT_MCUM_HVSystemError
        MCUM_MILlampReq: type=DT_DT_MCUM_MILlampReq
        MCUM_SeriousWarning_Level: type=DT_DT_MCUM_SeriousWarning_Level
        MCUM_DrvMotorRPMVD: type=DT_DT_MCUM_DrvMotorRPMVD
        MCUM_ActualTorqueFBVD: type=DT_DT_MCUM_ActualTorqueFBVD
        MCUM_CtrlModeVD: type=DT_DT_MCUM_CtrlModeVD
        MCUM_MaxTorqueAllow: type=DT_DT_MCUM_MaxTorqueAllow
        MCUM_MaxSpeedAllow: type=DT_DT_MCUM_MaxSpeedAllow
        MCUM_WaterPumpLevlReq: type=DT_DT_MCUM_WaterPumpLevlReq
        MCUM_ActiveReleaseSts: type=DT_DT_MCUM_ActiveReleaseSts
        MCUM_DCChargRelaySts: type=DT_DT_MCUM_DCChargRelaySts
        MCUM_Fault_DCChargRelay: type=DT_DT_MCUM_Fault_DCChargRelay
        MCUM_MinTorqueAllow: type=DT_DT_MCUM_MinTorqueAllow
        MCUM_MainWireVolt: type=DT_DT_MCUM_MainWireVolt
        MCUM_MotorTemp: type=DT_DT_MCUM_MotorTemp
        MCUM_IGBTTemp: type=DT_DT_MCUM_IGBTTemp
        MCUM_InletTemp: type=DT_DT_MCUM_InletTemp
        MCUM_MainWireCurr: type=DT_DT_MCUM_MainWireCurr
        MCUM_TMS_MotSelfHeatEnSts: type=DT_DT_MCUM_TMS_MotSelfHeatEnSts
        MCUM_TMS_MotSelfHeatLvlFb: type=DT_DT_MCUM_TMS_MotSelfHeatLvlFb
        MCUM_HeatPwrAllwd: type=DT_DT_MCUM_HeatPwrAllwd
        MCUM_HeatFdBck: type=DT_DT_MCUM_HeatFdBck
        MCUM_RPowerReduceSts: type=DT_DT_MCUM_RPowerReduceSts
        MCUM_HeatPwrAct: type=DT_DT_MCUM_HeatPwrAct
        MCUM_HeatPwrMax: type=DT_DT_MCUM_HeatPwrMax
        MCUM_HeatPwrAval: type=DT_DT_MCUM_HeatPwrAval
        MCUM_RCtrlMode: type=DT_DT_MCUM_RCtrlMode
        MCUM_RWarningLevel: type=DT_DT_MCUM_RWarningLevel
        MCUM_RSelfCheckSts: type=DT_DT_MCUM_RSelfCheckSts
        MCUM_RDrvMotorWorkSts: type=DT_DT_MCUM_RDrvMotorWorkSts
        MCUM_RCtrlModeVD: type=DT_DT_MCUM_RCtrlModeVD
        MCUM_RHWRdcFault: type=DT_DT_MCUM_RHWRdcFault
        MCUM_RDrvMotorRPMVD: type=DT_DT_MCUM_RDrvMotorRPMVD
        MCUM_RActualTorqueFBVD: type=DT_DT_MCUM_RActualTorqueFBVD
        MCUM_RDrvMotorRPM: type=DT_DT_MCUM_RDrvMotorRPM
        MCUM_RActualTorqueFB: type=DT_DT_MCUM_RActualTorqueFB
    IF_IBC_0x182
      25 x data:
        IBC_CRC_182: type=DT_DT_IBC_CRC_182
        IBC_RollingCounter_182: type=DT_DT_IBC_RollingCounter_182
        IBC_VehicleSpeed: type=DT_DT_IBC_VehicleSpeed
        IBC_VehicleSpeedVD: type=DT_DT_IBC_VehicleSpeedVD
        IBC_ABSActive: type=DT_DT_IBC_ABSActive
        IBC_ABSFailed: type=DT_DT_IBC_ABSFailed
        IBC_TCSActive: type=DT_DT_IBC_TCSActive
        IBC_TCSFailed: type=DT_DT_IBC_TCSFailed
        IBC_ESCFunctionStatus: type=DT_DT_IBC_ESCFunctionStatus
        IBC_BrakeForce: type=DT_DT_IBC_BrakeForce
        IBC_Vehiclestandstill: type=DT_DT_IBC_Vehiclestandstill
        IBC_EBDFailed: type=DT_DT_IBC_EBDFailed
        IBC_EBDActive: type=DT_DT_IBC_EBDActive
        IBC_VDCActive: type=DT_DT_IBC_VDCActive
        IBC_VDCFailed: type=DT_DT_IBC_VDCFailed
        IBC_EDCActive: type=DT_DT_IBC_EDCActive
        IBC_EDCFailed: type=DT_DT_IBC_EDCFailed
        IBC_SystemInitializeStatus: type=DT_DT_IBC_SystemInitializeStatus
        IBC_BTCSActive: type=DT_DT_IBC_BTCSActive
        IBC_ETCSActive: type=DT_DT_IBC_ETCSActive
        IBC_ARPActive: type=DT_DT_IBC_ARPActive
        IBC_VCU_DrumMode: type=DT_DT_IBC_VCU_DrumMode
        IBC_EscapeModeSts: type=DT_DT_IBC_EscapeModeSts
        IBC_TSAActive: type=DT_DT_IBC_TSAActive
        IBC_TSAStatus: type=DT_DT_IBC_TSAStatus
    IF_MCUM_0x605
      15 x data:
        MCUM_FaultData{0..14}: type=DT_DT_MCUM_FaultData{0..14}
    IF_MCUM_0x607
      15 x data:
        MCUM_R_FaultData{0..14}: type=DT_DT_MCUM_R_FaultData{0..14}
    IF_ICU_0x24D
      10 x data:
        ICU_CRC_24D: type=DT_DT_ICU_CRC_24D
        ICU_SpeedConversionCoefficient: type=DT_DT_ICU_SpeedConversionCoefficient
        ICU_RollingCounter_24D: type=DT_DT_ICU_RollingCounter_24D
        ICU_CCSFunctionStatus: type=DT_DT_ICU_CCSFunctionStatus
        ICU_CruiseVehicleSpeedCtl: type=DT_DT_ICU_CruiseVehicleSpeedCtl
        ICU_VehicleScreenSpeed: type=DT_DT_ICU_VehicleScreenSpeed
        ICU_VehicleSpeedUnit: type=DT_DT_ICU_VehicleSpeedUnit
        ICU_ACCFunctionStatus: type=DT_DT_ICU_ACCFunctionStatus
        ICU_LCCFunctionStatus: type=DT_DT_ICU_LCCFunctionStatus
        IVI_LPedalMode: type=DT_DT_IVI_LPedalMode
    IF_ICU_0x249
      7 x data:
        ICU_TotalOilmeterkm: type=DT_DT_ICU_TotalOilmeterkm
        ICU_CLTCoilMileage: type=DT_DT_ICU_CLTCoilMileage
        ICU_WLTC_oilMileage: type=DT_DT_ICU_WLTC_oilMileage
        ICU_CLTC_ElectticityMileage: type=DT_DT_ICU_CLTC_ElectticityMileage
        ICU_WLTC_ElectticityMileage: type=DT_DT_ICU_WLTC_ElectticityMileage
        ICU_Switch_CLTCOrWLTC: type=DT_DT_ICU_Switch_CLTCOrWLTC
        ICU_FuelPercent: type=DT_DT_ICU_FuelPercent
    IF_ACU_0x233
      9 x data:
        ACU_CRC_233: type=DT_DT_ACU_CRC_233
        ACU_RollingCounter_233: type=DT_DT_ACU_RollingCounter_233
        ACU_LateralAcce: type=DT_DT_ACU_LateralAcce
        ACU_LongitAcce: type=DT_DT_ACU_LongitAcce
        ACU_LateralAcceValid: type=DT_DT_ACU_LateralAcceValid
        ACU_LongitAcceValid: type=DT_DT_ACU_LongitAcceValid
        ACU_SensorCalSt: type=DT_DT_ACU_SensorCalSt
        ACU_YawRate: type=DT_DT_ACU_YawRate
        ACU_YawRateValid: type=DT_DT_ACU_YawRateValid
    IF_MCU_0x5C4
      34 x data:
        MotClb_UdFb: type=DT_DT_MotClb_UdFb
        MotClb_UqFb: type=DT_DT_MotClb_UqFb
        MotClb_IdSet: type=DT_DT_MotClb_IdSet
        MotClb_IqSet: type=DT_DT_MotClb_IqSet
        MotClb_IsCMD_Fb: type=DT_DT_MotClb_IsCMD_Fb
        MotClb_ThetaCMD_Fb: type=DT_DT_MotClb_ThetaCMD_Fb
        MotClb_Id_Fb: type=DT_DT_MotClb_Id_Fb
        MotClb_Iq_Fb: type=DT_DT_MotClb_Iq_Fb
        MotClb_Spd_rpm_Flt: type=DT_DT_MotClb_Spd_rpm_Flt
        MotClb_ThtSetReal: type=DT_DT_MotClb_ThtSetReal
        MotClb_Power_Inverter: type=DT_DT_MotClb_Power_Inverter
        MotClb_Volt_DC: type=DT_DT_MotClb_Volt_DC
        MotClb_UsOutFlt: type=DT_DT_MotClb_UsOutFlt
        MotClb_CoolWater_Temp: type=DT_DT_MotClb_CoolWater_Temp
        MotClb_Motor_Temp1_Flt: type=DT_DT_MotClb_Motor_Temp1_Flt
        MotClb_IGBT_Temp1: type=DT_DT_MotClb_IGBT_Temp1
        MotClb_ErrLevel: type=DT_DT_MotClb_ErrLevel
        MCUMR_MotClb_UdFb: type=DT_DT_MCUMR_MotClb_UdFb
        MCUMR_MotClb_UqFb: type=DT_DT_MCUMR_MotClb_UqFb
        MCUMR_MotClb_IdSet: type=DT_DT_MCUMR_MotClb_IdSet
        MCUMR_MotClb_IqSet: type=DT_DT_MCUMR_MotClb_IqSet
        MCUMR_MotClb_IsCMD_Fb: type=DT_DT_MCUMR_MotClb_IsCMD_Fb
        MCUMR_MotClb_ThetaCMD_Fb: type=DT_DT_MCUMR_MotClb_ThetaCMD_Fb
        MCUMR_MotClb_Id_Fb: type=DT_DT_MCUMR_MotClb_Id_Fb
        MCUMR_MotClb_Iq_Fb: type=DT_DT_MCUMR_MotClb_Iq_Fb
        MCUMR_MotClb_Spd_rpm_Flt: type=DT_DT_MCUMR_MotClb_Spd_rpm_Flt
        MCUMR_MotClb_ThtSetReal: type=DT_DT_MCUMR_MotClb_ThtSetReal
        MCUMR_MotClb_Power_Inverter: type=DT_DT_MCUMR_MotClb_Power_Inverter
        MCUMR_MotClb_Volt_DC: type=DT_DT_MCUMR_MotClb_Volt_DC
        MCUMR_MotClb_UsOutFlt: type=DT_DT_MCUMR_MotClb_UsOutFlt
        MCUMR_MotClb_CoolWater_Temp: type=DT_DT_MCUMR_MotClb_CoolWater_Temp
        MCUMR_MotClb_Motor_Temp1_Flt: type=DT_DT_MCUMR_MotClb_Motor_Temp1_Flt
        MCUMR_MotClb_IGBT_Temp1: type=DT_DT_MCUMR_MotClb_IGBT_Temp1
        MCUMR_MotClb_ErrLevel: type=DT_DT_MCUMR_MotClb_ErrLevel
    IF_BMS_0x1A1
      33 x data:
        BMS_CRC_1A1: type=DT_DT_BMS_CRC_1A1
        BMS_RollingCounter_1A1: type=DT_DT_BMS_RollingCounter_1A1
        BMS_Warning_Level: type=DT_DT_BMS_Warning_Level
        BMS_SelfCheck: type=DT_DT_BMS_SelfCheck
        BMS_BattChargerSts: type=DT_DT_BMS_BattChargerSts
        BMS_RHighVolSts: type=DT_DT_BMS_RHighVolSts
        BMS_RPreChargeRelayFB: type=DT_DT_BMS_RPreChargeRelayFB
        BMS_RPositiveRelayFB: type=DT_DT_BMS_RPositiveRelayFB
        BMS_RNegativeRelayFB: type=DT_DT_BMS_RNegativeRelayFB
        BMS_RPositiveRelay_F: type=DT_DT_BMS_RPositiveRelay_F
        BMS_RNegativeRelay_F: type=DT_DT_BMS_RNegativeRelay_F
        BMS_RPreChargeFinishSts: type=DT_DT_BMS_RPreChargeFinishSts
        BMS_MCUMHVILSts: type=DT_DT_BMS_MCUMHVILSts
        BMS_ACPTCHVILSts: type=DT_DT_BMS_ACPTCHVILSts
        BMS_PTCHVILSts: type=DT_DT_BMS_PTCHVILSts
        BMS_CCMHVILSts: type=DT_DT_BMS_CCMHVILSts
        BMS_CDUHVILSts: type=DT_DT_BMS_CDUHVILSts
        BMS_DCChgHVILSts: type=DT_DT_BMS_DCChgHVILSts
        BMS_MCUSHVILSts: type=DT_DT_BMS_MCUSHVILSts
        BMS_HVOffSts: type=DT_DT_BMS_HVOffSts
        BMS_SeriousWarning_Level: type=DT_DT_BMS_SeriousWarning_Level
        BMS_DCChgRelayCloseReq: type=DT_DT_BMS_DCChgRelayCloseReq
        BMS_DCChgRelayFB: type=DT_DT_BMS_DCChgRelayFB
        BMS_ChgStopReason: type=DT_DT_BMS_ChgStopReason
        BMS_GCUHVILSts: type=DT_DT_BMS_GCUHVILSts
        BMS_MILlampReq: type=DT_DT_BMS_MILlampReq
        BMS_IsoRessistanceSts: type=DT_DT_BMS_IsoRessistanceSts
        BMS_Integrity_Check: type=DT_DT_BMS_Integrity_Check
        BMS_BattVolt: type=DT_DT_BMS_BattVolt
        BMS_BattCurr: type=DT_DT_BMS_BattCurr
        BMS_BatDyn_Dchgpwr: type=DT_DT_BMS_BatDyn_Dchgpwr
        BMS_BatDyn_Chgpwr: type=DT_DT_BMS_BatDyn_Chgpwr
        BMS_Precharge_CoolingSts: type=DT_DT_BMS_Precharge_CoolingSts
    IF_IBC_0xB1
      14 x data:
        IBC_CRC_B1: type=DT_DT_IBC_CRC_B1
        IBC_RollingCounter_B1: type=DT_DT_IBC_RollingCounter_B1
        IBC_EngTorqDec_Main: type=DT_DT_IBC_EngTorqDec_Main
        IBC_EngTorqDecActive_Main: type=DT_DT_IBC_EngTorqDecActive_Main
        IBC_EngTorqInc_Main: type=DT_DT_IBC_EngTorqInc_Main
        IBC_EngTorqIncActive_Main: type=DT_DT_IBC_EngTorqIncActive_Main
        IBC_EngTorqDec_Sub: type=DT_DT_IBC_EngTorqDec_Sub
        IBC_EngTorqDecActive_Sub: type=DT_DT_IBC_EngTorqDecActive_Sub
        IBC_EngTorqInc_Sub: type=DT_DT_IBC_EngTorqInc_Sub
        IBC_EngTorqIncActive_Sub: type=DT_DT_IBC_EngTorqIncActive_Sub
        IBC_EngTorqDec_MainR: type=DT_DT_IBC_EngTorqDec_MainR
        IBC_EngTorqDecActive_MainR: type=DT_DT_IBC_EngTorqDecActive_MainR
        IBC_EngTorqInc_MainR: type=DT_DT_IBC_EngTorqInc_MainR
        IBC_EngTorqIncActive_MainR: type=DT_DT_IBC_EngTorqIncActive_MainR
    IF_ADDC_0x83
      31 x data:
        ADDC_CRC_83: type=DT_DT_ADDC_CRC_83
        ADDC_ACC_AVHReq: type=DT_DT_ADDC_ACC_AVHReq
        ADDC_ACC_HoldSts: type=DT_DT_ADDC_ACC_HoldSts
        ADDC_ACCTargetTrq: type=DT_DT_ADDC_ACCTargetTrq
        ADDC_ACCTargetTrqVD: type=DT_DT_ADDC_ACCTargetTrqVD
        ADDC_ACCTargetTrqBrkVD: type=DT_DT_ADDC_ACCTargetTrqBrkVD
        ADDC_ACCTargetTrqBrk: type=DT_DT_ADDC_ACCTargetTrqBrk
        ADDC_MAIWarnTrqCtrlFlg: type=DT_DT_ADDC_MAIWarnTrqCtrlFlg
        ADDC_RollingCounter_83: type=DT_DT_ADDC_RollingCounter_83
        ADDC_ACC_FunType: type=DT_DT_ADDC_ACC_FunType
        ADDC_ACCMode: type=DT_DT_ADDC_ACCMode
        ADDC_Driveoff_Request: type=DT_DT_ADDC_Driveoff_Request
        ADDC_DecToStop: type=DT_DT_ADDC_DecToStop
        ADDC_ACCAvailable: type=DT_DT_ADDC_ACCAvailable
        ADDC_ACCTargetAcc: type=DT_DT_ADDC_ACCTargetAcc
        ADDC_ACCTargetAccVD: type=DT_DT_ADDC_ACCTargetAccVD
        ADDC_ACC_RecordingPulse: type=DT_DT_ADDC_ACC_RecordingPulse
        ADDC_VehicleSpeedCtlVD: type=DT_DT_ADDC_VehicleSpeedCtlVD
        ADDC_VehicleSpeedCtl: type=DT_DT_ADDC_VehicleSpeedCtl
        ADDC_ACC_EPBReq: type=DT_DT_ADDC_ACC_EPBReq
        ADDC_ACC_VehicleDirectCtl: type=DT_DT_ADDC_ACC_VehicleDirectCtl
        ADDC_ACC_VehicleDirectCtlVD: type=DT_DT_ADDC_ACC_VehicleDirectCtlVD
        ADDC_AEBTargetDec: type=DT_DT_ADDC_AEBTargetDec
        ADDC_AEBDecCtrl: type=DT_DT_ADDC_AEBDecCtrl
        ADDC_AEBMode: type=DT_DT_ADDC_AEBMode
        ADDC_AEBAvailable: type=DT_DT_ADDC_AEBAvailable
        ADDC_ACC_VLCCtlReq: type=DT_DT_ADDC_ACC_VLCCtlReq
        ADDC_ACC_OvrdSts: type=DT_DT_ADDC_ACC_OvrdSts
        ADDC_RCTB_DecReq: type=DT_DT_ADDC_RCTB_DecReq
        ADDC_RAEB_DecReq: type=DT_DT_ADDC_RAEB_DecReq
        ADDC_MEB_DecReq: type=DT_DT_ADDC_MEB_DecReq
    IF_VCU_0x13B
      67 x data:
        VCU_CRC_13B: type=DT_DT_VCU_CRC_13B
        VCU_RollingCounter_13B: type=DT_DT_VCU_RollingCounter_13B
        VCU_Vehicle_Warning: type=DT_DT_VCU_Vehicle_Warning
        VCU_VehicleSts: type=DT_DT_VCU_VehicleSts
        VCU_GearLevelPosSts: type=DT_DT_VCU_GearLevelPosSts
        VCU_GearLeverValid: type=DT_DT_VCU_GearLeverValid
        VCU_AccPedalValid: type=DT_DT_VCU_AccPedalValid
        VCU_ThrottlePosition: type=DT_DT_VCU_ThrottlePosition
        VCU_BMSMainRelayR_Cmd: type=DT_DT_VCU_BMSMainRelayR_Cmd
        VCU_BMSMainRelayF_Cmd: type=DT_DT_VCU_BMSMainRelayF_Cmd
        VCU_BMSEmergencyCmd: type=DT_DT_VCU_BMSEmergencyCmd
        VCU_MCUMActiveReleaseCmd: type=DT_DT_VCU_MCUMActiveReleaseCmd
        VCU_MCUSActiveReleaseCmd: type=DT_DT_VCU_MCUSActiveReleaseCmd
        VCU_AlwACChargeInventerSts: type=DT_DT_VCU_AlwACChargeInventerSts
        VCU_AlwDCChargeSts: type=DT_DT_VCU_AlwDCChargeSts
        VCU_ChargePauseReq: type=DT_DT_VCU_ChargePauseReq
        VCU_SuppressJitterMCUSRequest: type=DT_DT_VCU_SuppressJitterMCUSRequest
        VCU_DCDCEnableCmd: type=DT_DT_VCU_DCDCEnableCmd
        VCU_ACOffReq: type=DT_DT_VCU_ACOffReq
        VCU_VehicleDirect: type=DT_DT_VCU_VehicleDirect
        VCU_BrakeSysFault: type=DT_DT_VCU_BrakeSysFault
        VCU_SuppressJitterMCUMRequest: type=DT_DT_VCU_SuppressJitterMCUMRequest
        VCU_MDrvControlMode: type=DT_DT_VCU_MDrvControlMode
        VCU_BrakePedalValue: type=DT_DT_VCU_BrakePedalValue
        VCU_MCUMMaxDischargePower: type=DT_DT_VCU_MCUMMaxDischargePower
        VCU_MCUMMaxChargePower: type=DT_DT_VCU_MCUMMaxChargePower
        VCU_MDrvRequestTorque: type=DT_DT_VCU_MDrvRequestTorque
        VCU_MDrvRequesSpeed: type=DT_DT_VCU_MDrvRequesSpeed
        VCU_SDrvRequestTorque: type=DT_DT_VCU_SDrvRequestTorque
        VCU_SDrvRequesSpeed: type=DT_DT_VCU_SDrvRequesSpeed
        VCU_SVehicleSts: type=DT_DT_VCU_SVehicleSts
        VCU_VehicleHighVoltModeF: type=DT_DT_VCU_VehicleHighVoltModeF
        VCU_SDrvControlMode: type=DT_DT_VCU_SDrvControlMode
        VCU_ON2BRelayReq: type=DT_DT_VCU_ON2BRelayReq
        VCU_VehPreHVPwrOffCmd: type=DT_DT_VCU_VehPreHVPwrOffCmd
        VCU_FuelTankLockReq: type=DT_DT_VCU_FuelTankLockReq
        VCU_VehicleDirectS: type=DT_DT_VCU_VehicleDirectS
        VCU_VehicleDirectS_VD: type=DT_DT_VCU_VehicleDirectS_VD
        VCU_ACPwrLimited: type=DT_DT_VCU_ACPwrLimited
        VCU_MCUSMaxDischargePower: type=DT_DT_VCU_MCUSMaxDischargePower
        VCU_VehicleDirectVD: type=DT_DT_VCU_VehicleDirectVD
        VCU_MDrvControlModeVD: type=DT_DT_VCU_MDrvControlModeVD
        VCU_MDrvRequestTorqueVD: type=DT_DT_VCU_MDrvRequestTorqueVD
        VCU_MDrvRequesSpeedVD: type=DT_DT_VCU_MDrvRequesSpeedVD
        VCU_SDrvRequestTorqueVD: type=DT_DT_VCU_SDrvRequestTorqueVD
        VCU_SDrvRequesSpeedVD: type=DT_DT_VCU_SDrvRequesSpeedVD
        VCU_SDrvControlModeVD: type=DT_DT_VCU_SDrvControlModeVD
        VCU_MCUSMaxChargePower: type=DT_DT_VCU_MCUSMaxChargePower
        VCU_VehicleHighVoltMode: type=DT_DT_VCU_VehicleHighVoltMode
        VCU_PDUHVIL_Sts: type=DT_DT_VCU_PDUHVIL_Sts
        VCU_PDU220VRelay_Req: type=DT_DT_VCU_PDU220VRelay_Req
        VCU_Cab220VRelay_Req: type=DT_DT_VCU_Cab220VRelay_Req
        VCU_Cabin220VRelay_Req: type=DT_DT_VCU_Cabin220VRelay_Req
        VCU_Alw_Cab220VInverter_Sts: type=DT_DT_VCU_Alw_Cab220VInverter_Sts
        VCU_Alw_Cabin220VInverter_Sts: type=DT_DT_VCU_Alw_Cabin220VInverter_Sts
        VCU_MCUMDampgLmtFactor: type=DT_DT_VCU_MCUMDampgLmtFactor
        VCU_MCUSDampgLmtFactor: type=DT_DT_VCU_MCUSDampgLmtFactor
        VCU_BCM_Authentication_Sts: type=DT_DT_VCU_BCM_Authentication_Sts
        VCU_AuthenticationKey_WSts: type=DT_DT_VCU_AuthenticationKey_WSts
        VCU_BrakePedalSts_P: type=DT_DT_VCU_BrakePedalSts_P
        VCU_BrakePedalStsValid_P: type=DT_DT_VCU_BrakePedalStsValid_P
        VCU_BoostMode_Fail: type=DT_DT_VCU_BoostMode_Fail
        VCU_BoostModeSts: type=DT_DT_VCU_BoostModeSts
        VCU_MCUSMaxPosDampgTrq: type=DT_DT_VCU_MCUSMaxPosDampgTrq
        VCU_MCUSMaxNegDampgTrq: type=DT_DT_VCU_MCUSMaxNegDampgTrq
        VCU_MCUMMaxPosDampgTrq: type=DT_DT_VCU_MCUMMaxPosDampgTrq
        VCU_MCUMMaxNegDampgTrq: type=DT_DT_VCU_MCUMMaxNegDampgTrq
    IF_BMS_0x310
      21 x data:
        BMS_InverterPower: type=DT_DT_BMS_InverterPower
        BMS_MaxChargeVolt: type=DT_DT_BMS_MaxChargeVolt
        BMS_MaxChargeCurr: type=DT_DT_BMS_MaxChargeCurr
        BMS_OBCWorkModeCtrl: type=DT_DT_BMS_OBCWorkModeCtrl
        BMS_MaxPower: type=DT_DT_BMS_MaxPower
        BMS_ChargerACInput: type=DT_DT_BMS_ChargerACInput
        BMS_ChargerDCInput: type=DT_DT_BMS_ChargerDCInput
        BMS_ChargeRequest: type=DT_DT_BMS_ChargeRequest
        BMS_InverterRequest: type=DT_DT_BMS_InverterRequest
        BMS_ChargeQuantity: type=DT_DT_BMS_ChargeQuantity
        BMS_BattMaxTemp: type=DT_DT_BMS_BattMaxTemp
        BMS_BattMinTemp: type=DT_DT_BMS_BattMinTemp
        BMS_BattIntakeTemp: type=DT_DT_BMS_BattIntakeTemp
        BMS_BattIOutletTemp: type=DT_DT_BMS_BattIOutletTemp
        BMS_BattSOC_Display: type=DT_DT_BMS_BattSOC_Display
        BMS_Req_Cab220VInverter_Sts: type=DT_DT_BMS_Req_Cab220VInverter_Sts
        BMS_Req_Cabin220VInverter_Sts: type=DT_DT_BMS_Req_Cabin220VInverter_Sts
        BMS_RemainEnergy: type=DT_DT_BMS_RemainEnergy
        BMS_StateOfEngeryMax: type=DT_DT_BMS_StateOfEngeryMax
        BMS_ThermalManageRequest: type=DT_DT_BMS_ThermalManageRequest
        BMS_PreHeatingState: type=DT_DT_BMS_PreHeatingState
    IF_MCUM_0x6F8
      52 x data:
        MCUM_UDS_SW{1..10}: type=DT_DT_MCUM_UDS_SW{1..10}
        MCUM_UDS_HW{1..10}: type=DT_DT_MCUM_UDS_HW{1..10}
        MCUM_UDS_Boot{1..10}: type=DT_DT_MCUM_UDS_Boot{1..10}
        MCUM_UDS_ProductModel{1..16}: type=DT_DT_MCUM_UDS_ProductModel{1..16}
        MCUM_UDS_Supplier{1..6}: type=DT_DT_MCUM_UDS_Supplier{1..6}
    IF_VCU_0xDE
      52 x data:
        VCU_BrkPedOpen: type=DT_DT_VCU_BrkPedOpen
        VCU_BrkPedClose: type=DT_DT_VCU_BrkPedClose
        VCU_ColumnShiftP: type=DT_DT_VCU_ColumnShiftP
        VCU_VehiCrashSts: type=DT_DT_VCU_VehiCrashSts
        VCU_SleepSatisfiedSts: type=DT_DT_VCU_SleepSatisfiedSts
        VCU_VehiHvCmd: type=DT_DT_VCU_VehiHvCmd
        VCU_GearQuitAps: type=DT_DT_VCU_GearQuitAps
        VCU_REOverChgPwrFlag: type=DT_DT_VCU_REOverChgPwrFlag
        VCU_VehiAccnFilt: type=DT_DT_VCU_VehiAccnFilt
        VCU_HvOffSts: type=DT_DT_VCU_HvOffSts
        VCU_ElecPwrBalanceReq: type=DT_DT_VCU_ElecPwrBalanceReq
        VCU_CDU_RecvTr: type=DT_DT_VCU_CDU_RecvTr
        VCU_BMS_RecvTr: type=DT_DT_VCU_BMS_RecvTr
        VCU_IVI_RecvTr: type=DT_DT_VCU_IVI_RecvTr
        VCU_WheelMaxDrvTrq: type=DT_DT_VCU_WheelMaxDrvTrq
        VCU_WheelMaxRecTrq: type=DT_DT_VCU_WheelMaxRecTrq
        VCU_GCU_RecvTr: type=DT_DT_VCU_GCU_RecvTr
        VCU_TCM_RecvTr: type=DT_DT_VCU_TCM_RecvTr
        VCU_PTC_RecvTr: type=DT_DT_VCU_PTC_RecvTr
        VCU_LossFctorFlgFL: type=DT_DT_VCU_LossFctorFlgFL
        VCU_LowBattVolt: type=DT_DT_VCU_LowBattVolt
        VCU_HighPerforDisable: type=DT_DT_VCU_HighPerforDisable
        VCU_AccPedHSigVolt: type=DT_DT_VCU_AccPedHSigVolt
        VCU_LossFctorFlgFR: type=DT_DT_VCU_LossFctorFlgFR
        VCU_AccPedLSigVolt: type=DT_DT_VCU_AccPedLSigVolt
        VCU_LossFctorFlgRL: type=DT_DT_VCU_LossFctorFlgRL
        VCU_AccPedHPwrVolt: type=DT_DT_VCU_AccPedHPwrVolt
        VCU_LossFctorFlgRR: type=DT_DT_VCU_LossFctorFlgRR
        VCU_AccPedLPwrVolt: type=DT_DT_VCU_AccPedLPwrVolt
        VCU_PreReqChgPwr: type=DT_DT_VCU_PreReqChgPwr
        VCU_VehPwrChageLimit: type=DT_DT_VCU_VehPwrChageLimit
        VCU_FastPwrRequest: type=DT_DT_VCU_FastPwrRequest
        VCU_On2KL15_Volt: type=DT_DT_VCU_On2KL15_Volt
        VCU_ClutchWrkModDebug: type=DT_DT_VCU_ClutchWrkModDebug
        VCU_HighPerforSwtFlg: type=DT_DT_VCU_HighPerforSwtFlg
        VCU_VehiPowrConsumption: type=DT_DT_VCU_VehiPowrConsumption
        VCU_MDrvFilterTrqRange: type=DT_DT_VCU_MDrvFilterTrqRange
        VCU_WheelPwrOvrLimitflgRE: type=DT_DT_VCU_WheelPwrOvrLimitflgRE
        VCU_MRDrvControlMode: type=DT_DT_VCU_MRDrvControlMode
        VCU_MRDrvControlModeVD: type=DT_DT_VCU_MRDrvControlModeVD
        VCU_VehicleDirectMR: type=DT_DT_VCU_VehicleDirectMR
        VCU_VehicleDirectMRVD: type=DT_DT_VCU_VehicleDirectMRVD
        VCU_MRDrvRequestTorque: type=DT_DT_VCU_MRDrvRequestTorque
        VCU_MRDrvRequesSpeed: type=DT_DT_VCU_MRDrvRequesSpeed
        VCU_MCUMRMaxDischargePower: type=DT_DT_VCU_MCUMRMaxDischargePower
        VCU_MCUMRMaxPosDampgTrq: type=DT_DT_VCU_MCUMRMaxPosDampgTrq
        VCU_MRDrvRequestTorqueVD: type=DT_DT_VCU_MRDrvRequestTorqueVD
        VCU_MCUMRMaxChargePower: type=DT_DT_VCU_MCUMRMaxChargePower
        VCU_MCUMRMaxNegDampgTrq: type=DT_DT_VCU_MCUMRMaxNegDampgTrq
        VCU_MRDrvRequesSpeedVD: type=DT_DT_VCU_MRDrvRequesSpeedVD
        VCU_MCUMRDampgLmtFactor: type=DT_DT_VCU_MCUMRDampgLmtFactor
        VCU_SuppressJitterMCUMRRequest: type=DT_DT_VCU_SuppressJitterMCUMRRequest
    IF_VCU_0x3
      52 x data:
        EOL_VCU_BrkPedOpen: type=DT_DT_EOL_VCU_BrkPedOpen
        EOL_VCU_BrkPedClose: type=DT_DT_EOL_VCU_BrkPedClose
        EOL_VCU_ColumnShiftP: type=DT_DT_EOL_VCU_ColumnShiftP
        EOL_VCU_VehiCrashSts: type=DT_DT_EOL_VCU_VehiCrashSts
        EOL_VCU_SleepSatisfiedSts: type=DT_DT_EOL_VCU_SleepSatisfiedSts
        EOL_VCU_VehiHvCmd: type=DT_DT_EOL_VCU_VehiHvCmd
        EOL_VCU_GearQuitAps: type=DT_DT_EOL_VCU_GearQuitAps
        EOL_VCU_REOverChgPwrFlag: type=DT_DT_EOL_VCU_REOverChgPwrFlag
        EOL_VCU_VehiAccnFilt: type=DT_DT_EOL_VCU_VehiAccnFilt
        EOL_VCU_HvOffSts: type=DT_DT_EOL_VCU_HvOffSts
        EOL_VCU_ElecPwrBalanceReq: type=DT_DT_EOL_VCU_ElecPwrBalanceReq
        EOL_VCU_CDU_RecvTr: type=DT_DT_EOL_VCU_CDU_RecvTr
        EOL_VCU_BMS_RecvTr: type=DT_DT_EOL_VCU_BMS_RecvTr
        EOL_VCU_IVI_RecvTr: type=DT_DT_EOL_VCU_IVI_RecvTr
        EOL_VCU_WheelMaxDrvTrq: type=DT_DT_EOL_VCU_WheelMaxDrvTrq
        EOL_VCU_WheelMaxRecTrq: type=DT_DT_EOL_VCU_WheelMaxRecTrq
        EOL_VCU_GCU_RecvTr: type=DT_DT_EOL_VCU_GCU_RecvTr
        EOL_VCU_TCM_RecvTr: type=DT_DT_EOL_VCU_TCM_RecvTr
        EOL_VCU_PTC_RecvTr: type=DT_DT_EOL_VCU_PTC_RecvTr
        EOL_VCU_LossFctorFlgFL: type=DT_DT_EOL_VCU_LossFctorFlgFL
        EOL_VCU_LowBattVolt: type=DT_DT_EOL_VCU_LowBattVolt
        EOL_VCU_HighPerforDisable: type=DT_DT_EOL_VCU_HighPerforDisable
        EOL_VCU_AccPedHSigVolt: type=DT_DT_EOL_VCU_AccPedHSigVolt
        EOL_VCU_LossFctorFlgFR: type=DT_DT_EOL_VCU_LossFctorFlgFR
        EOL_VCU_AccPedLSigVolt: type=DT_DT_EOL_VCU_AccPedLSigVolt
        EOL_VCU_LossFctorFlgRL: type=DT_DT_EOL_VCU_LossFctorFlgRL
        EOL_VCU_AccPedHPwrVolt: type=DT_DT_EOL_VCU_AccPedHPwrVolt
        EOL_VCU_LossFctorFlgRR: type=DT_DT_EOL_VCU_LossFctorFlgRR
        EOL_VCU_AccPedLPwrVolt: type=DT_DT_EOL_VCU_AccPedLPwrVolt
        EOL_VCU_PreReqChgPwr: type=DT_DT_EOL_VCU_PreReqChgPwr
        EOL_VCU_VehPwrChageLimit: type=DT_DT_EOL_VCU_VehPwrChageLimit
        EOL_VCU_FastPwrRequest: type=DT_DT_EOL_VCU_FastPwrRequest
        EOL_VCU_On2KL15_Volt: type=DT_DT_EOL_VCU_On2KL15_Volt
        EOL_VCU_ClutchWrkModDebug: type=DT_DT_EOL_VCU_ClutchWrkModDebug
        EOL_VCU_HighPerforSwtFlg: type=DT_DT_EOL_VCU_HighPerforSwtFlg
        EOL_VCU_VehiPowrConsumption: type=DT_DT_EOL_VCU_VehiPowrConsumption
        EOL_VCU_MDrvFilterTrqRange: type=DT_DT_EOL_VCU_MDrvFilterTrqRange
        EOL_VCU_WheelPwrOvrLimitflgRE: type=DT_DT_EOL_VCU_WheelPwrOvrLimitflgRE
        EOL_VCU_MRDrvControlMode: type=DT_DT_EOL_VCU_MRDrvControlMode
        EOL_VCU_MRDrvControlModeVD: type=DT_DT_EOL_VCU_MRDrvControlModeVD
        EOL_VCU_VehicleDirectMR: type=DT_DT_EOL_VCU_VehicleDirectMR
        EOL_VCU_VehicleDirectMRVD: type=DT_DT_EOL_VCU_VehicleDirectMRVD
        EOL_VCU_MRDrvRequestTorque: type=DT_DT_EOL_VCU_MRDrvRequestTorque
        EOL_VCU_MRDrvRequesSpeed: type=DT_DT_EOL_VCU_MRDrvRequesSpeed
        EOL_VCU_MCUMRMaxDischargePower: type=DT_DT_EOL_VCU_MCUMRMaxDischargePower
        EOL_VCU_MCUMRMaxPosDampgTrq: type=DT_DT_EOL_VCU_MCUMRMaxPosDampgTrq
        EOL_VCU_MRDrvRequestTorqueVD: type=DT_DT_EOL_VCU_MRDrvRequestTorqueVD
        EOL_VCU_MCUMRMaxChargePower: type=DT_DT_EOL_VCU_MCUMRMaxChargePower
        EOL_VCU_MCUMRMaxNegDampgTrq: type=DT_DT_EOL_VCU_MCUMRMaxNegDampgTrq
        EOL_VCU_MRDrvRequesSpeedVD: type=DT_DT_EOL_VCU_MRDrvRequesSpeedVD
        EOL_VCU_MCUMRDampgLmtFactor: type=DT_DT_EOL_VCU_MCUMRDampgLmtFactor
        EOL_VCU_SuppressJitterMCUMRRequest: type=DT_DT_EOL_VCU_SuppressJitterMCUMRRequest
    IF_GCU_0x2C1
      data GCU_SWVersionC: type=DT_DT_GCU_SWVersionC
      data GCU_SWVersionB: type=DT_DT_GCU_SWVersionB
      data GCU_SWVersionA: type=DT_DT_GCU_SWVersionA
    IF_VCU_0xB6
      22 x data:
        VCU_CRC_B6: type=DT_DT_VCU_CRC_B6
        VCU_TVTest2: type=DT_DT_VCU_TVTest2
        VCU_VPE_Test1: type=DT_DT_VCU_VPE_Test1
        VCU_VPE_Test2: type=DT_DT_VCU_VPE_Test2
        VCU_TVTest1: type=DT_DT_VCU_TVTest1
        VCU_RollingCounter_B6: type=DT_DT_VCU_RollingCounter_B6
        VCU_MDrvRequestTorque_IDB6_CCAN: type=DT_DT_VCU_MDrvRequestTorque_IDB6_CCAN
        VCU_MDriverRequireTorque: type=DT_DT_VCU_MDriverRequireTorque
        VCU_SDrvRequestTorque_IDB6_CCAN: type=DT_DT_VCU_SDrvRequestTorque_IDB6_CCAN
        VCU_SDriverRequireTorque: type=DT_DT_VCU_SDriverRequireTorque
        VCU_ThrottlePosition_IDB6_CCAN: type=DT_DT_VCU_ThrottlePosition_IDB6_CCAN
        VCU_AccPedalValid_IDB6_CCAN: type=DT_DT_VCU_AccPedalValid_IDB6_CCAN
        VCU_BrakeSysFault_IDB6_CCAN: type=DT_DT_VCU_BrakeSysFault_IDB6_CCAN
        VCU_BrakeLightReq: type=DT_DT_VCU_BrakeLightReq
        VCU_BrakePedalSts: type=DT_DT_VCU_BrakePedalSts
        VCU_BrakePedalStsValid: type=DT_DT_VCU_BrakePedalStsValid
        VCU_GearLevelPosSts_IDB6_CCAN: type=DT_DT_VCU_GearLevelPosSts_IDB6_CCAN
        VCU_GearLeverValid_IDB6_CCAN: type=DT_DT_VCU_GearLeverValid_IDB6_CCAN
        VCU_BrakeFirstSts: type=DT_DT_VCU_BrakeFirstSts
        VCU_DeliveryModeSts_IDB6_CCAN: type=DT_DT_VCU_DeliveryModeSts_IDB6_CCAN
        VCU_MRDrvRequestTorque_IDB6_CCAN: type=DT_DT_VCU_MRDrvRequestTorque_IDB6_CCAN
        VCU_MRDriverRequireTorque: type=DT_DT_VCU_MRDriverRequireTorque
    IF_HPCBCM_0x291
      28 x data:
        BCM_CRC_291: type=DT_DT_BCM_CRC_291
        BCM_ShutdownMode: type=DT_DT_BCM_ShutdownMode
        BCM_NM_PNC_ON_1ADr_Sts: type=DT_DT_BCM_NM_PNC_ON_1ADr_Sts
        BCM_RollingCounter_291: type=DT_DT_BCM_RollingCounter_291
        BCM_KeyPosition_ON2A: type=DT_DT_BCM_KeyPosition_ON2A
        BCM_CcmHvilSts_ID291: type=DT_DT_BCM_CcmHvilSts_ID291
        BCM_DriverDoorSts: type=DT_DT_BCM_DriverDoorSts
        BCM_FLDoorSts: type=DT_DT_BCM_FLDoorSts
        BCM_FRDoorSts: type=DT_DT_BCM_FRDoorSts
        BCM_RLDoorSts: type=DT_DT_BCM_RLDoorSts
        BCM_RRDoorSts: type=DT_DT_BCM_RRDoorSts
        BCM_BackDoorSts: type=DT_DT_BCM_BackDoorSts
        BCM_ON2BRelaySts: type=DT_DT_BCM_ON2BRelaySts
        BCM_ON2CRelaySts: type=DT_DT_BCM_ON2CRelaySts
        BCM_ON2InitiativeSts: type=DT_DT_BCM_ON2InitiativeSts
        BCM_VehicleRepairMode: type=DT_DT_BCM_VehicleRepairMode
        BCM_VehlockCtrl: type=DT_DT_BCM_VehlockCtrl
        BCM_VehLockSts: type=DT_DT_BCM_VehLockSts
        BCM_FuelTankLockReq: type=DT_DT_BCM_FuelTankLockReq
        BCM_ACChgLockCtrl: type=DT_DT_BCM_ACChgLockCtrl
        BCM_ChargeLockCtrl: type=DT_DT_BCM_ChargeLockCtrl
        BCM_DCChrgPwr_Sts_ID291: type=DT_DT_BCM_DCChrgPwr_Sts_ID291
        BCM_ACChrgPwr_Sts_ID291: type=DT_DT_BCM_ACChrgPwr_Sts_ID291
        BCM_DCChrgPwr_Volt_ID291: type=DT_DT_BCM_DCChrgPwr_Volt_ID291
        BCM_ACChrgPwr_Volt_ID291: type=DT_DT_BCM_ACChrgPwr_Volt_ID291
        BCM_KeyPosition_ON2B: type=DT_DT_BCM_KeyPosition_ON2B
        BCM_NM_PNC_ON_3Ch_Sts: type=DT_DT_BCM_NM_PNC_ON_3Ch_Sts
        BCM_HighVoltageReq: type=DT_DT_BCM_HighVoltageReq
    IF_ACU_0x2A3
      7 x data:
        ACU_CRC_2A3: type=DT_DT_ACU_CRC_2A3
        ACU_Trigger: type=DT_DT_ACU_Trigger
        ACU_RollingCounter_2A3: type=DT_DT_ACU_RollingCounter_2A3
        ACU_TotalCrashOutputSts: type=DT_DT_ACU_TotalCrashOutputSts
        ACU_SelfCheckSt: type=DT_DT_ACU_SelfCheckSt
        ACU_FLSeatBeltRSt: type=DT_DT_ACU_FLSeatBeltRSt
        ACU_FRSeatBeltRSt: type=DT_DT_ACU_FRSeatBeltRSt
    IF_IVI_0x34A
      data IVI_DeliveryModeReq: type=DT_DT_IVI_DeliveryModeReq
      data IVI_ShowCarModeReq: type=DT_DT_IVI_ShowCarModeReq
    IF_VCU_0xBB
      55 x data:
        VCU_CheckSum_BB: type=DT_DT_VCU_CheckSum_BB
        VCU_WorkModeReq_PHEV: type=DT_DT_VCU_WorkModeReq_PHEV
        VCU_WorkMode_PHEV: type=DT_DT_VCU_WorkMode_PHEV
        VCU_HEVAllow_PHEV: type=DT_DT_VCU_HEVAllow_PHEV
        VCU_REAllow_PHEV: type=DT_DT_VCU_REAllow_PHEV
        VCU_EVDualAllow_PHEV: type=DT_DT_VCU_EVDualAllow_PHEV
        VCU_EVSingleAllow_PHEV: type=DT_DT_VCU_EVSingleAllow_PHEV
        VCU_Clutch_2_RequesSpeed: type=DT_DT_VCU_Clutch_2_RequesSpeed
        VCU_Clutch_1_RequesSpeed: type=DT_DT_VCU_Clutch_1_RequesSpeed
        VCU_Clutch2Position: type=DT_DT_VCU_Clutch2Position
        VCU_Clutch1Position: type=DT_DT_VCU_Clutch1Position
        VCU_RollingCounter_BB: type=DT_DT_VCU_RollingCounter_BB
        VCU_EngPreStartFlg: type=DT_DT_VCU_EngPreStartFlg
        VCU_FuelChgModeMsg: type=DT_DT_VCU_FuelChgModeMsg
        VCU_FuelChgModeSts: type=DT_DT_VCU_FuelChgModeSts
        VCU_RoughRoadDetectionFlag: type=DT_DT_VCU_RoughRoadDetectionFlag
        VCU_Clutch_2_RequesSpeedValid: type=DT_DT_VCU_Clutch_2_RequesSpeedValid
        VCU_Clutch_1_RequesSpeedValid: type=DT_DT_VCU_Clutch_1_RequesSpeedValid
        VCU_GCURequestTorque: type=DT_DT_VCU_GCURequestTorque
        VCU_PowerReducetSts: type=DT_DT_VCU_PowerReducetSts
        VCU_GCUAassistFB: type=DT_DT_VCU_GCUAassistFB
        VCU_GCUActiveReleaseCmd: type=DT_DT_VCU_GCUActiveReleaseCmd
        VCU_PowerOverSts: type=DT_DT_VCU_PowerOverSts
        VCU_GCURequesSpeed: type=DT_DT_VCU_GCURequesSpeed
        VCU_GCUControlMode: type=DT_DT_VCU_GCUControlMode
        VCU_MotChargePower: type=DT_DT_VCU_MotChargePower
        VCU_APS1Position: type=DT_DT_VCU_APS1Position
        VCU_EngineStartReq: type=DT_DT_VCU_EngineStartReq
        VCU_EngineFuelInhibitReq: type=DT_DT_VCU_EngineFuelInhibitReq
        VCU_EngineOffRequest: type=DT_DT_VCU_EngineOffRequest
        VCU_STorqueReqValid: type=DT_DT_VCU_STorqueReqValid
        VCU_STorqueReq: type=DT_DT_VCU_STorqueReq
        VCU_FTorqueSwFb: type=DT_DT_VCU_FTorqueSwFb
        VCU_FVVOpenReq: type=DT_DT_VCU_FVVOpenReq
        VCU_WarmUpCycleIndicator: type=DT_DT_VCU_WarmUpCycleIndicator
        VCU_EngineResetSts: type=DT_DT_VCU_EngineResetSts
        VCU_EngineSts: type=DT_DT_VCU_EngineSts
        VCU_FTorqueReq: type=DT_DT_VCU_FTorqueReq
        VCU_FTorqueReqValid: type=DT_DT_VCU_FTorqueReqValid
        VCU_EngineIdleReq: type=DT_DT_VCU_EngineIdleReq
        VCU_REsystemSts: type=DT_DT_VCU_REsystemSts
        VCU_REsystemFaultSts: type=DT_DT_VCU_REsystemFaultSts
        VCU_APS2Position: type=DT_DT_VCU_APS2Position
        VCU_EngineRunAllowFlg: type=DT_DT_VCU_EngineRunAllowFlg
        VCU_EngineIdleSpeed: type=DT_DT_VCU_EngineIdleSpeed
        VCU_EngineFuleCutoffReq: type=DT_DT_VCU_EngineFuleCutoffReq
        VCU_MCUSClutchPosition: type=DT_DT_VCU_MCUSClutchPosition
        VCU_MGCUWorkMode: type=DT_DT_VCU_MGCUWorkMode
        VCU_REChgTarget: type=DT_DT_VCU_REChgTarget
        VCU_MotStartStopPowerUP: type=DT_DT_VCU_MotStartStopPowerUP
        VCU_MotStartStopPowerLOW: type=DT_DT_VCU_MotStartStopPowerLOW
        VCU_GCURequesSpeed_MGCU: type=DT_DT_VCU_GCURequesSpeed_MGCU
        VCU_DynamicChgPwr: type=DT_DT_VCU_DynamicChgPwr
        VCU_ForceChgPwr: type=DT_DT_VCU_ForceChgPwr
        VCU_REStartType: type=DT_DT_VCU_REStartType
    IF_VCU_0x515
      4 x data:
        VCU_Pending_DTC: type=DT_DT_VCU_Pending_DTC
        VCU_Comfirmed_DTC: type=DT_DT_VCU_Comfirmed_DTC
        VCU_Permanent_DTC: type=DT_DT_VCU_Permanent_DTC
        VCU_MilReq_DTC: type=DT_DT_VCU_MilReq_DTC
    IF_MCUM_0x42C
      data MCUM_NMControlRMR_Sts: type=DT_DT_MCUM_NMControlRMR_Sts
      data MCUM_WakeUpReason: type=DT_DT_MCUM_WakeUpReason
    IF_ICU_0xDF
      10 x data:
        ICU_CRC_DF: type=DT_DT_ICU_CRC_DF
        ICU_RollingCounter_DF: type=DT_DT_ICU_RollingCounter_DF
        ICU_IMU_ACC_x: type=DT_DT_ICU_IMU_ACC_x
        ICU_IMU_ACC_y: type=DT_DT_ICU_IMU_ACC_y
        ICU_IMU_ACC_z: type=DT_DT_ICU_IMU_ACC_z
        ICU_IMU_ACC_Roll_Rate: type=DT_DT_ICU_IMU_ACC_Roll_Rate
        ICU_IMU_ACC_Pitch_Rate: type=DT_DT_ICU_IMU_ACC_Pitch_Rate
        ICU_IMU_ACC_Yaw_Rate: type=DT_DT_ICU_IMU_ACC_Yaw_Rate
        ICU_IMU_Calibrated: type=DT_DT_ICU_IMU_Calibrated
        ICU_IMU_Valid: type=DT_DT_ICU_IMU_Valid
    IF_TMS_0x362
      data TMS_RAPTC_ModOprtgStsFrt: type=DT_DT_TMS_RAPTC_ModOprtgStsFrt
      data TMS_RAPTC_ModOpEnblCmd: type=DT_DT_TMS_RAPTC_ModOpEnblCmd
      data TMS_RAPTC_MsrdPwrFrt: type=DT_DT_TMS_RAPTC_MsrdPwrFrt
    IF_HPCBCM_0xDA
      9 x data:
        BCM_CRC_DA: type=DT_DT_BCM_CRC_DA
        BCM_RollingCounter_DA: type=DT_DT_BCM_RollingCounter_DA
        BCM_IMU_ACC_x: type=DT_DT_BCM_IMU_ACC_x
        BCM_IMU_ACC_y: type=DT_DT_BCM_IMU_ACC_y
        BCM_IMU_ACC_z: type=DT_DT_BCM_IMU_ACC_z
        BCM_IMU_ACC_Roll_Rate: type=DT_DT_BCM_IMU_ACC_Roll_Rate
        BCM_IMU_ACC_Pitch_Rate: type=DT_DT_BCM_IMU_ACC_Pitch_Rate
        BCM_IMU_ACC_Yaw_Rate: type=DT_DT_BCM_IMU_ACC_Yaw_Rate
        BCM_IMU_Valid: type=DT_DT_BCM_IMU_Valid
    IF_ACU_0x15
      14 x data:
        ACU_IMU_CRC_15: type=DT_DT_ACU_IMU_CRC_15
        ACU_IMU_RollingCounter_15: type=DT_DT_ACU_IMU_RollingCounter_15
        ACU_IMU_ACC_x: type=DT_DT_ACU_IMU_ACC_x
        ACU_IMU_ACC_y: type=DT_DT_ACU_IMU_ACC_y
        ACU_IMU_ACC_z: type=DT_DT_ACU_IMU_ACC_z
        ACU_IMU_Roll_Rate: type=DT_DT_ACU_IMU_Roll_Rate
        ACU_IMU_Pitch_Rate: type=DT_DT_ACU_IMU_Pitch_Rate
        ACU_IMU_Yaw_Rate: type=DT_DT_ACU_IMU_Yaw_Rate
        ACU_IMU_Calibrated: type=DT_DT_ACU_IMU_Calibrated
        ACU_IMU_Valid: type=DT_DT_ACU_IMU_Valid
        ACU_IMU_Fault_Status: type=DT_DT_ACU_IMU_Fault_Status
        ACU_IMU_MessageStatus: type=DT_DT_ACU_IMU_MessageStatus
        ACU_IMU_FunctionSafetyStatus: type=DT_DT_ACU_IMU_FunctionSafetyStatus
        ACU_IMU_Temperature: type=DT_DT_ACU_IMU_Temperature
  data type mapping set DTMSACU_0x15
    data-type-maps:
      application-data-type=DT_DT_ACU_IMU_CRC_15, implementation-data-type=DT_ACU_IMU_CRC_15
      application-data-type=DT_DT_ACU_IMU_RollingCounter_15, implementation-data-type=DT_ACU_IMU_RollingCounter_15
      application-data-type=DT_DT_ACU_IMU_ACC_x, implementation-data-type=DT_ACU_IMU_ACC_x
      application-data-type=DT_DT_ACU_IMU_ACC_y, implementation-data-type=DT_ACU_IMU_ACC_y
      application-data-type=DT_DT_ACU_IMU_ACC_z, implementation-data-type=DT_ACU_IMU_ACC_z
      application-data-type=DT_DT_ACU_IMU_Roll_Rate, implementation-data-type=DT_ACU_IMU_Roll_Rate
      application-data-type=DT_DT_ACU_IMU_Pitch_Rate, implementation-data-type=DT_ACU_IMU_Pitch_Rate
      application-data-type=DT_DT_ACU_IMU_Yaw_Rate, implementation-data-type=DT_ACU_IMU_Yaw_Rate
      application-data-type=DT_DT_ACU_IMU_Calibrated, implementation-data-type=DT_ACU_IMU_Calibrated
      application-data-type=DT_DT_ACU_IMU_Valid, implementation-data-type=DT_ACU_IMU_Valid
      application-data-type=DT_DT_ACU_IMU_Fault_Status, implementation-data-type=DT_ACU_IMU_Fault_Status
      application-data-type=DT_DT_ACU_IMU_MessageStatus, implementation-data-type=DT_ACU_IMU_MessageStatus
      application-data-type=DT_DT_ACU_IMU_FunctionSafetyStatus, implementation-data-type=DT_ACU_IMU_FunctionSafetyStatus
      application-data-type=DT_DT_ACU_IMU_Temperature, implementation-data-type=DT_ACU_IMU_Temperature
  data type mapping set DTMSHPCBCM_0xDA
    data-type-maps:
      application-data-type=DT_DT_BCM_CRC_DA, implementation-data-type=DT_BCM_CRC_DA
      application-data-type=DT_DT_BCM_RollingCounter_DA, implementation-data-type=DT_BCM_RollingCounter_DA
      application-data-type=DT_DT_BCM_IMU_ACC_x, implementation-data-type=DT_BCM_IMU_ACC_x
      application-data-type=DT_DT_BCM_IMU_ACC_y, implementation-data-type=DT_BCM_IMU_ACC_y
      application-data-type=DT_DT_BCM_IMU_ACC_z, implementation-data-type=DT_BCM_IMU_ACC_z
      application-data-type=DT_DT_BCM_IMU_ACC_Roll_Rate, implementation-data-type=DT_BCM_IMU_ACC_Roll_Rate
      application-data-type=DT_DT_BCM_IMU_ACC_Pitch_Rate, implementation-data-type=DT_BCM_IMU_ACC_Pitch_Rate
      application-data-type=DT_DT_BCM_IMU_ACC_Yaw_Rate, implementation-data-type=DT_BCM_IMU_ACC_Yaw_Rate
      application-data-type=DT_DT_BCM_IMU_Valid, implementation-data-type=DT_BCM_IMU_Valid
  4 x sender receiver interface:
    IF_LMC_0x133
      data LMC_CRC_133: type=DT_DT_LMC_CRC_133
      data LMC_DrvReqTorque: type=DT_DT_LMC_DrvReqTorque
      data LMC_RollingCounter_133: type=DT_DT_LMC_RollingCounter_133
    IF_LMCSSU_0x25A
      4 x data:
        LMC_CRC_25A: type=DT_DT_LMC_CRC_25A
        LMC_ECAS_DriveModeFb: type=DT_DT_LMC_ECAS_DriveModeFb
        LMC_CDC_DriveModeFb: type=DT_DT_LMC_CDC_DriveModeFb
        LMC_RollingCounter_25A: type=DT_DT_LMC_RollingCounter_25A
    IF_ICU_0x5BE
      5 x data:
        ICU_RollingCounter_5BE: type=DT_DT_ICU_RollingCounter_5BE
        ICU_Imu_Cal_Staus: type=DT_DT_ICU_Imu_Cal_Staus
        ICU_Imu_Cal_Gyro: type=DT_DT_ICU_Imu_Cal_Gyro
        ICU_Imu_Cal_Pitch: type=DT_DT_ICU_Imu_Cal_Pitch
        ICU_Imu_Cal_Roll: type=DT_DT_ICU_Imu_Cal_Roll
    IF_HPCBCM_0x4A
      5 x data:
        BCM_CRC_4A: type=DT_DT_BCM_CRC_4A
        BCM_IBCLimphomeSts: type=DT_DT_BCM_IBCLimphomeSts
        BCM_EOLAutomaticActiveSts_C: type=DT_DT_BCM_EOLAutomaticActiveSts_C
        BCM_TorqueLimte: type=DT_DT_BCM_TorqueLimte
        BCM_RollingCounter_4A: type=DT_DT_BCM_RollingCounter_4A
