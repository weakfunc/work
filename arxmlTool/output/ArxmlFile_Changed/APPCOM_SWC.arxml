[part 4 of 6: package /MVCU_AutoGenPkg/MVCU/Pck_AutoGen_Sw/DTMS]
AUTOSAR XML (schema 4-2-2)
package /MVCU_AutoGenPkg/MVCU/Pck_AutoGen_Sw/DTMS
  96 x data type mapping set:
    DTMSMCUM_0x135
      data-type-maps:
        application-data-type=DT_DT_MCUM_CRC_135, implementation-data-type=DT_MCUM_CRC_135
        application-data-type=DT_DT_MCUM_RollingCounter_135, implementation-data-type=DT_MCUM_RollingCounter_135
        application-data-type=DT_DT_MCUM_LDC_SWInfo, implementation-data-type=DT_MCUM_LDC_SWInfo
        application-data-type=DT_DT_MCUM_LDC_MTarOut_FA, implementation-data-type=DT_MCUM_LDC_MTarOut_FA
        application-data-type=DT_DT_MCUM_LDC_MTarOut_RA, implementation-data-type=DT_MCUM_LDC_MTarOut_RA
        application-data-type=DT_DT_MCUM_LDC_Available_FA, implementation-data-type=DT_MCUM_LDC_Available_FA
        application-data-type=DT_DT_MCUM_LDC_OperationMode_FA, implementation-data-type=DT_MCUM_LDC_OperationMode_FA
        application-data-type=DT_DT_MCUM_LDC_Available_RA, implementation-data-type=DT_MCUM_LDC_Available_RA
        application-data-type=DT_DT_MCUM_LDC_OperationMode_RA, implementation-data-type=DT_MCUM_LDC_OperationMode_RA
        application-data-type=DT_DT_MCUM_RTE_Exchange_Signal_Status, implementation-data-type=DT_MCUM_RTE_Exchange_Signal_Status
        application-data-type=DT_DT_MCUM_MTarIn_FA, implementation-data-type=DT_MCUM_MTarIn_FA
        application-data-type=DT_DT_MCUM_MTarIn_RA, implementation-data-type=DT_MCUM_MTarIn_RA
        application-data-type=DT_DT_MCUM_InputQF_FA, implementation-data-type=DT_MCUM_InputQF_FA
        application-data-type=DT_DT_MCUM_InputQF_RA, implementation-data-type=DT_MCUM_InputQF_RA
    DTMSIBC_0x136
      data-type-maps:
        application-data-type=DT_DT_IBC_CRC_136, implementation-data-type=DT_IBC_CRC_136
        application-data-type=DT_DT_IBC_RollingCounter_136, implementation-data-type=DT_IBC_RollingCounter_136
        application-data-type=DT_DT_IBC_ModeMinEDrvTar_FA, implementation-data-type=DT_IBC_ModeMinEDrvTar_FA
        application-data-type=DT_DT_IBC_ModeMinEDrvTar_RA, implementation-data-type=DT_IBC_ModeMinEDrvTar_RA
        application-data-type=DT_DT_IBC_ModeMaxEDrvTar_FA, implementation-data-type=DT_IBC_ModeMaxEDrvTar_FA
        application-data-type=DT_DT_IBC_ModeMaxEDrvTar_RA, implementation-data-type=DT_IBC_ModeMaxEDrvTar_RA
        application-data-type=DT_DT_IBC_torque_distribution_RA_Vaild, implementation-data-type=DT_IBC_torque_distribution_RA_Vaild
        application-data-type=DT_DT_IBC_torque_distribution_RA, implementation-data-type=DT_IBC_torque_distribution_RA
        application-data-type=DT_DT_IBC_mTar_FA, implementation-data-type=DT_IBC_mTar_FA
        application-data-type=DT_DT_IBC_mTar_RA, implementation-data-type=DT_IBC_mTar_RA
        application-data-type=DT_DT_IBC_iLDC_SWInfo, implementation-data-type=DT_IBC_iLDC_SWInfo
        application-data-type=DT_DT_IBC_Variant_Signal, implementation-data-type=DT_IBC_Variant_Signal
        application-data-type=DT_DT_IBC_nTarMax_FA, implementation-data-type=DT_IBC_nTarMax_FA
        application-data-type=DT_DT_IBC_nTarMax_RA, implementation-data-type=DT_IBC_nTarMax_RA
        application-data-type=DT_DT_IBC_nTarMin_FA, implementation-data-type=DT_IBC_nTarMin_FA
        application-data-type=DT_DT_IBC_nTarMin_RA, implementation-data-type=DT_IBC_nTarMin_RA
    DTMSEVCC_0x260
      data-type-maps:
        application-data-type=DT_DT_EVCC_DCAC_ChgMode, implementation-data-type=DT_EVCC_DCAC_ChgMode
        application-data-type=DT_DT_EVCC_CP_status, implementation-data-type=DT_EVCC_CP_status
        application-data-type=DT_DT_EVCC_CPDutyCycleValue, implementation-data-type=DT_EVCC_CPDutyCycleValue
        application-data-type=DT_DT_EVCC_EVSEMaximumCurrentLimit, implementation-data-type=DT_EVCC_EVSEMaximumCurrentLimit
        application-data-type=DT_DT_EVCC_EVSEMaximumPowerLimit, implementation-data-type=DT_EVCC_EVSEMaximumPowerLimit
    DTMSICU_0x24C
      data-type-maps:
        application-data-type=DT_DT_ICU_CRC_24C, implementation-data-type=DT_ICU_CRC_24C
        application-data-type=DT_DT_ICU_PHEVMode, implementation-data-type=DT_ICU_PHEVMode
        application-data-type=DT_DT_ICU_RollingCounter_24C, implementation-data-type=DT_ICU_RollingCounter_24C
        application-data-type=DT_DT_ICU_TotalOdometerkm, implementation-data-type=DT_ICU_TotalOdometerkm
        application-data-type=DT_DT_ICU_AccelerationMode, implementation-data-type=DT_ICU_AccelerationMode
        application-data-type=DT_DT_ICU_REMode, implementation-data-type=DT_ICU_REMode
        application-data-type=DT_DT_ICU_CreepMode, implementation-data-type=DT_ICU_CreepMode
        application-data-type=DT_DT_ICU_EnergyRecoveryMode, implementation-data-type=DT_ICU_EnergyRecoveryMode
    DTMSMCUS_0xDB
      data-type-maps:
        application-data-type=DT_DT_MCUS_CRC_DB, implementation-data-type=DT_MCUS_CRC_DB
        application-data-type=DT_DT_MCUS_Clutch_2_Fault, implementation-data-type=DT_MCUS_Clutch_2_Fault
        application-data-type=DT_DT_MCUS_Clutch_1_Fault, implementation-data-type=DT_MCUS_Clutch_1_Fault
        application-data-type=DT_DT_MCUS_Clutch_2_WarningLevel, implementation-data-type=DT_MCUS_Clutch_2_WarningLevel
        application-data-type=DT_DT_MCUS_Clutch_1_WarningLevel, implementation-data-type=DT_MCUS_Clutch_1_WarningLevel
        application-data-type=DT_DT_MCUS_Clutch_2_Pos, implementation-data-type=DT_MCUS_Clutch_2_Pos
        application-data-type=DT_DT_MCUS_Clutch_1_Pos, implementation-data-type=DT_MCUS_Clutch_1_Pos
        application-data-type=DT_DT_MCUS_RollingCounter_DB, implementation-data-type=DT_MCUS_RollingCounter_DB
        application-data-type=DT_DT_MCUS_WarningLevel, implementation-data-type=DT_MCUS_WarningLevel
        application-data-type=DT_DT_MCUS_SelfCheckSts, implementation-data-type=DT_MCUS_SelfCheckSts
        application-data-type=DT_DT_MCUS_DrvMotorWorkSts, implementation-data-type=DT_MCUS_DrvMotorWorkSts
        application-data-type=DT_DT_MCUS_PowerReduceSts, implementation-data-type=DT_MCUS_PowerReduceSts
        application-data-type=DT_DT_MCUS_SystemError, implementation-data-type=DT_MCUS_SystemError
        application-data-type=DT_DT_MCUS_LVSystemError, implementation-data-type=DT_MCUS_LVSystemError
        application-data-type=DT_DT_MCUS_MotorTempAlarm, implementation-data-type=DT_MCUS_MotorTempAlarm
        application-data-type=DT_DT_MCUS_HVSystemError, implementation-data-type=DT_MCUS_HVSystemError
        application-data-type=DT_DT_MCUS_SeriousWarning_Level, implementation-data-type=DT_MCUS_SeriousWarning_Level
        application-data-type=DT_DT_MCUS_CtrlModeVD, implementation-data-type=DT_MCUS_CtrlModeVD
        application-data-type=DT_DT_MCUS_WaterPumpLevlReq, implementation-data-type=DT_MCUS_WaterPumpLevlReq
        application-data-type=DT_DT_MCUS_MotorTemp, implementation-data-type=DT_MCUS_MotorTemp
        application-data-type=DT_DT_MCUS_IGBTTemp, implementation-data-type=DT_MCUS_IGBTTemp
        application-data-type=DT_DT_MCUS_InletTemp, implementation-data-type=DT_MCUS_InletTemp
        application-data-type=DT_DT_MCUS_DrvMotorRPM, implementation-data-type=DT_MCUS_DrvMotorRPM
        application-data-type=DT_DT_MCUS_ActualTorqueFB, implementation-data-type=DT_MCUS_ActualTorqueFB
        application-data-type=DT_DT_MCUS_HWRdcFault, implementation-data-type=DT_MCUS_HWRdcFault
        application-data-type=DT_DT_MCUS_HighVoltPowerOffReq, implementation-data-type=DT_MCUS_HighVoltPowerOffReq
        application-data-type=DT_DT_MCUS_HVILSts, implementation-data-type=DT_MCUS_HVILSts
        application-data-type=DT_DT_MCUS_DragSts, implementation-data-type=DT_MCUS_DragSts
        application-data-type=DT_DT_MCUS_CtrlMode, implementation-data-type=DT_MCUS_CtrlMode
        application-data-type=DT_DT_MCUS_MILlampReq, implementation-data-type=DT_MCUS_MILlampReq
        application-data-type=DT_DT_MCUS_DrvMotorRPMVD, implementation-data-type=DT_MCUS_DrvMotorRPMVD
        application-data-type=DT_DT_MCUS_ActualTorqueFBVD, implementation-data-type=DT_MCUS_ActualTorqueFBVD
        application-data-type=DT_DT_MCUS_MaxTorqueAllow, implementation-data-type=DT_MCUS_MaxTorqueAllow
        application-data-type=DT_DT_MCUS_MaxSpeedAllow, implementation-data-type=DT_MCUS_MaxSpeedAllow
        application-data-type=DT_DT_MCUS_ActiveReleaseSts, implementation-data-type=DT_MCUS_ActiveReleaseSts
        application-data-type=DT_DT_MCUS_MinTorqueAllow, implementation-data-type=DT_MCUS_MinTorqueAllow
        application-data-type=DT_DT_MCUS_MainWireVolt, implementation-data-type=DT_MCUS_MainWireVolt
        application-data-type=DT_DT_MCUS_MainWireCurr, implementation-data-type=DT_MCUS_MainWireCurr
        application-data-type=DT_DT_MCUS_Clutch_Pos, implementation-data-type=DT_MCUS_Clutch_Pos
        application-data-type=DT_DT_MCUS_Clutch_Fault, implementation-data-type=DT_MCUS_Clutch_Fault
        application-data-type=DT_DT_MCUS_TMS_FrMotSelfHeatEnSts, implementation-data-type=DT_MCUS_TMS_FrMotSelfHeatEnSts
        application-data-type=DT_DT_MCUS_TMS_FrMotSelfHeatLvlFb, implementation-data-type=DT_MCUS_TMS_FrMotSelfHeatLvlFb
        application-data-type=DT_DT_MCUS_HeatPwrAval, implementation-data-type=DT_MCUS_HeatPwrAval
    DTMSMCU_0x5C9
      data-type-maps:
        application-data-type=DT_DT_DelayIden_Rslt_Avg, implementation-data-type=DT_DelayIden_Rslt_Avg
        application-data-type=DT_DT_DelayIden_OverRange, implementation-data-type=DT_DelayIden_OverRange
        application-data-type=DT_DT_DelayIden_Iden_Finish, implementation-data-type=DT_DelayIden_Iden_Finish
        application-data-type=DT_DT_DelayIden_Write_Finish, implementation-data-type=DT_DelayIden_Write_Finish
        application-data-type=DT_DT_DelayIden_Rslt_U, implementation-data-type=DT_DelayIden_Rslt_U
        application-data-type=DT_DT_DelayIden_Rslt_V, implementation-data-type=DT_DelayIden_Rslt_V
        application-data-type=DT_DT_DelayIden_Rslt_W, implementation-data-type=DT_DelayIden_Rslt_W
        application-data-type=DT_DT_GainIden_Is_Samp_U, implementation-data-type=DT_GainIden_Is_Samp_U
        application-data-type=DT_DT_GainIden_Rslt_U, implementation-data-type=DT_GainIden_Rslt_U
        application-data-type=DT_DT_GainIden_OverRange, implementation-data-type=DT_GainIden_OverRange
        application-data-type=DT_DT_GainIden_Is_Samp_V, implementation-data-type=DT_GainIden_Is_Samp_V
        application-data-type=DT_DT_GainIden_Rslt_V, implementation-data-type=DT_GainIden_Rslt_V
        application-data-type=DT_DT_GainIden_Iden_Finish, implementation-data-type=DT_GainIden_Iden_Finish
        application-data-type=DT_DT_GainIden_Is_Samp_W, implementation-data-type=DT_GainIden_Is_Samp_W
        application-data-type=DT_DT_GainIden_Rslt_W, implementation-data-type=DT_GainIden_Rslt_W
        application-data-type=DT_DT_GainIden_Write_Finish, implementation-data-type=DT_GainIden_Write_Finish
        application-data-type=DT_DT_GainIden_Curr_Peak_U, implementation-data-type=DT_GainIden_Curr_Peak_U
        application-data-type=DT_DT_GainIden_Curr_Peak_V, implementation-data-type=DT_GainIden_Curr_Peak_V
        application-data-type=DT_DT_GainIden_Curr_Peak_W, implementation-data-type=DT_GainIden_Curr_Peak_W
        application-data-type=DT_DT_CurrLoad_CurExt_U, implementation-data-type=DT_CurrLoad_CurExt_U
        application-data-type=DT_DT_CurrLoad_CurExt_V, implementation-data-type=DT_CurrLoad_CurExt_V
        application-data-type=DT_DT_CurrLoad_CurExt_W, implementation-data-type=DT_CurrLoad_CurExt_W
        application-data-type=DT_DT_CurrLoad_offset_Iu, implementation-data-type=DT_CurrLoad_offset_Iu
        application-data-type=DT_DT_CurrLoad_offset_Iv, implementation-data-type=DT_CurrLoad_offset_Iv
        application-data-type=DT_DT_CurrLoad_offset_Iw, implementation-data-type=DT_CurrLoad_offset_Iw
        application-data-type=DT_DT_MCUMR_DelayIden_Rslt_Avg, implementation-data-type=DT_MCUMR_DelayIden_Rslt_Avg
        application-data-type=DT_DT_MCUMR_DelayIden_OverRange, implementation-data-type=DT_MCUMR_DelayIden_OverRange
        application-data-type=DT_DT_MCUMR_DelayIden_Iden_Finish, implementation-data-type=DT_MCUMR_DelayIden_Iden_Finish
        application-data-type=DT_DT_MCUMR_DelayIden_Write_Finish, implementation-data-type=DT_MCUMR_DelayIden_Write_Finish
        application-data-type=DT_DT_MCUMR_DelayIden_Rslt_U, implementation-data-type=DT_MCUMR_DelayIden_Rslt_U
        application-data-type=DT_DT_MCUMR_DelayIden_Rslt_V, implementation-data-type=DT_MCUMR_DelayIden_Rslt_V
        application-data-type=DT_DT_MCUMR_DelayIden_Rslt_W, implementation-data-type=DT_MCUMR_DelayIden_Rslt_W
        application-data-type=DT_DT_MCUMR_GainIden_Is_Samp_U, implementation-data-type=DT_MCUMR_GainIden_Is_Samp_U
        application-data-type=DT_DT_MCUMR_GainIden_Rslt_U, implementation-data-type=DT_MCUMR_GainIden_Rslt_U
        application-data-type=DT_DT_MCUMR_GainIden_OverRange, implementation-data-type=DT_MCUMR_GainIden_OverRange
        application-data-type=DT_DT_MCUMR_GainIden_Is_Samp_V, implementation-data-type=DT_MCUMR_GainIden_Is_Samp_V
        application-data-type=DT_DT_MCUMR_GainIden_Rslt_V, implementation-data-type=DT_MCUMR_GainIden_Rslt_V
        application-data-type=DT_DT_MCUMR_GainIden_Iden_Finish, implementation-data-type=DT_MCUMR_GainIden_Iden_Finish
        application-data-type=DT_DT_MCUMR_GainIden_Is_Samp_W, implementation-data-type=DT_MCUMR_GainIden_Is_Samp_W
        application-data-type=DT_DT_MCUMR_GainIden_Rslt_W, implementation-data-type=DT_MCUMR_GainIden_Rslt_W
        application-data-type=DT_DT_MCUMR_GainIden_Write_Finish, implementation-data-type=DT_MCUMR_GainIden_Write_Finish
        application-data-type=DT_DT_MCUMR_GainIden_Curr_Peak_U, implementation-data-type=DT_MCUMR_GainIden_Curr_Peak_U
        application-data-type=DT_DT_MCUMR_GainIden_Curr_Peak_V, implementation-data-type=DT_MCUMR_GainIden_Curr_Peak_V
        application-data-type=DT_DT_MCUMR_GainIden_Curr_Peak_W, implementation-data-type=DT_MCUMR_GainIden_Curr_Peak_W
        application-data-type=DT_DT_MCUMR_CurrLoad_CurExt_U, implementation-data-type=DT_MCUMR_CurrLoad_CurExt_U
        application-data-type=DT_DT_MCUMR_CurrLoad_CurExt_V, implementation-data-type=DT_MCUMR_CurrLoad_CurExt_V
        application-data-type=DT_DT_MCUMR_CurrLoad_CurExt_W, implementation-data-type=DT_MCUMR_CurrLoad_CurExt_W
        application-data-type=DT_DT_MCUMR_CurrLoad_offset_Iu, implementation-data-type=DT_MCUMR_CurrLoad_offset_Iu
        application-data-type=DT_DT_MCUMR_CurrLoad_offset_Iv, implementation-data-type=DT_MCUMR_CurrLoad_offset_Iv
        application-data-type=DT_DT_MCUMR_CurrLoad_offset_Iw, implementation-data-type=DT_MCUMR_CurrLoad_offset_Iw
    DTMSHPCBCM_0x1E6
      data-type-maps:
        application-data-type=DT_DT_BCM_VCU_Authentication_MAC_B{0..15}, implementation-data-type=DT_BCM_VCU_Authentication_MAC_B{0..15}
    DTMSUDS_Phy_Rx_7E0_ECM
      data-type-maps:
        application-data-type=DT_DT_ECM_UDS_PhyReq_Byte{0..7}, implementation-data-type=DT_ECM_UDS_PhyReq_Byte{0..7}
    DTMSMCUM_0x5D0
      data-type-maps:
        application-data-type=DT_DT_MCUM_Id_Ref, implementation-data-type=DT_MCUM_Id_Ref
        application-data-type=DT_DT_MCUM_Iq_Ref, implementation-data-type=DT_MCUM_Iq_Ref
        application-data-type=DT_DT_MCUM_Id_Fb, implementation-data-type=DT_MCUM_Id_Fb
        application-data-type=DT_DT_MCUM_Iq_Fb, implementation-data-type=DT_MCUM_Iq_Fb
        application-data-type=DT_DT_MCUM_Torque_Ref, implementation-data-type=DT_MCUM_Torque_Ref
        application-data-type=DT_DT_MCUM_R_Id_Ref, implementation-data-type=DT_MCUM_R_Id_Ref
        application-data-type=DT_DT_MCUM_R_Iq_Ref, implementation-data-type=DT_MCUM_R_Iq_Ref
        application-data-type=DT_DT_MCUM_R_Id_Fb, implementation-data-type=DT_MCUM_R_Id_Fb
        application-data-type=DT_DT_MCUM_R_Iq_Fb, implementation-data-type=DT_MCUM_R_Iq_Fb
        application-data-type=DT_DT_MCUM_R_Torque_Ref, implementation-data-type=DT_MCUM_R_Torque_Ref
    DTMSMCUM_0x5D1
      data-type-maps:
        application-data-type=DT_DT_MCUM_Vd_Ref, implementation-data-type=DT_MCUM_Vd_Ref
        application-data-type=DT_DT_MCUM_Vq_Ref, implementation-data-type=DT_MCUM_Vq_Ref
        application-data-type=DT_DT_MCUM_Id_LookUp, implementation-data-type=DT_MCUM_Id_LookUp
        application-data-type=DT_DT_MCUM_Iq_LookUp, implementation-data-type=DT_MCUM_Iq_LookUp
        application-data-type=DT_DT_MCUM_Spd_Delta, implementation-data-type=DT_MCUM_Spd_Delta
        application-data-type=DT_DT_MCUM_Us_Out, implementation-data-type=DT_MCUM_Us_Out
        application-data-type=DT_DT_MCUM_Torque_PwrEst, implementation-data-type=DT_MCUM_Torque_PwrEst
        application-data-type=DT_DT_MCUM_UserDefine_50ms, implementation-data-type=DT_MCUM_UserDefine_50ms
        application-data-type=DT_DT_MCUM_Torque_ExtChar, implementation-data-type=DT_MCUM_Torque_ExtChar
        application-data-type=DT_DT_MCUM_Damp_CompTorque, implementation-data-type=DT_MCUM_Damp_CompTorque
        application-data-type=DT_DT_MCUM_Damp_CompCoeff, implementation-data-type=DT_MCUM_Damp_CompCoeff
        application-data-type=DT_DT_MCUM_Damp_State, implementation-data-type=DT_MCUM_Damp_State
        application-data-type=DT_DT_MCUM_PWM_State, implementation-data-type=DT_MCUM_PWM_State
        application-data-type=DT_DT_MCUM_JuncTemp_Max, implementation-data-type=DT_MCUM_JuncTemp_Max
        application-data-type=DT_DT_MCUM_JuncLoss_Max, implementation-data-type=DT_MCUM_JuncLoss_Max
        application-data-type=DT_DT_MCUM_CurrAmp_Comp, implementation-data-type=DT_MCUM_CurrAmp_Comp
        application-data-type=DT_DT_MCUM_CurrTheta_Comp, implementation-data-type=DT_MCUM_CurrTheta_Comp
        application-data-type=DT_DT_MCUM_RawSinCorr, implementation-data-type=DT_MCUM_RawSinCorr
        application-data-type=DT_DT_MCUM_RawCosCorr, implementation-data-type=DT_MCUM_RawCosCorr
        application-data-type=DT_DT_MCUM_LUT_Spd, implementation-data-type=DT_MCUM_LUT_Spd
        application-data-type=DT_DT_MCUM_R_HighVoltPowerOffReq, implementation-data-type=DT_MCUM_R_HighVoltPowerOffReq
        application-data-type=DT_DT_MCUM_R_MaxTorqueAllow, implementation-data-type=DT_MCUM_R_MaxTorqueAllow
        application-data-type=DT_DT_MCUM_R_MaxSpeedAllow, implementation-data-type=DT_MCUM_R_MaxSpeedAllow
        application-data-type=DT_DT_MCUM_R_MinTorqueAllow, implementation-data-type=DT_MCUM_R_MinTorqueAllow
        application-data-type=DT_DT_MCUM_R_MotorTemp, implementation-data-type=DT_MCUM_R_MotorTemp
        application-data-type=DT_DT_MCUM_R_IGBTTemp, implementation-data-type=DT_MCUM_R_IGBTTemp
        application-data-type=DT_DT_MCUM_R_InletTemp, implementation-data-type=DT_MCUM_R_InletTemp
        application-data-type=DT_DT_MCUM_R_HeatPwrAllwd, implementation-data-type=DT_MCUM_R_HeatPwrAllwd
        application-data-type=DT_DT_MCUM_R_HeatFdBck, implementation-data-type=DT_MCUM_R_HeatFdBck
        application-data-type=DT_DT_MCUM_R_HeatPwrAct, implementation-data-type=DT_MCUM_R_HeatPwrAct
        application-data-type=DT_DT_MCUM_R_HeatPwrMax, implementation-data-type=DT_MCUM_R_HeatPwrMax
        application-data-type=DT_DT_MCUM_R_HeatPwrAval, implementation-data-type=DT_MCUM_R_HeatPwrAval
        application-data-type=DT_DT_MCUM_R_Vd_Ref, implementation-data-type=DT_MCUM_R_Vd_Ref
        application-data-type=DT_DT_MCUM_R_Vq_Ref, implementation-data-type=DT_MCUM_R_Vq_Ref
        application-data-type=DT_DT_MCUM_R_Id_LookUp, implementation-data-type=DT_MCUM_R_Id_LookUp
        application-data-type=DT_DT_MCUM_R_Iq_LookUp, implementation-data-type=DT_MCUM_R_Iq_LookUp
        application-data-type=DT_DT_MCUM_R_Spd_Delta, implementation-data-type=DT_MCUM_R_Spd_Delta
        application-data-type=DT_DT_MCUM_R_Us_Out, implementation-data-type=DT_MCUM_R_Us_Out
        application-data-type=DT_DT_MCUM_R_Torque_PwrEst, implementation-data-type=DT_MCUM_R_Torque_PwrEst
        application-data-type=DT_DT_MCUM_R_UserDefine_50ms, implementation-data-type=DT_MCUM_R_UserDefine_50ms
        application-data-type=DT_DT_MCUM_R_Torque_ExtChar, implementation-data-type=DT_MCUM_R_Torque_ExtChar
        application-data-type=DT_DT_MCUM_R_Damp_CompTorque, implementation-data-type=DT_MCUM_R_Damp_CompTorque
        application-data-type=DT_DT_MCUM_R_Damp_CompCoeff, implementation-data-type=DT_MCUM_R_Damp_CompCoeff
        application-data-type=DT_DT_MCUM_R_Damp_State, implementation-data-type=DT_MCUM_R_Damp_State
        application-data-type=DT_DT_MCUM_R_PWM_State, implementation-data-type=DT_MCUM_R_PWM_State
        application-data-type=DT_DT_MCUM_R_JuncTemp_Max, implementation-data-type=DT_MCUM_R_JuncTemp_Max
        application-data-type=DT_DT_MCUM_R_JuncLoss_Max, implementation-data-type=DT_MCUM_R_JuncLoss_Max
        application-data-type=DT_DT_MCUM_R_CurrAmp_Comp, implementation-data-type=DT_MCUM_R_CurrAmp_Comp
        application-data-type=DT_DT_MCUM_R_CurrTheta_Comp, implementation-data-type=DT_MCUM_R_CurrTheta_Comp
        application-data-type=DT_DT_MCUM_R_RawSinCorr, implementation-data-type=DT_MCUM_R_RawSinCorr
        application-data-type=DT_DT_MCUM_R_RawCosCorr, implementation-data-type=DT_MCUM_R_RawCosCorr
        application-data-type=DT_DT_MCUM_R_LUT_Spd, implementation-data-type=DT_MCUM_R_LUT_Spd
    DTMSMCUM_0x5D2
      data-type-maps:
        application-data-type=DT_DT_MCUM_R_StatorTemp_1, implementation-data-type=DT_MCUM_R_StatorTemp_1
        application-data-type=DT_DT_MCUM_R_L2TqAct, implementation-data-type=DT_MCUM_R_L2TqAct
        application-data-type=DT_DT_MCUM_R_EOPSw, implementation-data-type=DT_MCUM_R_EOPSw
        application-data-type=DT_DT_MCUM_R_StatorTemp_2, implementation-data-type=DT_MCUM_R_StatorTemp_2
        application-data-type=DT_DT_MCUM_R_IGBTTemp_U, implementation-data-type=DT_MCUM_R_IGBTTemp_U
        application-data-type=DT_DT_MCUM_R_IGBTTemp_V, implementation-data-type=DT_MCUM_R_IGBTTemp_V
        application-data-type=DT_DT_MCUM_R_IGBTTemp_W, implementation-data-type=DT_MCUM_R_IGBTTemp_W
        application-data-type=DT_DT_MCUM_R_Power_15V, implementation-data-type=DT_MCUM_R_Power_15V
        application-data-type=DT_DT_MCUM_R_Offset_IU, implementation-data-type=DT_MCUM_R_Offset_IU
        application-data-type=DT_DT_MCUM_R_Offset_IV, implementation-data-type=DT_MCUM_R_Offset_IV
        application-data-type=DT_DT_MCUM_R_Offset_IW, implementation-data-type=DT_MCUM_R_Offset_IW
        application-data-type=DT_DT_MCUM_R_MainSt_State, implementation-data-type=DT_MCUM_R_MainSt_State
        application-data-type=DT_DT_MCUM_R_Derate_Reason, implementation-data-type=DT_MCUM_R_Derate_Reason
        application-data-type=DT_DT_MCUM_R_PWM_Freq_kHz, implementation-data-type=DT_MCUM_R_PWM_Freq_kHz
        application-data-type=DT_DT_MCUM_R_PWMEn_State, implementation-data-type=DT_MCUM_R_PWMEn_State
        application-data-type=DT_DT_MCUM_R_DrvPwrEn_Out_State, implementation-data-type=DT_MCUM_R_DrvPwrEn_Out_State
        application-data-type=DT_DT_MCUM_R_NVM_RslvrZeroRFault, implementation-data-type=DT_MCUM_R_NVM_RslvrZeroRFault
        application-data-type=DT_DT_MCUM_R_Rotor_Position, implementation-data-type=DT_MCUM_R_Rotor_Position
        application-data-type=DT_DT_MCUM_R_PosTransduserFaultCode, implementation-data-type=DT_MCUM_R_PosTransduserFaultCode
        application-data-type=DT_DT_MCUM_R_NVM_RslvrDirRFault, implementation-data-type=DT_MCUM_R_NVM_RslvrDirRFault
        application-data-type=DT_DT_MCUM_R_NVM_RslvrDelayRFault, implementation-data-type=DT_MCUM_R_NVM_RslvrDelayRFault
        application-data-type=DT_DT_MCUM_R_NVM_RslvrParamRFault, implementation-data-type=DT_MCUM_R_NVM_RslvrParamRFault
        application-data-type=DT_DT_MCUM_R_NVM_HallGainRFault, implementation-data-type=DT_MCUM_R_NVM_HallGainRFault
        application-data-type=DT_DT_MCUM_R_NVM_HallDelayRFault, implementation-data-type=DT_MCUM_R_NVM_HallDelayRFault
        application-data-type=DT_DT_MCUM_R_NVM_IGBTTypeRFault, implementation-data-type=DT_MCUM_R_NVM_IGBTTypeRFault
        application-data-type=DT_DT_MCUM_R_ASC_EntryCount, implementation-data-type=DT_MCUM_R_ASC_EntryCount
        application-data-type=DT_DT_MCUM_R_Spd_Turn, implementation-data-type=DT_MCUM_R_Spd_Turn
        application-data-type=DT_DT_MCUM_R_LUT_Spd_Max, implementation-data-type=DT_MCUM_R_LUT_Spd_Max
        application-data-type=DT_DT_MCUM_R_EOP_Speed, implementation-data-type=DT_MCUM_R_EOP_Speed
        application-data-type=DT_DT_MCUM_R_EOP_IqFb, implementation-data-type=DT_MCUM_R_EOP_IqFb
        application-data-type=DT_DT_MCUM_R_EOP_IqRef, implementation-data-type=DT_MCUM_R_EOP_IqRef
        application-data-type=DT_DT_MCUM_R_EOP_DCVolt, implementation-data-type=DT_MCUM_R_EOP_DCVolt
        application-data-type=DT_DT_MCUM_R_EOP_DCCurr, implementation-data-type=DT_MCUM_R_EOP_DCCurr
        application-data-type=DT_DT_MCUM_R_EOP_Temp, implementation-data-type=DT_MCUM_R_EOP_Temp
        application-data-type=DT_DT_MCUM_R_EOP_State, implementation-data-type=DT_MCUM_R_EOP_State
        application-data-type=DT_DT_MCUM_R_EOP_FaultCode, implementation-data-type=DT_MCUM_R_EOP_FaultCode
        application-data-type=DT_DT_MCUM_R_HWFault_RstCnt, implementation-data-type=DT_MCUM_R_HWFault_RstCnt
        application-data-type=DT_DT_MCUM_R_HWFoB_RstCnt, implementation-data-type=DT_MCUM_R_HWFoB_RstCnt
        application-data-type=DT_DT_MCUM_R_HWFoT_RstCnt, implementation-data-type=DT_MCUM_R_HWFoT_RstCnt
        application-data-type=DT_DT_MCUM_R_HWDrvUV_RstCnt, implementation-data-type=DT_MCUM_R_HWDrvUV_RstCnt
        application-data-type=DT_DT_MCUM_R_HWRdc_RstCnt, implementation-data-type=DT_MCUM_R_HWRdc_RstCnt
        application-data-type=DT_DT_MCUM_R_HWOC_RstCnt, implementation-data-type=DT_MCUM_R_HWOC_RstCnt
        application-data-type=DT_DT_MCUM_R_HWOV_RstCnt, implementation-data-type=DT_MCUM_R_HWOV_RstCnt
        application-data-type=DT_DT_MCUM_R_L2agRtrElecDiff, implementation-data-type=DT_MCUM_R_L2agRtrElecDiff
        application-data-type=DT_DT_MCUM_R_500usOverTime_Cnt, implementation-data-type=DT_MCUM_R_500usOverTime_Cnt
        application-data-type=DT_DT_MCUM_R_5msOverTime_Cnt, implementation-data-type=DT_MCUM_R_5msOverTime_Cnt
        application-data-type=DT_DT_MCUM_R_CpldRest_TimeOut_flag, implementation-data-type=DT_MCUM_R_CpldRest_TimeOut_flag
        application-data-type=DT_DT_MCUM_R_DrvPCBCurr, implementation-data-type=DT_MCUM_R_DrvPCBCurr
        application-data-type=DT_DT_MCUM_R_EOL_StateMachine, implementation-data-type=DT_MCUM_R_EOL_StateMachine
        application-data-type=DT_DT_MCUM_R_CpldRest_ASC_Flag, implementation-data-type=DT_MCUM_R_CpldRest_ASC_Flag
        application-data-type=DT_DT_MCUM_R_LimSpdTorFlag, implementation-data-type=DT_MCUM_R_LimSpdTorFlag
        application-data-type=DT_DT_MCUM_R_PWM_Err_Count, implementation-data-type=DT_MCUM_R_PWM_Err_Count
        application-data-type=DT_DT_MCUM_R_RDC_Reset_Count, implementation-data-type=DT_MCUM_R_RDC_Reset_Count
        application-data-type=DT_DT_MCUM_R_ASC_Stop_Flag, implementation-data-type=DT_MCUM_R_ASC_Stop_Flag
        application-data-type=DT_DT_MCUM_R_ASC_Soft_Exiting_Flag, implementation-data-type=DT_MCUM_R_ASC_Soft_Exiting_Flag
        application-data-type=DT_DT_MCUM_R_Vbus_ServeLowChkEn, implementation-data-type=DT_MCUM_R_Vbus_ServeLowChkEn
        application-data-type=DT_DT_MCUM_R_EOP_BlockErr_IsLim_Flag, implementation-data-type=DT_MCUM_R_EOP_BlockErr_IsLim_Flag
        application-data-type=DT_DT_MCUM_R_IdqErrCount, implementation-data-type=DT_MCUM_R_IdqErrCount
        application-data-type=DT_DT_MCUM_R_MotSelfHeat_EnSts, implementation-data-type=DT_MCUM_R_MotSelfHeat_EnSts
        application-data-type=DT_DT_MCUM_R_MotBlockHeat_LvlFb, implementation-data-type=DT_MCUM_R_MotBlockHeat_LvlFb
        application-data-type=DT_DT_MCUM_R_MotRotaryHeat_LvlFb, implementation-data-type=DT_MCUM_R_MotRotaryHeat_LvlFb
        application-data-type=DT_DT_MCUM_R_MotSelfHeat_DropLvlFb, implementation-data-type=DT_MCUM_R_MotSelfHeat_DropLvlFb
        application-data-type=DT_DT_MCUM_R_MotSelfHeat_DropLvlRsn, implementation-data-type=DT_MCUM_R_MotSelfHeat_DropLvlRsn
        application-data-type=DT_DT_MCUM_R_MotBlockHeat_CurAngle, implementation-data-type=DT_MCUM_R_MotBlockHeat_CurAngle
        application-data-type=DT_DT_MCUM_R_MotBlockHeat_CurMag, implementation-data-type=DT_MCUM_R_MotBlockHeat_CurMag
        application-data-type=DT_DT_MCUM_R_UserDefine_Byte{1..4}, implementation-data-type=DT_MCUM_R_UserDefine_Byte{1..4}
        application-data-type=DT_DT_MCUM_R_UserDefine_Word{1..3}, implementation-data-type=DT_MCUM_R_UserDefine_Word{1..3}
    DTMSVCU_0x358
      data-type-maps:
        application-data-type=DT_DT_VCU_MotSelfHeatPwrFb, implementation-data-type=DT_VCU_MotSelfHeatPwrFb
        application-data-type=DT_DT_VCU_MotSelfHeatLvlFb, implementation-data-type=DT_VCU_MotSelfHeatLvlFb
        application-data-type=DT_DT_VCU_MCUMWaterPumpLevlReq, implementation-data-type=DT_VCU_MCUMWaterPumpLevlReq
        application-data-type=DT_DT_VCU_MCUSWaterPumpLevlReq, implementation-data-type=DT_VCU_MCUSWaterPumpLevlReq
        application-data-type=DT_DT_VCU_HeatPwrAval, implementation-data-type=DT_VCU_HeatPwrAval
        application-data-type=DT_DT_VCU_MotSelfHeatAllwd, implementation-data-type=DT_VCU_MotSelfHeatAllwd
        application-data-type=DT_DT_VCU_MMotSelfHeatEnReq, implementation-data-type=DT_VCU_MMotSelfHeatEnReq
        application-data-type=DT_DT_VCU_MMotSelfHeatLvlReq, implementation-data-type=DT_VCU_MMotSelfHeatLvlReq
        application-data-type=DT_DT_VCU_SMotSelfHeatEnReq, implementation-data-type=DT_VCU_SMotSelfHeatEnReq
        application-data-type=DT_DT_VCU_SMotSelfHeatLvlReq, implementation-data-type=DT_VCU_SMotSelfHeatLvlReq
    DTMSRMCU_0x2
      data-type-maps:
        application-data-type=DT_DT_Debug_MCU_CRC_CA, implementation-data-type=DT_Debug_MCU_CRC_CA
        application-data-type=DT_DT_Debug_MCU_RollingCounter_CA, implementation-data-type=DT_Debug_MCU_RollingCounter_CA
        application-data-type=DT_DT_Debug_MCU_WarningLevel, implementation-data-type=DT_Debug_MCU_WarningLevel
        application-data-type=DT_DT_Debug_MCU_SelfCheckSts, implementation-data-type=DT_Debug_MCU_SelfCheckSts
        application-data-type=DT_DT_Debug_MCU_DrvMotorWorkSts, implementation-data-type=DT_Debug_MCU_DrvMotorWorkSts
        application-data-type=DT_DT_Debug_MCU_PowerReduceSts, implementation-data-type=DT_Debug_MCU_PowerReduceSts
        application-data-type=DT_DT_Debug_MCU_DrvMotorRPM, implementation-data-type=DT_Debug_MCU_DrvMotorRPM
        application-data-type=DT_DT_Debug_MCU_ActualTorqueFB, implementation-data-type=DT_Debug_MCU_ActualTorqueFB
        application-data-type=DT_DT_Debug_MCU_HWRdcFault, implementation-data-type=DT_Debug_MCU_HWRdcFault
        application-data-type=DT_DT_Debug_MCU_HighVoltPowerOffReq, implementation-data-type=DT_Debug_MCU_HighVoltPowerOffReq
        application-data-type=DT_DT_Debug_MCU_HVILSts, implementation-data-type=DT_Debug_MCU_HVILSts
        application-data-type=DT_DT_Debug_MCU_DragSts, implementation-data-type=DT_Debug_MCU_DragSts
        application-data-type=DT_DT_Debug_MCU_CtrlMode, implementation-data-type=DT_Debug_MCU_CtrlMode
        application-data-type=DT_DT_Debug_MCU_MILlampReq, implementation-data-type=DT_Debug_MCU_MILlampReq
        application-data-type=DT_DT_Debug_MCU_DrvMotorRPMVD, implementation-data-type=DT_Debug_MCU_DrvMotorRPMVD
        application-data-type=DT_DT_Debug_MCU_ActualTorqueFBVD, implementation-data-type=DT_Debug_MCU_ActualTorqueFBVD
        application-data-type=DT_DT_Debug_MCU_MaxTorqueAllow, implementation-data-type=DT_Debug_MCU_MaxTorqueAllow
        application-data-type=DT_DT_Debug_MCU_MaxSpeedAllow, implementation-data-type=DT_Debug_MCU_MaxSpeedAllow
        application-data-type=DT_DT_Debug_MCU_ActiveReleaseSts, implementation-data-type=DT_Debug_MCU_ActiveReleaseSts
        application-data-type=DT_DT_Debug_MCU_DCChargRelaySts, implementation-data-type=DT_Debug_MCU_DCChargRelaySts
        application-data-type=DT_DT_Debug_MCUM_MinTorqueAllow, implementation-data-type=DT_Debug_MCUM_MinTorqueAllow
        application-data-type=DT_DT_Debug_MCU_MainWireVolt, implementation-data-type=DT_Debug_MCU_MainWireVolt
        application-data-type=DT_DT_Debug_MCU_MainWireCurr, implementation-data-type=DT_Debug_MCU_MainWireCurr
        application-data-type=DT_DT_Debug_MCUM_TMS_MotSelfHeatEnSts, implementation-data-type=DT_Debug_MCUM_TMS_MotSelfHeatEnSts
        application-data-type=DT_DT_Debug_MCUM_TMS_MotSelfHeatLvlFb, implementation-data-type=DT_Debug_MCUM_TMS_MotSelfHeatLvlFb
        application-data-type=DT_DT_Debug_MCUM_RPowerReduceSts, implementation-data-type=DT_Debug_MCUM_RPowerReduceSts
        application-data-type=DT_DT_Debug_MCUM_HeatPwrAval, implementation-data-type=DT_Debug_MCUM_HeatPwrAval
        application-data-type=DT_DT_Debug_MCUM_RCtrlMode, implementation-data-type=DT_Debug_MCUM_RCtrlMode
        application-data-type=DT_DT_Debug_MCUM_RWarningLevel, implementation-data-type=DT_Debug_MCUM_RWarningLevel
        application-data-type=DT_DT_Debug_MCUM_RSelfCheckSts, implementation-data-type=DT_Debug_MCUM_RSelfCheckSts
        application-data-type=DT_DT_Debug_MCUM_RDrvMotorWorkSts, implementation-data-type=DT_Debug_MCUM_RDrvMotorWorkSts
        application-data-type=DT_DT_Debug_MCUM_RCtrlModeVD, implementation-data-type=DT_Debug_MCUM_RCtrlModeVD
        application-data-type=DT_DT_Debug_MCUM_RHWRdcFault, implementation-data-type=DT_Debug_MCUM_RHWRdcFault
        application-data-type=DT_DT_Debug_MCUM_RDrvMotorRPMVD, implementation-data-type=DT_Debug_MCUM_RDrvMotorRPMVD
        application-data-type=DT_DT_Debug_MCUM_RActualTorqueFBVD, implementation-data-type=DT_Debug_MCUM_RActualTorqueFBVD
        application-data-type=DT_DT_Debug_MCUM_RDrvMotorRPM, implementation-data-type=DT_Debug_MCUM_RDrvMotorRPM
        application-data-type=DT_DT_Debug_MCUM_RActualTorqueFB, implementation-data-type=DT_Debug_MCUM_RActualTorqueFB
    DTMSIBS_0x225
      data-type-maps:
        application-data-type=DT_DT_IBS_CRC_225, implementation-data-type=DT_IBS_CRC_225
        application-data-type=DT_DT_IBS_RollingCounter_225, implementation-data-type=DT_IBS_RollingCounter_225
        application-data-type=DT_DT_IBS_Warning_Level, implementation-data-type=DT_IBS_Warning_Level
    DTMSADDC_0x84
      data-type-maps:
        application-data-type=DT_DT_ADDC_CRC_84, implementation-data-type=DT_ADDC_CRC_84
        application-data-type=DT_DT_ADDC_APS_AVHReq, implementation-data-type=DT_ADDC_APS_AVHReq
        application-data-type=DT_DT_ADDC_APS_HoldSts, implementation-data-type=DT_ADDC_APS_HoldSts
        application-data-type=DT_DT_ADDC_APSTargetTrqBrkVD, implementation-data-type=DT_ADDC_APSTargetTrqBrkVD
        application-data-type=DT_DT_ADDC_APSTargetTrqBrk, implementation-data-type=DT_ADDC_APSTargetTrqBrk
        application-data-type=DT_DT_ADDC_APSTargetTrqVD, implementation-data-type=DT_ADDC_APSTargetTrqVD
        application-data-type=DT_DT_ADDC_APSTargetTrq, implementation-data-type=DT_ADDC_APSTargetTrq
        application-data-type=DT_DT_ADDC_safety_valid, implementation-data-type=DT_ADDC_safety_valid
        application-data-type=DT_DT_ADDC_rearsafety_level, implementation-data-type=DT_ADDC_rearsafety_level
        application-data-type=DT_DT_ADDC_frontsafety_level, implementation-data-type=DT_ADDC_frontsafety_level
        application-data-type=DT_DT_ADDC_rightsafety_level, implementation-data-type=DT_ADDC_rightsafety_level
        application-data-type=DT_DT_ADDC_leftsafety_level, implementation-data-type=DT_ADDC_leftsafety_level
        application-data-type=DT_DT_ADDC_RollingCounter_84, implementation-data-type=DT_ADDC_RollingCounter_84
        application-data-type=DT_DT_ADDC_APS_EnableReq, implementation-data-type=DT_ADDC_APS_EnableReq
        application-data-type=DT_DT_ADDC_APS_WorkSts, implementation-data-type=DT_ADDC_APS_WorkSts
        application-data-type=DT_DT_ADDC_APS_PDCVehicleDirectCtlVD, implementation-data-type=DT_ADDC_APS_PDCVehicleDirectCtlVD
        application-data-type=DT_DT_ADDC_APS_VehicleSpeedCtlVD, implementation-data-type=DT_ADDC_APS_VehicleSpeedCtlVD
        application-data-type=DT_DT_ADDC_APS_PDC_VehicleDirectCtl, implementation-data-type=DT_ADDC_APS_PDC_VehicleDirectCtl
        application-data-type=DT_DT_ADDC_APS_PDC_SWAngCtl, implementation-data-type=DT_ADDC_APS_PDC_SWAngCtl
        application-data-type=DT_DT_ADDC_APS_ParkingReq, implementation-data-type=DT_ADDC_APS_ParkingReq
        application-data-type=DT_DT_ADDC_APS_EmergenceBrake, implementation-data-type=DT_ADDC_APS_EmergenceBrake
        application-data-type=DT_DT_ADDC_APS_TargetAccVD, implementation-data-type=DT_ADDC_APS_TargetAccVD
        application-data-type=DT_DT_ADDC_APS_TargetAcc, implementation-data-type=DT_ADDC_APS_TargetAcc
        application-data-type=DT_DT_ADDC_APS_VehicleSpeedCtl, implementation-data-type=DT_ADDC_APS_VehicleSpeedCtl
        application-data-type=DT_DT_ADDC_APS_DecToStop, implementation-data-type=DT_ADDC_APS_DecToStop
        application-data-type=DT_DT_ADDC_APS_Driveoff_Request, implementation-data-type=DT_ADDC_APS_Driveoff_Request
        application-data-type=DT_DT_ADDC_APS_FuncType, implementation-data-type=DT_ADDC_APS_FuncType
        application-data-type=DT_DT_ADDC_APS_Available, implementation-data-type=DT_ADDC_APS_Available
    DTMSIVI_0x5F6
      data-type-maps:
        application-data-type=DT_DT_IVI_Year, implementation-data-type=DT_IVI_Year
        application-data-type=DT_DT_IVI_Month, implementation-data-type=DT_IVI_Month
        application-data-type=DT_DT_IVI_Data, implementation-data-type=DT_IVI_Data
        application-data-type=DT_DT_IVI_Hour, implementation-data-type=DT_IVI_Hour
        application-data-type=DT_DT_IVI_Minute, implementation-data-type=DT_IVI_Minute
        application-data-type=DT_DT_IVI_Second, implementation-data-type=DT_IVI_Second
    DTMSDCDC_0x324
      data-type-maps:
        application-data-type=DT_DT_DCDC_CRC_324, implementation-data-type=DT_DCDC_CRC_324
        application-data-type=DT_DT_DCDC_RollingCounter_324, implementation-data-type=DT_DCDC_RollingCounter_324
        application-data-type=DT_DT_DCDC_WorkSts, implementation-data-type=DT_DCDC_WorkSts
        application-data-type=DT_DT_DCDC_Under_Output_Voltage, implementation-data-type=DT_DCDC_Under_Output_Voltage
        application-data-type=DT_DT_DCDC_Over_Output_Voltage, implementation-data-type=DT_DCDC_Over_Output_Voltage
        application-data-type=DT_DT_DCDC_Under_Input_Voltage, implementation-data-type=DT_DCDC_Under_Input_Voltage
        application-data-type=DT_DT_DCDC_Over_Input_Voltage, implementation-data-type=DT_DCDC_Over_Input_Voltage
        application-data-type=DT_DT_DCDC_Over_Input_Current, implementation-data-type=DT_DCDC_Over_Input_Current
        application-data-type=DT_DT_DCDC_Real_Output_Current, implementation-data-type=DT_DCDC_Real_Output_Current
        application-data-type=DT_DT_DCDC_Real_Output_Voltage, implementation-data-type=DT_DCDC_Real_Output_Voltage
        application-data-type=DT_DT_DCDC_Real_Input_Current, implementation-data-type=DT_DCDC_Real_Input_Current
        application-data-type=DT_DT_DCDC_Real_Input_Voltage, implementation-data-type=DT_DCDC_Real_Input_Voltage
        application-data-type=DT_DT_DCDC_Derating, implementation-data-type=DT_DCDC_Derating
        application-data-type=DT_DT_DCDC_Hardware_Fault_Flag, implementation-data-type=DT_DCDC_Hardware_Fault_Flag
        application-data-type=DT_DT_CDU_ACChg_HIVSts, implementation-data-type=DT_CDU_ACChg_HIVSts
        application-data-type=DT_DT_CDU_OBC_OverTemp, implementation-data-type=DT_CDU_OBC_OverTemp
        application-data-type=DT_DT_CDU_SelfCheckSt, implementation-data-type=DT_CDU_SelfCheckSt
        application-data-type=DT_DT_CDU_HV_HIVSts, implementation-data-type=DT_CDU_HV_HIVSts
    DTMSFSC_0x142
      data-type-maps:
        application-data-type=DT_DT_FSC_CRC_142, implementation-data-type=DT_FSC_CRC_142
        application-data-type=DT_DT_FSC_RollingCounter_142, implementation-data-type=DT_FSC_RollingCounter_142
        application-data-type=DT_DT_FSC_LCC_Mode, implementation-data-type=DT_FSC_LCC_Mode
    DTMSMCU_0x5C6
      data-type-maps:
        application-data-type=DT_DT_MotClb_FaultCode{1..8}, implementation-data-type=DT_MotClb_FaultCode{1..8}
        application-data-type=DT_DT_MotClb_OfsApply, implementation-data-type=DT_MotClb_OfsApply
        application-data-type=DT_DT_MCUMR_MotClb_FaultCode{1..8}, implementation-data-type=DT_MCUMR_MotClb_FaultCode{1..8}
        application-data-type=DT_DT_MCUMR_MotClb_OfsApply, implementation-data-type=DT_MCUMR_MotClb_OfsApply
    DTMSMCU_0x5C5
      data-type-maps:
        application-data-type=DT_DT_EOL_ModeCMD_Data{0..5}, implementation-data-type=DT_EOL_ModeCMD_Data{0..5}
        application-data-type=DT_DT_EOL_ModeCMD_Enable, implementation-data-type=DT_EOL_ModeCMD_Enable
        application-data-type=DT_DT_EOL_ModeCMD_Check, implementation-data-type=DT_EOL_ModeCMD_Check
        application-data-type=DT_DT_EOL_GainIden_UsApply, implementation-data-type=DT_EOL_GainIden_UsApply
        application-data-type=DT_DT_EOL_MotClb_CtrlMode, implementation-data-type=DT_EOL_MotClb_CtrlMode
        application-data-type=DT_DT_MotClb_OfsSet, implementation-data-type=DT_MotClb_OfsSet
        application-data-type=DT_DT_EOL_MotClb_IsCMD, implementation-data-type=DT_EOL_MotClb_IsCMD
        application-data-type=DT_DT_EOL_MotClb_ThetaCMD, implementation-data-type=DT_EOL_MotClb_ThetaCMD
        application-data-type=DT_DT_EOL_frqsync, implementation-data-type=DT_EOL_frqsync
        application-data-type=DT_DT_EOL_MotClb_Enable, implementation-data-type=DT_EOL_MotClb_Enable
        application-data-type=DT_DT_EOL_ActiveReleaseCmd, implementation-data-type=DT_EOL_ActiveReleaseCmd
        application-data-type=DT_DT_MotClb_OfsAdjEn, implementation-data-type=DT_MotClb_OfsAdjEn
        application-data-type=DT_DT_EOL_Asc_CMD, implementation-data-type=DT_EOL_Asc_CMD
        application-data-type=DT_DT_EOL_PosDly_SnsrSupplier, implementation-data-type=DT_EOL_PosDly_SnsrSupplier
        application-data-type=DT_DT_FstRcrd_Enable, implementation-data-type=DT_FstRcrd_Enable
        application-data-type=DT_DT_GainIden_CurrRMS_Ref_U, implementation-data-type=DT_GainIden_CurrRMS_Ref_U
        application-data-type=DT_DT_GainIden_CurrRMS_Ref_V, implementation-data-type=DT_GainIden_CurrRMS_Ref_V
        application-data-type=DT_DT_GainIden_CurrRMS_Ref_W, implementation-data-type=DT_GainIden_CurrRMS_Ref_W
        application-data-type=DT_DT_MCUMR_EOL_GainIden_UsApply, implementation-data-type=DT_MCUMR_EOL_GainIden_UsApply
        application-data-type=DT_DT_MCUMR_EOL_MotClb_CtrlMode, implementation-data-type=DT_MCUMR_EOL_MotClb_CtrlMode
        application-data-type=DT_DT_MCUMR_MotClb_OfsSet, implementation-data-type=DT_MCUMR_MotClb_OfsSet
        application-data-type=DT_DT_MCUMR_EOL_MotClb_IsCMD, implementation-data-type=DT_MCUMR_EOL_MotClb_IsCMD
        application-data-type=DT_DT_MCUMR_EOL_MotClb_ThetaCMD, implementation-data-type=DT_MCUMR_EOL_MotClb_ThetaCMD
        application-data-type=DT_DT_MCUMR_EOL_frqsync, implementation-data-type=DT_MCUMR_EOL_frqsync
        application-data-type=DT_DT_MCUMR_EOL_MotClb_Enable, implementation-data-type=DT_MCUMR_EOL_MotClb_Enable
        application-data-type=DT_DT_MCUMR_EOL_ActiveReleaseCmd, implementation-data-type=DT_MCUMR_EOL_ActiveReleaseCmd
        application-data-type=DT_DT_MCUMR_MotClb_OfsAdjEn, implementation-data-type=DT_MCUMR_MotClb_OfsAdjEn
        application-data-type=DT_DT_MCUMR_EOL_Asc_CMD, implementation-data-type=DT_MCUMR_EOL_Asc_CMD
        application-data-type=DT_DT_MCUMR_EOL_PosDly_SnsrSupplier, implementation-data-type=DT_MCUMR_EOL_PosDly_SnsrSupplier
        application-data-type=DT_DT_MCUMR_FstRcrd_Enable, implementation-data-type=DT_MCUMR_FstRcrd_Enable
        application-data-type=DT_DT_MCUMR_GainIden_CurrRMS_Ref_U, implementation-data-type=DT_MCUMR_GainIden_CurrRMS_Ref_U
        application-data-type=DT_DT_MCUMR_GainIden_CurrRMS_Ref_V, implementation-data-type=DT_MCUMR_GainIden_CurrRMS_Ref_V
        application-data-type=DT_DT_MCUMR_GainIden_CurrRMS_Ref_W, implementation-data-type=DT_MCUMR_GainIden_CurrRMS_Ref_W
    DTMSMCUS_0x14
      data-type-maps:
        application-data-type=DT_DT_MCUS_CRC_14, implementation-data-type=DT_MCUS_CRC_14
        application-data-type=DT_DT_MCUS_RollingCounter_14, implementation-data-type=DT_MCUS_RollingCounter_14
        application-data-type=DT_DT_MCUS_DrvMotorRPM_prvt, implementation-data-type=DT_MCUS_DrvMotorRPM_prvt
        application-data-type=DT_DT_MCUS_ActualTorqueFB_prvt, implementation-data-type=DT_MCUS_ActualTorqueFB_prvt
        application-data-type=DT_DT_MCUS_DrvMotorRPMVD_prvt, implementation-data-type=DT_MCUS_DrvMotorRPMVD_prvt
        application-data-type=DT_DT_MCUS_ActualTorqueFBVD_prvt, implementation-data-type=DT_MCUS_ActualTorqueFBVD_prvt
    DTMSMCU_0x5C7
      data-type-maps:
        application-data-type=DT_DT_U16_CMD{1..4}, implementation-data-type=DT_U16_CMD{1..4}
        application-data-type=DT_DT_S16_CMD{1..4}, implementation-data-type=DT_S16_CMD{1..4}
        application-data-type=DT_DT_R16_CMD{1..4}, implementation-data-type=DT_R16_CMD{1..4}
        application-data-type=DT_DT_U8_CMD{1..8}, implementation-data-type=DT_U8_CMD{1..8}
    DTMSOBC_0x316
      data-type-maps:
        application-data-type=DT_DT_OBC_CRC_316, implementation-data-type=DT_OBC_CRC_316
        application-data-type=DT_DT_OBC_RollingCounter_316, implementation-data-type=DT_OBC_RollingCounter_316
        application-data-type=DT_DT_OBC_WorkSts, implementation-data-type=DT_OBC_WorkSts
        application-data-type=DT_DT_OBC_StartSts, implementation-data-type=DT_OBC_StartSts
        application-data-type=DT_DT_OBC_DCSts, implementation-data-type=DT_OBC_DCSts
        application-data-type=DT_DT_OBC_ACChargeOutputSts, implementation-data-type=DT_OBC_ACChargeOutputSts
        application-data-type=DT_DT_OBC_DCVolt, implementation-data-type=DT_OBC_DCVolt
        application-data-type=DT_DT_OBC_HardwareSts, implementation-data-type=DT_OBC_HardwareSts
        application-data-type=DT_DT_OBC_DCCurr, implementation-data-type=DT_OBC_DCCurr
        application-data-type=DT_DT_OBC_ACVolt, implementation-data-type=DT_OBC_ACVolt
        application-data-type=DT_DT_OBC_ACCurr, implementation-data-type=DT_OBC_ACCurr
        application-data-type=DT_DT_OBC_CCConnectSts, implementation-data-type=DT_OBC_CCConnectSts
        application-data-type=DT_DT_OBC_CPDutyCycleFault, implementation-data-type=DT_OBC_CPDutyCycleFault
        application-data-type=DT_DT_OBC_CPDutyCycleValue, implementation-data-type=DT_OBC_CPDutyCycleValue
        application-data-type=DT_DT_OBC_ACMaxPower, implementation-data-type=DT_OBC_ACMaxPower
        application-data-type=DT_DT_OBC_ACPowerState, implementation-data-type=DT_OBC_ACPowerState
    DTMSLMC_0xFA
      data-type-maps:
        application-data-type=DT_DT_LMC_CRC_FA, implementation-data-type=DT_LMC_CRC_FA
        application-data-type=DT_DT_LMC_RollingCounter_FA, implementation-data-type=DT_LMC_RollingCounter_FA
        application-data-type=DT_DT_LMC_EngTorqDec_Main, implementation-data-type=DT_LMC_EngTorqDec_Main
        application-data-type=DT_DT_LMC_EngTorqDecActive_Main, implementation-data-type=DT_LMC_EngTorqDecActive_Main
        application-data-type=DT_DT_LMC_AMM_St, implementation-data-type=DT_LMC_AMM_St
        application-data-type=DT_DT_LMC_EngTorqInc_Main, implementation-data-type=DT_LMC_EngTorqInc_Main
        application-data-type=DT_DT_LMC_EngTorqIncActive_Main, implementation-data-type=DT_LMC_EngTorqIncActive_Main
        application-data-type=DT_DT_LMC_EngTorqDec_Sub, implementation-data-type=DT_LMC_EngTorqDec_Sub
        application-data-type=DT_DT_LMC_EngTorqDecActive_Sub, implementation-data-type=DT_LMC_EngTorqDecActive_Sub
        application-data-type=DT_DT_LMC_EngTorqInc_Sub, implementation-data-type=DT_LMC_EngTorqInc_Sub
        application-data-type=DT_DT_LMC_EngTorqIncActive_Sub, implementation-data-type=DT_LMC_EngTorqIncActive_Sub
        application-data-type=DT_DT_LMC_SysSt, implementation-data-type=DT_LMC_SysSt
        application-data-type=DT_DT_LMC_HSPC_ActiveSt, implementation-data-type=DT_LMC_HSPC_ActiveSt
        application-data-type=DT_DT_LMC_FTSC_ActiveSt, implementation-data-type=DT_LMC_FTSC_ActiveSt
        application-data-type=DT_DT_LMC_SDRM_ActiveSt, implementation-data-type=DT_LMC_SDRM_ActiveSt
        application-data-type=DT_DT_LMC_NSPC_ActiveSt, implementation-data-type=DT_LMC_NSPC_ActiveSt
        application-data-type=DT_DT_LMC_EAF_ActiveSt, implementation-data-type=DT_LMC_EAF_ActiveSt
        application-data-type=DT_DT_LMC_SelfCheckSt, implementation-data-type=DT_LMC_SelfCheckSt
        application-data-type=DT_DT_LMC_WBDC_ActiveSt, implementation-data-type=DT_LMC_WBDC_ActiveSt
        application-data-type=DT_DT_LMC_LSFCActiveSt, implementation-data-type=DT_LMC_LSFCActiveSt
        application-data-type=DT_DT_LMC_EngTorqDec_Main_R, implementation-data-type=DT_LMC_EngTorqDec_Main_R
        application-data-type=DT_DT_LMC_EngTorqDecActive_Main_R, implementation-data-type=DT_LMC_EngTorqDecActive_Main_R
        application-data-type=DT_DT_LMC_EngTorqInc_Main_R, implementation-data-type=DT_LMC_EngTorqInc_Main_R
        application-data-type=DT_DT_LMC_EngTorqIncActive_Main_R, implementation-data-type=DT_LMC_EngTorqIncActive_Main_R
    DTMSLMC_0x18C
      data-type-maps:
        application-data-type=DT_DT_LMC_CRC_18C, implementation-data-type=DT_LMC_CRC_18C
        application-data-type=DT_DT_LMC_RollingCounter_18C, implementation-data-type=DT_LMC_RollingCounter_18C
        application-data-type=DT_DT_LMC_TqTotalBrakeTorque, implementation-data-type=DT_LMC_TqTotalBrakeTorque
        application-data-type=DT_DT_LMC_TqTotalBrakeTorque_Valid, implementation-data-type=DT_LMC_TqTotalBrakeTorque_Valid
        application-data-type=DT_DT_LMC_CmpUTurnLockwhists, implementation-data-type=DT_LMC_CmpUTurnLockwhists
    DTMSHPCGW_0x3B1
      data-type-maps:
        application-data-type=DT_DT_GW_CRC_3B1, implementation-data-type=DT_GW_CRC_3B1
        application-data-type=DT_DT_GW_RollingCounter_3B1, implementation-data-type=DT_GW_RollingCounter_3B1
        application-data-type=DT_DT_GW_ACU_FLSeatBeltRSt, implementation-data-type=DT_GW_ACU_FLSeatBeltRSt
        application-data-type=DT_DT_GW_ACU_FRSeatBeltRSt, implementation-data-type=DT_GW_ACU_FRSeatBeltRSt
        application-data-type=DT_DT_GW_IBC_EPB_Status, implementation-data-type=DT_GW_IBC_EPB_Status
        application-data-type=DT_DT_GW_ACU_TotalCrashOutputSts, implementation-data-type=DT_GW_ACU_TotalCrashOutputSts
        application-data-type=DT_DT_GW_BZCU_DCChgExitTemp_Pos, implementation-data-type=DT_GW_BZCU_DCChgExitTemp_Pos
        application-data-type=DT_DT_GW_BZCU_DCChgExitTemp_Neg, implementation-data-type=DT_GW_BZCU_DCChgExitTemp_Neg
        application-data-type=DT_DT_GW_BZCU_ACChgExitTemp_Pos, implementation-data-type=DT_GW_BZCU_ACChgExitTemp_Pos
        application-data-type=DT_DT_GW_BZCU_FuelTankSts, implementation-data-type=DT_GW_BZCU_FuelTankSts
        application-data-type=DT_DT_GW_BZCU_LBMS_VoltA, implementation-data-type=DT_GW_BZCU_LBMS_VoltA
        application-data-type=DT_DT_GW_BZCU_ACChgExitTemp_Neg, implementation-data-type=DT_GW_BZCU_ACChgExitTemp_Neg
        application-data-type=DT_DT_GW_BZCU_FuelTankStsLockSts, implementation-data-type=DT_GW_BZCU_FuelTankStsLockSts
        application-data-type=DT_DT_GW_BZCU_FuelTankLockCtrl, implementation-data-type=DT_GW_BZCU_FuelTankLockCtrl
        application-data-type=DT_DT_GW_BZCU_ACChgLockSts, implementation-data-type=DT_GW_BZCU_ACChgLockSts
        application-data-type=DT_DT_GW_RZCU_Cabin_220Vconnect_Sts, implementation-data-type=DT_GW_RZCU_Cabin_220Vconnect_Sts
        application-data-type=DT_DT_GW_BZCU_Cab_220VRelay_CtrlSts, implementation-data-type=DT_GW_BZCU_Cab_220VRelay_CtrlSts
        application-data-type=DT_DT_GW_BZCU_Cab_PDU220VRelay_CtrlSts, implementation-data-type=DT_GW_BZCU_Cab_PDU220VRelay_CtrlSts
        application-data-type=DT_DT_GW_BZCU_Cabin_220VRelay_CtrlSts, implementation-data-type=DT_GW_BZCU_Cabin_220VRelay_CtrlSts
        application-data-type=DT_DT_GW_BZCU_Cab_220Vconnect_Sts, implementation-data-type=DT_GW_BZCU_Cab_220Vconnect_Sts
        application-data-type=DT_DT_GW_TBOXSOC_Altitude, implementation-data-type=DT_GW_TBOXSOC_Altitude
    DTMSVCU_0x359
      data-type-maps:
        application-data-type=DT_DT_VCU_EolCfg_ESC, implementation-data-type=DT_VCU_EolCfg_ESC
        application-data-type=DT_DT_VCU_IMMOKeyWriteCnt, implementation-data-type=DT_VCU_IMMOKeyWriteCnt
        application-data-type=DT_DT_VCU_AbStartupFlag, implementation-data-type=DT_VCU_AbStartupFlag
        application-data-type=DT_DT_VCU_AbResetFlag, implementation-data-type=DT_VCU_AbResetFlag
        application-data-type=DT_DT_VCU_AbResetlnitFinish, implementation-data-type=DT_VCU_AbResetlnitFinish
        application-data-type=DT_DT_VCU_EolCfg_EPB, implementation-data-type=DT_VCU_EolCfg_EPB
        application-data-type=DT_DT_VCU_EolCfg_AEB, implementation-data-type=DT_VCU_EolCfg_AEB
        application-data-type=DT_DT_VCU_EolCfg_InverterFunc, implementation-data-type=DT_VCU_EolCfg_InverterFunc
        application-data-type=DT_DT_VCU_EolCfg_APS, implementation-data-type=DT_VCU_EolCfg_APS
        application-data-type=DT_DT_VCU_EolCfg_VehiModels, implementation-data-type=DT_VCU_EolCfg_VehiModels
        application-data-type=DT_DT_VCU_EolCfg_SpdLmtVal, implementation-data-type=DT_VCU_EolCfg_SpdLmtVal
        application-data-type=DT_DT_VCU_EolCfg_WheelType, implementation-data-type=DT_VCU_EolCfg_WheelType
        application-data-type=DT_DT_VCU_EolCfg_Curise, implementation-data-type=DT_VCU_EolCfg_Curise
        application-data-type=DT_DT_VCU_REStartReq, implementation-data-type=DT_VCU_REStartReq
        application-data-type=DT_DT_VCU_REStopReq, implementation-data-type=DT_VCU_REStopReq
        application-data-type=DT_DT_VCU_EolCfg_VehiType, implementation-data-type=DT_VCU_EolCfg_VehiType
        application-data-type=DT_DT_VCU_EolCfg_MotPwr, implementation-data-type=DT_VCU_EolCfg_MotPwr
        application-data-type=DT_DT_VCU_Vehicle_NVHPwrLimitVal, implementation-data-type=DT_VCU_Vehicle_NVHPwrLimitVal
        application-data-type=DT_DT_VCU_EolCfg_MotDrvStructure, implementation-data-type=DT_VCU_EolCfg_MotDrvStructure
        application-data-type=DT_DT_VCU_WLTCModeFlag, implementation-data-type=DT_VCU_WLTCModeFlag
        application-data-type=DT_DT_VCU_EolCfg_RudderDir, implementation-data-type=DT_VCU_EolCfg_RudderDir
        application-data-type=DT_DT_VCU_EolCfg_DCChgRelayPos, implementation-data-type=DT_VCU_EolCfg_DCChgRelayPos
        application-data-type=DT_DT_VCU_EolCfg_FPTCIL, implementation-data-type=DT_VCU_EolCfg_FPTCIL
        application-data-type=DT_DT_VCU_PWakeupSt, implementation-data-type=DT_VCU_PWakeupSt
        application-data-type=DT_DT_VCU_SpdLimitReason, implementation-data-type=DT_VCU_SpdLimitReason
        application-data-type=DT_DT_BSW_VertifySts, implementation-data-type=DT_BSW_VertifySts
        application-data-type=DT_DT_VCU_InterAllowEngStart, implementation-data-type=DT_VCU_InterAllowEngStart
        application-data-type=DT_DT_VCU_EngineOff_Flag, implementation-data-type=DT_VCU_EngineOff_Flag
        application-data-type=DT_DT_VCU_EngineStopAllow, implementation-data-type=DT_VCU_EngineStopAllow
        application-data-type=DT_DT_VCU_EmergencyStopReq, implementation-data-type=DT_VCU_EmergencyStopReq
        application-data-type=DT_DT_VCU_EngineAllowStop, implementation-data-type=DT_VCU_EngineAllowStop
        application-data-type=DT_DT_VCU_REVehiWheelTrqReq, implementation-data-type=DT_VCU_REVehiWheelTrqReq
        application-data-type=DT_DT_VCU_REHighPerformVehiPwr, implementation-data-type=DT_VCU_REHighPerformVehiPwr
        application-data-type=DT_DT_VCU_REPwrDampingFactor, implementation-data-type=DT_VCU_REPwrDampingFactor
        application-data-type=DT_DT_VCU_REDrvTarPwrFit, implementation-data-type=DT_VCU_REDrvTarPwrFit
        application-data-type=DT_DT_VCU_AdditionalPwrVal, implementation-data-type=DT_VCU_AdditionalPwrVal
        application-data-type=DT_DT_VCU_VehichRealPwDown, implementation-data-type=DT_VCU_VehichRealPwDown
        application-data-type=DT_DT_VCU_IMMOStsResult, implementation-data-type=DT_VCU_IMMOStsResult
        application-data-type=DT_DT_VCU_IMMOStateMachine, implementation-data-type=DT_VCU_IMMOStateMachine
        application-data-type=DT_DT_VCU_ShowCarModeNvmResult, implementation-data-type=DT_VCU_ShowCarModeNvmResult
        application-data-type=DT_DT_VCU_DeliveryModeNvmData, implementation-data-type=DT_VCU_DeliveryModeNvmData
        application-data-type=DT_DT_VCU_AccPedFaultLvNvmResult, implementation-data-type=DT_VCU_AccPedFaultLvNvmResult
        application-data-type=DT_DT_VCU_VehicleConfigNvmResult, implementation-data-type=DT_VCU_VehicleConfigNvmResult
        application-data-type=DT_DT_VCU_EngRunTimeNvmResult, implementation-data-type=DT_VCU_EngRunTimeNvmResult
    DTMSVCU_0x514
      data-type-maps:
        application-data-type=DT_DT_VCU_FuelConsumption, implementation-data-type=DT_VCU_FuelConsumption
        application-data-type=DT_DT_VCU_SVSLamp, implementation-data-type=DT_VCU_SVSLamp
        application-data-type=DT_DT_VCU_MilLamp, implementation-data-type=DT_VCU_MilLamp
        application-data-type=DT_DT_VCU_SinglePedalSts_ID514, implementation-data-type=DT_VCU_SinglePedalSts_ID514
        application-data-type=DT_DT_VCU_GearLevelPosFault_ID514, implementation-data-type=DT_VCU_GearLevelPosFault_ID514
        application-data-type=DT_DT_VCU_EngineStartFailure_ID514, implementation-data-type=DT_VCU_EngineStartFailure_ID514
        application-data-type=DT_DT_VCU_ParkBeforeFuelup, implementation-data-type=DT_VCU_ParkBeforeFuelup
        application-data-type=DT_DT_VCU_REsystemFaultSts_ID514, implementation-data-type=DT_VCU_REsystemFaultSts_ID514
        application-data-type=DT_DT_VCU_EngineRunAllowFlg_ID514, implementation-data-type=DT_VCU_EngineRunAllowFlg_ID514
        application-data-type=DT_DT_VCU_InverterTip, implementation-data-type=DT_VCU_InverterTip
        application-data-type=DT_DT_VCU_EMSRepairModeSts, implementation-data-type=DT_VCU_EMSRepairModeSts
        application-data-type=DT_DT_VCU_FuelTankFlapSts, implementation-data-type=DT_VCU_FuelTankFlapSts
        application-data-type=DT_DT_VCU_REsystemSts_ID514, implementation-data-type=DT_VCU_REsystemSts_ID514
        application-data-type=DT_DT_VCU_PowerModeAllow, implementation-data-type=DT_VCU_PowerModeAllow
        application-data-type=DT_DT_VCU_PowerModeSwitchMsg, implementation-data-type=DT_VCU_PowerModeSwitchMsg
        application-data-type=DT_DT_VCU_HighVoltFailed_M, implementation-data-type=DT_VCU_HighVoltFailed_M
        application-data-type=DT_DT_VCU_HighVoltFailed_S, implementation-data-type=DT_VCU_HighVoltFailed_S
        application-data-type=DT_DT_VCU_BrakeBeforeGear, implementation-data-type=DT_VCU_BrakeBeforeGear
        application-data-type=DT_DT_VCU_ParkBeforeGear, implementation-data-type=DT_VCU_ParkBeforeGear
        application-data-type=DT_DT_VCU_GearBeforDriving, implementation-data-type=DT_VCU_GearBeforDriving
        application-data-type=DT_DT_VCU_UnlockBeforeDriving, implementation-data-type=DT_VCU_UnlockBeforeDriving
        application-data-type=DT_DT_VCU_PreventSliding, implementation-data-type=DT_VCU_PreventSliding
        application-data-type=DT_DT_VCU_MMErrorSts, implementation-data-type=DT_VCU_MMErrorSts
        application-data-type=DT_DT_VCU_ShowCarModeSts, implementation-data-type=DT_VCU_ShowCarModeSts
        application-data-type=DT_DT_VCU_PGearFlashSts, implementation-data-type=DT_VCU_PGearFlashSts
        application-data-type=DT_DT_VCU_ACConnectSts, implementation-data-type=DT_VCU_ACConnectSts
        application-data-type=DT_DT_VCU_DcChgPwrSts, implementation-data-type=DT_VCU_DcChgPwrSts
        application-data-type=DT_DT_VCU_DriverAssistProhibitSts_ID514, implementation-data-type=DT_VCU_DriverAssistProhibitSts_ID514
        application-data-type=DT_DT_VCU_MilLampRequest_ID514, implementation-data-type=DT_VCU_MilLampRequest_ID514
        application-data-type=DT_DT_VCU_CcmHvilInSigFreq_FB, implementation-data-type=DT_VCU_CcmHvilInSigFreq_FB
        application-data-type=DT_DT_VCU_CcmHvilInSigDuty_FB, implementation-data-type=DT_VCU_CcmHvilInSigDuty_FB
        application-data-type=DT_DT_VCU_FuelDectionModeSts, implementation-data-type=DT_VCU_FuelDectionModeSts
        application-data-type=DT_DT_VCU_EnergyCtrlMode, implementation-data-type=DT_VCU_EnergyCtrlMode
        application-data-type=DT_DT_VCU_VehSpdLimtRemind_ID514, implementation-data-type=DT_VCU_VehSpdLimtRemind_ID514
        application-data-type=DT_DT_VCU_TurtleLamp, implementation-data-type=DT_VCU_TurtleLamp
        application-data-type=DT_DT_VCU_EngLongTimeStartReq, implementation-data-type=DT_VCU_EngLongTimeStartReq
    DTMSHPCGW_0x13A
      data-type-maps:
        application-data-type=DT_DT_GW_CRC_13A, implementation-data-type=DT_GW_CRC_13A
        application-data-type=DT_DT_GW_RollingCounter_13A, implementation-data-type=DT_GW_RollingCounter_13A
        application-data-type=DT_DT_GW_IBC_VehicleSpeed, implementation-data-type=DT_GW_IBC_VehicleSpeed
        application-data-type=DT_DT_GW_IBC_VehicleSpeedVD, implementation-data-type=DT_GW_IBC_VehicleSpeedVD
        application-data-type=DT_DT_GW_IBC_AVHStatus, implementation-data-type=DT_GW_IBC_AVHStatus
        application-data-type=DT_DT_GW_IBC_RAB_Avatiable, implementation-data-type=DT_GW_IBC_RAB_Avatiable
        application-data-type=DT_DT_GW_IBC_RAB_Active, implementation-data-type=DT_GW_IBC_RAB_Active
        application-data-type=DT_DT_GW_IBC_FLWheelSpeedKPH, implementation-data-type=DT_GW_IBC_FLWheelSpeedKPH
        application-data-type=DT_DT_GW_IBC_FRWheelSpeedKPH, implementation-data-type=DT_GW_IBC_FRWheelSpeedKPH
        application-data-type=DT_DT_GW_IBC_RLWheelSpeedKPH, implementation-data-type=DT_GW_IBC_RLWheelSpeedKPH
        application-data-type=DT_DT_GW_IBC_RRWheelSpeedKPH, implementation-data-type=DT_GW_IBC_RRWheelSpeedKPH
        application-data-type=DT_DT_GW_IBC_FLWheelDirection, implementation-data-type=DT_GW_IBC_FLWheelDirection
        application-data-type=DT_DT_GW_IBC_FRWheelDirection, implementation-data-type=DT_GW_IBC_FRWheelDirection
        application-data-type=DT_DT_GW_IBC_RLWheelDirection, implementation-data-type=DT_GW_IBC_RLWheelDirection
        application-data-type=DT_DT_GW_IBC_RRWheelDirection, implementation-data-type=DT_GW_IBC_RRWheelDirection
        application-data-type=DT_DT_GW_IBC_FLWheelSpeedVD, implementation-data-type=DT_GW_IBC_FLWheelSpeedVD
        application-data-type=DT_DT_GW_IBC_FRWheelSpeedVD, implementation-data-type=DT_GW_IBC_FRWheelSpeedVD
        application-data-type=DT_DT_GW_IBC_RLWheelSpeedVD, implementation-data-type=DT_GW_IBC_RLWheelSpeedVD
        application-data-type=DT_DT_GW_IBC_RRWheelSpeedVD, implementation-data-type=DT_GW_IBC_RRWheelSpeedVD
        application-data-type=DT_DT_GW_IBC_PlungerPressure_Q, implementation-data-type=DT_GW_IBC_PlungerPressure_Q
        application-data-type=DT_DT_GW_IBC_PlungerPressure, implementation-data-type=DT_GW_IBC_PlungerPressure
    DTMSCCM_0x36A
      data-type-maps:
        application-data-type=DT_DT_CCM_Volt, implementation-data-type=DT_CCM_Volt
        application-data-type=DT_DT_CCM_RollingCounter_36A, implementation-data-type=DT_CCM_RollingCounter_36A
        application-data-type=DT_DT_CCM_BaseState, implementation-data-type=DT_CCM_BaseState
        application-data-type=DT_DT_CCM_Power, implementation-data-type=DT_CCM_Power
        application-data-type=DT_DT_CCM_APTC_BscSts, implementation-data-type=DT_CCM_APTC_BscSts
        application-data-type=DT_DT_CCM_APTC_Power, implementation-data-type=DT_CCM_APTC_Power
    DTMSIBC_0x227
      data-type-maps:
        application-data-type=DT_DT_IBC_CRC_227, implementation-data-type=DT_IBC_CRC_227
        application-data-type=DT_DT_IBC_RollingCounter_227, implementation-data-type=DT_IBC_RollingCounter_227
        application-data-type=DT_DT_IBC_EPB_FailStatus, implementation-data-type=DT_IBC_EPB_FailStatus
        application-data-type=DT_DT_IBC_EPB_Status, implementation-data-type=DT_IBC_EPB_Status
        application-data-type=DT_DT_IBC_EPB_DrumMode, implementation-data-type=DT_IBC_EPB_DrumMode
        application-data-type=DT_DT_IBC_EPB_AchievedClampForce, implementation-data-type=DT_IBC_EPB_AchievedClampForce
        application-data-type=DT_DT_IBC_EPB_FailureLamp, implementation-data-type=DT_IBC_EPB_FailureLamp
        application-data-type=DT_DT_IBC_EPB_ActuatorStateLeft, implementation-data-type=DT_IBC_EPB_ActuatorStateLeft
        application-data-type=DT_DT_IBC_EPB_ActuatorStateRight, implementation-data-type=DT_IBC_EPB_ActuatorStateRight
        application-data-type=DT_DT_IBC_EPB_HostAvailabilityLeft, implementation-data-type=DT_IBC_EPB_HostAvailabilityLeft
        application-data-type=DT_DT_IBC_EPB_HostAvailabilityRight, implementation-data-type=DT_IBC_EPB_HostAvailabilityRight
    DTMSMCU_0x5C8
      data-type-maps:
        application-data-type=DT_DT_Harness_igbt_temp{1..3}, implementation-data-type=DT_Harness_igbt_temp{1..3}
        application-data-type=DT_DT_Harness_CoolWaterTemp, implementation-data-type=DT_Harness_CoolWaterTemp
        application-data-type=DT_DT_Harness_V_DC, implementation-data-type=DT_Harness_V_DC
        application-data-type=DT_DT_Harness_PWM_DIR, implementation-data-type=DT_Harness_PWM_DIR
        application-data-type=DT_DT_Harness_HVIL_State, implementation-data-type=DT_Harness_HVIL_State
        application-data-type=DT_DT_Harness_crash_err_flag, implementation-data-type=DT_Harness_crash_err_flag
        application-data-type=DT_DT_Harness_KeyON, implementation-data-type=DT_Harness_KeyON
        application-data-type=DT_DT_Harness_HWRdc, implementation-data-type=DT_Harness_HWRdc
        application-data-type=DT_DT_Harness_HWFoT, implementation-data-type=DT_Harness_HWFoT
        application-data-type=DT_DT_Harness_HWVoltLower, implementation-data-type=DT_Harness_HWVoltLower
        application-data-type=DT_DT_Harness_HWFoB, implementation-data-type=DT_Harness_HWFoB
        application-data-type=DT_DT_Harness_MotorTemp1, implementation-data-type=DT_Harness_MotorTemp1
        application-data-type=DT_DT_Harness_MotorTemp2, implementation-data-type=DT_Harness_MotorTemp2
        application-data-type=DT_DT_Harness_I_U, implementation-data-type=DT_Harness_I_U
        application-data-type=DT_DT_Harness_I_W, implementation-data-type=DT_Harness_I_W
        application-data-type=DT_DT_Harness_I_V, implementation-data-type=DT_Harness_I_V
        application-data-type=DT_DT_Harness_HVRelayPosVolt, implementation-data-type=DT_Harness_HVRelayPosVolt
        application-data-type=DT_DT_MCUMR_Harness_igbt_temp{1..3}, implementation-data-type=DT_MCUMR_Harness_igbt_temp{1..3}
        application-data-type=DT_DT_MCUMR_Harness_CoolWaterTemp, implementation-data-type=DT_MCUMR_Harness_CoolWaterTemp
        application-data-type=DT_DT_MCUMR_Harness_V_DC, implementation-data-type=DT_MCUMR_Harness_V_DC
        application-data-type=DT_DT_MCUMR_Harness_PWM_DIR, implementation-data-type=DT_MCUMR_Harness_PWM_DIR
        application-data-type=DT_DT_MCUMR_Harness_HWRdc, implementation-data-type=DT_MCUMR_Harness_HWRdc
        application-data-type=DT_DT_MCUMR_Harness_HWFoT, implementation-data-type=DT_MCUMR_Harness_HWFoT
        application-data-type=DT_DT_MCUMR_Harness_HWVoltLower, implementation-data-type=DT_MCUMR_Harness_HWVoltLower
        application-data-type=DT_DT_MCUMR_Harness_HWFoB, implementation-data-type=DT_MCUMR_Harness_HWFoB
        application-data-type=DT_DT_MCUMR_Harness_MotorTemp1, implementation-data-type=DT_MCUMR_Harness_MotorTemp1
        application-data-type=DT_DT_MCUMR_Harness_MotorTemp2, implementation-data-type=DT_MCUMR_Harness_MotorTemp2
        application-data-type=DT_DT_MCUMR_Harness_I_U, implementation-data-type=DT_MCUMR_Harness_I_U
        application-data-type=DT_DT_MCUMR_Harness_I_W, implementation-data-type=DT_MCUMR_Harness_I_W
        application-data-type=DT_DT_MCUMR_Harness_I_V, implementation-data-type=DT_MCUMR_Harness_I_V
    DTMSHPCBCM_0x290
      data-type-maps:
        application-data-type=DT_DT_BCM_CRC_290, implementation-data-type=DT_BCM_CRC_290
        application-data-type=DT_DT_BCM_RRDoorSts_ID290_CCAN, implementation-data-type=DT_BCM_RRDoorSts_ID290_CCAN
        application-data-type=DT_DT_BCM_RLDoorSts_ID290_CCAN, implementation-data-type=DT_BCM_RLDoorSts_ID290_CCAN
        application-data-type=DT_DT_BCM_RollingCounter_290, implementation-data-type=DT_BCM_RollingCounter_290
        application-data-type=DT_DT_BCM_HazardSwtSts, implementation-data-type=DT_BCM_HazardSwtSts
        application-data-type=DT_DT_BCM_DrOC_PPD_Status, implementation-data-type=DT_BCM_DrOC_PPD_Status
        application-data-type=DT_DT_BCM_FLOC_PPD_Status, implementation-data-type=DT_BCM_FLOC_PPD_Status
        application-data-type=DT_DT_BCM_FROC_PPD_Status, implementation-data-type=DT_BCM_FROC_PPD_Status
        application-data-type=DT_DT_BCM_DriverDoorSts_ID290_CCAN, implementation-data-type=DT_BCM_DriverDoorSts_ID290_CCAN
        application-data-type=DT_DT_BCM_DriverDoorSts_VD, implementation-data-type=DT_BCM_DriverDoorSts_VD
        application-data-type=DT_DT_BCM_FLDoorSts_ID290_CCAN, implementation-data-type=DT_BCM_FLDoorSts_ID290_CCAN
        application-data-type=DT_DT_BCM_FRDoorSts_ID290_CCAN, implementation-data-type=DT_BCM_FRDoorSts_ID290_CCAN
        application-data-type=DT_DT_BCM_BackDoorSts_ID290_CCAN, implementation-data-type=DT_BCM_BackDoorSts_ID290_CCAN
        application-data-type=DT_DT_BCM_FrontCoverSts, implementation-data-type=DT_BCM_FrontCoverSts
        application-data-type=DT_DT_BCM_HazardSwtOpenSts, implementation-data-type=DT_BCM_HazardSwtOpenSts
        application-data-type=DT_DT_BCM_BrakeFluidLevel, implementation-data-type=DT_BCM_BrakeFluidLevel
        application-data-type=DT_DT_BCM_ON2BRelaySts_ID290_CCAN, implementation-data-type=DT_BCM_ON2BRelaySts_ID290_CCAN
        application-data-type=DT_DT_BCM_ON2CRelaySts_ID290_CCAN, implementation-data-type=DT_BCM_ON2CRelaySts_ID290_CCAN
        application-data-type=DT_DT_BCM_AlarmMode_C, implementation-data-type=DT_BCM_AlarmMode_C
    DTMSVCU_0x13
      data-type-maps:
        application-data-type=DT_DT_VCU_CRC_13, implementation-data-type=DT_VCU_CRC_13
        application-data-type=DT_DT_VCU_RollingCounter_13, implementation-data-type=DT_VCU_RollingCounter_13
        application-data-type=DT_DT_VCU_SDrvRequestTorque_prvt, implementation-data-type=DT_VCU_SDrvRequestTorque_prvt
        application-data-type=DT_DT_VCU_SDrvRequestTorqueVD_prvt, implementation-data-type=DT_VCU_SDrvRequestTorqueVD_prvt
        application-data-type=DT_DT_VCU_MCUSDampgLmtFactor_prvt, implementation-data-type=DT_VCU_MCUSDampgLmtFactor_prvt
        application-data-type=DT_DT_VCU_VehicleDirectS_prvt, implementation-data-type=DT_VCU_VehicleDirectS_prvt
        application-data-type=DT_DT_VCU_VehicleDirectS_VD_prvt, implementation-data-type=DT_VCU_VehicleDirectS_VD_prvt
        application-data-type=DT_DT_VCU_MCUSMaxPosDampgTrq_prvt, implementation-data-type=DT_VCU_MCUSMaxPosDampgTrq_prvt
        application-data-type=DT_DT_VCU_MCUSMaxNegDampgTrq_prvt, implementation-data-type=DT_VCU_MCUSMaxNegDampgTrq_prvt
    DTMSVCU_0x1
      data-type-maps:
        application-data-type=DT_DT_EOL_CRC_13B, implementation-data-type=DT_EOL_CRC_13B
        application-data-type=DT_DT_EOL_RollingCounter_13B, implementation-data-type=DT_EOL_RollingCounter_13B
        application-data-type=DT_DT_EOL_VehicleSts, implementation-data-type=DT_EOL_VehicleSts
        application-data-type=DT_DT_EOL_GearLevelPosSts, implementation-data-type=DT_EOL_GearLevelPosSts
        application-data-type=DT_DT_EOL_GearLeverValid, implementation-data-type=DT_EOL_GearLeverValid
        application-data-type=DT_DT_EOL_AccPedalValid, implementation-data-type=DT_EOL_AccPedalValid
        application-data-type=DT_DT_EOL_ThrottlePosition, implementation-data-type=DT_EOL_ThrottlePosition
        application-data-type=DT_DT_EOL_RMCUActiveReleaseCmd, implementation-data-type=DT_EOL_RMCUActiveReleaseCmd
        application-data-type=DT_DT_EOL_VehicleDirect, implementation-data-type=DT_EOL_VehicleDirect
        application-data-type=DT_DT_EOL_SuppressJitterRMCURequest, implementation-data-type=DT_EOL_SuppressJitterRMCURequest
        application-data-type=DT_DT_EOL_RDrvControlMode, implementation-data-type=DT_EOL_RDrvControlMode
        application-data-type=DT_DT_EOL_BrakePedalValue, implementation-data-type=DT_EOL_BrakePedalValue
        application-data-type=DT_DT_EOL_RMCUMaxDischargePower, implementation-data-type=DT_EOL_RMCUMaxDischargePower
        application-data-type=DT_DT_EOL_RMCUMaxChargePower, implementation-data-type=DT_EOL_RMCUMaxChargePower
        application-data-type=DT_DT_EOL_RDrvRequestTorque, implementation-data-type=DT_EOL_RDrvRequestTorque
        application-data-type=DT_DT_EOL_RDrvRequesSpeed, implementation-data-type=DT_EOL_RDrvRequesSpeed
        application-data-type=DT_DT_EOL_FDrvRequestTorque, implementation-data-type=DT_EOL_FDrvRequestTorque
        application-data-type=DT_DT_EOL_FDrvRequesSpeed, implementation-data-type=DT_EOL_FDrvRequesSpeed
        application-data-type=DT_DT_EOL_FVehicleSts, implementation-data-type=DT_EOL_FVehicleSts
        application-data-type=DT_DT_EOL_FDrvControlMode, implementation-data-type=DT_EOL_FDrvControlMode
        application-data-type=DT_DT_EOL_ON2BRelayReq, implementation-data-type=DT_EOL_ON2BRelayReq
        application-data-type=DT_DT_EOL_VehicleDirectVD, implementation-data-type=DT_EOL_VehicleDirectVD
        application-data-type=DT_DT_EOL_RDrvControlModeVD, implementation-data-type=DT_EOL_RDrvControlModeVD
        application-data-type=DT_DT_EOL_RDrvRequestTorqueVD, implementation-data-type=DT_EOL_RDrvRequestTorqueVD
        application-data-type=DT_DT_EOL_RDrvRequesSpeedVD, implementation-data-type=DT_EOL_RDrvRequesSpeedVD
        application-data-type=DT_DT_EOL_FDrvRequestTorqueVD, implementation-data-type=DT_EOL_FDrvRequestTorqueVD
        application-data-type=DT_DT_EOL_FDrvRequesSpeedVD, implementation-data-type=DT_EOL_FDrvRequesSpeedVD
        application-data-type=DT_DT_EOL_FDrvControlModeVD, implementation-data-type=DT_EOL_FDrvControlModeVD
        application-data-type=DT_DT_EOL_MCUMDampgLmtFactor, implementation-data-type=DT_EOL_MCUMDampgLmtFactor
        application-data-type=DT_DT_EOL_VCU_BoostMode_Fail, implementation-data-type=DT_EOL_VCU_BoostMode_Fail
        application-data-type=DT_DT_EOL_VCU_BoostModeSts, implementation-data-type=DT_EOL_VCU_BoostModeSts
        application-data-type=DT_DT_EOL_MCUMMaxPosDampgTrq, implementation-data-type=DT_EOL_MCUMMaxPosDampgTrq
        application-data-type=DT_DT_EOL_MCUMMaxNegDampgTrq, implementation-data-type=DT_EOL_MCUMMaxNegDampgTrq
    DTMSTMS_0x5FE: data-type-map{application-data-type=DT_DT_TMS_MilLampReq, implementation-data-type=DT_TMS_MilLampReq}
    DTMSEMS_0xBE
      data-type-maps:
        application-data-type=DT_DT_EMS_CRC_BE, implementation-data-type=DT_EMS_CRC_BE
        application-data-type=DT_DT_EMS_RollingCounter_BE, implementation-data-type=DT_EMS_RollingCounter_BE
        application-data-type=DT_DT_EMS_EngineSts, implementation-data-type=DT_EMS_EngineSts
        application-data-type=DT_DT_ECM_FaultLevel, implementation-data-type=DT_ECM_FaultLevel
        application-data-type=DT_DT_ECM_ActualEngineTorqueValid, implementation-data-type=DT_ECM_ActualEngineTorqueValid
        application-data-type=DT_DT_ECM_EngineTorqueLoss, implementation-data-type=DT_ECM_EngineTorqueLoss
        application-data-type=DT_DT_ECM_ActualEngineTorque, implementation-data-type=DT_ECM_ActualEngineTorque
        application-data-type=DT_DT_ECM_EngineTorqueMax, implementation-data-type=DT_ECM_EngineTorqueMax
        application-data-type=DT_DT_ECM_EngineTorqueMin, implementation-data-type=DT_ECM_EngineTorqueMin
        application-data-type=DT_DT_ECM_EngineSpeed, implementation-data-type=DT_ECM_EngineSpeed
        application-data-type=DT_DT_ECM_EngineSpeedValid, implementation-data-type=DT_ECM_EngineSpeedValid
        application-data-type=DT_DT_ECM_EngineStopAllow, implementation-data-type=DT_ECM_EngineStopAllow
        application-data-type=DT_DT_ECM_EngineOilPressureLow, implementation-data-type=DT_ECM_EngineOilPressureLow
        application-data-type=DT_DT_ECM_EngineFuleCutoffSts, implementation-data-type=DT_ECM_EngineFuleCutoffSts
        application-data-type=DT_DT_ECM_EngineStartedCompleted, implementation-data-type=DT_ECM_EngineStartedCompleted
        application-data-type=DT_DT_ECM_CatalystWarmUpSts, implementation-data-type=DT_ECM_CatalystWarmUpSts
        application-data-type=DT_DT_ECM_CatalystWarmUpReq, implementation-data-type=DT_ECM_CatalystWarmUpReq
        application-data-type=DT_DT_ECM_IdleTargetSpeed, implementation-data-type=DT_ECM_IdleTargetSpeed
        application-data-type=DT_DT_ECM_IdleActive, implementation-data-type=DT_ECM_IdleActive
        application-data-type=DT_DT_ECM_EngineStartReq, implementation-data-type=DT_ECM_EngineStartReq
        application-data-type=DT_DT_ECM_EngineStopInhibit, implementation-data-type=DT_ECM_EngineStopInhibit
        application-data-type=DT_DT_ECM_GPFRegenlamp, implementation-data-type=DT_ECM_GPFRegenlamp
        application-data-type=DT_DT_ECM_EngineCoolantTemp, implementation-data-type=DT_ECM_EngineCoolantTemp
        application-data-type=DT_DT_ECM_EngineCoolantTempValid, implementation-data-type=DT_ECM_EngineCoolantTempValid
        application-data-type=DT_DT_ECM_FVVSts, implementation-data-type=DT_ECM_FVVSts
        application-data-type=DT_DT_ECM_learningReq, implementation-data-type=DT_ECM_learningReq
        application-data-type=DT_DT_ECM_EngineIdleStateRequest, implementation-data-type=DT_ECM_EngineIdleStateRequest
        application-data-type=DT_DT_ECM_EngineDFCOConditionRequest, implementation-data-type=DT_ECM_EngineDFCOConditionRequest
        application-data-type=DT_DT_ECM_GPFRegenReq, implementation-data-type=DT_ECM_GPFRegenReq
        application-data-type=DT_DT_ECM_SVSLampRequest, implementation-data-type=DT_ECM_SVSLampRequest
        application-data-type=DT_DT_ECM_TankPressure, implementation-data-type=DT_ECM_TankPressure
        application-data-type=DT_DT_ECM_TankPressureValid, implementation-data-type=DT_ECM_TankPressureValid
        application-data-type=DT_DT_ECM_MilLampRequest, implementation-data-type=DT_ECM_MilLampRequest
        application-data-type=DT_DT_ECM_ToothlearningSucValid, implementation-data-type=DT_ECM_ToothlearningSucValid
        application-data-type=DT_DT_ECM_FuelCloseLoopSts, implementation-data-type=DT_ECM_FuelCloseLoopSts
        application-data-type=DT_DT_ECM_RestrictorOpenValue, implementation-data-type=DT_ECM_RestrictorOpenValue
        application-data-type=DT_DT_ECM_FuelLevelSensorValid, implementation-data-type=DT_ECM_FuelLevelSensorValid
        application-data-type=DT_DT_ECM_FuelLevel, implementation-data-type=DT_ECM_FuelLevel
        application-data-type=DT_DT_ECM_SelfCheckSt, implementation-data-type=DT_ECM_SelfCheckSt
        application-data-type=DT_DT_ECM_PCVPipeDiagReq, implementation-data-type=DT_ECM_PCVPipeDiagReq
        application-data-type=DT_DT_ECM_CalculatedLoad, implementation-data-type=DT_ECM_CalculatedLoad
        application-data-type=DT_DT_ECM_AirPressure, implementation-data-type=DT_ECM_AirPressure
        application-data-type=DT_DT_ECM_FanSts, implementation-data-type=DT_ECM_FanSts
        application-data-type=DT_DT_ECM_ClearingSparkcarbonedRequest, implementation-data-type=DT_ECM_ClearingSparkcarbonedRequest
    DTMSEPS_0x18D
      data-type-maps:
        application-data-type=DT_DT_EPS_CRC_18D, implementation-data-type=DT_EPS_CRC_18D
        application-data-type=DT_DT_EPS_RollingCounter_18D, implementation-data-type=DT_EPS_RollingCounter_18D
        application-data-type=DT_DT_EPS_Fault, implementation-data-type=DT_EPS_Fault
        application-data-type=DT_DT_EPS_CalibrationSts, implementation-data-type=DT_EPS_CalibrationSts
        application-data-type=DT_DT_EPS_FailureSts, implementation-data-type=DT_EPS_FailureSts
        application-data-type=DT_DT_EPS_SteeringAngleValidData, implementation-data-type=DT_EPS_SteeringAngleValidData
        application-data-type=DT_DT_EPS_SteeringAngleSpeedValidData, implementation-data-type=DT_EPS_SteeringAngleSpeedValidData
        application-data-type=DT_DT_EPS_SteerWheelAngle, implementation-data-type=DT_EPS_SteerWheelAngle
        application-data-type=DT_DT_EPS_SteerWheelRotSpd, implementation-data-type=DT_EPS_SteerWheelRotSpd
        application-data-type=DT_DT_EPS_SelfCheckSt, implementation-data-type=DT_EPS_SelfCheckSt
        application-data-type=DT_DT_EPS_AssistanceSts, implementation-data-type=DT_EPS_AssistanceSts
    DTMSGCU_0xBD
      data-type-maps:
        application-data-type=DT_DT_GCU_CRC_BD, implementation-data-type=DT_GCU_CRC_BD
        application-data-type=DT_DT_GCU_EngineCylinderDeactivationStatus, implementation-data-type=DT_GCU_EngineCylinderDeactivationStatus
        application-data-type=DT_DT_GCU_EngineFuelInhibitReq, implementation-data-type=DT_GCU_EngineFuelInhibitReq
        application-data-type=DT_DT_GCU_RollingCounter_BD, implementation-data-type=DT_GCU_RollingCounter_BD
        application-data-type=DT_DT_GCU_MainWireCurr, implementation-data-type=DT_GCU_MainWireCurr
        application-data-type=DT_DT_GCU_MainWireVolt, implementation-data-type=DT_GCU_MainWireVolt
        application-data-type=DT_DT_GCU_SystemWarning, implementation-data-type=DT_GCU_SystemWarning
        application-data-type=DT_DT_GCU_MILlampReq, implementation-data-type=DT_GCU_MILlampReq
        application-data-type=DT_DT_GCU_MoterTemp, implementation-data-type=DT_GCU_MoterTemp
        application-data-type=DT_DT_GCU_Temp, implementation-data-type=DT_GCU_Temp
        application-data-type=DT_DT_GCU_SelfCheck, implementation-data-type=DT_GCU_SelfCheck
        application-data-type=DT_DT_GCU_Warning_Level, implementation-data-type=DT_GCU_Warning_Level
        application-data-type=DT_DT_GCU_HVILSts, implementation-data-type=DT_GCU_HVILSts
        application-data-type=DT_DT_GCU__PowerReduceSts, implementation-data-type=DT_GCU__PowerReduceSts
        application-data-type=DT_DT_GCU_ActualMotorRPM_VD, implementation-data-type=DT_GCU_ActualMotorRPM_VD
        application-data-type=DT_DT_GCU_ActualMotorTorque_VD, implementation-data-type=DT_GCU_ActualMotorTorque_VD
        application-data-type=DT_DT_GCU_ActualMotorTorque, implementation-data-type=DT_GCU_ActualMotorTorque
        application-data-type=DT_DT_GCU_MaxTorque, implementation-data-type=DT_GCU_MaxTorque
        application-data-type=DT_DT_GCU_ActiveReleaseFB, implementation-data-type=DT_GCU_ActiveReleaseFB
        application-data-type=DT_DT_GCU_MAXPower, implementation-data-type=DT_GCU_MAXPower
        application-data-type=DT_DT_GCU_TransientPower, implementation-data-type=DT_GCU_TransientPower
        application-data-type=DT_DT_GCU_HVOffReq, implementation-data-type=DT_GCU_HVOffReq
        application-data-type=DT_DT_GCU_ControlMode, implementation-data-type=DT_GCU_ControlMode
        application-data-type=DT_DT_GCU_Operating_Mode, implementation-data-type=DT_GCU_Operating_Mode
        application-data-type=DT_DT_GCU_ActualMotorRPM, implementation-data-type=DT_GCU_ActualMotorRPM
    DTMSBMS_0x5B5
      data-type-maps:
        application-data-type=DT_DT_BMS_WkupVolt_DC12V, implementation-data-type=DT_BMS_WkupVolt_DC12V
        application-data-type=DT_DT_BMS_WkupVolt_AC12V, implementation-data-type=DT_BMS_WkupVolt_AC12V
        application-data-type=DT_DT_BMS_HVPackPosRelayExternalVolt, implementation-data-type=DT_BMS_HVPackPosRelayExternalVolt
        application-data-type=DT_DT_BMS_SOC_target, implementation-data-type=DT_BMS_SOC_target
        application-data-type=DT_DT_BMS_CorrectSOEPer, implementation-data-type=DT_BMS_CorrectSOEPer
        application-data-type=DT_DT_BMS_SOCModifyFlag, implementation-data-type=DT_BMS_SOCModifyFlag
        application-data-type=DT_DT_BMS_BMU_SoftwareVersion, implementation-data-type=DT_BMS_BMU_SoftwareVersion
    DTMSVCU_0xBC
      data-type-maps:
        application-data-type=DT_DT_VCU_VehicleSpdDirect, implementation-data-type=DT_VCU_VehicleSpdDirect
        application-data-type=DT_DT_VCU_ADM_ActualMode, implementation-data-type=DT_VCU_ADM_ActualMode
        application-data-type=DT_DT_VCU_ADM_MainMode, implementation-data-type=DT_VCU_ADM_MainMode
        application-data-type=DT_DT_VCU_DeliveryModeSts, implementation-data-type=DT_VCU_DeliveryModeSts
        application-data-type=DT_DT_VCU_VehSpdLimtRemind, implementation-data-type=DT_VCU_VehSpdLimtRemind
        application-data-type=DT_DT_VCU_SinglePedalSts, implementation-data-type=DT_VCU_SinglePedalSts
        application-data-type=DT_DT_VCU_GearLvrChangeSts, implementation-data-type=DT_VCU_GearLvrChangeSts
        application-data-type=DT_DT_VCU_HighVoltSysSts, implementation-data-type=DT_VCU_HighVoltSysSts
        application-data-type=DT_DT_VCU_ChrgDischrgFunSts, implementation-data-type=DT_VCU_ChrgDischrgFunSts
        application-data-type=DT_DT_VCU_CalibrationVersion, implementation-data-type=DT_VCU_CalibrationVersion
        application-data-type=DT_DT_VCU_CalibrationNumber, implementation-data-type=DT_VCU_CalibrationNumber
        application-data-type=DT_DT_VCU_VehicleNegTrqRspdSts, implementation-data-type=DT_VCU_VehicleNegTrqRspdSts
        application-data-type=DT_DT_VCU_SlopeEst, implementation-data-type=DT_VCU_SlopeEst
        application-data-type=DT_DT_VCU_SlopeEst_Valid, implementation-data-type=DT_VCU_SlopeEst_Valid
        application-data-type=DT_DT_VCU_WheelTrqType, implementation-data-type=DT_VCU_WheelTrqType
        application-data-type=DT_DT_VCU_DriverAssistProhibitSts, implementation-data-type=DT_VCU_DriverAssistProhibitSts
        application-data-type=DT_DT_VCU_VacumRlySts, implementation-data-type=DT_VCU_VacumRlySts
        application-data-type=DT_DT_VCU_DriveSHVILSts, implementation-data-type=DT_VCU_DriveSHVILSts
        application-data-type=DT_DT_VCU_DriveMHVILSts, implementation-data-type=DT_VCU_DriveMHVILSts
        application-data-type=DT_DT_VCU_DCChgHVILSts, implementation-data-type=DT_VCU_DCChgHVILSts
        application-data-type=DT_DT_VCU_ACChgHVILSts, implementation-data-type=DT_VCU_ACChgHVILSts
        application-data-type=DT_DT_VCU_CCMHVILSts, implementation-data-type=DT_VCU_CCMHVILSts
        application-data-type=DT_DT_VCU_SystemError, implementation-data-type=DT_VCU_SystemError
        application-data-type=DT_DT_VCU_AccPedalFaultLV, implementation-data-type=DT_VCU_AccPedalFaultLV
        application-data-type=DT_DT_VCU_HVILSysSts, implementation-data-type=DT_VCU_HVILSysSts
        application-data-type=DT_DT_VCU_VacuumDegree, implementation-data-type=DT_VCU_VacuumDegree
        application-data-type=DT_DT_VCU_LPedalModeSts, implementation-data-type=DT_VCU_LPedalModeSts
        application-data-type=DT_DT_VCU_LVSystemError, implementation-data-type=DT_VCU_LVSystemError
        application-data-type=DT_DT_VCU_HVSystemError, implementation-data-type=DT_VCU_HVSystemError
        application-data-type=DT_DT_VCU_OpeartingMode, implementation-data-type=DT_VCU_OpeartingMode
        application-data-type=DT_DT_VCU_EnergyMode, implementation-data-type=DT_VCU_EnergyMode
        application-data-type=DT_DT_VCU_GearLevelPosFault, implementation-data-type=DT_VCU_GearLevelPosFault
        application-data-type=DT_DT_VCU_BrakeSwitchSts, implementation-data-type=DT_VCU_BrakeSwitchSts
        application-data-type=DT_DT_VCU_SpdLimModeSts, implementation-data-type=DT_VCU_SpdLimModeSts
        application-data-type=DT_DT_VCU_TrqDstrbutnPrio, implementation-data-type=DT_VCU_TrqDstrbutnPrio
        application-data-type=DT_DT_VCU_TrqDstrbutnTransferSts, implementation-data-type=DT_VCU_TrqDstrbutnTransferSts
        application-data-type=DT_DT_VCU_MCUMDiffProtectSts, implementation-data-type=DT_VCU_MCUMDiffProtectSts
        application-data-type=DT_DT_VCU_MCUSDiffProtectSts, implementation-data-type=DT_VCU_MCUSDiffProtectSts
    DTMSICU_0x332
      data-type-maps:
        application-data-type=DT_DT_ICU_CRC_332, implementation-data-type=DT_ICU_CRC_332
        application-data-type=DT_DT_ICU_RollingCounter_332, implementation-data-type=DT_ICU_RollingCounter_332
        application-data-type=DT_DT_ICU_AEB_SW, implementation-data-type=DT_ICU_AEB_SW
        application-data-type=DT_DT_ICU_ISA_controlSW, implementation-data-type=DT_ICU_ISA_controlSW
        application-data-type=DT_DT_ICU_SLIF_SW, implementation-data-type=DT_ICU_SLIF_SW
        application-data-type=DT_DT_ICU_SLWF_SW, implementation-data-type=DT_ICU_SLWF_SW
    DTMSTMS_0x5A2
      data-type-maps:
        application-data-type=DT_DT_TMS_MainMotPumpSpdResp, implementation-data-type=DT_TMS_MainMotPumpSpdResp
        application-data-type=DT_DT_TMS_MainMotPump_Operation_Temp, implementation-data-type=DT_TMS_MainMotPump_Operation_Temp
        application-data-type=DT_DT_TMS_MainMotPump_Operation_Current, implementation-data-type=DT_TMS_MainMotPump_Operation_Current
        application-data-type=DT_DT_TMS_MainMotPump_Supplied_Voltage, implementation-data-type=DT_TMS_MainMotPump_Supplied_Voltage
        application-data-type=DT_DT_TMS_MainMotPumpErrSts, implementation-data-type=DT_TMS_MainMotPumpErrSts
    DTMSIBC_0x184
      data-type-maps:
        application-data-type=DT_DT_IBC_CRC_184, implementation-data-type=DT_IBC_CRC_184
        application-data-type=DT_DT_IBC_RollingCounter_184, implementation-data-type=DT_IBC_RollingCounter_184
        application-data-type=DT_DT_IBC_FLWheelSpeedKPH, implementation-data-type=DT_IBC_FLWheelSpeedKPH
        application-data-type=DT_DT_IBC_FRWheelSpeedKPH, implementation-data-type=DT_IBC_FRWheelSpeedKPH
        application-data-type=DT_DT_IBC_RLWheelSpeedKPH, implementation-data-type=DT_IBC_RLWheelSpeedKPH
        application-data-type=DT_DT_IBC_RRWheelSpeedKPH, implementation-data-type=DT_IBC_RRWheelSpeedKPH
        application-data-type=DT_DT_IBC_FLWheelDirection, implementation-data-type=DT_IBC_FLWheelDirection
        application-data-type=DT_DT_IBC_FRWheelDirection, implementation-data-type=DT_IBC_FRWheelDirection
        application-data-type=DT_DT_IBC_RLWheelDirection, implementation-data-type=DT_IBC_RLWheelDirection
        application-data-type=DT_DT_IBC_RRWheelDirection, implementation-data-type=DT_IBC_RRWheelDirection
        application-data-type=DT_DT_IBC_FLWheelSpeedVD, implementation-data-type=DT_IBC_FLWheelSpeedVD
        application-data-type=DT_DT_IBC_FRWheelSpeedVD, implementation-data-type=DT_IBC_FRWheelSpeedVD
        application-data-type=DT_DT_IBC_RLWheelSpeedVD, implementation-data-type=DT_IBC_RLWheelSpeedVD
        application-data-type=DT_DT_IBC_RRWheelSpeedVD, implementation-data-type=DT_IBC_RRWheelSpeedVD
        application-data-type=DT_DT_IBC_FLWheelSpeedRC, implementation-data-type=DT_IBC_FLWheelSpeedRC
        application-data-type=DT_DT_IBC_FRWheelSpeedRC, implementation-data-type=DT_IBC_FRWheelSpeedRC
        application-data-type=DT_DT_IBC_RLWheelSpeedRC, implementation-data-type=DT_IBC_RLWheelSpeedRC
        application-data-type=DT_DT_IBC_RRWheelSpeedRC, implementation-data-type=DT_IBC_RRWheelSpeedRC
        application-data-type=DT_DT_IBC_DiscTemperatureFL, implementation-data-type=DT_IBC_DiscTemperatureFL
        application-data-type=DT_DT_IBC_DiscTemperatureFLVD, implementation-data-type=DT_IBC_DiscTemperatureFLVD
        application-data-type=DT_DT_IBC_DiscTemperatureFR, implementation-data-type=DT_IBC_DiscTemperatureFR
        application-data-type=DT_DT_IBC_DiscTemperatureFRVD, implementation-data-type=DT_IBC_DiscTemperatureFRVD
        application-data-type=DT_DT_IBC_DiscTemperatureRL, implementation-data-type=DT_IBC_DiscTemperatureRL
        application-data-type=DT_DT_IBC_DiscTemperatureRLVD, implementation-data-type=DT_IBC_DiscTemperatureRLVD
        application-data-type=DT_DT_IBC_DiscTemperatureRR, implementation-data-type=DT_IBC_DiscTemperatureRR
        application-data-type=DT_DT_IBC_DiscTemperatureRRVD, implementation-data-type=DT_IBC_DiscTemperatureRRVD
    DTMSIBC_0x183
      data-type-maps:
        application-data-type=DT_DT_IBC_CRC_183, implementation-data-type=DT_IBC_CRC_183
        application-data-type=DT_DT_IBC_RollingCounter_183, implementation-data-type=DT_IBC_RollingCounter_183
        application-data-type=DT_DT_IBC_RecuBrakeTorqueRequest, implementation-data-type=DT_IBC_RecuBrakeTorqueRequest
        application-data-type=DT_DT_IBC_RecuBrakeTorqueRequest_Q, implementation-data-type=DT_IBC_RecuBrakeTorqueRequest_Q
        application-data-type=DT_DT_IBC_sOutputRodDriverPer_Q, implementation-data-type=DT_IBC_sOutputRodDriverPer_Q
        application-data-type=DT_DT_IBC_BrakePedalApplied_Q, implementation-data-type=DT_IBC_BrakePedalApplied_Q
        application-data-type=DT_DT_IBC_HydraTorqTgtAct_Q, implementation-data-type=DT_IBC_HydraTorqTgtAct_Q
        application-data-type=DT_DT_IBC_HydraTorqTgtAct, implementation-data-type=DT_IBC_HydraTorqTgtAct
        application-data-type=DT_DT_IBC_BrakePedalApplied, implementation-data-type=DT_IBC_BrakePedalApplied
        application-data-type=DT_DT_IBC_sOutputRodDriverPer, implementation-data-type=DT_IBC_sOutputRodDriverPer
        application-data-type=DT_DT_IBC_HydraTorqAvailable, implementation-data-type=DT_IBC_HydraTorqAvailable
        application-data-type=DT_DT_IBC_CtrlMode, implementation-data-type=DT_IBC_CtrlMode
        application-data-type=DT_DT_IBC_QDC_HydraTorqTgt, implementation-data-type=DT_IBC_QDC_HydraTorqTgt
        application-data-type=DT_DT_IBC_InPutRodDriver, implementation-data-type=DT_IBC_InPutRodDriver
        application-data-type=DT_DT_IBC_InPutRodDriver_Q, implementation-data-type=DT_IBC_InPutRodDriver_Q
        application-data-type=DT_DT_IBC_SystemAssistedStatus, implementation-data-type=DT_IBC_SystemAssistedStatus
        application-data-type=DT_DT_IBC_EngTorq_VLC_Vaild, implementation-data-type=DT_IBC_EngTorq_VLC_Vaild
        application-data-type=DT_DT_IBC_EngTorq_VLC, implementation-data-type=DT_IBC_EngTorq_VLC
        application-data-type=DT_DT_IBC_BrkTorq_VLC, implementation-data-type=DT_IBC_BrkTorq_VLC
        application-data-type=DT_DT_IBC_BrkTorq_VLC_Vaild, implementation-data-type=DT_IBC_BrkTorq_VLC_Vaild
    DTMSIBC_0x186
      data-type-maps:
        application-data-type=DT_DT_IBC_CRC_186, implementation-data-type=DT_IBC_CRC_186
        application-data-type=DT_DT_IBC_RollingCounter_186, implementation-data-type=DT_IBC_RollingCounter_186
        application-data-type=DT_DT_IBC_WheelPressureReliabilityFL, implementation-data-type=DT_IBC_WheelPressureReliabilityFL
        application-data-type=DT_DT_IBC_WheelPressureReliabilityFR, implementation-data-type=DT_IBC_WheelPressureReliabilityFR
        application-data-type=DT_DT_IBC_WheelPressureReliabilityRL, implementation-data-type=DT_IBC_WheelPressureReliabilityRL
        application-data-type=DT_DT_IBC_WheelPressureReliabilityRR, implementation-data-type=DT_IBC_WheelPressureReliabilityRR
        application-data-type=DT_DT_IBC_WheelCylinderPressure_FL, implementation-data-type=DT_IBC_WheelCylinderPressure_FL
        application-data-type=DT_DT_IBC_WheelCylinderPressure_FR, implementation-data-type=DT_IBC_WheelCylinderPressure_FR
        application-data-type=DT_DT_IBC_WheelCylinderPressure_RL, implementation-data-type=DT_IBC_WheelCylinderPressure_RL
        application-data-type=DT_DT_IBC_WheelCylinderPressure_RR, implementation-data-type=DT_IBC_WheelCylinderPressure_RR
        application-data-type=DT_DT_IBC_WheelSlipFLVD, implementation-data-type=DT_IBC_WheelSlipFLVD
        application-data-type=DT_DT_IBC_WheelSlipFRVD, implementation-data-type=DT_IBC_WheelSlipFRVD
        application-data-type=DT_DT_IBC_WheelSlipRLVD, implementation-data-type=DT_IBC_WheelSlipRLVD
        application-data-type=DT_DT_IBC_WheelSlipRRVD, implementation-data-type=DT_IBC_WheelSlipRRVD
        application-data-type=DT_DT_IBC_WheelSlipFL, implementation-data-type=DT_IBC_WheelSlipFL
        application-data-type=DT_DT_IBC_WheelSlipFR, implementation-data-type=DT_IBC_WheelSlipFR
        application-data-type=DT_DT_IBC_WheelSlipRL, implementation-data-type=DT_IBC_WheelSlipRL
        application-data-type=DT_DT_IBC_WheelSlipRR, implementation-data-type=DT_IBC_WheelSlipRR
        application-data-type=DT_DT_IBC_Slop_Pencent, implementation-data-type=DT_IBC_Slop_Pencent
    DTMSPTC_0x367
      data-type-maps:
        application-data-type=DT_DT_PTC_BscSts, implementation-data-type=DT_PTC_BscSts
        application-data-type=DT_DT_PTC_RollingCounter_367, implementation-data-type=DT_PTC_RollingCounter_367
        application-data-type=DT_DT_PTC_Fault, implementation-data-type=DT_PTC_Fault
        application-data-type=DT_DT_PTC_Power, implementation-data-type=DT_PTC_Power
        application-data-type=DT_DT_PTC_HV_interlock_faultSt, implementation-data-type=DT_PTC_HV_interlock_faultSt
    DTMSVCU_0x600
      data-type-maps:
        application-data-type=DT_DT_VCU_FaultData{0..31}, implementation-data-type=DT_VCU_FaultData{0..31}
    DTMSHPCGW_0x30B
      data-type-maps:
        application-data-type=DT_DT_GW_TCM_CRC_30B, implementation-data-type=DT_GW_TCM_CRC_30B
        application-data-type=DT_DT_GW_TCM_RollingCounter_30B, implementation-data-type=DT_GW_TCM_RollingCounter_30B
        application-data-type=DT_DT_GW_TCM_ParkingSwSts, implementation-data-type=DT_GW_TCM_ParkingSwSts
        application-data-type=DT_DT_GW_TCM_STATUS_Park, implementation-data-type=DT_GW_TCM_STATUS_Park
        application-data-type=DT_DT_GW_TCM_Counter_Park, implementation-data-type=DT_GW_TCM_Counter_Park
        application-data-type=DT_DT_GW_TCM_CRC_Park, implementation-data-type=DT_GW_TCM_CRC_Park
        application-data-type=DT_DT_GW_TCM_GearLevelSwitchSts, implementation-data-type=DT_GW_TCM_GearLevelSwitchSts
        application-data-type=DT_DT_GW_TCM_STATUS_RND, implementation-data-type=DT_GW_TCM_STATUS_RND
        application-data-type=DT_DT_GW_TCM_Counter_RND, implementation-data-type=DT_GW_TCM_Counter_RND
        application-data-type=DT_DT_GW_TCM_CRC_RND, implementation-data-type=DT_GW_TCM_CRC_RND
        application-data-type=DT_DT_GW_TCM_SelfCheckSt, implementation-data-type=DT_GW_TCM_SelfCheckSt
    DTMSVCU_0xB7
      data-type-maps:
        application-data-type=DT_DT_VCU_CRC_B7, implementation-data-type=DT_VCU_CRC_B7
        application-data-type=DT_DT_VCU_KeepWorkModeFlag, implementation-data-type=DT_VCU_KeepWorkModeFlag
        application-data-type=DT_DT_VCU_MAI_Active, implementation-data-type=DT_VCU_MAI_Active
        application-data-type=DT_DT_VCU_MAI_Available, implementation-data-type=DT_VCU_MAI_Available
        application-data-type=DT_DT_VCU_GetCrashStsReq, implementation-data-type=DT_VCU_GetCrashStsReq
        application-data-type=DT_DT_VCU_ADASPosTorqueCap_VD, implementation-data-type=DT_VCU_ADASPosTorqueCap_VD
        application-data-type=DT_DT_VCU_ADASPosTorqueCap, implementation-data-type=DT_VCU_ADASPosTorqueCap
        application-data-type=DT_DT_VCU_RollingCounter_B7, implementation-data-type=DT_VCU_RollingCounter_B7
        application-data-type=DT_DT_VCU_Vehicle_Warning_IDB7_CCAN, implementation-data-type=DT_VCU_Vehicle_Warning_IDB7_CCAN
        application-data-type=DT_DT_VCU_VehicleSts_IDB7_CCAN, implementation-data-type=DT_VCU_VehicleSts_IDB7_CCAN
        application-data-type=DT_DT_VCU_PowerReduceReq, implementation-data-type=DT_VCU_PowerReduceReq
        application-data-type=DT_DT_VCU_ParkingReqToEPB_VD, implementation-data-type=DT_VCU_ParkingReqToEPB_VD
        application-data-type=DT_DT_VCU_ParkingReqToEPB, implementation-data-type=DT_VCU_ParkingReqToEPB
        application-data-type=DT_DT_VCU_ACCAvailable, implementation-data-type=DT_VCU_ACCAvailable
        application-data-type=DT_DT_VCU_ACCActiveSts, implementation-data-type=DT_VCU_ACCActiveSts
        application-data-type=DT_DT_VCU_Active_APS, implementation-data-type=DT_VCU_Active_APS
        application-data-type=DT_DT_VCU_Available_APS, implementation-data-type=DT_VCU_Available_APS
        application-data-type=DT_DT_VCU_ESCActive, implementation-data-type=DT_VCU_ESCActive
        application-data-type=DT_DT_VCU_ESCTorqReqAvailability_Rear, implementation-data-type=DT_VCU_ESCTorqReqAvailability_Rear
        application-data-type=DT_DT_VCU_AutoHold_ibit, implementation-data-type=DT_VCU_AutoHold_ibit
        application-data-type=DT_DT_VCU_VehicleSpeedVD, implementation-data-type=DT_VCU_VehicleSpeedVD
        application-data-type=DT_DT_VCU_CCSStatus, implementation-data-type=DT_VCU_CCSStatus
        application-data-type=DT_DT_VCU_AutoDriveRequest, implementation-data-type=DT_VCU_AutoDriveRequest
        application-data-type=DT_DT_VCU_CCSAllow, implementation-data-type=DT_VCU_CCSAllow
        application-data-type=DT_DT_VCU_VlcHoldSts, implementation-data-type=DT_VCU_VlcHoldSts
        application-data-type=DT_DT_VCU_HoldReqSts, implementation-data-type=DT_VCU_HoldReqSts
        application-data-type=DT_DT_VCU_HoldReqStsValid, implementation-data-type=DT_VCU_HoldReqStsValid
        application-data-type=DT_DT_VCU_DriverAssistProhibitSts_IDB7_CCAN, implementation-data-type=DT_VCU_DriverAssistProhibitSts_IDB7_CCAN
        application-data-type=DT_DT_VCU_SpeedLimitedSts, implementation-data-type=DT_VCU_SpeedLimitedSts
        application-data-type=DT_DT_VCU_SpeedLimitedValue, implementation-data-type=DT_VCU_SpeedLimitedValue
        application-data-type=DT_DT_VCU_TheoAccePedalPercent, implementation-data-type=DT_VCU_TheoAccePedalPercent
        application-data-type=DT_DT_VCU_RecuBrakeTorqueCap, implementation-data-type=DT_VCU_RecuBrakeTorqueCap
        application-data-type=DT_DT_VCU_RecuBrakeTorqueAct, implementation-data-type=DT_VCU_RecuBrakeTorqueAct
        application-data-type=DT_DT_VCU_TheoAccePedalValid, implementation-data-type=DT_VCU_TheoAccePedalValid
        application-data-type=DT_DT_VCU_HydraTorqTgt, implementation-data-type=DT_VCU_HydraTorqTgt
        application-data-type=DT_DT_VCU_RecuBrakeTorqueActDrag, implementation-data-type=DT_VCU_RecuBrakeTorqueActDrag
        application-data-type=DT_DT_VCU_ESCTorqReqAvailability_Frnt, implementation-data-type=DT_VCU_ESCTorqReqAvailability_Frnt
        application-data-type=DT_DT_VCU_RecuBrakeTorqueCap_Q, implementation-data-type=DT_VCU_RecuBrakeTorqueCap_Q
        application-data-type=DT_DT_VCU_RecuBrakeTorqueAct_Q, implementation-data-type=DT_VCU_RecuBrakeTorqueAct_Q
        application-data-type=DT_DT_VCU_HydraTorqTgt_Q, implementation-data-type=DT_VCU_HydraTorqTgt_Q
        application-data-type=DT_DT_VCU_RecuBrakeTorqueActDrag_Q, implementation-data-type=DT_VCU_RecuBrakeTorqueActDrag_Q
        application-data-type=DT_DT_VCU_RecuBrakeTorqueTarget_Drag, implementation-data-type=DT_VCU_RecuBrakeTorqueTarget_Drag
        application-data-type=DT_DT_VCU_PreventVehSlipSts, implementation-data-type=DT_VCU_PreventVehSlipSts
        application-data-type=DT_DT_VCU_RecuBrakeTorqueTarget_Drag_Q, implementation-data-type=DT_VCU_RecuBrakeTorqueTarget_Drag_Q
        application-data-type=DT_DT_VCU_AllMotWhlTrqFB, implementation-data-type=DT_VCU_AllMotWhlTrqFB
        application-data-type=DT_DT_VCU_AllMotWhlTrqFB_VD, implementation-data-type=DT_VCU_AllMotWhlTrqFB_VD
        application-data-type=DT_DT_VCU_LSFC_Allow, implementation-data-type=DT_VCU_LSFC_Allow
        application-data-type=DT_DT_VCU_LSFC_Active, implementation-data-type=DT_VCU_LSFC_Active
        application-data-type=DT_DT_VCU_MGCUWorkMode_C, implementation-data-type=DT_VCU_MGCUWorkMode_C
        application-data-type=DT_DT_VCU_AllRoadSts, implementation-data-type=DT_VCU_AllRoadSts
        application-data-type=DT_DT_VCU_CmpUTurnAllow, implementation-data-type=DT_VCU_CmpUTurnAllow
        application-data-type=DT_DT_VCU_CmpUTurnSts, implementation-data-type=DT_VCU_CmpUTurnSts
        application-data-type=DT_DT_VCU_AllowCmpUTurnStartFlag, implementation-data-type=DT_VCU_AllowCmpUTurnStartFlag
        application-data-type=DT_DT_VCU_CmpUTurnLockWhl, implementation-data-type=DT_VCU_CmpUTurnLockWhl
        application-data-type=DT_DT_VCU_CmpUTurnActAngle, implementation-data-type=DT_VCU_CmpUTurnActAngle
        application-data-type=DT_DT_VCU_CmpUTurnActSpinSpd, implementation-data-type=DT_VCU_CmpUTurnActSpinSpd
        application-data-type=DT_DT_VCU_CmpUTurnFltHMI, implementation-data-type=DT_VCU_CmpUTurnFltHMI
        application-data-type=DT_DT_VCU_EscapeModeSts, implementation-data-type=DT_VCU_EscapeModeSts
        application-data-type=DT_DT_VCU_MCUSWorkFailMsg, implementation-data-type=DT_VCU_MCUSWorkFailMsg
        application-data-type=DT_DT_VCU_EscapeWorkFailMsg, implementation-data-type=DT_VCU_EscapeWorkFailMsg
        application-data-type=DT_DT_VCU_REClutchFltMsg, implementation-data-type=DT_VCU_REClutchFltMsg
        application-data-type=DT_DT_VCU_MCUSWorkFailMsg, implementation-data-type=DT_VCU_MCUSWorkFailMsg
        application-data-type=DT_DT_VCU_EscapeWorkFailMsg, implementation-data-type=DT_VCU_EscapeWorkFailMsg
        application-data-type=DT_DT_VCU_REClutchFltMsg, implementation-data-type=DT_VCU_REClutchFltMsg
        application-data-type=DT_DT_VCU_BoostMode_Fail_C, implementation-data-type=DT_VCU_BoostMode_Fail_C
        application-data-type=DT_DT_VCU_BoostModeSts_C, implementation-data-type=DT_VCU_BoostModeSts_C
    DTMSVCU_0xE6
      data-type-maps:
        application-data-type=DT_DT_DbgSignal{1..12}_FA, implementation-data-type=DT_DbgSignal{1..12}_FA
        application-data-type=DT_DT_DbgSignal{1..12}_RA, implementation-data-type=DT_DbgSignal{1..12}_RA
    DTMSUDS_Phy_Tx_7E8_ECM
      data-type-maps:
        application-data-type=DT_DT_ECM_UDS_Res_Byte{0..7}, implementation-data-type=DT_ECM_UDS_Res_Byte{0..7}
    DTMSVCU_0x1E5
      data-type-maps:
        application-data-type=DT_DT_VCU_BCM_Authentication_MAC_A{0..15}, implementation-data-type=DT_VCU_BCM_Authentication_MAC_A{0..15}
        application-data-type=DT_DT_VCU_BCM_Authentication_Challenge_B{0..3}, implementation-data-type=DT_VCU_BCM_Authentication_Challenge_B{0..3}
    DTMSTMS_0x5FF
      data-type-maps:
        application-data-type=DT_DT_TMS_MCUMHeatPwrReq, implementation-data-type=DT_TMS_MCUMHeatPwrReq
        application-data-type=DT_DT_TMS_MCUMHeatModEnad, implementation-data-type=DT_TMS_MCUMHeatModEnad
        application-data-type=DT_DT_TMS_VCU_MotSelfHeatEnReq, implementation-data-type=DT_TMS_VCU_MotSelfHeatEnReq
        application-data-type=DT_DT_TMS_VCU_MotSelfHeatLvlReq, implementation-data-type=DT_TMS_VCU_MotSelfHeatLvlReq
    DTMSECM_0x148
      data-type-maps:
        application-data-type=DT_DT_ECM_SWVersionC, implementation-data-type=DT_ECM_SWVersionC
        application-data-type=DT_DT_ECM_SWVersionB, implementation-data-type=DT_ECM_SWVersionB
        application-data-type=DT_DT_ECM_SWVersionA, implementation-data-type=DT_ECM_SWVersionA
        application-data-type=DT_DT_ECM_Total_fuel_consumed, implementation-data-type=DT_ECM_Total_fuel_consumed
    DTMSIVI_0x331
      data-type-maps:
        application-data-type=DT_DT_IVI_CRC_331, implementation-data-type=DT_IVI_CRC_331
        application-data-type=DT_DT_IVI_RollingCounter_331, implementation-data-type=DT_IVI_RollingCounter_331
        application-data-type=DT_DT_IVI_EPBRequst, implementation-data-type=DT_IVI_EPBRequst
        application-data-type=DT_DT_IVI_TerrainMatchMode, implementation-data-type=DT_IVI_TerrainMatchMode
        application-data-type=DT_DT_IVI_LPedalModeSW, implementation-data-type=DT_IVI_LPedalModeSW
        application-data-type=DT_DT_IVI_AVHSw_X, implementation-data-type=DT_IVI_AVHSw_X
        application-data-type=DT_DT_IVI_ESCSw_X, implementation-data-type=DT_IVI_ESCSw_X
        application-data-type=DT_DT_IVI_HDCSw_X, implementation-data-type=DT_IVI_HDCSw_X
        application-data-type=DT_DT_IVI_CSTSw_X, implementation-data-type=DT_IVI_CSTSw_X
        application-data-type=DT_DT_IVI_AutoAllRoad, implementation-data-type=DT_IVI_AutoAllRoad
        application-data-type=DT_DT_IVI_CampingMode_SW, implementation-data-type=DT_IVI_CampingMode_SW
        application-data-type=DT_DT_IVI_BraPedMod, implementation-data-type=DT_IVI_BraPedMod
        application-data-type=DT_DT_IVI_SlowspeedSmartCtrl, implementation-data-type=DT_IVI_SlowspeedSmartCtrl
        application-data-type=DT_DT_IVI_TrailerModeCtrl, implementation-data-type=DT_IVI_TrailerModeCtrl
        application-data-type=DT_DT_IVI_EscapeMode_SW, implementation-data-type=DT_IVI_EscapeMode_SW
        application-data-type=DT_DT_IVI_PowerSavingModeReq, implementation-data-type=DT_IVI_PowerSavingModeReq
        application-data-type=DT_DT_IVI_SelfAdaptionDriveSW, implementation-data-type=DT_IVI_SelfAdaptionDriveSW
        application-data-type=DT_DT_IVI_CmpUTurnStartUI, implementation-data-type=DT_IVI_CmpUTurnStartUI
        application-data-type=DT_DT_IVI_CmpUTurnLockWhlUI, implementation-data-type=DT_IVI_CmpUTurnLockWhlUI
        application-data-type=DT_DT_IVI_CmpUTurnTarDirUI, implementation-data-type=DT_IVI_CmpUTurnTarDirUI
        application-data-type=DT_DT_IVI_CmpUTurnTarAngleUI, implementation-data-type=DT_IVI_CmpUTurnTarAngleUI
        application-data-type=DT_DT_IVI_CmpUTurnReq, implementation-data-type=DT_IVI_CmpUTurnReq
    DTMSIVI_0x3D8
      data-type-maps:
        application-data-type=DT_DT_IVI_InventerLimitOdometerkm, implementation-data-type=DT_IVI_InventerLimitOdometerkm
        application-data-type=DT_DT_IVI_FuelDetMode, implementation-data-type=DT_IVI_FuelDetMode
        application-data-type=DT_DT_IVI_EngineIdlingMode, implementation-data-type=DT_IVI_EngineIdlingMode
        application-data-type=DT_DT_IVI_CarWashMode, implementation-data-type=DT_IVI_CarWashMode
        application-data-type=DT_DT_IVI_CampingModeSW, implementation-data-type=DT_IVI_CampingModeSW
        application-data-type=DT_DT_IVI_SpeedLimitModeSW, implementation-data-type=DT_IVI_SpeedLimitModeSW
        application-data-type=DT_DT_IVI_FuelupReq, implementation-data-type=DT_IVI_FuelupReq
        application-data-type=DT_DT_IVI_FuelChgLevel, implementation-data-type=DT_IVI_FuelChgLevel
        application-data-type=DT_DT_IVI_FuelChgMode, implementation-data-type=DT_IVI_FuelChgMode
        application-data-type=DT_DT_IVI_InventerLimitOdometerkmVD, implementation-data-type=DT_IVI_InventerLimitOdometerkmVD
        application-data-type=DT_DT_IVI_EMSRepairModeReq, implementation-data-type=DT_IVI_EMSRepairModeReq
        application-data-type=DT_DT_IVI_ForceChgModeReq, implementation-data-type=DT_IVI_ForceChgModeReq
        application-data-type=DT_DT_IVI_ForceChgTargetSOCVD, implementation-data-type=DT_IVI_ForceChgTargetSOCVD
        application-data-type=DT_DT_IVI_SpeedLimitModeSpeed, implementation-data-type=DT_IVI_SpeedLimitModeSpeed
        application-data-type=DT_DT_IVI_AWDModeSW, implementation-data-type=DT_IVI_AWDModeSW
        application-data-type=DT_DT_IVI_ForceChgTargetSOC, implementation-data-type=DT_IVI_ForceChgTargetSOC
    DTMSHPCBCM_0x292
      data-type-maps:
        application-data-type=DT_DT_BCM_VCU_Authentication_Sts, implementation-data-type=DT_BCM_VCU_Authentication_Sts
        application-data-type=DT_DT_BCM_PTCLossMissErr, implementation-data-type=DT_BCM_PTCLossMissErr
        application-data-type=DT_DT_BCM_PTCRollCntErr, implementation-data-type=DT_BCM_PTCRollCntErr
        application-data-type=DT_DT_BCM_PTCChksumErr, implementation-data-type=DT_BCM_PTCChksumErr
        application-data-type=DT_DT_BCM_PDUHVIL_STs, implementation-data-type=DT_BCM_PDUHVIL_STs
        application-data-type=DT_DT_BCM_Cab220VHVIL_STs, implementation-data-type=DT_BCM_Cab220VHVIL_STs
        application-data-type=DT_DT_BCM_Cabin220VHVIL_STs, implementation-data-type=DT_BCM_Cabin220VHVIL_STs
    DTMSIBC_0x185
      data-type-maps:
        application-data-type=DT_DT_IBC_CRC_185, implementation-data-type=DT_IBC_CRC_185
        application-data-type=DT_DT_IBC_RollingCounter_185, implementation-data-type=DT_IBC_RollingCounter_185
        application-data-type=DT_DT_IBC_PlungerPressure, implementation-data-type=DT_IBC_PlungerPressure
        application-data-type=DT_DT_IBC_PlungerPressure_Q, implementation-data-type=DT_IBC_PlungerPressure_Q
        application-data-type=DT_DT_IBC_SimulatorPressure, implementation-data-type=DT_IBC_SimulatorPressure
        application-data-type=DT_DT_IBC_SimulatorPressure_Q, implementation-data-type=DT_IBC_SimulatorPressure_Q
        application-data-type=DT_DT_IBC_HMI_WarningOn, implementation-data-type=DT_IBC_HMI_WarningOn
        application-data-type=DT_DT_IBC_MIL_WarningOn, implementation-data-type=DT_IBC_MIL_WarningOn
        application-data-type=DT_DT_IBC_LongitAcceAct, implementation-data-type=DT_IBC_LongitAcceAct
        application-data-type=DT_DT_IBC_LongitAcceActValid, implementation-data-type=DT_IBC_LongitAcceActValid
        application-data-type=DT_DT_IBC_brakeFluidWarning, implementation-data-type=DT_IBC_brakeFluidWarning
        application-data-type=DT_DT_IBC_SCM_Active, implementation-data-type=DT_IBC_SCM_Active
        application-data-type=DT_DT_IBC_SCM_Failed, implementation-data-type=DT_IBC_SCM_Failed
        application-data-type=DT_DT_IBC_CDPAvailable, implementation-data-type=DT_IBC_CDPAvailable
        application-data-type=DT_DT_IBC_CDPIntervention, implementation-data-type=DT_IBC_CDPIntervention
        application-data-type=DT_DT_IBC_AEB_active, implementation-data-type=DT_IBC_AEB_active
        application-data-type=DT_DT_IBC_AEBdecAvailable, implementation-data-type=DT_IBC_AEBdecAvailable
        application-data-type=DT_DT_IBC_AVHStatus, implementation-data-type=DT_IBC_AVHStatus
        application-data-type=DT_DT_IBC_AVHAvailable, implementation-data-type=DT_IBC_AVHAvailable
        application-data-type=DT_DT_IBC_HHCActive, implementation-data-type=DT_IBC_HHCActive
        application-data-type=DT_DT_IBC_HHCFailed, implementation-data-type=DT_IBC_HHCFailed
        application-data-type=DT_DT_IBC_CDD_Available_APA, implementation-data-type=DT_IBC_CDD_Available_APA
        application-data-type=DT_DT_IBC_CDD_Active_APA, implementation-data-type=DT_IBC_CDD_Active_APA
        application-data-type=DT_DT_IBC_CDD_Available_ACC, implementation-data-type=DT_IBC_CDD_Available_ACC
        application-data-type=DT_DT_IBC_CDD_Active_ACC, implementation-data-type=DT_IBC_CDD_Active_ACC
        application-data-type=DT_DT_IBC_HDCStatus, implementation-data-type=DT_IBC_HDCStatus
        application-data-type=DT_DT_IBC_HDCAvailable, implementation-data-type=DT_IBC_HDCAvailable
        application-data-type=DT_DT_IBC_CSTStatus, implementation-data-type=DT_IBC_CSTStatus
        application-data-type=DT_DT_IBC_CSTAvailable, implementation-data-type=DT_IBC_CSTAvailable
        application-data-type=DT_DT_IBC_VLC_Available_ACC, implementation-data-type=DT_IBC_VLC_Available_ACC
        application-data-type=DT_DT_IBC_VLC_Active_ACC, implementation-data-type=DT_IBC_VLC_Active_ACC
        application-data-type=DT_DT_IBC_VLC_Available_APA, implementation-data-type=DT_IBC_VLC_Available_APA
        application-data-type=DT_DT_IBC_VLC_Active_APA, implementation-data-type=DT_IBC_VLC_Active_APA
        application-data-type=DT_DT_IBC_VehicleHoldStatus, implementation-data-type=DT_IBC_VehicleHoldStatus
        application-data-type=DT_DT_IBC_DrvrBrkTqAtWhlsReqd, implementation-data-type=DT_IBC_DrvrBrkTqAtWhlsReqd
    DTMSTMS_0x363
      data-type-maps:
        application-data-type=DT_DT_TMS_RollingCounter_363, implementation-data-type=DT_TMS_RollingCounter_363
        application-data-type=DT_DT_TMS_AC_Command, implementation-data-type=DT_TMS_AC_Command
        application-data-type=DT_DT_TMS_PTCHeatingReq, implementation-data-type=DT_TMS_PTCHeatingReq
        application-data-type=DT_DT_TMS_PTCPowerSet, implementation-data-type=DT_TMS_PTCPowerSet
        application-data-type=DT_DT_TMS_OutsideTempVD, implementation-data-type=DT_TMS_OutsideTempVD
        application-data-type=DT_DT_TMS_OutsideTemp_Corrected, implementation-data-type=DT_TMS_OutsideTemp_Corrected
    DTMSBMS_0x5B1
      data-type-maps:
        application-data-type=DT_DT_BMS_SOC_Real, implementation-data-type=DT_BMS_SOC_Real
        application-data-type=DT_DT_BMS_MODE_t, implementation-data-type=DT_BMS_MODE_t
        application-data-type=DT_DT_BMS_VoltLoDeratLevel_NA, implementation-data-type=DT_BMS_VoltLoDeratLevel_NA
        application-data-type=DT_DT_BMS_VoltHiDeratLevel_NA, implementation-data-type=DT_BMS_VoltHiDeratLevel_NA
    DTMSTMS_0x561
      data-type-maps:
        application-data-type=DT_DT_TMS_MCUOutTemp, implementation-data-type=DT_TMS_MCUOutTemp
        application-data-type=DT_DT_TMS_MCUMIntelTemp, implementation-data-type=DT_TMS_MCUMIntelTemp
        application-data-type=DT_DT_TMS_MCUSIntelTemp, implementation-data-type=DT_TMS_MCUSIntelTemp
    DTMSHPCBCM_0x1E4
      data-type-maps:
        application-data-type=DT_DT_BCM_VCU_Authentication_Challenge_A{0..3}, implementation-data-type=DT_BCM_VCU_Authentication_Challenge_A{0..3}
    DTMSICU_0xDF
      data-type-maps:
        application-data-type=DT_DT_ICU_CRC_DF, implementation-data-type=DT_ICU_CRC_DF
        application-data-type=DT_DT_ICU_RollingCounter_DF, implementation-data-type=DT_ICU_RollingCounter_DF
        application-data-type=DT_DT_ICU_IMU_ACC_x, implementation-data-type=DT_ICU_IMU_ACC_x
        application-data-type=DT_DT_ICU_IMU_ACC_y, implementation-data-type=DT_ICU_IMU_ACC_y
        application-data-type=DT_DT_ICU_IMU_ACC_z, implementation-data-type=DT_ICU_IMU_ACC_z
        application-data-type=DT_DT_ICU_IMU_ACC_Roll_Rate, implementation-data-type=DT_ICU_IMU_ACC_Roll_Rate
        application-data-type=DT_DT_ICU_IMU_ACC_Pitch_Rate, implementation-data-type=DT_ICU_IMU_ACC_Pitch_Rate
        application-data-type=DT_DT_ICU_IMU_ACC_Yaw_Rate, implementation-data-type=DT_ICU_IMU_ACC_Yaw_Rate
        application-data-type=DT_DT_ICU_IMU_Calibrated, implementation-data-type=DT_ICU_IMU_Calibrated
        application-data-type=DT_DT_ICU_IMU_Valid, implementation-data-type=DT_ICU_IMU_Valid
    DTMSMCU_0x5CA
      data-type-maps:
        application-data-type=DT_DT_EddyCur_Para_Cos_m, implementation-data-type=DT_EddyCur_Para_Cos_m
        application-data-type=DT_DT_EddyCur_Stage, implementation-data-type=DT_EddyCur_Stage
        application-data-type=DT_DT_EddyCur_IdenFinish_Flag, implementation-data-type=DT_EddyCur_IdenFinish_Flag
        application-data-type=DT_DT_EddyCur_Para_Sin_m, implementation-data-type=DT_EddyCur_Para_Sin_m
        application-data-type=DT_DT_EddyCur_Write_Flag, implementation-data-type=DT_EddyCur_Write_Flag
        application-data-type=DT_DT_EddyCur_FauPro_IDEL_OTime_Flag, implementation-data-type=DT_EddyCur_FauPro_IDEL_OTime_Flag
        application-data-type=DT_DT_EddyCur_FauPro_SpdInstab_Flag, implementation-data-type=DT_EddyCur_FauPro_SpdInstab_Flag
        application-data-type=DT_DT_EddyCur_FauPro_IDPara_OVal_Flag, implementation-data-type=DT_EddyCur_FauPro_IDPara_OVal_Flag
        application-data-type=DT_DT_EddyCur_Para_Cos_k, implementation-data-type=DT_EddyCur_Para_Cos_k
        application-data-type=DT_DT_EddyCur_Enable, implementation-data-type=DT_EddyCur_Enable
        application-data-type=DT_DT_EddyCur_Para_Sin_k, implementation-data-type=DT_EddyCur_Para_Sin_k
        application-data-type=DT_DT_EddyCur_IdenFail_Flag, implementation-data-type=DT_EddyCur_IdenFail_Flag
        application-data-type=DT_DT_EddyCur_Para_Cos_Pha, implementation-data-type=DT_EddyCur_Para_Cos_Pha
        application-data-type=DT_DT_EddyCur_Para_Sin_Pha, implementation-data-type=DT_EddyCur_Para_Sin_Pha
        application-data-type=DT_DT_EddyCur_ReadSuccess_Flag, implementation-data-type=DT_EddyCur_ReadSuccess_Flag
        application-data-type=DT_DT_OfsIden_ReadSuccess_Flag, implementation-data-type=DT_OfsIden_ReadSuccess_Flag
        application-data-type=DT_DT_OfsIden_SpdUp_Overtime, implementation-data-type=DT_OfsIden_SpdUp_Overtime
        application-data-type=DT_DT_OfsIden_SpdUp_OverSpd, implementation-data-type=DT_OfsIden_SpdUp_OverSpd
        application-data-type=DT_DT_OfsIden_IdenDiverge, implementation-data-type=DT_OfsIden_IdenDiverge
        application-data-type=DT_DT_OfsIden_IdenCntOver, implementation-data-type=DT_OfsIden_IdenCntOver
        application-data-type=DT_DT_OfsIden_MtrLock, implementation-data-type=DT_OfsIden_MtrLock
        application-data-type=DT_DT_OfsIden_OfsRslt, implementation-data-type=DT_OfsIden_OfsRslt
        application-data-type=DT_DT_OfsIden_Sts, implementation-data-type=DT_OfsIden_Sts
        application-data-type=DT_DT_OfsIden_Finish, implementation-data-type=DT_OfsIden_Finish
        application-data-type=DT_DT_OfsIden_OfsWrite_Finish, implementation-data-type=DT_OfsIden_OfsWrite_Finish
        application-data-type=DT_DT_OfsIden_DirWrite_Finish, implementation-data-type=DT_OfsIden_DirWrite_Finish
        application-data-type=DT_DT_OfsIden_DirIden_Rslt, implementation-data-type=DT_OfsIden_DirIden_Rslt
        application-data-type=DT_DT_OfsIden_ZeroAlign_OverTime, implementation-data-type=DT_OfsIden_ZeroAlign_OverTime
        application-data-type=DT_DT_OfsIden_ZeroAlign_Fail, implementation-data-type=DT_OfsIden_ZeroAlign_Fail
        application-data-type=DT_DT_OfsIden_IFStart_Overtime, implementation-data-type=DT_OfsIden_IFStart_Overtime
        application-data-type=DT_DT_OfsIden_IFStart_Fail, implementation-data-type=DT_OfsIden_IFStart_Fail
        application-data-type=DT_DT_PosDly_Cal_RslvDelayTime, implementation-data-type=DT_PosDly_Cal_RslvDelayTime
        application-data-type=DT_DT_PosDly_Theta_k_Std, implementation-data-type=DT_PosDly_Theta_k_Std
        application-data-type=DT_DT_PosDly_Supplier, implementation-data-type=DT_PosDly_Supplier
        application-data-type=DT_DT_PosDly_FauPro_Ident_OTm_Flag, implementation-data-type=DT_PosDly_FauPro_Ident_OTm_Flag
        application-data-type=DT_DT_PosDly_FauPro_SpdDn_OTm_Flag, implementation-data-type=DT_PosDly_FauPro_SpdDn_OTm_Flag
        application-data-type=DT_DT_PosDly_RslvOffsetComp, implementation-data-type=DT_PosDly_RslvOffsetComp
        application-data-type=DT_DT_PosDly_Enable, implementation-data-type=DT_PosDly_Enable
        application-data-type=DT_DT_PosDly_IdentFail_Flag, implementation-data-type=DT_PosDly_IdentFail_Flag
        application-data-type=DT_DT_PosDly_IdentFinish_Flag, implementation-data-type=DT_PosDly_IdentFinish_Flag
        application-data-type=DT_DT_PosDly_Write_Flag, implementation-data-type=DT_PosDly_Write_Flag
        application-data-type=DT_DT_PosDly_FauPro_Chk_DlyTime_OVal, implementation-data-type=DT_PosDly_FauPro_Chk_DlyTime_OVal
        application-data-type=DT_DT_PosDly_FauPro_Chk_RslvOfst_OVal, implementation-data-type=DT_PosDly_FauPro_Chk_RslvOfst_OVal
        application-data-type=DT_DT_PosDly_FauPro_Check_Divergence, implementation-data-type=DT_PosDly_FauPro_Check_Divergence
        application-data-type=DT_DT_PosDly_FauPro_SpdUp_OTm_Flag, implementation-data-type=DT_PosDly_FauPro_SpdUp_OTm_Flag
        application-data-type=DT_DT_PosDly_Stage, implementation-data-type=DT_PosDly_Stage
        application-data-type=DT_DT_IMParaIdent_ParEstMainStep, implementation-data-type=DT_IMParaIdent_ParEstMainStep
        application-data-type=DT_DT_IMParaIdent_Rs, implementation-data-type=DT_IMParaIdent_Rs
        application-data-type=DT_DT_IMParaIdent_Rr, implementation-data-type=DT_IMParaIdent_Rr
        application-data-type=DT_DT_IMParaIdent_Ll, implementation-data-type=DT_IMParaIdent_Ll
        application-data-type=DT_DT_IMParaIdent_Lm, implementation-data-type=DT_IMParaIdent_Lm
        application-data-type=DT_DT_IMParaIdent_TotalLo, implementation-data-type=DT_IMParaIdent_TotalLo
        application-data-type=DT_DT_IMParaIdent_IdentSubStep, implementation-data-type=DT_IMParaIdent_IdentSubStep
        application-data-type=DT_DT_MCUMR_EddyCur_Para_Cos_m, implementation-data-type=DT_MCUMR_EddyCur_Para_Cos_m
        application-data-type=DT_DT_MCUMR_EddyCur_Stage, implementation-data-type=DT_MCUMR_EddyCur_Stage
        application-data-type=DT_DT_MCUMR_EddyCur_IdenFinish_Flag, implementation-data-type=DT_MCUMR_EddyCur_IdenFinish_Flag
        application-data-type=DT_DT_MCUMR_EddyCur_Para_Sin_m, implementation-data-type=DT_MCUMR_EddyCur_Para_Sin_m
        application-data-type=DT_DT_MCUMR_EddyCur_Write_Flag, implementation-data-type=DT_MCUMR_EddyCur_Write_Flag
        application-data-type=DT_DT_MCUMR_EddyCur_FauPro_IDEL_OTime_Flag, implementation-data-type=DT_MCUMR_EddyCur_FauPro_IDEL_OTime_Flag
        application-data-type=DT_DT_MCUMR_EddyCur_FauPro_SpdInstab_Flag, implementation-data-type=DT_MCUMR_EddyCur_FauPro_SpdInstab_Flag
        application-data-type=DT_DT_MCUMR_EddyCur_FauPro_IDPara_OVal_Flag, implementation-data-type=DT_MCUMR_EddyCur_FauPro_IDPara_OVal_Flag
        application-data-type=DT_DT_MCUMR_EddyCur_Para_Cos_k, implementation-data-type=DT_MCUMR_EddyCur_Para_Cos_k
        application-data-type=DT_DT_MCUMR_EddyCur_Enable, implementation-data-type=DT_MCUMR_EddyCur_Enable
        application-data-type=DT_DT_MCUMR_EddyCur_Para_Sin_k, implementation-data-type=DT_MCUMR_EddyCur_Para_Sin_k
        application-data-type=DT_DT_MCUMR_EddyCur_IdenFail_Flag, implementation-data-type=DT_MCUMR_EddyCur_IdenFail_Flag
        application-data-type=DT_DT_MCUMR_EddyCur_Para_Cos_Pha, implementation-data-type=DT_MCUMR_EddyCur_Para_Cos_Pha
        application-data-type=DT_DT_MCUMR_EddyCur_Para_Sin_Pha, implementation-data-type=DT_MCUMR_EddyCur_Para_Sin_Pha
        application-data-type=DT_DT_MCUMR_EddyCur_ReadSuccess_Flag, implementation-data-type=DT_MCUMR_EddyCur_ReadSuccess_Flag
        application-data-type=DT_DT_MCUMR_OfsIden_ReadSuccess_Flag, implementation-data-type=DT_MCUMR_OfsIden_ReadSuccess_Flag
        application-data-type=DT_DT_MCUMR_OfsIden_SpdUp_Overtime, implementation-data-type=DT_MCUMR_OfsIden_SpdUp_Overtime
        application-data-type=DT_DT_MCUMR_OfsIden_SpdUp_OverSpd, implementation-data-type=DT_MCUMR_OfsIden_SpdUp_OverSpd
        application-data-type=DT_DT_MCUMR_OfsIden_IdenDiverge, implementation-data-type=DT_MCUMR_OfsIden_IdenDiverge
        application-data-type=DT_DT_MCUMR_OfsIden_IdenCntOver, implementation-data-type=DT_MCUMR_OfsIden_IdenCntOver
        application-data-type=DT_DT_MCUMR_OfsIden_MtrLock, implementation-data-type=DT_MCUMR_OfsIden_MtrLock
        application-data-type=DT_DT_MCUMR_OfsIden_OfsRslt, implementation-data-type=DT_MCUMR_OfsIden_OfsRslt
        application-data-type=DT_DT_MCUMR_OfsIden_Sts, implementation-data-type=DT_MCUMR_OfsIden_Sts
        application-data-type=DT_DT_MCUMR_OfsIden_Finish, implementation-data-type=DT_MCUMR_OfsIden_Finish
        application-data-type=DT_DT_MCUMR_OfsIden_OfsWrite_Finish, implementation-data-type=DT_MCUMR_OfsIden_OfsWrite_Finish
        application-data-type=DT_DT_MCUMR_OfsIden_DirWrite_Finish, implementation-data-type=DT_MCUMR_OfsIden_DirWrite_Finish
        application-data-type=DT_DT_MCUMR_OfsIden_DirIden_Rslt, implementation-data-type=DT_MCUMR_OfsIden_DirIden_Rslt
        application-data-type=DT_DT_MCUMR_OfsIden_ZeroAlign_OverTime, implementation-data-type=DT_MCUMR_OfsIden_ZeroAlign_OverTime
        application-data-type=DT_DT_MCUMR_OfsIden_ZeroAlign_Fail, implementation-data-type=DT_MCUMR_OfsIden_ZeroAlign_Fail
        application-data-type=DT_DT_MCUMR_OfsIden_IFStart_Overtime, implementation-data-type=DT_MCUMR_OfsIden_IFStart_Overtime
        application-data-type=DT_DT_MCUMR_OfsIden_IFStart_Fail, implementation-data-type=DT_MCUMR_OfsIden_IFStart_Fail
    DTMSMCUM_0x5D3
      data-type-maps:
        application-data-type=DT_DT_MCUM_StatorTemp_1, implementation-data-type=DT_MCUM_StatorTemp_1
        application-data-type=DT_DT_MCUM_L2TqAct, implementation-data-type=DT_MCUM_L2TqAct
        application-data-type=DT_DT_MCUM_EOPSw, implementation-data-type=DT_MCUM_EOPSw
        application-data-type=DT_DT_MCUM_StatorTemp_2, implementation-data-type=DT_MCUM_StatorTemp_2
        application-data-type=DT_DT_MCUM_IGBTTemp_U, implementation-data-type=DT_MCUM_IGBTTemp_U
        application-data-type=DT_DT_MCUM_IGBTTemp_V, implementation-data-type=DT_MCUM_IGBTTemp_V
        application-data-type=DT_DT_MCUM_IGBTTemp_W, implementation-data-type=DT_MCUM_IGBTTemp_W
        application-data-type=DT_DT_MCUM_PCBTemp, implementation-data-type=DT_MCUM_PCBTemp
        application-data-type=DT_DT_MCUM_Power_12V, implementation-data-type=DT_MCUM_Power_12V
        application-data-type=DT_DT_MCUM_Power_15V, implementation-data-type=DT_MCUM_Power_15V
        application-data-type=DT_DT_MCUM_Offset_IU, implementation-data-type=DT_MCUM_Offset_IU
        application-data-type=DT_DT_MCUM_Offset_IV, implementation-data-type=DT_MCUM_Offset_IV
        application-data-type=DT_DT_MCUM_Offset_IW, implementation-data-type=DT_MCUM_Offset_IW
        application-data-type=DT_DT_MCUM_MainSt_State, implementation-data-type=DT_MCUM_MainSt_State
        application-data-type=DT_DT_MCUM_Derate_Reason, implementation-data-type=DT_MCUM_Derate_Reason
        application-data-type=DT_DT_MCUM_PWM_Freq_kHz, implementation-data-type=DT_MCUM_PWM_Freq_kHz
        application-data-type=DT_DT_MCUM_PWMEn_State, implementation-data-type=DT_MCUM_PWMEn_State
        application-data-type=DT_DT_MCUM_DrvPwrEn_Out_State, implementation-data-type=DT_MCUM_DrvPwrEn_Out_State
        application-data-type=DT_DT_MCUM_SBC_SelfCheckFault, implementation-data-type=DT_MCUM_SBC_SelfCheckFault
        application-data-type=DT_DT_MCUM_SBC_TempOverFault, implementation-data-type=DT_MCUM_SBC_TempOverFault
        application-data-type=DT_DT_MCUM_SBC_SPIFault, implementation-data-type=DT_MCUM_SBC_SPIFault
        application-data-type=DT_DT_MCUM_SBC_InsideVotageFault, implementation-data-type=DT_MCUM_SBC_InsideVotageFault
        application-data-type=DT_DT_MCUM_SBC_OutPutVotageFault, implementation-data-type=DT_MCUM_SBC_OutPutVotageFault
        application-data-type=DT_DT_MCUM_SBC_FeedDogFault, implementation-data-type=DT_MCUM_SBC_FeedDogFault
        application-data-type=DT_DT_MCUM_NVM_RslvrZeroRFault, implementation-data-type=DT_MCUM_NVM_RslvrZeroRFault
        application-data-type=DT_DT_MCUM_Rotor_Position, implementation-data-type=DT_MCUM_Rotor_Position
        application-data-type=DT_DT_MCUM_PosTransduserFaultCode, implementation-data-type=DT_MCUM_PosTransduserFaultCode
        application-data-type=DT_DT_MCUM_NVM_RslvrDirRFault, implementation-data-type=DT_MCUM_NVM_RslvrDirRFault
        application-data-type=DT_DT_MCUM_NVM_RslvrDelayRFault, implementation-data-type=DT_MCUM_NVM_RslvrDelayRFault
        application-data-type=DT_DT_MCUM_NVM_RslvrParamRFault, implementation-data-type=DT_MCUM_NVM_RslvrParamRFault
        application-data-type=DT_DT_MCUM_NVM_HallGainRFault, implementation-data-type=DT_MCUM_NVM_HallGainRFault
        application-data-type=DT_DT_MCUM_NVM_HallDelayRFault, implementation-data-type=DT_MCUM_NVM_HallDelayRFault
        application-data-type=DT_DT_MCUM_NVM_IGBTTypeRFault, implementation-data-type=DT_MCUM_NVM_IGBTTypeRFault
        application-data-type=DT_DT_MCUM_NVM_MotorTypeRFault, implementation-data-type=DT_MCUM_NVM_MotorTypeRFault
        application-data-type=DT_DT_MCUM_NVM_VehicleTypeRFault, implementation-data-type=DT_MCUM_NVM_VehicleTypeRFault
        application-data-type=DT_DT_MCUM_ASC_EntryCount, implementation-data-type=DT_MCUM_ASC_EntryCount
        application-data-type=DT_DT_MCUM_Spd_Turn, implementation-data-type=DT_MCUM_Spd_Turn
        application-data-type=DT_DT_MCUM_LUT_Spd_Max, implementation-data-type=DT_MCUM_LUT_Spd_Max
        application-data-type=DT_DT_MCUM_EOP_Speed, implementation-data-type=DT_MCUM_EOP_Speed
        application-data-type=DT_DT_MCUM_EOP_IqFb, implementation-data-type=DT_MCUM_EOP_IqFb
        application-data-type=DT_DT_MCUM_EOP_IqRef, implementation-data-type=DT_MCUM_EOP_IqRef
        application-data-type=DT_DT_MCUM_EOP_DCVolt, implementation-data-type=DT_MCUM_EOP_DCVolt
        application-data-type=DT_DT_MCUM_EOP_DCCurr, implementation-data-type=DT_MCUM_EOP_DCCurr
        application-data-type=DT_DT_MCUM_EOP_Temp, implementation-data-type=DT_MCUM_EOP_Temp
        application-data-type=DT_DT_MCUM_EOP_State, implementation-data-type=DT_MCUM_EOP_State
        application-data-type=DT_DT_MCUM_EOP_FaultCode, implementation-data-type=DT_MCUM_EOP_FaultCode
        application-data-type=DT_DT_MCUM_HWFault_RstCnt, implementation-data-type=DT_MCUM_HWFault_RstCnt
        application-data-type=DT_DT_MCUM_HWFoB_RstCnt, implementation-data-type=DT_MCUM_HWFoB_RstCnt
        application-data-type=DT_DT_MCUM_HWFoT_RstCnt, implementation-data-type=DT_MCUM_HWFoT_RstCnt
        application-data-type=DT_DT_MCUM_HWDrvUV_RstCnt, implementation-data-type=DT_MCUM_HWDrvUV_RstCnt
        application-data-type=DT_DT_MCUM_HWRdc_RstCnt, implementation-data-type=DT_MCUM_HWRdc_RstCnt
        application-data-type=DT_DT_MCUM_HWOC_RstCnt, implementation-data-type=DT_MCUM_HWOC_RstCnt
        application-data-type=DT_DT_MCUM_HWOV_RstCnt, implementation-data-type=DT_MCUM_HWOV_RstCnt
        application-data-type=DT_DT_MCUM_L2agRtrElecDiff, implementation-data-type=DT_MCUM_L2agRtrElecDiff
        application-data-type=DT_DT_MCUM_500usOverTime_Cnt, implementation-data-type=DT_MCUM_500usOverTime_Cnt
        application-data-type=DT_DT_MCUM_5msOverTime_Cnt, implementation-data-type=DT_MCUM_5msOverTime_Cnt
        application-data-type=DT_DT_MCUM_12VHop_Cnt, implementation-data-type=DT_MCUM_12VHop_Cnt
        application-data-type=DT_DT_MCUM_12V_Max, implementation-data-type=DT_MCUM_12V_Max
        application-data-type=DT_DT_MCUM_12V_Min, implementation-data-type=DT_MCUM_12V_Min
        application-data-type=DT_DT_MCUM_NVMFail_Cnt, implementation-data-type=DT_MCUM_NVMFail_Cnt
        application-data-type=DT_DT_MCUM_EOL_CANCommReq, implementation-data-type=DT_MCUM_EOL_CANCommReq
        application-data-type=DT_DT_MCUM_ResetReason, implementation-data-type=DT_MCUM_ResetReason
        application-data-type=DT_DT_MCUM_CpldRest_TimeOut_flag, implementation-data-type=DT_MCUM_CpldRest_TimeOut_flag
        application-data-type=DT_DT_MCUM_DrvPCBCurr, implementation-data-type=DT_MCUM_DrvPCBCurr
        application-data-type=DT_DT_MCUM_EOL_StateMachine, implementation-data-type=DT_MCUM_EOL_StateMachine
        application-data-type=DT_DT_MCUM_CpldRest_ASC_Flag, implementation-data-type=DT_MCUM_CpldRest_ASC_Flag
        application-data-type=DT_DT_MCUM_LimSpdTorFlag, implementation-data-type=DT_MCUM_LimSpdTorFlag
        application-data-type=DT_DT_MCUM_PWM_Err_Count, implementation-data-type=DT_MCUM_PWM_Err_Count
        application-data-type=DT_DT_MCUM_RDC_Reset_Count, implementation-data-type=DT_MCUM_RDC_Reset_Count
        application-data-type=DT_DT_MCUM_ASC_Stop_Flag, implementation-data-type=DT_MCUM_ASC_Stop_Flag
        application-data-type=DT_DT_MCUM_ASC_Soft_Exiting_Flag, implementation-data-type=DT_MCUM_ASC_Soft_Exiting_Flag
        application-data-type=DT_DT_MCUM_Vbus_ServeLowChkEn, implementation-data-type=DT_MCUM_Vbus_ServeLowChkEn
        application-data-type=DT_DT_MCUM_EOP_BlockErr_IsLim_Flag, implementation-data-type=DT_MCUM_EOP_BlockErr_IsLim_Flag
        application-data-type=DT_DT_MCUM_MotSelfHeat_EnSts, implementation-data-type=DT_MCUM_MotSelfHeat_EnSts
        application-data-type=DT_DT_MCUM_MotBlockHeat_LvlFb, implementation-data-type=DT_MCUM_MotBlockHeat_LvlFb
        application-data-type=DT_DT_MCUM_MotRotaryHeat_LvlFb, implementation-data-type=DT_MCUM_MotRotaryHeat_LvlFb
        application-data-type=DT_DT_MCUM_MotSelfHeat_DropLvlFb, implementation-data-type=DT_MCUM_MotSelfHeat_DropLvlFb
        application-data-type=DT_DT_MCUM_MotSelfHeat_DropLvlRsn, implementation-data-type=DT_MCUM_MotSelfHeat_DropLvlRsn
        application-data-type=DT_DT_MCUM_MotBlockHeat_CurAngle, implementation-data-type=DT_MCUM_MotBlockHeat_CurAngle
        application-data-type=DT_DT_MCUM_MotBlockHeat_CurMag, implementation-data-type=DT_MCUM_MotBlockHeat_CurMag
        application-data-type=DT_DT_MCUM_FaultDataRec_State, implementation-data-type=DT_MCUM_FaultDataRec_State
        application-data-type=DT_DT_MCUM_UserDefine_Byte{1..4}, implementation-data-type=DT_MCUM_UserDefine_Byte{1..4}
        application-data-type=DT_DT_MCUM_UserDefine_Word{1..3}, implementation-data-type=DT_MCUM_UserDefine_Word{1..3}
    DTMSECM_0x5EC: data-type-map{application-data-type=DT_DT_ECM_EngineWorktime, implementation-data-type=DT_ECM_EngineWorktime}
    DTMSECM_0x147: data-type-map{application-data-type=DT_DT_ECM_FuelConsumption, implementation-data-type=DT_ECM_FuelConsumption}
    DTMSMCU_0x5CB
      data-type-maps:
        application-data-type=DT_DT_GTC_TestSts, implementation-data-type=DT_GTC_TestSts
        application-data-type=DT_DT_GTC_ThetaPos, implementation-data-type=DT_GTC_ThetaPos
        application-data-type=DT_DT_GTC_ThetaNeg, implementation-data-type=DT_GTC_ThetaNeg
        application-data-type=DT_DT_GTC_ThetaDelt, implementation-data-type=DT_GTC_ThetaDelt
        application-data-type=DT_DT_GTC_TestRslt, implementation-data-type=DT_GTC_TestRslt
        application-data-type=DT_DT_MCUMR_GTC_TestSts, implementation-data-type=DT_MCUMR_GTC_TestSts
        application-data-type=DT_DT_MCUMR_GTC_ThetaPos, implementation-data-type=DT_MCUMR_GTC_ThetaPos
        application-data-type=DT_DT_MCUMR_GTC_ThetaNeg, implementation-data-type=DT_MCUMR_GTC_ThetaNeg
        application-data-type=DT_DT_MCUMR_GTC_ThetaDelt, implementation-data-type=DT_MCUMR_GTC_ThetaDelt
        application-data-type=DT_DT_MCUMR_GTC_TestRslt, implementation-data-type=DT_MCUMR_GTC_TestRslt
    DTMSMCUM_0xCA
      data-type-maps:
        application-data-type=DT_DT_MCUM_CRC_CA, implementation-data-type=DT_MCUM_CRC_CA
        application-data-type=DT_DT_MCUM_RollingCounter_CA, implementation-data-type=DT_MCUM_RollingCounter_CA
        application-data-type=DT_DT_MCUM_WarningLevel, implementation-data-type=DT_MCUM_WarningLevel
        application-data-type=DT_DT_MCUM_SelfCheckSts, implementation-data-type=DT_MCUM_SelfCheckSts
        application-data-type=DT_DT_MCUM_DrvMotorWorkSts, implementation-data-type=DT_MCUM_DrvMotorWorkSts
        application-data-type=DT_DT_MCUM_PowerReduceSts, implementation-data-type=DT_MCUM_PowerReduceSts
        application-data-type=DT_DT_MCUM_SystemError, implementation-data-type=DT_MCUM_SystemError
        application-data-type=DT_DT_MCUM_DrvMotorRPM, implementation-data-type=DT_MCUM_DrvMotorRPM
        application-data-type=DT_DT_MCUM_ActualTorqueFB, implementation-data-type=DT_MCUM_ActualTorqueFB
        application-data-type=DT_DT_MCUM_HWRdcFault, implementation-data-type=DT_MCUM_HWRdcFault
        application-data-type=DT_DT_MCUM_LVSystemError, implementation-data-type=DT_MCUM_LVSystemError
        application-data-type=DT_DT_MCUM_HighVoltPowerOffReq, implementation-data-type=DT_MCUM_HighVoltPowerOffReq
        application-data-type=DT_DT_MCUM_HVILSts, implementation-data-type=DT_MCUM_HVILSts
        application-data-type=DT_DT_MCUM_DragSts, implementation-data-type=DT_MCUM_DragSts
        application-data-type=DT_DT_MCUM_CtrlMode, implementation-data-type=DT_MCUM_CtrlMode
        application-data-type=DT_DT_MCUM_MotorTempAlarm, implementation-data-type=DT_MCUM_MotorTempAlarm
        application-data-type=DT_DT_MCUM_HVSystemError, implementation-data-type=DT_MCUM_HVSystemError
        application-data-type=DT_DT_MCUM_MILlampReq, implementation-data-type=DT_MCUM_MILlampReq
        application-data-type=DT_DT_MCUM_SeriousWarning_Level, implementation-data-type=DT_MCUM_SeriousWarning_Level
        application-data-type=DT_DT_MCUM_DrvMotorRPMVD, implementation-data-type=DT_MCUM_DrvMotorRPMVD
        application-data-type=DT_DT_MCUM_ActualTorqueFBVD, implementation-data-type=DT_MCUM_ActualTorqueFBVD
        application-data-type=DT_DT_MCUM_CtrlModeVD, implementation-data-type=DT_MCUM_CtrlModeVD
        application-data-type=DT_DT_MCUM_MaxTorqueAllow, implementation-data-type=DT_MCUM_MaxTorqueAllow
        application-data-type=DT_DT_MCUM_MaxSpeedAllow, implementation-data-type=DT_MCUM_MaxSpeedAllow
        application-data-type=DT_DT_MCUM_WaterPumpLevlReq, implementation-data-type=DT_MCUM_WaterPumpLevlReq
        application-data-type=DT_DT_MCUM_ActiveReleaseSts, implementation-data-type=DT_MCUM_ActiveReleaseSts
        application-data-type=DT_DT_MCUM_DCChargRelaySts, implementation-data-type=DT_MCUM_DCChargRelaySts
        application-data-type=DT_DT_MCUM_Fault_DCChargRelay, implementation-data-type=DT_MCUM_Fault_DCChargRelay
        application-data-type=DT_DT_MCUM_MinTorqueAllow, implementation-data-type=DT_MCUM_MinTorqueAllow
        application-data-type=DT_DT_MCUM_MainWireVolt, implementation-data-type=DT_MCUM_MainWireVolt
        application-data-type=DT_DT_MCUM_MotorTemp, implementation-data-type=DT_MCUM_MotorTemp
        application-data-type=DT_DT_MCUM_IGBTTemp, implementation-data-type=DT_MCUM_IGBTTemp
        application-data-type=DT_DT_MCUM_InletTemp, implementation-data-type=DT_MCUM_InletTemp
        application-data-type=DT_DT_MCUM_MainWireCurr, implementation-data-type=DT_MCUM_MainWireCurr
        application-data-type=DT_DT_MCUM_TMS_MotSelfHeatEnSts, implementation-data-type=DT_MCUM_TMS_MotSelfHeatEnSts
        application-data-type=DT_DT_MCUM_TMS_MotSelfHeatLvlFb, implementation-data-type=DT_MCUM_TMS_MotSelfHeatLvlFb
        application-data-type=DT_DT_MCUM_HeatPwrAllwd, implementation-data-type=DT_MCUM_HeatPwrAllwd
        application-data-type=DT_DT_MCUM_HeatFdBck, implementation-data-type=DT_MCUM_HeatFdBck
        application-data-type=DT_DT_MCUM_RPowerReduceSts, implementation-data-type=DT_MCUM_RPowerReduceSts
        application-data-type=DT_DT_MCUM_HeatPwrAct, implementation-data-type=DT_MCUM_HeatPwrAct
        application-data-type=DT_DT_MCUM_HeatPwrMax, implementation-data-type=DT_MCUM_HeatPwrMax
        application-data-type=DT_DT_MCUM_HeatPwrAval, implementation-data-type=DT_MCUM_HeatPwrAval
        application-data-type=DT_DT_MCUM_RCtrlMode, implementation-data-type=DT_MCUM_RCtrlMode
        application-data-type=DT_DT_MCUM_RWarningLevel, implementation-data-type=DT_MCUM_RWarningLevel
        application-data-type=DT_DT_MCUM_RSelfCheckSts, implementation-data-type=DT_MCUM_RSelfCheckSts
        application-data-type=DT_DT_MCUM_RDrvMotorWorkSts, implementation-data-type=DT_MCUM_RDrvMotorWorkSts
        application-data-type=DT_DT_MCUM_RCtrlModeVD, implementation-data-type=DT_MCUM_RCtrlModeVD
        application-data-type=DT_DT_MCUM_RHWRdcFault, implementation-data-type=DT_MCUM_RHWRdcFault
        application-data-type=DT_DT_MCUM_RDrvMotorRPMVD, implementation-data-type=DT_MCUM_RDrvMotorRPMVD
        application-data-type=DT_DT_MCUM_RActualTorqueFBVD, implementation-data-type=DT_MCUM_RActualTorqueFBVD
        application-data-type=DT_DT_MCUM_RDrvMotorRPM, implementation-data-type=DT_MCUM_RDrvMotorRPM
        application-data-type=DT_DT_MCUM_RActualTorqueFB, implementation-data-type=DT_MCUM_RActualTorqueFB
    DTMSIBC_0x182
      data-type-maps:
        application-data-type=DT_DT_IBC_CRC_182, implementation-data-type=DT_IBC_CRC_182
        application-data-type=DT_DT_IBC_RollingCounter_182, implementation-data-type=DT_IBC_RollingCounter_182
        application-data-type=DT_DT_IBC_VehicleSpeed, implementation-data-type=DT_IBC_VehicleSpeed
        application-data-type=DT_DT_IBC_VehicleSpeedVD, implementation-data-type=DT_IBC_VehicleSpeedVD
        application-data-type=DT_DT_IBC_ABSActive, implementation-data-type=DT_IBC_ABSActive
        application-data-type=DT_DT_IBC_ABSFailed, implementation-data-type=DT_IBC_ABSFailed
        application-data-type=DT_DT_IBC_TCSActive, implementation-data-type=DT_IBC_TCSActive
        application-data-type=DT_DT_IBC_TCSFailed, implementation-data-type=DT_IBC_TCSFailed
        application-data-type=DT_DT_IBC_ESCFunctionStatus, implementation-data-type=DT_IBC_ESCFunctionStatus
        application-data-type=DT_DT_IBC_BrakeForce, implementation-data-type=DT_IBC_BrakeForce
        application-data-type=DT_DT_IBC_Vehiclestandstill, implementation-data-type=DT_IBC_Vehiclestandstill
        application-data-type=DT_DT_IBC_EBDFailed, implementation-data-type=DT_IBC_EBDFailed
        application-data-type=DT_DT_IBC_EBDActive, implementation-data-type=DT_IBC_EBDActive
        application-data-type=DT_DT_IBC_VDCActive, implementation-data-type=DT_IBC_VDCActive
        application-data-type=DT_DT_IBC_VDCFailed, implementation-data-type=DT_IBC_VDCFailed
        application-data-type=DT_DT_IBC_EDCActive, implementation-data-type=DT_IBC_EDCActive
        application-data-type=DT_DT_IBC_EDCFailed, implementation-data-type=DT_IBC_EDCFailed
        application-data-type=DT_DT_IBC_SystemInitializeStatus, implementation-data-type=DT_IBC_SystemInitializeStatus
        application-data-type=DT_DT_IBC_BTCSActive, implementation-data-type=DT_IBC_BTCSActive
        application-data-type=DT_DT_IBC_ETCSActive, implementation-data-type=DT_IBC_ETCSActive
        application-data-type=DT_DT_IBC_ARPActive, implementation-data-type=DT_IBC_ARPActive
        application-data-type=DT_DT_IBC_VCU_DrumMode, implementation-data-type=DT_IBC_VCU_DrumMode
        application-data-type=DT_DT_IBC_EscapeModeSts, implementation-data-type=DT_IBC_EscapeModeSts
        application-data-type=DT_DT_IBC_TSAActive, implementation-data-type=DT_IBC_TSAActive
        application-data-type=DT_DT_IBC_TSAStatus, implementation-data-type=DT_IBC_TSAStatus
    DTMSMCUM_0x605
      data-type-maps:
        application-data-type=DT_DT_MCUM_FaultData{0..14}, implementation-data-type=DT_MCUM_FaultData{0..14}
    DTMSMCUM_0x607
      data-type-maps:
        application-data-type=DT_DT_MCUM_R_FaultData{0..14}, implementation-data-type=DT_MCUM_R_FaultData{0..14}
    DTMSICU_0x24D
      data-type-maps:
        application-data-type=DT_DT_ICU_CRC_24D, implementation-data-type=DT_ICU_CRC_24D
        application-data-type=DT_DT_ICU_SpeedConversionCoefficient, implementation-data-type=DT_ICU_SpeedConversionCoefficient
        application-data-type=DT_DT_ICU_RollingCounter_24D, implementation-data-type=DT_ICU_RollingCounter_24D
        application-data-type=DT_DT_ICU_CCSFunctionStatus, implementation-data-type=DT_ICU_CCSFunctionStatus
        application-data-type=DT_DT_ICU_CruiseVehicleSpeedCtl, implementation-data-type=DT_ICU_CruiseVehicleSpeedCtl
        application-data-type=DT_DT_ICU_VehicleScreenSpeed, implementation-data-type=DT_ICU_VehicleScreenSpeed
        application-data-type=DT_DT_ICU_VehicleSpeedUnit, implementation-data-type=DT_ICU_VehicleSpeedUnit
        application-data-type=DT_DT_ICU_ACCFunctionStatus, implementation-data-type=DT_ICU_ACCFunctionStatus
        application-data-type=DT_DT_ICU_LCCFunctionStatus, implementation-data-type=DT_ICU_LCCFunctionStatus
        application-data-type=DT_DT_IVI_LPedalMode, implementation-data-type=DT_IVI_LPedalMode
    DTMSICU_0x249
      data-type-maps:
        application-data-type=DT_DT_ICU_TotalOilmeterkm, implementation-data-type=DT_ICU_TotalOilmeterkm
        application-data-type=DT_DT_ICU_CLTCoilMileage, implementation-data-type=DT_ICU_CLTCoilMileage
        application-data-type=DT_DT_ICU_WLTC_oilMileage, implementation-data-type=DT_ICU_WLTC_oilMileage
        application-data-type=DT_DT_ICU_CLTC_ElectticityMileage, implementation-data-type=DT_ICU_CLTC_ElectticityMileage
        application-data-type=DT_DT_ICU_WLTC_ElectticityMileage, implementation-data-type=DT_ICU_WLTC_ElectticityMileage
        application-data-type=DT_DT_ICU_Switch_CLTCOrWLTC, implementation-data-type=DT_ICU_Switch_CLTCOrWLTC
        application-data-type=DT_DT_ICU_FuelPercent, implementation-data-type=DT_ICU_FuelPercent
    DTMSACU_0x233
      data-type-maps:
        application-data-type=DT_DT_ACU_CRC_233, implementation-data-type=DT_ACU_CRC_233
        application-data-type=DT_DT_ACU_RollingCounter_233, implementation-data-type=DT_ACU_RollingCounter_233
        application-data-type=DT_DT_ACU_LateralAcce, implementation-data-type=DT_ACU_LateralAcce
        application-data-type=DT_DT_ACU_LongitAcce, implementation-data-type=DT_ACU_LongitAcce
        application-data-type=DT_DT_ACU_LateralAcceValid, implementation-data-type=DT_ACU_LateralAcceValid
        application-data-type=DT_DT_ACU_LongitAcceValid, implementation-data-type=DT_ACU_LongitAcceValid
        application-data-type=DT_DT_ACU_SensorCalSt, implementation-data-type=DT_ACU_SensorCalSt
        application-data-type=DT_DT_ACU_YawRate, implementation-data-type=DT_ACU_YawRate
        application-data-type=DT_DT_ACU_YawRateValid, implementation-data-type=DT_ACU_YawRateValid
    DTMSMCU_0x5C4
      data-type-maps:
        application-data-type=DT_DT_MotClb_UdFb, implementation-data-type=DT_MotClb_UdFb
        application-data-type=DT_DT_MotClb_UqFb, implementation-data-type=DT_MotClb_UqFb
        application-data-type=DT_DT_MotClb_IdSet, implementation-data-type=DT_MotClb_IdSet
        application-data-type=DT_DT_MotClb_IqSet, implementation-data-type=DT_MotClb_IqSet
        application-data-type=DT_DT_MotClb_IsCMD_Fb, implementation-data-type=DT_MotClb_IsCMD_Fb
        application-data-type=DT_DT_MotClb_ThetaCMD_Fb, implementation-data-type=DT_MotClb_ThetaCMD_Fb
        application-data-type=DT_DT_MotClb_Id_Fb, implementation-data-type=DT_MotClb_Id_Fb
        application-data-type=DT_DT_MotClb_Iq_Fb, implementation-data-type=DT_MotClb_Iq_Fb
        application-data-type=DT_DT_MotClb_Spd_rpm_Flt, implementation-data-type=DT_MotClb_Spd_rpm_Flt
        application-data-type=DT_DT_MotClb_ThtSetReal, implementation-data-type=DT_MotClb_ThtSetReal
        application-data-type=DT_DT_MotClb_Power_Inverter, implementation-data-type=DT_MotClb_Power_Inverter
        application-data-type=DT_DT_MotClb_Volt_DC, implementation-data-type=DT_MotClb_Volt_DC
        application-data-type=DT_DT_MotClb_UsOutFlt, implementation-data-type=DT_MotClb_UsOutFlt
        application-data-type=DT_DT_MotClb_CoolWater_Temp, implementation-data-type=DT_MotClb_CoolWater_Temp
        application-data-type=DT_DT_MotClb_Motor_Temp1_Flt, implementation-data-type=DT_MotClb_Motor_Temp1_Flt
        application-data-type=DT_DT_MotClb_IGBT_Temp1, implementation-data-type=DT_MotClb_IGBT_Temp1
        application-data-type=DT_DT_MotClb_ErrLevel, implementation-data-type=DT_MotClb_ErrLevel
        application-data-type=DT_DT_MCUMR_MotClb_UdFb, implementation-data-type=DT_MCUMR_MotClb_UdFb
        application-data-type=DT_DT_MCUMR_MotClb_UqFb, implementation-data-type=DT_MCUMR_MotClb_UqFb
        application-data-type=DT_DT_MCUMR_MotClb_IdSet, implementation-data-type=DT_MCUMR_MotClb_IdSet
        application-data-type=DT_DT_MCUMR_MotClb_IqSet, implementation-data-type=DT_MCUMR_MotClb_IqSet
        application-data-type=DT_DT_MCUMR_MotClb_IsCMD_Fb, implementation-data-type=DT_MCUMR_MotClb_IsCMD_Fb
        application-data-type=DT_DT_MCUMR_MotClb_ThetaCMD_Fb, implementation-data-type=DT_MCUMR_MotClb_ThetaCMD_Fb
        application-data-type=DT_DT_MCUMR_MotClb_Id_Fb, implementation-data-type=DT_MCUMR_MotClb_Id_Fb
        application-data-type=DT_DT_MCUMR_MotClb_Iq_Fb, implementation-data-type=DT_MCUMR_MotClb_Iq_Fb
        application-data-type=DT_DT_MCUMR_MotClb_Spd_rpm_Flt, implementation-data-type=DT_MCUMR_MotClb_Spd_rpm_Flt
        application-data-type=DT_DT_MCUMR_MotClb_ThtSetReal, implementation-data-type=DT_MCUMR_MotClb_ThtSetReal
        application-data-type=DT_DT_MCUMR_MotClb_Power_Inverter, implementation-data-type=DT_MCUMR_MotClb_Power_Inverter
        application-data-type=DT_DT_MCUMR_MotClb_Volt_DC, implementation-data-type=DT_MCUMR_MotClb_Volt_DC
        application-data-type=DT_DT_MCUMR_MotClb_UsOutFlt, implementation-data-type=DT_MCUMR_MotClb_UsOutFlt
        application-data-type=DT_DT_MCUMR_MotClb_CoolWater_Temp, implementation-data-type=DT_MCUMR_MotClb_CoolWater_Temp
        application-data-type=DT_DT_MCUMR_MotClb_Motor_Temp1_Flt, implementation-data-type=DT_MCUMR_MotClb_Motor_Temp1_Flt
        application-data-type=DT_DT_MCUMR_MotClb_IGBT_Temp1, implementation-data-type=DT_MCUMR_MotClb_IGBT_Temp1
        application-data-type=DT_DT_MCUMR_MotClb_ErrLevel, implementation-data-type=DT_MCUMR_MotClb_ErrLevel
    DTMSBMS_0x1A1
      data-type-maps:
        application-data-type=DT_DT_BMS_CRC_1A1, implementation-data-type=DT_BMS_CRC_1A1
        application-data-type=DT_DT_BMS_RollingCounter_1A1, implementation-data-type=DT_BMS_RollingCounter_1A1
        application-data-type=DT_DT_BMS_Warning_Level, implementation-data-type=DT_BMS_Warning_Level
        application-data-type=DT_DT_BMS_SelfCheck, implementation-data-type=DT_BMS_SelfCheck
        application-data-type=DT_DT_BMS_BattChargerSts, implementation-data-type=DT_BMS_BattChargerSts
        application-data-type=DT_DT_BMS_RHighVolSts, implementation-data-type=DT_BMS_RHighVolSts
        application-data-type=DT_DT_BMS_RPreChargeRelayFB, implementation-data-type=DT_BMS_RPreChargeRelayFB
        application-data-type=DT_DT_BMS_RPositiveRelayFB, implementation-data-type=DT_BMS_RPositiveRelayFB
        application-data-type=DT_DT_BMS_RNegativeRelayFB, implementation-data-type=DT_BMS_RNegativeRelayFB
        application-data-type=DT_DT_BMS_RPositiveRelay_F, implementation-data-type=DT_BMS_RPositiveRelay_F
        application-data-type=DT_DT_BMS_RNegativeRelay_F, implementation-data-type=DT_BMS_RNegativeRelay_F
        application-data-type=DT_DT_BMS_RPreChargeFinishSts, implementation-data-type=DT_BMS_RPreChargeFinishSts
        application-data-type=DT_DT_BMS_MCUMHVILSts, implementation-data-type=DT_BMS_MCUMHVILSts
        application-data-type=DT_DT_BMS_ACPTCHVILSts, implementation-data-type=DT_BMS_ACPTCHVILSts
        application-data-type=DT_DT_BMS_PTCHVILSts, implementation-data-type=DT_BMS_PTCHVILSts
        application-data-type=DT_DT_BMS_CCMHVILSts, implementation-data-type=DT_BMS_CCMHVILSts
        application-data-type=DT_DT_BMS_CDUHVILSts, implementation-data-type=DT_BMS_CDUHVILSts
        application-data-type=DT_DT_BMS_DCChgHVILSts, implementation-data-type=DT_BMS_DCChgHVILSts
        application-data-type=DT_DT_BMS_MCUSHVILSts, implementation-data-type=DT_BMS_MCUSHVILSts
        application-data-type=DT_DT_BMS_HVOffSts, implementation-data-type=DT_BMS_HVOffSts
        application-data-type=DT_DT_BMS_SeriousWarning_Level, implementation-data-type=DT_BMS_SeriousWarning_Level
        application-data-type=DT_DT_BMS_DCChgRelayCloseReq, implementation-data-type=DT_BMS_DCChgRelayCloseReq
        application-data-type=DT_DT_BMS_DCChgRelayFB, implementation-data-type=DT_BMS_DCChgRelayFB
        application-data-type=DT_DT_BMS_ChgStopReason, implementation-data-type=DT_BMS_ChgStopReason
        application-data-type=DT_DT_BMS_GCUHVILSts, implementation-data-type=DT_BMS_GCUHVILSts
        application-data-type=DT_DT_BMS_MILlampReq, implementation-data-type=DT_BMS_MILlampReq
        application-data-type=DT_DT_BMS_IsoRessistanceSts, implementation-data-type=DT_BMS_IsoRessistanceSts
        application-data-type=DT_DT_BMS_Integrity_Check, implementation-data-type=DT_BMS_Integrity_Check
        application-data-type=DT_DT_BMS_BattVolt, implementation-data-type=DT_BMS_BattVolt
        application-data-type=DT_DT_BMS_BattCurr, implementation-data-type=DT_BMS_BattCurr
        application-data-type=DT_DT_BMS_BatDyn_Dchgpwr, implementation-data-type=DT_BMS_BatDyn_Dchgpwr
        application-data-type=DT_DT_BMS_BatDyn_Chgpwr, implementation-data-type=DT_BMS_BatDyn_Chgpwr
        application-data-type=DT_DT_BMS_Precharge_CoolingSts, implementation-data-type=DT_BMS_Precharge_CoolingSts
    DTMSIBC_0xB1
      data-type-maps:
        application-data-type=DT_DT_IBC_CRC_B1, implementation-data-type=DT_IBC_CRC_B1
        application-data-type=DT_DT_IBC_RollingCounter_B1, implementation-data-type=DT_IBC_RollingCounter_B1
        application-data-type=DT_DT_IBC_EngTorqDec_Main, implementation-data-type=DT_IBC_EngTorqDec_Main
        application-data-type=DT_DT_IBC_EngTorqDecActive_Main, implementation-data-type=DT_IBC_EngTorqDecActive_Main
        application-data-type=DT_DT_IBC_EngTorqInc_Main, implementation-data-type=DT_IBC_EngTorqInc_Main
        application-data-type=DT_DT_IBC_EngTorqIncActive_Main, implementation-data-type=DT_IBC_EngTorqIncActive_Main
        application-data-type=DT_DT_IBC_EngTorqDec_Sub, implementation-data-type=DT_IBC_EngTorqDec_Sub
        application-data-type=DT_DT_IBC_EngTorqDecActive_Sub, implementation-data-type=DT_IBC_EngTorqDecActive_Sub
        application-data-type=DT_DT_IBC_EngTorqInc_Sub, implementation-data-type=DT_IBC_EngTorqInc_Sub
        application-data-type=DT_DT_IBC_EngTorqIncActive_Sub, implementation-data-type=DT_IBC_EngTorqIncActive_Sub
        application-data-type=DT_DT_IBC_EngTorqDec_MainR, implementation-data-type=DT_IBC_EngTorqDec_MainR
        application-data-type=DT_DT_IBC_EngTorqDecActive_MainR, implementation-data-type=DT_IBC_EngTorqDecActive_MainR
        application-data-type=DT_DT_IBC_EngTorqInc_MainR, implementation-data-type=DT_IBC_EngTorqInc_MainR
        application-data-type=DT_DT_IBC_EngTorqIncActive_MainR, implementation-data-type=DT_IBC_EngTorqIncActive_MainR
    DTMSADDC_0x83
      data-type-maps:
        application-data-type=DT_DT_ADDC_CRC_83, implementation-data-type=DT_ADDC_CRC_83
        application-data-type=DT_DT_ADDC_ACC_AVHReq, implementation-data-type=DT_ADDC_ACC_AVHReq
        application-data-type=DT_DT_ADDC_ACC_HoldSts, implementation-data-type=DT_ADDC_ACC_HoldSts
        application-data-type=DT_DT_ADDC_ACCTargetTrq, implementation-data-type=DT_ADDC_ACCTargetTrq
        application-data-type=DT_DT_ADDC_ACCTargetTrqVD, implementation-data-type=DT_ADDC_ACCTargetTrqVD
        application-data-type=DT_DT_ADDC_ACCTargetTrqBrkVD, implementation-data-type=DT_ADDC_ACCTargetTrqBrkVD
        application-data-type=DT_DT_ADDC_ACCTargetTrqBrk, implementation-data-type=DT_ADDC_ACCTargetTrqBrk
        application-data-type=DT_DT_ADDC_MAIWarnTrqCtrlFlg, implementation-data-type=DT_ADDC_MAIWarnTrqCtrlFlg
        application-data-type=DT_DT_ADDC_RollingCounter_83, implementation-data-type=DT_ADDC_RollingCounter_83
        application-data-type=DT_DT_ADDC_ACC_FunType, implementation-data-type=DT_ADDC_ACC_FunType
        application-data-type=DT_DT_ADDC_ACCMode, implementation-data-type=DT_ADDC_ACCMode
        application-data-type=DT_DT_ADDC_Driveoff_Request, implementation-data-type=DT_ADDC_Driveoff_Request
        application-data-type=DT_DT_ADDC_DecToStop, implementation-data-type=DT_ADDC_DecToStop
        application-data-type=DT_DT_ADDC_ACCAvailable, implementation-data-type=DT_ADDC_ACCAvailable
        application-data-type=DT_DT_ADDC_ACCTargetAcc, implementation-data-type=DT_ADDC_ACCTargetAcc
        application-data-type=DT_DT_ADDC_ACCTargetAccVD, implementation-data-type=DT_ADDC_ACCTargetAccVD
        application-data-type=DT_DT_ADDC_ACC_RecordingPulse, implementation-data-type=DT_ADDC_ACC_RecordingPulse
        application-data-type=DT_DT_ADDC_VehicleSpeedCtlVD, implementation-data-type=DT_ADDC_VehicleSpeedCtlVD
        application-data-type=DT_DT_ADDC_VehicleSpeedCtl, implementation-data-type=DT_ADDC_VehicleSpeedCtl
        application-data-type=DT_DT_ADDC_ACC_EPBReq, implementation-data-type=DT_ADDC_ACC_EPBReq
        application-data-type=DT_DT_ADDC_ACC_VehicleDirectCtl, implementation-data-type=DT_ADDC_ACC_VehicleDirectCtl
        application-data-type=DT_DT_ADDC_ACC_VehicleDirectCtlVD, implementation-data-type=DT_ADDC_ACC_VehicleDirectCtlVD
        application-data-type=DT_DT_ADDC_AEBTargetDec, implementation-data-type=DT_ADDC_AEBTargetDec
        application-data-type=DT_DT_ADDC_AEBDecCtrl, implementation-data-type=DT_ADDC_AEBDecCtrl
        application-data-type=DT_DT_ADDC_AEBMode, implementation-data-type=DT_ADDC_AEBMode
        application-data-type=DT_DT_ADDC_AEBAvailable, implementation-data-type=DT_ADDC_AEBAvailable
        application-data-type=DT_DT_ADDC_ACC_VLCCtlReq, implementation-data-type=DT_ADDC_ACC_VLCCtlReq
        application-data-type=DT_DT_ADDC_ACC_OvrdSts, implementation-data-type=DT_ADDC_ACC_OvrdSts
        application-data-type=DT_DT_ADDC_RCTB_DecReq, implementation-data-type=DT_ADDC_RCTB_DecReq
        application-data-type=DT_DT_ADDC_RAEB_DecReq, implementation-data-type=DT_ADDC_RAEB_DecReq
        application-data-type=DT_DT_ADDC_MEB_DecReq, implementation-data-type=DT_ADDC_MEB_DecReq
    DTMSVCU_0x13B
      data-type-maps:
        application-data-type=DT_DT_VCU_CRC_13B, implementation-data-type=DT_VCU_CRC_13B
        application-data-type=DT_DT_VCU_RollingCounter_13B, implementation-data-type=DT_VCU_RollingCounter_13B
        application-data-type=DT_DT_VCU_Vehicle_Warning, implementation-data-type=DT_VCU_Vehicle_Warning
        application-data-type=DT_DT_VCU_VehicleSts, implementation-data-type=DT_VCU_VehicleSts
        application-data-type=DT_DT_VCU_GearLevelPosSts, implementation-data-type=DT_VCU_GearLevelPosSts
        application-data-type=DT_DT_VCU_GearLeverValid, implementation-data-type=DT_VCU_GearLeverValid
        application-data-type=DT_DT_VCU_AccPedalValid, implementation-data-type=DT_VCU_AccPedalValid
        application-data-type=DT_DT_VCU_ThrottlePosition, implementation-data-type=DT_VCU_ThrottlePosition
        application-data-type=DT_DT_VCU_BMSMainRelayR_Cmd, implementation-data-type=DT_VCU_BMSMainRelayR_Cmd
        application-data-type=DT_DT_VCU_BMSMainRelayF_Cmd, implementation-data-type=DT_VCU_BMSMainRelayF_Cmd
        application-data-type=DT_DT_VCU_BMSEmergencyCmd, implementation-data-type=DT_VCU_BMSEmergencyCmd
        application-data-type=DT_DT_VCU_MCUMActiveReleaseCmd, implementation-data-type=DT_VCU_MCUMActiveReleaseCmd
        application-data-type=DT_DT_VCU_MCUSActiveReleaseCmd, implementation-data-type=DT_VCU_MCUSActiveReleaseCmd
        application-data-type=DT_DT_VCU_AlwACChargeInventerSts, implementation-data-type=DT_VCU_AlwACChargeInventerSts
        application-data-type=DT_DT_VCU_AlwDCChargeSts, implementation-data-type=DT_VCU_AlwDCChargeSts
        application-data-type=DT_DT_VCU_ChargePauseReq, implementation-data-type=DT_VCU_ChargePauseReq
        application-data-type=DT_DT_VCU_SuppressJitterMCUSRequest, implementation-data-type=DT_VCU_SuppressJitterMCUSRequest
        application-data-type=DT_DT_VCU_DCDCEnableCmd, implementation-data-type=DT_VCU_DCDCEnableCmd
        application-data-type=DT_DT_VCU_ACOffReq, implementation-data-type=DT_VCU_ACOffReq
        application-data-type=DT_DT_VCU_VehicleDirect, implementation-data-type=DT_VCU_VehicleDirect
        application-data-type=DT_DT_VCU_BrakeSysFault, implementation-data-type=DT_VCU_BrakeSysFault
        application-data-type=DT_DT_VCU_SuppressJitterMCUMRequest, implementation-data-type=DT_VCU_SuppressJitterMCUMRequest
        application-data-type=DT_DT_VCU_MDrvControlMode, implementation-data-type=DT_VCU_MDrvControlMode
        application-data-type=DT_DT_VCU_BrakePedalValue, implementation-data-type=DT_VCU_BrakePedalValue
        application-data-type=DT_DT_VCU_MCUMMaxDischargePower, implementation-data-type=DT_VCU_MCUMMaxDischargePower
        application-data-type=DT_DT_VCU_MCUMMaxChargePower, implementation-data-type=DT_VCU_MCUMMaxChargePower
        application-data-type=DT_DT_VCU_MDrvRequestTorque, implementation-data-type=DT_VCU_MDrvRequestTorque
        application-data-type=DT_DT_VCU_MDrvRequesSpeed, implementation-data-type=DT_VCU_MDrvRequesSpeed
        application-data-type=DT_DT_VCU_SDrvRequestTorque, implementation-data-type=DT_VCU_SDrvRequestTorque
        application-data-type=DT_DT_VCU_SDrvRequesSpeed, implementation-data-type=DT_VCU_SDrvRequesSpeed
        application-data-type=DT_DT_VCU_SVehicleSts, implementation-data-type=DT_VCU_SVehicleSts
        application-data-type=DT_DT_VCU_VehicleHighVoltModeF, implementation-data-type=DT_VCU_VehicleHighVoltModeF
        application-data-type=DT_DT_VCU_SDrvControlMode, implementation-data-type=DT_VCU_SDrvControlMode
        application-data-type=DT_DT_VCU_ON2BRelayReq, implementation-data-type=DT_VCU_ON2BRelayReq
        application-data-type=DT_DT_VCU_VehPreHVPwrOffCmd, implementation-data-type=DT_VCU_VehPreHVPwrOffCmd
        application-data-type=DT_DT_VCU_FuelTankLockReq, implementation-data-type=DT_VCU_FuelTankLockReq
        application-data-type=DT_DT_VCU_VehicleDirectS, implementation-data-type=DT_VCU_VehicleDirectS
        application-data-type=DT_DT_VCU_VehicleDirectS_VD, implementation-data-type=DT_VCU_VehicleDirectS_VD
        application-data-type=DT_DT_VCU_ACPwrLimited, implementation-data-type=DT_VCU_ACPwrLimited
        application-data-type=DT_DT_VCU_MCUSMaxDischargePower, implementation-data-type=DT_VCU_MCUSMaxDischargePower
        application-data-type=DT_DT_VCU_VehicleDirectVD, implementation-data-type=DT_VCU_VehicleDirectVD
        application-data-type=DT_DT_VCU_MDrvControlModeVD, implementation-data-type=DT_VCU_MDrvControlModeVD
        application-data-type=DT_DT_VCU_MDrvRequestTorqueVD, implementation-data-type=DT_VCU_MDrvRequestTorqueVD
        application-data-type=DT_DT_VCU_MDrvRequesSpeedVD, implementation-data-type=DT_VCU_MDrvRequesSpeedVD
        application-data-type=DT_DT_VCU_SDrvRequestTorqueVD, implementation-data-type=DT_VCU_SDrvRequestTorqueVD
        application-data-type=DT_DT_VCU_SDrvRequesSpeedVD, implementation-data-type=DT_VCU_SDrvRequesSpeedVD
        application-data-type=DT_DT_VCU_SDrvControlModeVD, implementation-data-type=DT_VCU_SDrvControlModeVD
        application-data-type=DT_DT_VCU_MCUSMaxChargePower, implementation-data-type=DT_VCU_MCUSMaxChargePower
        application-data-type=DT_DT_VCU_VehicleHighVoltMode, implementation-data-type=DT_VCU_VehicleHighVoltMode
        application-data-type=DT_DT_VCU_PDUHVIL_Sts, implementation-data-type=DT_VCU_PDUHVIL_Sts
        application-data-type=DT_DT_VCU_PDU220VRelay_Req, implementation-data-type=DT_VCU_PDU220VRelay_Req
        application-data-type=DT_DT_VCU_Cab220VRelay_Req, implementation-data-type=DT_VCU_Cab220VRelay_Req
        application-data-type=DT_DT_VCU_Cabin220VRelay_Req, implementation-data-type=DT_VCU_Cabin220VRelay_Req
        application-data-type=DT_DT_VCU_Alw_Cab220VInverter_Sts, implementation-data-type=DT_VCU_Alw_Cab220VInverter_Sts
        application-data-type=DT_DT_VCU_Alw_Cabin220VInverter_Sts, implementation-data-type=DT_VCU_Alw_Cabin220VInverter_Sts
        application-data-type=DT_DT_VCU_MCUMDampgLmtFactor, implementation-data-type=DT_VCU_MCUMDampgLmtFactor
        application-data-type=DT_DT_VCU_MCUSDampgLmtFactor, implementation-data-type=DT_VCU_MCUSDampgLmtFactor
        application-data-type=DT_DT_VCU_BCM_Authentication_Sts, implementation-data-type=DT_VCU_BCM_Authentication_Sts
        application-data-type=DT_DT_VCU_AuthenticationKey_WSts, implementation-data-type=DT_VCU_AuthenticationKey_WSts
        application-data-type=DT_DT_VCU_BrakePedalSts_P, implementation-data-type=DT_VCU_BrakePedalSts_P
        application-data-type=DT_DT_VCU_BrakePedalStsValid_P, implementation-data-type=DT_VCU_BrakePedalStsValid_P
        application-data-type=DT_DT_VCU_BoostMode_Fail, implementation-data-type=DT_VCU_BoostMode_Fail
        application-data-type=DT_DT_VCU_BoostModeSts, implementation-data-type=DT_VCU_BoostModeSts
        application-data-type=DT_DT_VCU_MCUSMaxPosDampgTrq, implementation-data-type=DT_VCU_MCUSMaxPosDampgTrq
        application-data-type=DT_DT_VCU_MCUSMaxNegDampgTrq, implementation-data-type=DT_VCU_MCUSMaxNegDampgTrq
        application-data-type=DT_DT_VCU_MCUMMaxPosDampgTrq, implementation-data-type=DT_VCU_MCUMMaxPosDampgTrq
        application-data-type=DT_DT_VCU_MCUMMaxNegDampgTrq, implementation-data-type=DT_VCU_MCUMMaxNegDampgTrq
    DTMSBMS_0x310
      data-type-maps:
        application-data-type=DT_DT_BMS_InverterPower, implementation-data-type=DT_BMS_InverterPower
        application-data-type=DT_DT_BMS_MaxChargeVolt, implementation-data-type=DT_BMS_MaxChargeVolt
        application-data-type=DT_DT_BMS_MaxChargeCurr, implementation-data-type=DT_BMS_MaxChargeCurr
        application-data-type=DT_DT_BMS_OBCWorkModeCtrl, implementation-data-type=DT_BMS_OBCWorkModeCtrl
        application-data-type=DT_DT_BMS_MaxPower, implementation-data-type=DT_BMS_MaxPower
        application-data-type=DT_DT_BMS_ChargerACInput, implementation-data-type=DT_BMS_ChargerACInput
        application-data-type=DT_DT_BMS_ChargerDCInput, implementation-data-type=DT_BMS_ChargerDCInput
        application-data-type=DT_DT_BMS_ChargeRequest, implementation-data-type=DT_BMS_ChargeRequest
        application-data-type=DT_DT_BMS_InverterRequest, implementation-data-type=DT_BMS_InverterRequest
        application-data-type=DT_DT_BMS_ChargeQuantity, implementation-data-type=DT_BMS_ChargeQuantity
        application-data-type=DT_DT_BMS_BattMaxTemp, implementation-data-type=DT_BMS_BattMaxTemp
        application-data-type=DT_DT_BMS_BattMinTemp, implementation-data-type=DT_BMS_BattMinTemp
        application-data-type=DT_DT_BMS_BattIntakeTemp, implementation-data-type=DT_BMS_BattIntakeTemp
        application-data-type=DT_DT_BMS_BattIOutletTemp, implementation-data-type=DT_BMS_BattIOutletTemp
        application-data-type=DT_DT_BMS_BattSOC_Display, implementation-data-type=DT_BMS_BattSOC_Display
        application-data-type=DT_DT_BMS_Req_Cab220VInverter_Sts, implementation-data-type=DT_BMS_Req_Cab220VInverter_Sts
        application-data-type=DT_DT_BMS_Req_Cabin220VInverter_Sts, implementation-data-type=DT_BMS_Req_Cabin220VInverter_Sts
        application-data-type=DT_DT_BMS_RemainEnergy, implementation-data-type=DT_BMS_RemainEnergy
        application-data-type=DT_DT_BMS_StateOfEngeryMax, implementation-data-type=DT_BMS_StateOfEngeryMax
        application-data-type=DT_DT_BMS_ThermalManageRequest, implementation-data-type=DT_BMS_ThermalManageRequest
        application-data-type=DT_DT_BMS_PreHeatingState, implementation-data-type=DT_BMS_PreHeatingState
    DTMSMCUM_0x6F8
      data-type-maps:
        application-data-type=DT_DT_MCUM_UDS_SW{1..10}, implementation-data-type=DT_MCUM_UDS_SW{1..10}
        application-data-type=DT_DT_MCUM_UDS_HW{1..10}, implementation-data-type=DT_MCUM_UDS_HW{1..10}
        application-data-type=DT_DT_MCUM_UDS_Boot{1..10}, implementation-data-type=DT_MCUM_UDS_Boot{1..10}
        application-data-type=DT_DT_MCUM_UDS_ProductModel{1..16}, implementation-data-type=DT_MCUM_UDS_ProductModel{1..16}
        application-data-type=DT_DT_MCUM_UDS_Supplier{1..6}, implementation-data-type=DT_MCUM_UDS_Supplier{1..6}
    DTMSVCU_0xDE
      data-type-maps:
        application-data-type=DT_DT_VCU_BrkPedOpen, implementation-data-type=DT_VCU_BrkPedOpen
        application-data-type=DT_DT_VCU_BrkPedClose, implementation-data-type=DT_VCU_BrkPedClose
        application-data-type=DT_DT_VCU_ColumnShiftP, implementation-data-type=DT_VCU_ColumnShiftP
        application-data-type=DT_DT_VCU_VehiCrashSts, implementation-data-type=DT_VCU_VehiCrashSts
        application-data-type=DT_DT_VCU_SleepSatisfiedSts, implementation-data-type=DT_VCU_SleepSatisfiedSts
        application-data-type=DT_DT_VCU_VehiHvCmd, implementation-data-type=DT_VCU_VehiHvCmd
        application-data-type=DT_DT_VCU_GearQuitAps, implementation-data-type=DT_VCU_GearQuitAps
        application-data-type=DT_DT_VCU_REOverChgPwrFlag, implementation-data-type=DT_VCU_REOverChgPwrFlag
        application-data-type=DT_DT_VCU_VehiAccnFilt, implementation-data-type=DT_VCU_VehiAccnFilt
        application-data-type=DT_DT_VCU_HvOffSts, implementation-data-type=DT_VCU_HvOffSts
        application-data-type=DT_DT_VCU_ElecPwrBalanceReq, implementation-data-type=DT_VCU_ElecPwrBalanceReq
        application-data-type=DT_DT_VCU_CDU_RecvTr, implementation-data-type=DT_VCU_CDU_RecvTr
        application-data-type=DT_DT_VCU_BMS_RecvTr, implementation-data-type=DT_VCU_BMS_RecvTr
        application-data-type=DT_DT_VCU_IVI_RecvTr, implementation-data-type=DT_VCU_IVI_RecvTr
        application-data-type=DT_DT_VCU_WheelMaxDrvTrq, implementation-data-type=DT_VCU_WheelMaxDrvTrq
        application-data-type=DT_DT_VCU_WheelMaxRecTrq, implementation-data-type=DT_VCU_WheelMaxRecTrq
        application-data-type=DT_DT_VCU_GCU_RecvTr, implementation-data-type=DT_VCU_GCU_RecvTr
        application-data-type=DT_DT_VCU_TCM_RecvTr, implementation-data-type=DT_VCU_TCM_RecvTr
        application-data-type=DT_DT_VCU_PTC_RecvTr, implementation-data-type=DT_VCU_PTC_RecvTr
        application-data-type=DT_DT_VCU_LossFctorFlgFL, implementation-data-type=DT_VCU_LossFctorFlgFL
        application-data-type=DT_DT_VCU_LowBattVolt, implementation-data-type=DT_VCU_LowBattVolt
        application-data-type=DT_DT_VCU_HighPerforDisable, implementation-data-type=DT_VCU_HighPerforDisable
        application-data-type=DT_DT_VCU_AccPedHSigVolt, implementation-data-type=DT_VCU_AccPedHSigVolt
        application-data-type=DT_DT_VCU_LossFctorFlgFR, implementation-data-type=DT_VCU_LossFctorFlgFR
        application-data-type=DT_DT_VCU_AccPedLSigVolt, implementation-data-type=DT_VCU_AccPedLSigVolt
        application-data-type=DT_DT_VCU_LossFctorFlgRL, implementation-data-type=DT_VCU_LossFctorFlgRL
        application-data-type=DT_DT_VCU_AccPedHPwrVolt, implementation-data-type=DT_VCU_AccPedHPwrVolt
        application-data-type=DT_DT_VCU_LossFctorFlgRR, implementation-data-type=DT_VCU_LossFctorFlgRR
        application-data-type=DT_DT_VCU_AccPedLPwrVolt, implementation-data-type=DT_VCU_AccPedLPwrVolt
        application-data-type=DT_DT_VCU_PreReqChgPwr, implementation-data-type=DT_VCU_PreReqChgPwr
        application-data-type=DT_DT_VCU_VehPwrChageLimit, implementation-data-type=DT_VCU_VehPwrChageLimit
        application-data-type=DT_DT_VCU_FastPwrRequest, implementation-data-type=DT_VCU_FastPwrRequest
        application-data-type=DT_DT_VCU_On2KL15_Volt, implementation-data-type=DT_VCU_On2KL15_Volt
        application-data-type=DT_DT_VCU_ClutchWrkModDebug, implementation-data-type=DT_VCU_ClutchWrkModDebug
        application-data-type=DT_DT_VCU_HighPerforSwtFlg, implementation-data-type=DT_VCU_HighPerforSwtFlg
        application-data-type=DT_DT_VCU_VehiPowrConsumption, implementation-data-type=DT_VCU_VehiPowrConsumption
        application-data-type=DT_DT_VCU_MDrvFilterTrqRange, implementation-data-type=DT_VCU_MDrvFilterTrqRange
        application-data-type=DT_DT_VCU_WheelPwrOvrLimitflgRE, implementation-data-type=DT_VCU_WheelPwrOvrLimitflgRE
        application-data-type=DT_DT_VCU_MRDrvControlMode, implementation-data-type=DT_VCU_MRDrvControlMode
        application-data-type=DT_DT_VCU_MRDrvControlModeVD, implementation-data-type=DT_VCU_MRDrvControlModeVD
        application-data-type=DT_DT_VCU_VehicleDirectMR, implementation-data-type=DT_VCU_VehicleDirectMR
        application-data-type=DT_DT_VCU_VehicleDirectMRVD, implementation-data-type=DT_VCU_VehicleDirectMRVD
        application-data-type=DT_DT_VCU_MRDrvRequestTorque, implementation-data-type=DT_VCU_MRDrvRequestTorque
        application-data-type=DT_DT_VCU_MRDrvRequesSpeed, implementation-data-type=DT_VCU_MRDrvRequesSpeed
        application-data-type=DT_DT_VCU_MCUMRMaxDischargePower, implementation-data-type=DT_VCU_MCUMRMaxDischargePower
        application-data-type=DT_DT_VCU_MCUMRMaxPosDampgTrq, implementation-data-type=DT_VCU_MCUMRMaxPosDampgTrq
        application-data-type=DT_DT_VCU_MRDrvRequestTorqueVD, implementation-data-type=DT_VCU_MRDrvRequestTorqueVD
        application-data-type=DT_DT_VCU_MCUMRMaxChargePower, implementation-data-type=DT_VCU_MCUMRMaxChargePower
        application-data-type=DT_DT_VCU_MCUMRMaxNegDampgTrq, implementation-data-type=DT_VCU_MCUMRMaxNegDampgTrq
        application-data-type=DT_DT_VCU_MRDrvRequesSpeedVD, implementation-data-type=DT_VCU_MRDrvRequesSpeedVD
        application-data-type=DT_DT_VCU_MCUMRDampgLmtFactor, implementation-data-type=DT_VCU_MCUMRDampgLmtFactor
        application-data-type=DT_DT_VCU_SuppressJitterMCUMRRequest, implementation-data-type=DT_VCU_SuppressJitterMCUMRRequest
    DTMSVCU_0x3
      data-type-maps:
        application-data-type=DT_DT_EOL_VCU_BrkPedOpen, implementation-data-type=DT_EOL_VCU_BrkPedOpen
        application-data-type=DT_DT_EOL_VCU_BrkPedClose, implementation-data-type=DT_EOL_VCU_BrkPedClose
        application-data-type=DT_DT_EOL_VCU_ColumnShiftP, implementation-data-type=DT_EOL_VCU_ColumnShiftP
        application-data-type=DT_DT_EOL_VCU_VehiCrashSts, implementation-data-type=DT_EOL_VCU_VehiCrashSts
        application-data-type=DT_DT_EOL_VCU_SleepSatisfiedSts, implementation-data-type=DT_EOL_VCU_SleepSatisfiedSts
        application-data-type=DT_DT_EOL_VCU_VehiHvCmd, implementation-data-type=DT_EOL_VCU_VehiHvCmd
        application-data-type=DT_DT_EOL_VCU_GearQuitAps, implementation-data-type=DT_EOL_VCU_GearQuitAps
        application-data-type=DT_DT_EOL_VCU_REOverChgPwrFlag, implementation-data-type=DT_EOL_VCU_REOverChgPwrFlag
        application-data-type=DT_DT_EOL_VCU_VehiAccnFilt, implementation-data-type=DT_EOL_VCU_VehiAccnFilt
        application-data-type=DT_DT_EOL_VCU_HvOffSts, implementation-data-type=DT_EOL_VCU_HvOffSts
        application-data-type=DT_DT_EOL_VCU_ElecPwrBalanceReq, implementation-data-type=DT_EOL_VCU_ElecPwrBalanceReq
        application-data-type=DT_DT_EOL_VCU_CDU_RecvTr, implementation-data-type=DT_EOL_VCU_CDU_RecvTr
        application-data-type=DT_DT_EOL_VCU_BMS_RecvTr, implementation-data-type=DT_EOL_VCU_BMS_RecvTr
        application-data-type=DT_DT_EOL_VCU_IVI_RecvTr, implementation-data-type=DT_EOL_VCU_IVI_RecvTr
        application-data-type=DT_DT_EOL_VCU_WheelMaxDrvTrq, implementation-data-type=DT_EOL_VCU_WheelMaxDrvTrq
        application-data-type=DT_DT_EOL_VCU_WheelMaxRecTrq, implementation-data-type=DT_EOL_VCU_WheelMaxRecTrq
        application-data-type=DT_DT_EOL_VCU_GCU_RecvTr, implementation-data-type=DT_EOL_VCU_GCU_RecvTr
        application-data-type=DT_DT_EOL_VCU_TCM_RecvTr, implementation-data-type=DT_EOL_VCU_TCM_RecvTr
        application-data-type=DT_DT_EOL_VCU_PTC_RecvTr, implementation-data-type=DT_EOL_VCU_PTC_RecvTr
        application-data-type=DT_DT_EOL_VCU_LossFctorFlgFL, implementation-data-type=DT_EOL_VCU_LossFctorFlgFL
        application-data-type=DT_DT_EOL_VCU_LowBattVolt, implementation-data-type=DT_EOL_VCU_LowBattVolt
        application-data-type=DT_DT_EOL_VCU_HighPerforDisable, implementation-data-type=DT_EOL_VCU_HighPerforDisable
        application-data-type=DT_DT_EOL_VCU_AccPedHSigVolt, implementation-data-type=DT_EOL_VCU_AccPedHSigVolt
        application-data-type=DT_DT_EOL_VCU_LossFctorFlgFR, implementation-data-type=DT_EOL_VCU_LossFctorFlgFR
        application-data-type=DT_DT_EOL_VCU_AccPedLSigVolt, implementation-data-type=DT_EOL_VCU_AccPedLSigVolt
        application-data-type=DT_DT_EOL_VCU_LossFctorFlgRL, implementation-data-type=DT_EOL_VCU_LossFctorFlgRL
        application-data-type=DT_DT_EOL_VCU_AccPedHPwrVolt, implementation-data-type=DT_EOL_VCU_AccPedHPwrVolt
        application-data-type=DT_DT_EOL_VCU_LossFctorFlgRR, implementation-data-type=DT_EOL_VCU_LossFctorFlgRR
        application-data-type=DT_DT_EOL_VCU_AccPedLPwrVolt, implementation-data-type=DT_EOL_VCU_AccPedLPwrVolt
        application-data-type=DT_DT_EOL_VCU_PreReqChgPwr, implementation-data-type=DT_EOL_VCU_PreReqChgPwr
        application-data-type=DT_DT_EOL_VCU_VehPwrChageLimit, implementation-data-type=DT_EOL_VCU_VehPwrChageLimit
        application-data-type=DT_DT_EOL_VCU_FastPwrRequest, implementation-data-type=DT_EOL_VCU_FastPwrRequest
        application-data-type=DT_DT_EOL_VCU_On2KL15_Volt, implementation-data-type=DT_EOL_VCU_On2KL15_Volt
        application-data-type=DT_DT_EOL_VCU_ClutchWrkModDebug, implementation-data-type=DT_EOL_VCU_ClutchWrkModDebug
        application-data-type=DT_DT_EOL_VCU_HighPerforSwtFlg, implementation-data-type=DT_EOL_VCU_HighPerforSwtFlg
        application-data-type=DT_DT_EOL_VCU_VehiPowrConsumption, implementation-data-type=DT_EOL_VCU_VehiPowrConsumption
        application-data-type=DT_DT_EOL_VCU_MDrvFilterTrqRange, implementation-data-type=DT_EOL_VCU_MDrvFilterTrqRange
        application-data-type=DT_DT_EOL_VCU_WheelPwrOvrLimitflgRE, implementation-data-type=DT_EOL_VCU_WheelPwrOvrLimitflgRE
        application-data-type=DT_DT_EOL_VCU_MRDrvControlMode, implementation-data-type=DT_EOL_VCU_MRDrvControlMode
        application-data-type=DT_DT_EOL_VCU_MRDrvControlModeVD, implementation-data-type=DT_EOL_VCU_MRDrvControlModeVD
        application-data-type=DT_DT_EOL_VCU_VehicleDirectMR, implementation-data-type=DT_EOL_VCU_VehicleDirectMR
        application-data-type=DT_DT_EOL_VCU_VehicleDirectMRVD, implementation-data-type=DT_EOL_VCU_VehicleDirectMRVD
        application-data-type=DT_DT_EOL_VCU_MRDrvRequestTorque, implementation-data-type=DT_EOL_VCU_MRDrvRequestTorque
        application-data-type=DT_DT_EOL_VCU_MRDrvRequesSpeed, implementation-data-type=DT_EOL_VCU_MRDrvRequesSpeed
        application-data-type=DT_DT_EOL_VCU_MCUMRMaxDischargePower, implementation-data-type=DT_EOL_VCU_MCUMRMaxDischargePower
        application-data-type=DT_DT_EOL_VCU_MCUMRMaxPosDampgTrq, implementation-data-type=DT_EOL_VCU_MCUMRMaxPosDampgTrq
        application-data-type=DT_DT_EOL_VCU_MRDrvRequestTorqueVD, implementation-data-type=DT_EOL_VCU_MRDrvRequestTorqueVD
        application-data-type=DT_DT_EOL_VCU_MCUMRMaxChargePower, implementation-data-type=DT_EOL_VCU_MCUMRMaxChargePower
        application-data-type=DT_DT_EOL_VCU_MCUMRMaxNegDampgTrq, implementation-data-type=DT_EOL_VCU_MCUMRMaxNegDampgTrq
        application-data-type=DT_DT_EOL_VCU_MRDrvRequesSpeedVD, implementation-data-type=DT_EOL_VCU_MRDrvRequesSpeedVD
        application-data-type=DT_DT_EOL_VCU_MCUMRDampgLmtFactor, implementation-data-type=DT_EOL_VCU_MCUMRDampgLmtFactor
        application-data-type=DT_DT_EOL_VCU_SuppressJitterMCUMRRequest, implementation-data-type=DT_EOL_VCU_SuppressJitterMCUMRRequest
    DTMSGCU_0x2C1
      data-type-maps:
        application-data-type=DT_DT_GCU_SWVersionC, implementation-data-type=DT_GCU_SWVersionC
        application-data-type=DT_DT_GCU_SWVersionB, implementation-data-type=DT_GCU_SWVersionB
        application-data-type=DT_DT_GCU_SWVersionA, implementation-data-type=DT_GCU_SWVersionA
    DTMSVCU_0xB6
      data-type-maps:
        application-data-type=DT_DT_VCU_CRC_B6, implementation-data-type=DT_VCU_CRC_B6
        application-data-type=DT_DT_VCU_TVTest2, implementation-data-type=DT_VCU_TVTest2
        application-data-type=DT_DT_VCU_VPE_Test1, implementation-data-type=DT_VCU_VPE_Test1
        application-data-type=DT_DT_VCU_VPE_Test2, implementation-data-type=DT_VCU_VPE_Test2
        application-data-type=DT_DT_VCU_TVTest1, implementation-data-type=DT_VCU_TVTest1
        application-data-type=DT_DT_VCU_RollingCounter_B6, implementation-data-type=DT_VCU_RollingCounter_B6
        application-data-type=DT_DT_VCU_MDrvRequestTorque_IDB6_CCAN, implementation-data-type=DT_VCU_MDrvRequestTorque_IDB6_CCAN
        application-data-type=DT_DT_VCU_MDriverRequireTorque, implementation-data-type=DT_VCU_MDriverRequireTorque
        application-data-type=DT_DT_VCU_SDrvRequestTorque_IDB6_CCAN, implementation-data-type=DT_VCU_SDrvRequestTorque_IDB6_CCAN
        application-data-type=DT_DT_VCU_SDriverRequireTorque, implementation-data-type=DT_VCU_SDriverRequireTorque
        application-data-type=DT_DT_VCU_ThrottlePosition_IDB6_CCAN, implementation-data-type=DT_VCU_ThrottlePosition_IDB6_CCAN
        application-data-type=DT_DT_VCU_AccPedalValid_IDB6_CCAN, implementation-data-type=DT_VCU_AccPedalValid_IDB6_CCAN
        application-data-type=DT_DT_VCU_BrakeSysFault_IDB6_CCAN, implementation-data-type=DT_VCU_BrakeSysFault_IDB6_CCAN
        application-data-type=DT_DT_VCU_BrakeLightReq, implementation-data-type=DT_VCU_BrakeLightReq
        application-data-type=DT_DT_VCU_BrakePedalSts, implementation-data-type=DT_VCU_BrakePedalSts
        application-data-type=DT_DT_VCU_BrakePedalStsValid, implementation-data-type=DT_VCU_BrakePedalStsValid
        application-data-type=DT_DT_VCU_GearLevelPosSts_IDB6_CCAN, implementation-data-type=DT_VCU_GearLevelPosSts_IDB6_CCAN
        application-data-type=DT_DT_VCU_GearLeverValid_IDB6_CCAN, implementation-data-type=DT_VCU_GearLeverValid_IDB6_CCAN
        application-data-type=DT_DT_VCU_BrakeFirstSts, implementation-data-type=DT_VCU_BrakeFirstSts
        application-data-type=DT_DT_VCU_DeliveryModeSts_IDB6_CCAN, implementation-data-type=DT_VCU_DeliveryModeSts_IDB6_CCAN
        application-data-type=DT_DT_VCU_MRDrvRequestTorque_IDB6_CCAN, implementation-data-type=DT_VCU_MRDrvRequestTorque_IDB6_CCAN
        application-data-type=DT_DT_VCU_MRDriverRequireTorque, implementation-data-type=DT_VCU_MRDriverRequireTorque
    DTMSHPCBCM_0x291
      data-type-maps:
        application-data-type=DT_DT_BCM_CRC_291, implementation-data-type=DT_BCM_CRC_291
        application-data-type=DT_DT_BCM_ShutdownMode, implementation-data-type=DT_BCM_ShutdownMode
        application-data-type=DT_DT_BCM_NM_PNC_ON_1ADr_Sts, implementation-data-type=DT_BCM_NM_PNC_ON_1ADr_Sts
        application-data-type=DT_DT_BCM_RollingCounter_291, implementation-data-type=DT_BCM_RollingCounter_291
        application-data-type=DT_DT_BCM_KeyPosition_ON2A, implementation-data-type=DT_BCM_KeyPosition_ON2A
        application-data-type=DT_DT_BCM_CcmHvilSts_ID291, implementation-data-type=DT_BCM_CcmHvilSts_ID291
        application-data-type=DT_DT_BCM_DriverDoorSts, implementation-data-type=DT_BCM_DriverDoorSts
        application-data-type=DT_DT_BCM_FLDoorSts, implementation-data-type=DT_BCM_FLDoorSts
        application-data-type=DT_DT_BCM_FRDoorSts, implementation-data-type=DT_BCM_FRDoorSts
        application-data-type=DT_DT_BCM_RLDoorSts, implementation-data-type=DT_BCM_RLDoorSts
        application-data-type=DT_DT_BCM_RRDoorSts, implementation-data-type=DT_BCM_RRDoorSts
        application-data-type=DT_DT_BCM_BackDoorSts, implementation-data-type=DT_BCM_BackDoorSts
        application-data-type=DT_DT_BCM_ON2BRelaySts, implementation-data-type=DT_BCM_ON2BRelaySts
        application-data-type=DT_DT_BCM_ON2CRelaySts, implementation-data-type=DT_BCM_ON2CRelaySts
        application-data-type=DT_DT_BCM_ON2InitiativeSts, implementation-data-type=DT_BCM_ON2InitiativeSts
        application-data-type=DT_DT_BCM_VehicleRepairMode, implementation-data-type=DT_BCM_VehicleRepairMode
        application-data-type=DT_DT_BCM_VehlockCtrl, implementation-data-type=DT_BCM_VehlockCtrl
        application-data-type=DT_DT_BCM_VehLockSts, implementation-data-type=DT_BCM_VehLockSts
        application-data-type=DT_DT_BCM_FuelTankLockReq, implementation-data-type=DT_BCM_FuelTankLockReq
        application-data-type=DT_DT_BCM_ACChgLockCtrl, implementation-data-type=DT_BCM_ACChgLockCtrl
        application-data-type=DT_DT_BCM_ChargeLockCtrl, implementation-data-type=DT_BCM_ChargeLockCtrl
        application-data-type=DT_DT_BCM_DCChrgPwr_Sts_ID291, implementation-data-type=DT_BCM_DCChrgPwr_Sts_ID291
        application-data-type=DT_DT_BCM_ACChrgPwr_Sts_ID291, implementation-data-type=DT_BCM_ACChrgPwr_Sts_ID291
        application-data-type=DT_DT_BCM_DCChrgPwr_Volt_ID291, implementation-data-type=DT_BCM_DCChrgPwr_Volt_ID291
        application-data-type=DT_DT_BCM_ACChrgPwr_Volt_ID291, implementation-data-type=DT_BCM_ACChrgPwr_Volt_ID291
        application-data-type=DT_DT_BCM_KeyPosition_ON2B, implementation-data-type=DT_BCM_KeyPosition_ON2B
        application-data-type=DT_DT_BCM_NM_PNC_ON_3Ch_Sts, implementation-data-type=DT_BCM_NM_PNC_ON_3Ch_Sts
        application-data-type=DT_DT_BCM_HighVoltageReq, implementation-data-type=DT_BCM_HighVoltageReq
    DTMSACU_0x2A3
      data-type-maps:
        application-data-type=DT_DT_ACU_CRC_2A3, implementation-data-type=DT_ACU_CRC_2A3
        application-data-type=DT_DT_ACU_Trigger, implementation-data-type=DT_ACU_Trigger
        application-data-type=DT_DT_ACU_RollingCounter_2A3, implementation-data-type=DT_ACU_RollingCounter_2A3
        application-data-type=DT_DT_ACU_TotalCrashOutputSts, implementation-data-type=DT_ACU_TotalCrashOutputSts
        application-data-type=DT_DT_ACU_SelfCheckSt, implementation-data-type=DT_ACU_SelfCheckSt
        application-data-type=DT_DT_ACU_FLSeatBeltRSt, implementation-data-type=DT_ACU_FLSeatBeltRSt
        application-data-type=DT_DT_ACU_FRSeatBeltRSt, implementation-data-type=DT_ACU_FRSeatBeltRSt
    DTMSIVI_0x34A
      data-type-maps:
        application-data-type=DT_DT_IVI_DeliveryModeReq, implementation-data-type=DT_IVI_DeliveryModeReq
        application-data-type=DT_DT_IVI_ShowCarModeReq, implementation-data-type=DT_IVI_ShowCarModeReq
    DTMSVCU_0xBB
      data-type-maps:
        application-data-type=DT_DT_VCU_CheckSum_BB, implementation-data-type=DT_VCU_CheckSum_BB
        application-data-type=DT_DT_VCU_WorkModeReq_PHEV, implementation-data-type=DT_VCU_WorkModeReq_PHEV
        application-data-type=DT_DT_VCU_WorkMode_PHEV, implementation-data-type=DT_VCU_WorkMode_PHEV
        application-data-type=DT_DT_VCU_HEVAllow_PHEV, implementation-data-type=DT_VCU_HEVAllow_PHEV
        application-data-type=DT_DT_VCU_REAllow_PHEV, implementation-data-type=DT_VCU_REAllow_PHEV
        application-data-type=DT_DT_VCU_EVDualAllow_PHEV, implementation-data-type=DT_VCU_EVDualAllow_PHEV
        application-data-type=DT_DT_VCU_EVSingleAllow_PHEV, implementation-data-type=DT_VCU_EVSingleAllow_PHEV
        application-data-type=DT_DT_VCU_Clutch_2_RequesSpeed, implementation-data-type=DT_VCU_Clutch_2_RequesSpeed
        application-data-type=DT_DT_VCU_Clutch_1_RequesSpeed, implementation-data-type=DT_VCU_Clutch_1_RequesSpeed
        application-data-type=DT_DT_VCU_Clutch2Position, implementation-data-type=DT_VCU_Clutch2Position
        application-data-type=DT_DT_VCU_Clutch1Position, implementation-data-type=DT_VCU_Clutch1Position
        application-data-type=DT_DT_VCU_RollingCounter_BB, implementation-data-type=DT_VCU_RollingCounter_BB
        application-data-type=DT_DT_VCU_EngPreStartFlg, implementation-data-type=DT_VCU_EngPreStartFlg
        application-data-type=DT_DT_VCU_FuelChgModeMsg, implementation-data-type=DT_VCU_FuelChgModeMsg
        application-data-type=DT_DT_VCU_FuelChgModeSts, implementation-data-type=DT_VCU_FuelChgModeSts
        application-data-type=DT_DT_VCU_RoughRoadDetectionFlag, implementation-data-type=DT_VCU_RoughRoadDetectionFlag
        application-data-type=DT_DT_VCU_Clutch_2_RequesSpeedValid, implementation-data-type=DT_VCU_Clutch_2_RequesSpeedValid
        application-data-type=DT_DT_VCU_Clutch_1_RequesSpeedValid, implementation-data-type=DT_VCU_Clutch_1_RequesSpeedValid
        application-data-type=DT_DT_VCU_GCURequestTorque, implementation-data-type=DT_VCU_GCURequestTorque
        application-data-type=DT_DT_VCU_PowerReducetSts, implementation-data-type=DT_VCU_PowerReducetSts
        application-data-type=DT_DT_VCU_GCUAassistFB, implementation-data-type=DT_VCU_GCUAassistFB
        application-data-type=DT_DT_VCU_GCUActiveReleaseCmd, implementation-data-type=DT_VCU_GCUActiveReleaseCmd
        application-data-type=DT_DT_VCU_PowerOverSts, implementation-data-type=DT_VCU_PowerOverSts
        application-data-type=DT_DT_VCU_GCURequesSpeed, implementation-data-type=DT_VCU_GCURequesSpeed
        application-data-type=DT_DT_VCU_GCUControlMode, implementation-data-type=DT_VCU_GCUControlMode
        application-data-type=DT_DT_VCU_MotChargePower, implementation-data-type=DT_VCU_MotChargePower
        application-data-type=DT_DT_VCU_APS1Position, implementation-data-type=DT_VCU_APS1Position
        application-data-type=DT_DT_VCU_EngineStartReq, implementation-data-type=DT_VCU_EngineStartReq
        application-data-type=DT_DT_VCU_EngineFuelInhibitReq, implementation-data-type=DT_VCU_EngineFuelInhibitReq
        application-data-type=DT_DT_VCU_EngineOffRequest, implementation-data-type=DT_VCU_EngineOffRequest
        application-data-type=DT_DT_VCU_STorqueReqValid, implementation-data-type=DT_VCU_STorqueReqValid
        application-data-type=DT_DT_VCU_STorqueReq, implementation-data-type=DT_VCU_STorqueReq
        application-data-type=DT_DT_VCU_FTorqueSwFb, implementation-data-type=DT_VCU_FTorqueSwFb
        application-data-type=DT_DT_VCU_FVVOpenReq, implementation-data-type=DT_VCU_FVVOpenReq
        application-data-type=DT_DT_VCU_WarmUpCycleIndicator, implementation-data-type=DT_VCU_WarmUpCycleIndicator
        application-data-type=DT_DT_VCU_EngineResetSts, implementation-data-type=DT_VCU_EngineResetSts
        application-data-type=DT_DT_VCU_EngineSts, implementation-data-type=DT_VCU_EngineSts
        application-data-type=DT_DT_VCU_FTorqueReq, implementation-data-type=DT_VCU_FTorqueReq
        application-data-type=DT_DT_VCU_FTorqueReqValid, implementation-data-type=DT_VCU_FTorqueReqValid
        application-data-type=DT_DT_VCU_EngineIdleReq, implementation-data-type=DT_VCU_EngineIdleReq
        application-data-type=DT_DT_VCU_REsystemSts, implementation-data-type=DT_VCU_REsystemSts
        application-data-type=DT_DT_VCU_REsystemFaultSts, implementation-data-type=DT_VCU_REsystemFaultSts
        application-data-type=DT_DT_VCU_APS2Position, implementation-data-type=DT_VCU_APS2Position
        application-data-type=DT_DT_VCU_EngineRunAllowFlg, implementation-data-type=DT_VCU_EngineRunAllowFlg
        application-data-type=DT_DT_VCU_EngineIdleSpeed, implementation-data-type=DT_VCU_EngineIdleSpeed
        application-data-type=DT_DT_VCU_EngineFuleCutoffReq, implementation-data-type=DT_VCU_EngineFuleCutoffReq
        application-data-type=DT_DT_VCU_MCUSClutchPosition, implementation-data-type=DT_VCU_MCUSClutchPosition
        application-data-type=DT_DT_VCU_MGCUWorkMode, implementation-data-type=DT_VCU_MGCUWorkMode
        application-data-type=DT_DT_VCU_REChgTarget, implementation-data-type=DT_VCU_REChgTarget
        application-data-type=DT_DT_VCU_MotStartStopPowerUP, implementation-data-type=DT_VCU_MotStartStopPowerUP
        application-data-type=DT_DT_VCU_MotStartStopPowerLOW, implementation-data-type=DT_VCU_MotStartStopPowerLOW
        application-data-type=DT_DT_VCU_GCURequesSpeed_MGCU, implementation-data-type=DT_VCU_GCURequesSpeed_MGCU
        application-data-type=DT_DT_VCU_DynamicChgPwr, implementation-data-type=DT_VCU_DynamicChgPwr
        application-data-type=DT_DT_VCU_ForceChgPwr, implementation-data-type=DT_VCU_ForceChgPwr
        application-data-type=DT_DT_VCU_REStartType, implementation-data-type=DT_VCU_REStartType
    DTMSVCU_0x515
      data-type-maps:
        application-data-type=DT_DT_VCU_Pending_DTC, implementation-data-type=DT_VCU_Pending_DTC
        application-data-type=DT_DT_VCU_Comfirmed_DTC, implementation-data-type=DT_VCU_Comfirmed_DTC
        application-data-type=DT_DT_VCU_Permanent_DTC, implementation-data-type=DT_VCU_Permanent_DTC
        application-data-type=DT_DT_VCU_MilReq_DTC, implementation-data-type=DT_VCU_MilReq_DTC
    DTMSLMC_0x133
      data-type-maps:
        application-data-type=DT_DT_LMC_CRC_133, implementation-data-type=DT_LMC_CRC_133
        application-data-type=DT_DT_LMC_DrvReqTorque, implementation-data-type=DT_LMC_DrvReqTorque
        application-data-type=DT_DT_LMC_RollingCounter_133, implementation-data-type=DT_LMC_RollingCounter_133
    DTMSLMCSSU_0x25A
      data-type-maps:
        application-data-type=DT_DT_LMC_CRC_25A, implementation-data-type=DT_LMC_CRC_25A
        application-data-type=DT_DT_LMC_ECAS_DriveModeFb, implementation-data-type=DT_LMC_ECAS_DriveModeFb
        application-data-type=DT_DT_LMC_CDC_DriveModeFb, implementation-data-type=DT_LMC_CDC_DriveModeFb
        application-data-type=DT_DT_LMC_RollingCounter_25A, implementation-data-type=DT_LMC_RollingCounter_25A
    DTMSHPCBCM_0x4A
      data-type-maps:
        application-data-type=DT_DT_BCM_CRC_4A, implementation-data-type=DT_BCM_CRC_4A
        application-data-type=DT_DT_BCM_IBCLimphomeSts, implementation-data-type=DT_BCM_IBCLimphomeSts
        application-data-type=DT_DT_BCM_EOLAutomaticActiveSts_C, implementation-data-type=DT_BCM_EOLAutomaticActiveSts_C
        application-data-type=DT_DT_BCM_TorqueLimte, implementation-data-type=DT_BCM_TorqueLimte
        application-data-type=DT_DT_BCM_RollingCounter_4A, implementation-data-type=DT_BCM_RollingCounter_4A
    DTMSICU_0x5BE
      data-type-maps:
        application-data-type=DT_DT_ICU_RollingCounter_5BE, implementation-data-type=DT_ICU_RollingCounter_5BE
        application-data-type=DT_DT_ICU_Imu_Cal_Staus, implementation-data-type=DT_ICU_Imu_Cal_Staus
        application-data-type=DT_DT_ICU_Imu_Cal_Gyro, implementation-data-type=DT_ICU_Imu_Cal_Gyro
        application-data-type=DT_DT_ICU_Imu_Cal_Pitch, implementation-data-type=DT_ICU_Imu_Cal_Pitch
        application-data-type=DT_DT_ICU_Imu_Cal_Roll, implementation-data-type=DT_ICU_Imu_Cal_Roll
