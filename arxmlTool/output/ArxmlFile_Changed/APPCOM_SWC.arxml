[part 2 of 6: package /MVCU_AutoGenPkg/MVCU/Pck_AutoGen_Sw/Components]
AUTOSAR XML (schema 4-2-2)
package /MVCU_AutoGenPkg/MVCU/Pck_AutoGen_Sw/Components  (continued)
  application sw component type APPCOM_SWC  (continued)
    behavior IB_APPCOM_SWC: data-type-mapping=[DTMSMCUM_0x135, DTMSIBC_0x136, DTMSEVCC_0x260, DTMSICU_0x24C, DTMSMCUS_0xDB, DTMSMCU_0x5C9, DTMSHPCBCM_0x1E6, DTMSUDS_Phy_Rx_7E0_ECM, DTMSMCUM_0x5D0, DTMSMCUM_0x5D1, DTMSMCUM_0x5D2, DTMSVCU_0x358, DTMSRMCU_0x2, DTMSIBS_0x225, DTMSADDC_0x84, DTMSIVI_0x5F6, DTMSDCDC_0x324, DTMSFSC_0x142, DTMSMCU_0x5C6, DTMSMCU_0x5C5, DTMSMCUS_0x14, DTMSMCU_0x5C7, DTMSOBC_0x316, DTMSLMC_0xFA, DTMSLMC_0x18C, DTMSHPCGW_0x3B1, DTMSVCU_0x359, DTMSVCU_0x514, DTMSHPCGW_0x13A, DTMSCCM_0x36A, DTMSIBC_0x227, DTMSMCU_0x5C8, DTMSHPCBCM_0x290, DTMSVCU_0x13, DTMSVCU_0x1, DTMSVCU_0x3, DTMSTMS_0x5FE, DTMSEMS_0xBE, DTMSEPS_0x18D, DTMSGCU_0xBD, DTMSBMS_0x5B5, DTMSVCU_0xBC, DTMSICU_0x332, DTMSTMS_0x5A2, DTMSIBC_0x184, DTMSIBC_0x183, DTMSIBC_0x186, DTMSPTC_0x367, DTMSVCU_0x600, DTMSHPCGW_0x30B, DTMSVCU_0xB7, DTMSVCU_0xE6, DTMSUDS_Phy_Tx_7E8_ECM, DTMSVCU_0x1E5, DTMSTMS_0x5FF, DTMSECM_0x148, DTMSIVI_0x331, DTMSIVI_0x3D8, DTMSHPCBCM_0x292, DTMSIBC_0x185, DTMSTMS_0x363, DTMSBMS_0x5B1, DTMSTMS_0x561, DTMSHPCBCM_0x1E4, DTMSMCU_0x5CA, DTMSMCUM_0x5D3, DTMSECM_0x5EC, DTMSECM_0x147, DTMSMCU_0x5CB, DTMSMCUM_0xCA, DTMSIBC_0x182, DTMSMCUM_0x605, DTMSMCUM_0x607, DTMSICU_0x24D, DTMSICU_0x249, DTMSACU_0x233, DTMSMCU_0x5C4, DTMSBMS_0x1A1, DTMSIBC_0xB1, DTMSADDC_0x83, DTMSVCU_0x13B, DTMSBMS_0x310, DTMSMCUM_0x6F8, DTMSVCU_0xDE, DTMSGCU_0x2C1, DTMSVCU_0xB6, DTMSHPCBCM_0x291, DTMSACU_0x2A3, DTMSIVI_0x34A, DTMSVCU_0xBB, DTMSVCU_0x515, DTMS_DevCanComm_Req, DTMSMCUM_0x42C, DTMSMCUM_0x42C_PCANFD, DTMSICU_0xDF, DTMSTMS_0x362, DTMSACU_0x15, DTMSHPCBCM_0xDA, DTMSLMC_0x133, DTMSLMCSSU_0x25A, DTMSICU_0x5BE, DTMSHPCBCM_0x4A], handle-termination-and-restart=NO-SUPPORT
      timing event TE_APPCOM_SWC_10ms: start-on-event=RE_APPCOM_SWC_Main, period=0.01
      init event APPCOM_SWC_InitEvent: start-on-event=RE_APPCOM_SWC_Init
      17 x timing event:
        TE_APPCOM_Rx_10ms: start-on-event=RE_APPCOM_Rx_10ms, period=0.01
        TE_APPCOM_Rx_20ms: start-on-event=RE_APPCOM_Rx_20ms, period=0.02
        TE_APPCOM_Rx_50ms: start-on-event=RE_APPCOM_Rx_50ms, period=0.05
        TE_APPCOM_Rx_100ms: start-on-event=RE_APPCOM_Rx_100ms, period=0.1
        TE_APPCOM_Rx_200ms: start-on-event=RE_APPCOM_Rx_200ms, period=0.2
        TE_APPCOM_Tx_10ms: start-on-event=RE_APPCOM_Tx_10ms, period=0.01
        TE_APPCOM_Tx_20ms: start-on-event=RE_APPCOM_Tx_20ms, period=0.02
        TE_APPCOM_Tx_50ms: start-on-event=RE_APPCOM_Tx_50ms, period=0.05
        TE_APPCOM_Tx_100ms: start-on-event=RE_APPCOM_Tx_100ms, period=0.1
        TE_APPCOM_Tx_200ms: start-on-event=RE_APPCOM_Tx_200ms, period=0.2
        TE_APPCOM_Tx_500ms: start-on-event=RE_APPCOM_Tx_500ms, period=0.5
        TE_APPCOM_Rx_500ms: start-on-event=RE_APPCOM_Rx_500ms, period=0.5
        TE_APPCOM_Tx_1ms: start-on-event=RE_APPCOM_Tx_1ms, period=0.001
        TE_APPCOM_Tx_1000ms: start-on-event=RE_APPCOM_Tx_1000ms, period=1.0
        TE_APPCOM_Rx_1000ms: start-on-event=RE_APPCOM_Rx_1000ms, period=1.0
        TE_APPCOM_Rx_2ms: start-on-event=RE_APPCOM_Rx_2ms, period=0.002
        TE_APPCOM_Tx_2ms: start-on-event=RE_APPCOM_Tx_2ms, period=0.002
      19 x runnable:
        RE_APPCOM_SWC_Main: symbol=APPCOM_SWC_Main
          data-receive-point-by-arguments:
            993 x access:
              DataReceivePointByValues_IBC_CRC_136: accessed-variable=IBC_0x136.IBC_CRC_136
              DataReceivePointByValues_IBC_RollingCounter_136: accessed-variable=IBC_0x136.IBC_RollingCounter_136
              DataReceivePointByValues_IBC_ModeMinEDrvTar_FA: accessed-variable=IBC_0x136.IBC_ModeMinEDrvTar_FA
              DataReceivePointByValues_IBC_ModeMinEDrvTar_RA: accessed-variable=IBC_0x136.IBC_ModeMinEDrvTar_RA
              DataReceivePointByValues_IBC_ModeMaxEDrvTar_FA: accessed-variable=IBC_0x136.IBC_ModeMaxEDrvTar_FA
              DataReceivePointByValues_IBC_ModeMaxEDrvTar_RA: accessed-variable=IBC_0x136.IBC_ModeMaxEDrvTar_RA
              DataReceivePointByValues_IBC_torque_distribution_RA_Vaild: accessed-variable=IBC_0x136.IBC_torque_distribution_RA_Vaild
              DataReceivePointByValues_IBC_torque_distribution_RA: accessed-variable=IBC_0x136.IBC_torque_distribution_RA
              DataReceivePointByValues_IBC_mTar_FA: accessed-variable=IBC_0x136.IBC_mTar_FA
              DataReceivePointByValues_IBC_mTar_RA: accessed-variable=IBC_0x136.IBC_mTar_RA
              DataReceivePointByValues_IBC_iLDC_SWInfo: accessed-variable=IBC_0x136.IBC_iLDC_SWInfo
              DataReceivePointByValues_IBC_Variant_Signal: accessed-variable=IBC_0x136.IBC_Variant_Signal
              DataReceivePointByValues_IBC_nTarMax_FA: accessed-variable=IBC_0x136.IBC_nTarMax_FA
              DataReceivePointByValues_IBC_nTarMax_RA: accessed-variable=IBC_0x136.IBC_nTarMax_RA
              DataReceivePointByValues_IBC_nTarMin_FA: accessed-variable=IBC_0x136.IBC_nTarMin_FA
              DataReceivePointByValues_IBC_nTarMin_RA: accessed-variable=IBC_0x136.IBC_nTarMin_RA
              DataReceivePointByValues_EVCC_DCAC_ChgMode: accessed-variable=EVCC_0x260.EVCC_DCAC_ChgMode
              DataReceivePointByValues_EVCC_CP_status: accessed-variable=EVCC_0x260.EVCC_CP_status
              DataReceivePointByValues_EVCC_CPDutyCycleValue: accessed-variable=EVCC_0x260.EVCC_CPDutyCycleValue
              DataReceivePointByValues_EVCC_EVSEMaximumCurrentLimit: accessed-variable=EVCC_0x260.EVCC_EVSEMaximumCurrentLimit
              DataReceivePointByValues_EVCC_EVSEMaximumPowerLimit: accessed-variable=EVCC_0x260.EVCC_EVSEMaximumPowerLimit
              DataReceivePointByValues_ICU_CRC_24C: accessed-variable=ICU_0x24C.ICU_CRC_24C
              DataReceivePointByValues_ICU_PHEVMode: accessed-variable=ICU_0x24C.ICU_PHEVMode
              DataReceivePointByValues_ICU_RollingCounter_24C: accessed-variable=ICU_0x24C.ICU_RollingCounter_24C
              DataReceivePointByValues_ICU_TotalOdometerkm: accessed-variable=ICU_0x24C.ICU_TotalOdometerkm
              DataReceivePointByValues_ICU_AccelerationMode: accessed-variable=ICU_0x24C.ICU_AccelerationMode
              DataReceivePointByValues_ICU_REMode: accessed-variable=ICU_0x24C.ICU_REMode
              DataReceivePointByValues_ICU_CreepMode: accessed-variable=ICU_0x24C.ICU_CreepMode
              DataReceivePointByValues_ICU_EnergyRecoveryMode: accessed-variable=ICU_0x24C.ICU_EnergyRecoveryMode
              DataReceivePointByValues_MCUS_CRC_DB: accessed-variable=MCUS_0xDB.MCUS_CRC_DB
              DataReceivePointByValues_MCUS_Clutch_2_Fault: accessed-variable=MCUS_0xDB.MCUS_Clutch_2_Fault
              DataReceivePointByValues_MCUS_Clutch_1_Fault: accessed-variable=MCUS_0xDB.MCUS_Clutch_1_Fault
              DataReceivePointByValues_MCUS_Clutch_2_WarningLevel: accessed-variable=MCUS_0xDB.MCUS_Clutch_2_WarningLevel
              DataReceivePointByValues_MCUS_Clutch_1_WarningLevel: accessed-variable=MCUS_0xDB.MCUS_Clutch_1_WarningLevel
              DataReceivePointByValues_MCUS_Clutch_2_Pos: accessed-variable=MCUS_0xDB.MCUS_Clutch_2_Pos
              DataReceivePointByValues_MCUS_Clutch_1_Pos: accessed-variable=MCUS_0xDB.MCUS_Clutch_1_Pos
              DataReceivePointByValues_MCUS_RollingCounter_DB: accessed-variable=MCUS_0xDB.MCUS_RollingCounter_DB
              DataReceivePointByValues_MCUS_WarningLevel: accessed-variable=MCUS_0xDB.MCUS_WarningLevel
              DataReceivePointByValues_MCUS_SelfCheckSts: accessed-variable=MCUS_0xDB.MCUS_SelfCheckSts
              DataReceivePointByValues_MCUS_DrvMotorWorkSts: accessed-variable=MCUS_0xDB.MCUS_DrvMotorWorkSts
              DataReceivePointByValues_MCUS_PowerReduceSts: accessed-variable=MCUS_0xDB.MCUS_PowerReduceSts
              DataReceivePointByValues_MCUS_SystemError: accessed-variable=MCUS_0xDB.MCUS_SystemError
              DataReceivePointByValues_MCUS_LVSystemError: accessed-variable=MCUS_0xDB.MCUS_LVSystemError
              DataReceivePointByValues_MCUS_MotorTempAlarm: accessed-variable=MCUS_0xDB.MCUS_MotorTempAlarm
              DataReceivePointByValues_MCUS_HVSystemError: accessed-variable=MCUS_0xDB.MCUS_HVSystemError
              DataReceivePointByValues_MCUS_SeriousWarning_Level: accessed-variable=MCUS_0xDB.MCUS_SeriousWarning_Level
              DataReceivePointByValues_MCUS_CtrlModeVD: accessed-variable=MCUS_0xDB.MCUS_CtrlModeVD
              DataReceivePointByValues_MCUS_WaterPumpLevlReq: accessed-variable=MCUS_0xDB.MCUS_WaterPumpLevlReq
              DataReceivePointByValues_MCUS_MotorTemp: accessed-variable=MCUS_0xDB.MCUS_MotorTemp
              DataReceivePointByValues_MCUS_IGBTTemp: accessed-variable=MCUS_0xDB.MCUS_IGBTTemp
              DataReceivePointByValues_MCUS_InletTemp: accessed-variable=MCUS_0xDB.MCUS_InletTemp
              DataReceivePointByValues_MCUS_DrvMotorRPM: accessed-variable=MCUS_0xDB.MCUS_DrvMotorRPM
              DataReceivePointByValues_MCUS_ActualTorqueFB: accessed-variable=MCUS_0xDB.MCUS_ActualTorqueFB
              DataReceivePointByValues_MCUS_HWRdcFault: accessed-variable=MCUS_0xDB.MCUS_HWRdcFault
              DataReceivePointByValues_MCUS_HighVoltPowerOffReq: accessed-variable=MCUS_0xDB.MCUS_HighVoltPowerOffReq
              DataReceivePointByValues_MCUS_HVILSts: accessed-variable=MCUS_0xDB.MCUS_HVILSts
              DataReceivePointByValues_MCUS_DragSts: accessed-variable=MCUS_0xDB.MCUS_DragSts
              DataReceivePointByValues_MCUS_CtrlMode: accessed-variable=MCUS_0xDB.MCUS_CtrlMode
              DataReceivePointByValues_MCUS_MILlampReq: accessed-variable=MCUS_0xDB.MCUS_MILlampReq
              DataReceivePointByValues_MCUS_DrvMotorRPMVD: accessed-variable=MCUS_0xDB.MCUS_DrvMotorRPMVD
              DataReceivePointByValues_MCUS_ActualTorqueFBVD: accessed-variable=MCUS_0xDB.MCUS_ActualTorqueFBVD
              DataReceivePointByValues_MCUS_MaxTorqueAllow: accessed-variable=MCUS_0xDB.MCUS_MaxTorqueAllow
              DataReceivePointByValues_MCUS_MaxSpeedAllow: accessed-variable=MCUS_0xDB.MCUS_MaxSpeedAllow
              DataReceivePointByValues_MCUS_ActiveReleaseSts: accessed-variable=MCUS_0xDB.MCUS_ActiveReleaseSts
              DataReceivePointByValues_MCUS_MinTorqueAllow: accessed-variable=MCUS_0xDB.MCUS_MinTorqueAllow
              DataReceivePointByValues_MCUS_MainWireVolt: accessed-variable=MCUS_0xDB.MCUS_MainWireVolt
              DataReceivePointByValues_MCUS_MainWireCurr: accessed-variable=MCUS_0xDB.MCUS_MainWireCurr
              DataReceivePointByValues_MCUS_Clutch_Pos: accessed-variable=MCUS_0xDB.MCUS_Clutch_Pos
              DataReceivePointByValues_MCUS_Clutch_Fault: accessed-variable=MCUS_0xDB.MCUS_Clutch_Fault
              DataReceivePointByValues_MCUS_TMS_FrMotSelfHeatEnSts: accessed-variable=MCUS_0xDB.MCUS_TMS_FrMotSelfHeatEnSts
              DataReceivePointByValues_MCUS_TMS_FrMotSelfHeatLvlFb: accessed-variable=MCUS_0xDB.MCUS_TMS_FrMotSelfHeatLvlFb
              DataReceivePointByValues_MCUS_HeatPwrAval: accessed-variable=MCUS_0xDB.MCUS_HeatPwrAval
              DataReceivePointByValues_BCM_VCU_Authentication_MAC_B{0..15}: accessed-variable=HPCBCM_0x1E6.BCM_VCU_Authentication_MAC_B{0..15}
              DataReceivePointByValues_ECM_UDS_PhyReq_Byte{0..7}: accessed-variable=UDS_Phy_Rx_7E0_ECM.ECM_UDS_PhyReq_Byte{0..7}
              DataReceivePointByValues_Debug_MCU_CRC_CA: accessed-variable=RMCU_0x2.Debug_MCU_CRC_CA
              DataReceivePointByValues_Debug_MCU_RollingCounter_CA: accessed-variable=RMCU_0x2.Debug_MCU_RollingCounter_CA
              DataReceivePointByValues_Debug_MCU_WarningLevel: accessed-variable=RMCU_0x2.Debug_MCU_WarningLevel
              DataReceivePointByValues_Debug_MCU_SelfCheckSts: accessed-variable=RMCU_0x2.Debug_MCU_SelfCheckSts
              DataReceivePointByValues_Debug_MCU_DrvMotorWorkSts: accessed-variable=RMCU_0x2.Debug_MCU_DrvMotorWorkSts
              DataReceivePointByValues_Debug_MCU_PowerReduceSts: accessed-variable=RMCU_0x2.Debug_MCU_PowerReduceSts
              DataReceivePointByValues_Debug_MCU_DrvMotorRPM: accessed-variable=RMCU_0x2.Debug_MCU_DrvMotorRPM
              DataReceivePointByValues_Debug_MCU_ActualTorqueFB: accessed-variable=RMCU_0x2.Debug_MCU_ActualTorqueFB
              DataReceivePointByValues_Debug_MCU_HWRdcFault: accessed-variable=RMCU_0x2.Debug_MCU_HWRdcFault
              DataReceivePointByValues_Debug_MCU_HighVoltPowerOffReq: accessed-variable=RMCU_0x2.Debug_MCU_HighVoltPowerOffReq
              DataReceivePointByValues_Debug_MCU_HVILSts: accessed-variable=RMCU_0x2.Debug_MCU_HVILSts
              DataReceivePointByValues_Debug_MCU_DragSts: accessed-variable=RMCU_0x2.Debug_MCU_DragSts
              DataReceivePointByValues_Debug_MCU_CtrlMode: accessed-variable=RMCU_0x2.Debug_MCU_CtrlMode
              DataReceivePointByValues_Debug_MCU_MILlampReq: accessed-variable=RMCU_0x2.Debug_MCU_MILlampReq
              DataReceivePointByValues_Debug_MCU_DrvMotorRPMVD: accessed-variable=RMCU_0x2.Debug_MCU_DrvMotorRPMVD
              DataReceivePointByValues_Debug_MCU_ActualTorqueFBVD: accessed-variable=RMCU_0x2.Debug_MCU_ActualTorqueFBVD
              DataReceivePointByValues_Debug_MCU_MaxTorqueAllow: accessed-variable=RMCU_0x2.Debug_MCU_MaxTorqueAllow
              DataReceivePointByValues_Debug_MCU_MaxSpeedAllow: accessed-variable=RMCU_0x2.Debug_MCU_MaxSpeedAllow
              DataReceivePointByValues_Debug_MCU_ActiveReleaseSts: accessed-variable=RMCU_0x2.Debug_MCU_ActiveReleaseSts
              DataReceivePointByValues_Debug_MCU_DCChargRelaySts: accessed-variable=RMCU_0x2.Debug_MCU_DCChargRelaySts
              DataReceivePointByValues_Debug_MCUM_MinTorqueAllow: accessed-variable=RMCU_0x2.Debug_MCUM_MinTorqueAllow
              DataReceivePointByValues_Debug_MCU_MainWireVolt: accessed-variable=RMCU_0x2.Debug_MCU_MainWireVolt
              DataReceivePointByValues_Debug_MCU_MainWireCurr: accessed-variable=RMCU_0x2.Debug_MCU_MainWireCurr
              DataReceivePointByValues_Debug_MCUM_TMS_MotSelfHeatEnSts: accessed-variable=RMCU_0x2.Debug_MCUM_TMS_MotSelfHeatEnSts
              DataReceivePointByValues_Debug_MCUM_TMS_MotSelfHeatLvlFb: accessed-variable=RMCU_0x2.Debug_MCUM_TMS_MotSelfHeatLvlFb
              DataReceivePointByValues_Debug_MCUM_RPowerReduceSts: accessed-variable=RMCU_0x2.Debug_MCUM_RPowerReduceSts
              DataReceivePointByValues_Debug_MCUM_HeatPwrAval: accessed-variable=RMCU_0x2.Debug_MCUM_HeatPwrAval
              DataReceivePointByValues_Debug_MCUM_RCtrlMode: accessed-variable=RMCU_0x2.Debug_MCUM_RCtrlMode
              DataReceivePointByValues_Debug_MCUM_RWarningLevel: accessed-variable=RMCU_0x2.Debug_MCUM_RWarningLevel
              DataReceivePointByValues_Debug_MCUM_RSelfCheckSts: accessed-variable=RMCU_0x2.Debug_MCUM_RSelfCheckSts
              DataReceivePointByValues_Debug_MCUM_RDrvMotorWorkSts: accessed-variable=RMCU_0x2.Debug_MCUM_RDrvMotorWorkSts
              DataReceivePointByValues_Debug_MCUM_RCtrlModeVD: accessed-variable=RMCU_0x2.Debug_MCUM_RCtrlModeVD
              DataReceivePointByValues_Debug_MCUM_RHWRdcFault: accessed-variable=RMCU_0x2.Debug_MCUM_RHWRdcFault
              DataReceivePointByValues_Debug_MCUM_RDrvMotorRPMVD: accessed-variable=RMCU_0x2.Debug_MCUM_RDrvMotorRPMVD
              DataReceivePointByValues_Debug_MCUM_RActualTorqueFBVD: accessed-variable=RMCU_0x2.Debug_MCUM_RActualTorqueFBVD
              DataReceivePointByValues_Debug_MCUM_RDrvMotorRPM: accessed-variable=RMCU_0x2.Debug_MCUM_RDrvMotorRPM
              DataReceivePointByValues_Debug_MCUM_RActualTorqueFB: accessed-variable=RMCU_0x2.Debug_MCUM_RActualTorqueFB
              DataReceivePointByValues_IBS_CRC_225: accessed-variable=IBS_0x225.IBS_CRC_225
              DataReceivePointByValues_IBS_RollingCounter_225: accessed-variable=IBS_0x225.IBS_RollingCounter_225
              DataReceivePointByValues_IBS_Warning_Level: accessed-variable=IBS_0x225.IBS_Warning_Level
              DataReceivePointByValues_ADDC_CRC_84: accessed-variable=ADDC_0x84.ADDC_CRC_84
              DataReceivePointByValues_ADDC_APS_AVHReq: accessed-variable=ADDC_0x84.ADDC_APS_AVHReq
              DataReceivePointByValues_ADDC_APS_HoldSts: accessed-variable=ADDC_0x84.ADDC_APS_HoldSts
              DataReceivePointByValues_ADDC_APSTargetTrqBrkVD: accessed-variable=ADDC_0x84.ADDC_APSTargetTrqBrkVD
              DataReceivePointByValues_ADDC_APSTargetTrqBrk: accessed-variable=ADDC_0x84.ADDC_APSTargetTrqBrk
              DataReceivePointByValues_ADDC_APSTargetTrqVD: accessed-variable=ADDC_0x84.ADDC_APSTargetTrqVD
              DataReceivePointByValues_ADDC_APSTargetTrq: accessed-variable=ADDC_0x84.ADDC_APSTargetTrq
              DataReceivePointByValues_ADDC_safety_valid: accessed-variable=ADDC_0x84.ADDC_safety_valid
              DataReceivePointByValues_ADDC_rearsafety_level: accessed-variable=ADDC_0x84.ADDC_rearsafety_level
              DataReceivePointByValues_ADDC_frontsafety_level: accessed-variable=ADDC_0x84.ADDC_frontsafety_level
              DataReceivePointByValues_ADDC_rightsafety_level: accessed-variable=ADDC_0x84.ADDC_rightsafety_level
              DataReceivePointByValues_ADDC_leftsafety_level: accessed-variable=ADDC_0x84.ADDC_leftsafety_level
              DataReceivePointByValues_ADDC_RollingCounter_84: accessed-variable=ADDC_0x84.ADDC_RollingCounter_84
              DataReceivePointByValues_ADDC_APS_EnableReq: accessed-variable=ADDC_0x84.ADDC_APS_EnableReq
              DataReceivePointByValues_ADDC_APS_WorkSts: accessed-variable=ADDC_0x84.ADDC_APS_WorkSts
              DataReceivePointByValues_ADDC_APS_PDCVehicleDirectCtlVD: accessed-variable=ADDC_0x84.ADDC_APS_PDCVehicleDirectCtlVD
              DataReceivePointByValues_ADDC_APS_VehicleSpeedCtlVD: accessed-variable=ADDC_0x84.ADDC_APS_VehicleSpeedCtlVD
              DataReceivePointByValues_ADDC_APS_PDC_VehicleDirectCtl: accessed-variable=ADDC_0x84.ADDC_APS_PDC_VehicleDirectCtl
              DataReceivePointByValues_ADDC_APS_PDC_SWAngCtl: accessed-variable=ADDC_0x84.ADDC_APS_PDC_SWAngCtl
              DataReceivePointByValues_ADDC_APS_ParkingReq: accessed-variable=ADDC_0x84.ADDC_APS_ParkingReq
              DataReceivePointByValues_ADDC_APS_EmergenceBrake: accessed-variable=ADDC_0x84.ADDC_APS_EmergenceBrake
              DataReceivePointByValues_ADDC_APS_TargetAccVD: accessed-variable=ADDC_0x84.ADDC_APS_TargetAccVD
              DataReceivePointByValues_ADDC_APS_TargetAcc: accessed-variable=ADDC_0x84.ADDC_APS_TargetAcc
              DataReceivePointByValues_ADDC_APS_VehicleSpeedCtl: accessed-variable=ADDC_0x84.ADDC_APS_VehicleSpeedCtl
              DataReceivePointByValues_ADDC_APS_DecToStop: accessed-variable=ADDC_0x84.ADDC_APS_DecToStop
              DataReceivePointByValues_ADDC_APS_Driveoff_Request: accessed-variable=ADDC_0x84.ADDC_APS_Driveoff_Request
              DataReceivePointByValues_ADDC_APS_FuncType: accessed-variable=ADDC_0x84.ADDC_APS_FuncType
              DataReceivePointByValues_ADDC_APS_Available: accessed-variable=ADDC_0x84.ADDC_APS_Available
              DataReceivePointByValues_IVI_Year: accessed-variable=IVI_0x5F6.IVI_Year
              DataReceivePointByValues_IVI_Month: accessed-variable=IVI_0x5F6.IVI_Month
              DataReceivePointByValues_IVI_Data: accessed-variable=IVI_0x5F6.IVI_Data
              DataReceivePointByValues_IVI_Hour: accessed-variable=IVI_0x5F6.IVI_Hour
              DataReceivePointByValues_IVI_Minute: accessed-variable=IVI_0x5F6.IVI_Minute
              DataReceivePointByValues_IVI_Second: accessed-variable=IVI_0x5F6.IVI_Second
              DataReceivePointByValues_DCDC_CRC_324: accessed-variable=DCDC_0x324.DCDC_CRC_324
              DataReceivePointByValues_DCDC_RollingCounter_324: accessed-variable=DCDC_0x324.DCDC_RollingCounter_324
              DataReceivePointByValues_DCDC_WorkSts: accessed-variable=DCDC_0x324.DCDC_WorkSts
              DataReceivePointByValues_DCDC_Under_Output_Voltage: accessed-variable=DCDC_0x324.DCDC_Under_Output_Voltage
              DataReceivePointByValues_DCDC_Over_Output_Voltage: accessed-variable=DCDC_0x324.DCDC_Over_Output_Voltage
              DataReceivePointByValues_DCDC_Under_Input_Voltage: accessed-variable=DCDC_0x324.DCDC_Under_Input_Voltage
              DataReceivePointByValues_DCDC_Over_Input_Voltage: accessed-variable=DCDC_0x324.DCDC_Over_Input_Voltage
              DataReceivePointByValues_DCDC_Over_Input_Current: accessed-variable=DCDC_0x324.DCDC_Over_Input_Current
              DataReceivePointByValues_DCDC_Real_Output_Current: accessed-variable=DCDC_0x324.DCDC_Real_Output_Current
              DataReceivePointByValues_DCDC_Real_Output_Voltage: accessed-variable=DCDC_0x324.DCDC_Real_Output_Voltage
              DataReceivePointByValues_DCDC_Real_Input_Current: accessed-variable=DCDC_0x324.DCDC_Real_Input_Current
              DataReceivePointByValues_DCDC_Real_Input_Voltage: accessed-variable=DCDC_0x324.DCDC_Real_Input_Voltage
              DataReceivePointByValues_DCDC_Derating: accessed-variable=DCDC_0x324.DCDC_Derating
              DataReceivePointByValues_DCDC_Hardware_Fault_Flag: accessed-variable=DCDC_0x324.DCDC_Hardware_Fault_Flag
              DataReceivePointByValues_CDU_ACChg_HIVSts: accessed-variable=DCDC_0x324.CDU_ACChg_HIVSts
              DataReceivePointByValues_CDU_OBC_OverTemp: accessed-variable=DCDC_0x324.CDU_OBC_OverTemp
              DataReceivePointByValues_CDU_SelfCheckSt: accessed-variable=DCDC_0x324.CDU_SelfCheckSt
              DataReceivePointByValues_CDU_HV_HIVSts: accessed-variable=DCDC_0x324.CDU_HV_HIVSts
              DataReceivePointByValues_FSC_CRC_142: accessed-variable=FSC_0x142.FSC_CRC_142
              DataReceivePointByValues_FSC_RollingCounter_142: accessed-variable=FSC_0x142.FSC_RollingCounter_142
              DataReceivePointByValues_FSC_LCC_Mode: accessed-variable=FSC_0x142.FSC_LCC_Mode
              DataReceivePointByValues_EOL_ModeCMD_Data{0..5}: accessed-variable=MCU_0x5C5.EOL_ModeCMD_Data{0..5}
              DataReceivePointByValues_EOL_ModeCMD_Enable: accessed-variable=MCU_0x5C5.EOL_ModeCMD_Enable
              DataReceivePointByValues_EOL_ModeCMD_Check: accessed-variable=MCU_0x5C5.EOL_ModeCMD_Check
              DataReceivePointByValues_EOL_GainIden_UsApply: accessed-variable=MCU_0x5C5.EOL_GainIden_UsApply
              DataReceivePointByValues_EOL_MotClb_CtrlMode: accessed-variable=MCU_0x5C5.EOL_MotClb_CtrlMode
              DataReceivePointByValues_MotClb_OfsSet: accessed-variable=MCU_0x5C5.MotClb_OfsSet
              DataReceivePointByValues_EOL_MotClb_IsCMD: accessed-variable=MCU_0x5C5.EOL_MotClb_IsCMD
              DataReceivePointByValues_EOL_MotClb_ThetaCMD: accessed-variable=MCU_0x5C5.EOL_MotClb_ThetaCMD
              DataReceivePointByValues_EOL_frqsync: accessed-variable=MCU_0x5C5.EOL_frqsync
              DataReceivePointByValues_EOL_MotClb_Enable: accessed-variable=MCU_0x5C5.EOL_MotClb_Enable
              DataReceivePointByValues_EOL_ActiveReleaseCmd: accessed-variable=MCU_0x5C5.EOL_ActiveReleaseCmd
              DataReceivePointByValues_MotClb_OfsAdjEn: accessed-variable=MCU_0x5C5.MotClb_OfsAdjEn
              DataReceivePointByValues_EOL_Asc_CMD: accessed-variable=MCU_0x5C5.EOL_Asc_CMD
              DataReceivePointByValues_EOL_PosDly_SnsrSupplier: accessed-variable=MCU_0x5C5.EOL_PosDly_SnsrSupplier
              DataReceivePointByValues_FstRcrd_Enable: accessed-variable=MCU_0x5C5.FstRcrd_Enable
              DataReceivePointByValues_GainIden_CurrRMS_Ref_U: accessed-variable=MCU_0x5C5.GainIden_CurrRMS_Ref_U
              DataReceivePointByValues_GainIden_CurrRMS_Ref_V: accessed-variable=MCU_0x5C5.GainIden_CurrRMS_Ref_V
              DataReceivePointByValues_GainIden_CurrRMS_Ref_W: accessed-variable=MCU_0x5C5.GainIden_CurrRMS_Ref_W
              DataReceivePointByValues_MCUMR_EOL_GainIden_UsApply: accessed-variable=MCU_0x5C5.MCUMR_EOL_GainIden_UsApply
              DataReceivePointByValues_MCUMR_EOL_MotClb_CtrlMode: accessed-variable=MCU_0x5C5.MCUMR_EOL_MotClb_CtrlMode
              DataReceivePointByValues_MCUMR_MotClb_OfsSet: accessed-variable=MCU_0x5C5.MCUMR_MotClb_OfsSet
              DataReceivePointByValues_MCUMR_EOL_MotClb_IsCMD: accessed-variable=MCU_0x5C5.MCUMR_EOL_MotClb_IsCMD
              DataReceivePointByValues_MCUMR_EOL_MotClb_ThetaCMD: accessed-variable=MCU_0x5C5.MCUMR_EOL_MotClb_ThetaCMD
              DataReceivePointByValues_MCUMR_EOL_frqsync: accessed-variable=MCU_0x5C5.MCUMR_EOL_frqsync
              DataReceivePointByValues_MCUMR_EOL_MotClb_Enable: accessed-variable=MCU_0x5C5.MCUMR_EOL_MotClb_Enable
              DataReceivePointByValues_MCUMR_EOL_ActiveReleaseCmd: accessed-variable=MCU_0x5C5.MCUMR_EOL_ActiveReleaseCmd
              DataReceivePointByValues_MCUMR_MotClb_OfsAdjEn: accessed-variable=MCU_0x5C5.MCUMR_MotClb_OfsAdjEn
              DataReceivePointByValues_MCUMR_EOL_Asc_CMD: accessed-variable=MCU_0x5C5.MCUMR_EOL_Asc_CMD
              DataReceivePointByValues_MCUMR_EOL_PosDly_SnsrSupplier: accessed-variable=MCU_0x5C5.MCUMR_EOL_PosDly_SnsrSupplier
              DataReceivePointByValues_MCUMR_FstRcrd_Enable: accessed-variable=MCU_0x5C5.MCUMR_FstRcrd_Enable
              DataReceivePointByValues_MCUMR_GainIden_CurrRMS_Ref_U: accessed-variable=MCU_0x5C5.MCUMR_GainIden_CurrRMS_Ref_U
              DataReceivePointByValues_MCUMR_GainIden_CurrRMS_Ref_V: accessed-variable=MCU_0x5C5.MCUMR_GainIden_CurrRMS_Ref_V
              DataReceivePointByValues_MCUMR_GainIden_CurrRMS_Ref_W: accessed-variable=MCU_0x5C5.MCUMR_GainIden_CurrRMS_Ref_W
              DataReceivePointByValues_MCUS_CRC_14: accessed-variable=MCUS_0x14.MCUS_CRC_14
              DataReceivePointByValues_MCUS_RollingCounter_14: accessed-variable=MCUS_0x14.MCUS_RollingCounter_14
              DataReceivePointByValues_MCUS_DrvMotorRPM_prvt: accessed-variable=MCUS_0x14.MCUS_DrvMotorRPM_prvt
              DataReceivePointByValues_MCUS_ActualTorqueFB_prvt: accessed-variable=MCUS_0x14.MCUS_ActualTorqueFB_prvt
              DataReceivePointByValues_MCUS_DrvMotorRPMVD_prvt: accessed-variable=MCUS_0x14.MCUS_DrvMotorRPMVD_prvt
              DataReceivePointByValues_MCUS_ActualTorqueFBVD_prvt: accessed-variable=MCUS_0x14.MCUS_ActualTorqueFBVD_prvt
              DataReceivePointByValues_U16_CMD{1..4}: accessed-variable=MCU_0x5C7.U16_CMD{1..4}
              DataReceivePointByValues_S16_CMD{1..4}: accessed-variable=MCU_0x5C7.S16_CMD{1..4}
              DataReceivePointByValues_R16_CMD{1..4}: accessed-variable=MCU_0x5C7.R16_CMD{1..4}
              DataReceivePointByValues_U8_CMD{1..8}: accessed-variable=MCU_0x5C7.U8_CMD{1..8}
              DataReceivePointByValues_OBC_CRC_316: accessed-variable=OBC_0x316.OBC_CRC_316
              DataReceivePointByValues_OBC_RollingCounter_316: accessed-variable=OBC_0x316.OBC_RollingCounter_316
              DataReceivePointByValues_OBC_WorkSts: accessed-variable=OBC_0x316.OBC_WorkSts
              DataReceivePointByValues_OBC_StartSts: accessed-variable=OBC_0x316.OBC_StartSts
              DataReceivePointByValues_OBC_DCSts: accessed-variable=OBC_0x316.OBC_DCSts
              DataReceivePointByValues_OBC_ACChargeOutputSts: accessed-variable=OBC_0x316.OBC_ACChargeOutputSts
              DataReceivePointByValues_OBC_DCVolt: accessed-variable=OBC_0x316.OBC_DCVolt
              DataReceivePointByValues_OBC_HardwareSts: accessed-variable=OBC_0x316.OBC_HardwareSts
              DataReceivePointByValues_OBC_DCCurr: accessed-variable=OBC_0x316.OBC_DCCurr
              DataReceivePointByValues_OBC_ACVolt: accessed-variable=OBC_0x316.OBC_ACVolt
              DataReceivePointByValues_OBC_ACCurr: accessed-variable=OBC_0x316.OBC_ACCurr
              DataReceivePointByValues_OBC_CCConnectSts: accessed-variable=OBC_0x316.OBC_CCConnectSts
              DataReceivePointByValues_OBC_CPDutyCycleFault: accessed-variable=OBC_0x316.OBC_CPDutyCycleFault
              DataReceivePointByValues_OBC_CPDutyCycleValue: accessed-variable=OBC_0x316.OBC_CPDutyCycleValue
              DataReceivePointByValues_OBC_ACMaxPower: accessed-variable=OBC_0x316.OBC_ACMaxPower
              DataReceivePointByValues_OBC_ACPowerState: accessed-variable=OBC_0x316.OBC_ACPowerState
              DataReceivePointByValues_LMC_CRC_FA: accessed-variable=LMC_0xFA.LMC_CRC_FA
              DataReceivePointByValues_LMC_RollingCounter_FA: accessed-variable=LMC_0xFA.LMC_RollingCounter_FA
              DataReceivePointByValues_LMC_EngTorqDec_Main: accessed-variable=LMC_0xFA.LMC_EngTorqDec_Main
              DataReceivePointByValues_LMC_EngTorqDecActive_Main: accessed-variable=LMC_0xFA.LMC_EngTorqDecActive_Main
              DataReceivePointByValues_LMC_AMM_St: accessed-variable=LMC_0xFA.LMC_AMM_St
              DataReceivePointByValues_LMC_EngTorqInc_Main: accessed-variable=LMC_0xFA.LMC_EngTorqInc_Main
              DataReceivePointByValues_LMC_EngTorqIncActive_Main: accessed-variable=LMC_0xFA.LMC_EngTorqIncActive_Main
              DataReceivePointByValues_LMC_EngTorqDec_Sub: accessed-variable=LMC_0xFA.LMC_EngTorqDec_Sub
              DataReceivePointByValues_LMC_EngTorqDecActive_Sub: accessed-variable=LMC_0xFA.LMC_EngTorqDecActive_Sub
              DataReceivePointByValues_LMC_EngTorqInc_Sub: accessed-variable=LMC_0xFA.LMC_EngTorqInc_Sub
              DataReceivePointByValues_LMC_EngTorqIncActive_Sub: accessed-variable=LMC_0xFA.LMC_EngTorqIncActive_Sub
              DataReceivePointByValues_LMC_CRC_18C: accessed-variable=LMC_0x18C.LMC_CRC_18C
              DataReceivePointByValues_LMC_RollingCounter_18C: accessed-variable=LMC_0x18C.LMC_RollingCounter_18C
              DataReceivePointByValues_LMC_TqTotalBrakeTorque: accessed-variable=LMC_0x18C.LMC_TqTotalBrakeTorque
              DataReceivePointByValues_LMC_TqTotalBrakeTorque_Valid: accessed-variable=LMC_0x18C.LMC_TqTotalBrakeTorque_Valid
              DataReceivePointByValues_LMC_CmpUTurnLockwhists: accessed-variable=LMC_0x18C.LMC_CmpUTurnLockwhists
              DataReceivePointByValues_GW_CRC_3B1: accessed-variable=HPCGW_0x3B1.GW_CRC_3B1
              DataReceivePointByValues_GW_RollingCounter_3B1: accessed-variable=HPCGW_0x3B1.GW_RollingCounter_3B1
              DataReceivePointByValues_GW_ACU_FLSeatBeltRSt: accessed-variable=HPCGW_0x3B1.GW_ACU_FLSeatBeltRSt
              DataReceivePointByValues_GW_ACU_FRSeatBeltRSt: accessed-variable=HPCGW_0x3B1.GW_ACU_FRSeatBeltRSt
              DataReceivePointByValues_GW_IBC_EPB_Status: accessed-variable=HPCGW_0x3B1.GW_IBC_EPB_Status
              DataReceivePointByValues_GW_ACU_TotalCrashOutputSts: accessed-variable=HPCGW_0x3B1.GW_ACU_TotalCrashOutputSts
              DataReceivePointByValues_GW_BZCU_DCChgExitTemp_Pos: accessed-variable=HPCGW_0x3B1.GW_BZCU_DCChgExitTemp_Pos
              DataReceivePointByValues_GW_BZCU_DCChgExitTemp_Neg: accessed-variable=HPCGW_0x3B1.GW_BZCU_DCChgExitTemp_Neg
              DataReceivePointByValues_GW_BZCU_ACChgExitTemp_Pos: accessed-variable=HPCGW_0x3B1.GW_BZCU_ACChgExitTemp_Pos
              DataReceivePointByValues_GW_BZCU_FuelTankSts: accessed-variable=HPCGW_0x3B1.GW_BZCU_FuelTankSts
              DataReceivePointByValues_GW_BZCU_LBMS_VoltA: accessed-variable=HPCGW_0x3B1.GW_BZCU_LBMS_VoltA
              DataReceivePointByValues_GW_BZCU_ACChgExitTemp_Neg: accessed-variable=HPCGW_0x3B1.GW_BZCU_ACChgExitTemp_Neg
              DataReceivePointByValues_GW_BZCU_FuelTankStsLockSts: accessed-variable=HPCGW_0x3B1.GW_BZCU_FuelTankStsLockSts
              DataReceivePointByValues_GW_BZCU_FuelTankLockCtrl: accessed-variable=HPCGW_0x3B1.GW_BZCU_FuelTankLockCtrl
              DataReceivePointByValues_GW_BZCU_ACChgLockSts: accessed-variable=HPCGW_0x3B1.GW_BZCU_ACChgLockSts
              DataReceivePointByValues_GW_RZCU_Cabin_220Vconnect_Sts: accessed-variable=HPCGW_0x3B1.GW_RZCU_Cabin_220Vconnect_Sts
              DataReceivePointByValues_GW_BZCU_Cab_220VRelay_CtrlSts: accessed-variable=HPCGW_0x3B1.GW_BZCU_Cab_220VRelay_CtrlSts
              DataReceivePointByValues_GW_BZCU_Cab_PDU220VRelay_CtrlSts: accessed-variable=HPCGW_0x3B1.GW_BZCU_Cab_PDU220VRelay_CtrlSts
              DataReceivePointByValues_GW_BZCU_Cabin_220VRelay_CtrlSts: accessed-variable=HPCGW_0x3B1.GW_BZCU_Cabin_220VRelay_CtrlSts
              DataReceivePointByValues_GW_BZCU_Cab_220Vconnect_Sts: accessed-variable=HPCGW_0x3B1.GW_BZCU_Cab_220Vconnect_Sts
              DataReceivePointByValues_GW_TBOXSOC_Altitude: accessed-variable=HPCGW_0x3B1.GW_TBOXSOC_Altitude
              DataReceivePointByValues_GW_CRC_13A: accessed-variable=HPCGW_0x13A.GW_CRC_13A
              DataReceivePointByValues_GW_RollingCounter_13A: accessed-variable=HPCGW_0x13A.GW_RollingCounter_13A
              DataReceivePointByValues_GW_IBC_VehicleSpeed: accessed-variable=HPCGW_0x13A.GW_IBC_VehicleSpeed
              DataReceivePointByValues_GW_IBC_VehicleSpeedVD: accessed-variable=HPCGW_0x13A.GW_IBC_VehicleSpeedVD
              DataReceivePointByValues_GW_IBC_AVHStatus: accessed-variable=HPCGW_0x13A.GW_IBC_AVHStatus
              DataReceivePointByValues_GW_IBC_RAB_Avatiable: accessed-variable=HPCGW_0x13A.GW_IBC_RAB_Avatiable
              DataReceivePointByValues_GW_IBC_RAB_Active: accessed-variable=HPCGW_0x13A.GW_IBC_RAB_Active
              DataReceivePointByValues_GW_IBC_FLWheelSpeedKPH: accessed-variable=HPCGW_0x13A.GW_IBC_FLWheelSpeedKPH
              DataReceivePointByValues_GW_IBC_FRWheelSpeedKPH: accessed-variable=HPCGW_0x13A.GW_IBC_FRWheelSpeedKPH
              DataReceivePointByValues_GW_IBC_RLWheelSpeedKPH: accessed-variable=HPCGW_0x13A.GW_IBC_RLWheelSpeedKPH
              DataReceivePointByValues_GW_IBC_RRWheelSpeedKPH: accessed-variable=HPCGW_0x13A.GW_IBC_RRWheelSpeedKPH
              DataReceivePointByValues_GW_IBC_FLWheelDirection: accessed-variable=HPCGW_0x13A.GW_IBC_FLWheelDirection
              DataReceivePointByValues_GW_IBC_FRWheelDirection: accessed-variable=HPCGW_0x13A.GW_IBC_FRWheelDirection
              DataReceivePointByValues_GW_IBC_RLWheelDirection: accessed-variable=HPCGW_0x13A.GW_IBC_RLWheelDirection
              DataReceivePointByValues_GW_IBC_RRWheelDirection: accessed-variable=HPCGW_0x13A.GW_IBC_RRWheelDirection
              DataReceivePointByValues_GW_IBC_FLWheelSpeedVD: accessed-variable=HPCGW_0x13A.GW_IBC_FLWheelSpeedVD
              DataReceivePointByValues_GW_IBC_FRWheelSpeedVD: accessed-variable=HPCGW_0x13A.GW_IBC_FRWheelSpeedVD
              DataReceivePointByValues_GW_IBC_RLWheelSpeedVD: accessed-variable=HPCGW_0x13A.GW_IBC_RLWheelSpeedVD
              DataReceivePointByValues_GW_IBC_RRWheelSpeedVD: accessed-variable=HPCGW_0x13A.GW_IBC_RRWheelSpeedVD
              DataReceivePointByValues_GW_IBC_PlungerPressure_Q: accessed-variable=HPCGW_0x13A.GW_IBC_PlungerPressure_Q
              DataReceivePointByValues_GW_IBC_PlungerPressure: accessed-variable=HPCGW_0x13A.GW_IBC_PlungerPressure
              DataReceivePointByValues_CCM_Volt: accessed-variable=CCM_0x36A.CCM_Volt
              DataReceivePointByValues_CCM_RollingCounter_36A: accessed-variable=CCM_0x36A.CCM_RollingCounter_36A
              DataReceivePointByValues_CCM_BaseState: accessed-variable=CCM_0x36A.CCM_BaseState
              DataReceivePointByValues_CCM_Power: accessed-variable=CCM_0x36A.CCM_Power
              DataReceivePointByValues_CCM_APTC_BscSts: accessed-variable=CCM_0x36A.CCM_APTC_BscSts
              DataReceivePointByValues_CCM_APTC_Power: accessed-variable=CCM_0x36A.CCM_APTC_Power
              DataReceivePointByValues_IBC_CRC_227: accessed-variable=IBC_0x227.IBC_CRC_227
              DataReceivePointByValues_IBC_RollingCounter_227: accessed-variable=IBC_0x227.IBC_RollingCounter_227
              DataReceivePointByValues_IBC_EPB_FailStatus: accessed-variable=IBC_0x227.IBC_EPB_FailStatus
              DataReceivePointByValues_IBC_EPB_Status: accessed-variable=IBC_0x227.IBC_EPB_Status
              DataReceivePointByValues_IBC_EPB_DrumMode: accessed-variable=IBC_0x227.IBC_EPB_DrumMode
              DataReceivePointByValues_IBC_EPB_AchievedClampForce: accessed-variable=IBC_0x227.IBC_EPB_AchievedClampForce
              DataReceivePointByValues_IBC_EPB_FailureLamp: accessed-variable=IBC_0x227.IBC_EPB_FailureLamp
              DataReceivePointByValues_IBC_EPB_ActuatorStateLeft: accessed-variable=IBC_0x227.IBC_EPB_ActuatorStateLeft
              DataReceivePointByValues_IBC_EPB_ActuatorStateRight: accessed-variable=IBC_0x227.IBC_EPB_ActuatorStateRight
              DataReceivePointByValues_IBC_EPB_HostAvailabilityLeft: accessed-variable=IBC_0x227.IBC_EPB_HostAvailabilityLeft
              DataReceivePointByValues_IBC_EPB_HostAvailabilityRight: accessed-variable=IBC_0x227.IBC_EPB_HostAvailabilityRight
              DataReceivePointByValues_BCM_CRC_290: accessed-variable=HPCBCM_0x290.BCM_CRC_290
              DataReceivePointByValues_BCM_RRDoorSts_ID290_CCAN: accessed-variable=HPCBCM_0x290.BCM_RRDoorSts_ID290_CCAN
              DataReceivePointByValues_BCM_RLDoorSts_ID290_CCAN: accessed-variable=HPCBCM_0x290.BCM_RLDoorSts_ID290_CCAN
              DataReceivePointByValues_BCM_RollingCounter_290: accessed-variable=HPCBCM_0x290.BCM_RollingCounter_290
              DataReceivePointByValues_BCM_HazardSwtSts: accessed-variable=HPCBCM_0x290.BCM_HazardSwtSts
              DataReceivePointByValues_BCM_DrOC_PPD_Status: accessed-variable=HPCBCM_0x290.BCM_DrOC_PPD_Status
              DataReceivePointByValues_BCM_FLOC_PPD_Status: accessed-variable=HPCBCM_0x290.BCM_FLOC_PPD_Status
              DataReceivePointByValues_BCM_FROC_PPD_Status: accessed-variable=HPCBCM_0x290.BCM_FROC_PPD_Status
              DataReceivePointByValues_BCM_DriverDoorSts_ID290_CCAN: accessed-variable=HPCBCM_0x290.BCM_DriverDoorSts_ID290_CCAN
              DataReceivePointByValues_BCM_DriverDoorSts_VD: accessed-variable=HPCBCM_0x290.BCM_DriverDoorSts_VD
              DataReceivePointByValues_BCM_FLDoorSts_ID290_CCAN: accessed-variable=HPCBCM_0x290.BCM_FLDoorSts_ID290_CCAN
              DataReceivePointByValues_BCM_FRDoorSts_ID290_CCAN: accessed-variable=HPCBCM_0x290.BCM_FRDoorSts_ID290_CCAN
              DataReceivePointByValues_BCM_BackDoorSts_ID290_CCAN: accessed-variable=HPCBCM_0x290.BCM_BackDoorSts_ID290_CCAN
              DataReceivePointByValues_BCM_FrontCoverSts: accessed-variable=HPCBCM_0x290.BCM_FrontCoverSts
              DataReceivePointByValues_BCM_HazardSwtOpenSts: accessed-variable=HPCBCM_0x290.BCM_HazardSwtOpenSts
              DataReceivePointByValues_BCM_BrakeFluidLevel: accessed-variable=HPCBCM_0x290.BCM_BrakeFluidLevel
              DataReceivePointByValues_BCM_ON2BRelaySts_ID290_CCAN: accessed-variable=HPCBCM_0x290.BCM_ON2BRelaySts_ID290_CCAN
              DataReceivePointByValues_BCM_ON2CRelaySts_ID290_CCAN: accessed-variable=HPCBCM_0x290.BCM_ON2CRelaySts_ID290_CCAN
              DataReceivePointByValues_BCM_AlarmMode_C: accessed-variable=HPCBCM_0x290.BCM_AlarmMode_C
              DataReceivePointByValues_EOL_CRC_13B: accessed-variable=VCU_0x1.EOL_CRC_13B
              DataReceivePointByValues_EOL_RollingCounter_13B: accessed-variable=VCU_0x1.EOL_RollingCounter_13B
              DataReceivePointByValues_EOL_VehicleSts: accessed-variable=VCU_0x1.EOL_VehicleSts
              DataReceivePointByValues_EOL_GearLevelPosSts: accessed-variable=VCU_0x1.EOL_GearLevelPosSts
              DataReceivePointByValues_EOL_GearLeverValid: accessed-variable=VCU_0x1.EOL_GearLeverValid
              DataReceivePointByValues_EOL_AccPedalValid: accessed-variable=VCU_0x1.EOL_AccPedalValid
              DataReceivePointByValues_EOL_ThrottlePosition: accessed-variable=VCU_0x1.EOL_ThrottlePosition
              DataReceivePointByValues_EOL_RMCUActiveReleaseCmd: accessed-variable=VCU_0x1.EOL_RMCUActiveReleaseCmd
              DataReceivePointByValues_EOL_VehicleDirect: accessed-variable=VCU_0x1.EOL_VehicleDirect
              DataReceivePointByValues_EOL_SuppressJitterRMCURequest: accessed-variable=VCU_0x1.EOL_SuppressJitterRMCURequest
              DataReceivePointByValues_EOL_RDrvControlMode: accessed-variable=VCU_0x1.EOL_RDrvControlMode
              DataReceivePointByValues_EOL_BrakePedalValue: accessed-variable=VCU_0x1.EOL_BrakePedalValue
              DataReceivePointByValues_EOL_RMCUMaxDischargePower: accessed-variable=VCU_0x1.EOL_RMCUMaxDischargePower
              DataReceivePointByValues_EOL_RMCUMaxChargePower: accessed-variable=VCU_0x1.EOL_RMCUMaxChargePower
              DataReceivePointByValues_EOL_RDrvRequestTorque: accessed-variable=VCU_0x1.EOL_RDrvRequestTorque
              DataReceivePointByValues_EOL_RDrvRequesSpeed: accessed-variable=VCU_0x1.EOL_RDrvRequesSpeed
              DataReceivePointByValues_EOL_FDrvRequestTorque: accessed-variable=VCU_0x1.EOL_FDrvRequestTorque
              DataReceivePointByValues_EOL_FDrvRequesSpeed: accessed-variable=VCU_0x1.EOL_FDrvRequesSpeed
              DataReceivePointByValues_EOL_FVehicleSts: accessed-variable=VCU_0x1.EOL_FVehicleSts
              DataReceivePointByValues_EOL_FDrvControlMode: accessed-variable=VCU_0x1.EOL_FDrvControlMode
              DataReceivePointByValues_EOL_ON2BRelayReq: accessed-variable=VCU_0x1.EOL_ON2BRelayReq
              DataReceivePointByValues_EOL_VehicleDirectVD: accessed-variable=VCU_0x1.EOL_VehicleDirectVD
              DataReceivePointByValues_EOL_RDrvControlModeVD: accessed-variable=VCU_0x1.EOL_RDrvControlModeVD
              DataReceivePointByValues_EOL_RDrvRequestTorqueVD: accessed-variable=VCU_0x1.EOL_RDrvRequestTorqueVD
              DataReceivePointByValues_EOL_RDrvRequesSpeedVD: accessed-variable=VCU_0x1.EOL_RDrvRequesSpeedVD
              DataReceivePointByValues_EOL_FDrvRequestTorqueVD: accessed-variable=VCU_0x1.EOL_FDrvRequestTorqueVD
              DataReceivePointByValues_EOL_FDrvRequesSpeedVD: accessed-variable=VCU_0x1.EOL_FDrvRequesSpeedVD
              DataReceivePointByValues_EOL_FDrvControlModeVD: accessed-variable=VCU_0x1.EOL_FDrvControlModeVD
              DataReceivePointByValues_EOL_MCUMDampgLmtFactor: accessed-variable=VCU_0x1.EOL_MCUMDampgLmtFactor
              DataReceivePointByValues_EOL_VCU_BoostMode_Fail: accessed-variable=VCU_0x1.EOL_VCU_BoostMode_Fail
              DataReceivePointByValues_EOL_VCU_BoostModeSts: accessed-variable=VCU_0x1.EOL_VCU_BoostModeSts
              DataReceivePointByValues_EOL_MCUMMaxPosDampgTrq: accessed-variable=VCU_0x1.EOL_MCUMMaxPosDampgTrq
              DataReceivePointByValues_EOL_MCUMMaxNegDampgTrq: accessed-variable=VCU_0x1.EOL_MCUMMaxNegDampgTrq
              DataSendPoints_EOL_VCU_BrkPedOpen: accessed-variable=VCU_0x3.EOL_VCU_BrkPedOpen
              DataSendPoints_EOL_VCU_BrkPedClose: accessed-variable=VCU_0x3.EOL_VCU_BrkPedClose
              DataSendPoints_EOL_VCU_ColumnShiftP: accessed-variable=VCU_0x3.EOL_VCU_ColumnShiftP
              DataSendPoints_EOL_VCU_VehiCrashSts: accessed-variable=VCU_0x3.EOL_VCU_VehiCrashSts
              DataSendPoints_EOL_VCU_SleepSatisfiedSts: accessed-variable=VCU_0x3.EOL_VCU_SleepSatisfiedSts
              DataSendPoints_EOL_VCU_VehiHvCmd: accessed-variable=VCU_0x3.EOL_VCU_VehiHvCmd
              DataSendPoints_EOL_VCU_GearQuitAps: accessed-variable=VCU_0x3.EOL_VCU_GearQuitAps
              DataSendPoints_EOL_VCU_REOverChgPwrFlag: accessed-variable=VCU_0x3.EOL_VCU_REOverChgPwrFlag
              DataSendPoints_EOL_VCU_VehiAccnFilt: accessed-variable=VCU_0x3.EOL_VCU_VehiAccnFilt
              DataSendPoints_EOL_VCU_HvOffSts: accessed-variable=VCU_0x3.EOL_VCU_HvOffSts
              DataSendPoints_EOL_VCU_ElecPwrBalanceReq: accessed-variable=VCU_0x3.EOL_VCU_ElecPwrBalanceReq
              DataSendPoints_EOL_VCU_CDU_RecvTr: accessed-variable=VCU_0x3.EOL_VCU_CDU_RecvTr
              DataSendPoints_EOL_VCU_BMS_RecvTr: accessed-variable=VCU_0x3.EOL_VCU_BMS_RecvTr
              DataSendPoints_EOL_VCU_IVI_RecvTr: accessed-variable=VCU_0x3.EOL_VCU_IVI_RecvTr
              DataSendPoints_EOL_VCU_WheelMaxDrvTrq: accessed-variable=VCU_0x3.EOL_VCU_WheelMaxDrvTrq
              DataSendPoints_EOL_VCU_WheelMaxRecTrq: accessed-variable=VCU_0x3.EOL_VCU_WheelMaxRecTrq
              DataSendPoints_EOL_VCU_GCU_RecvTr: accessed-variable=VCU_0x3.EOL_VCU_GCU_RecvTr
              DataSendPoints_EOL_VCU_TCM_RecvTr: accessed-variable=VCU_0x3.EOL_VCU_TCM_RecvTr
              DataSendPoints_EOL_VCU_PTC_RecvTr: accessed-variable=VCU_0x3.EOL_VCU_PTC_RecvTr
              DataSendPoints_EOL_VCU_LossFctorFlgFL: accessed-variable=VCU_0x3.EOL_VCU_LossFctorFlgFL
              DataSendPoints_EOL_VCU_LowBattVolt: accessed-variable=VCU_0x3.EOL_VCU_LowBattVolt
              DataSendPoints_EOL_VCU_HighPerforDisable: accessed-variable=VCU_0x3.EOL_VCU_HighPerforDisable
              DataSendPoints_EOL_VCU_AccPedHSigVolt: accessed-variable=VCU_0x3.EOL_VCU_AccPedHSigVolt
              DataSendPoints_EOL_VCU_LossFctorFlgFR: accessed-variable=VCU_0x3.EOL_VCU_LossFctorFlgFR
              DataSendPoints_EOL_VCU_AccPedLSigVolt: accessed-variable=VCU_0x3.EOL_VCU_AccPedLSigVolt
              DataSendPoints_EOL_VCU_LossFctorFlgRL: accessed-variable=VCU_0x3.EOL_VCU_LossFctorFlgRL
              DataSendPoints_EOL_VCU_AccPedHPwrVolt: accessed-variable=VCU_0x3.EOL_VCU_AccPedHPwrVolt
              DataSendPoints_EOL_VCU_LossFctorFlgRR: accessed-variable=VCU_0x3.EOL_VCU_LossFctorFlgRR
              DataSendPoints_EOL_VCU_AccPedLPwrVolt: accessed-variable=VCU_0x3.EOL_VCU_AccPedLPwrVolt
              DataSendPoints_EOL_VCU_PreReqChgPwr: accessed-variable=VCU_0x3.EOL_VCU_PreReqChgPwr
              DataSendPoints_EOL_VCU_VehPwrChageLimit: accessed-variable=VCU_0x3.EOL_VCU_VehPwrChageLimit
              DataSendPoints_EOL_VCU_FastPwrRequest: accessed-variable=VCU_0x3.EOL_VCU_FastPwrRequest
              DataSendPoints_EOL_VCU_On2KL15_Volt: accessed-variable=VCU_0x3.EOL_VCU_On2KL15_Volt
              DataSendPoints_EOL_VCU_ClutchWrkModDebug: accessed-variable=VCU_0x3.EOL_VCU_ClutchWrkModDebug
              DataSendPoints_EOL_VCU_HighPerforSwtFlg: accessed-variable=VCU_0x3.EOL_VCU_HighPerforSwtFlg
              DataSendPoints_EOL_VCU_VehiPowrConsumption: accessed-variable=VCU_0x3.EOL_VCU_VehiPowrConsumption
              DataSendPoints_EOL_VCU_MDrvFilterTrqRange: accessed-variable=VCU_0x3.EOL_VCU_MDrvFilterTrqRange
              DataSendPoints_EOL_VCU_WheelPwrOvrLimitflgRE: accessed-variable=VCU_0x3.EOL_VCU_WheelPwrOvrLimitflgRE
              DataSendPoints_EOL_VCU_MRDrvControlMode: accessed-variable=VCU_0x3.EOL_VCU_MRDrvControlMode
              DataSendPoints_EOL_VCU_MRDrvControlModeVD: accessed-variable=VCU_0x3.EOL_VCU_MRDrvControlModeVD
              DataSendPoints_EOL_VCU_VehicleDirectMR: accessed-variable=VCU_0x3.EOL_VCU_VehicleDirectMR
              DataSendPoints_EOL_VCU_VehicleDirectMRVD: accessed-variable=VCU_0x3.EOL_VCU_VehicleDirectMRVD
              DataSendPoints_EOL_VCU_MRDrvRequestTorque: accessed-variable=VCU_0x3.EOL_VCU_MRDrvRequestTorque
              DataSendPoints_EOL_VCU_MRDrvRequesSpeed: accessed-variable=VCU_0x3.EOL_VCU_MRDrvRequesSpeed
              DataSendPoints_EOL_VCU_MCUMRMaxDischargePower: accessed-variable=VCU_0x3.EOL_VCU_MCUMRMaxDischargePower
              DataSendPoints_EOL_VCU_MCUMRMaxPosDampgTrq: accessed-variable=VCU_0x3.EOL_VCU_MCUMRMaxPosDampgTrq
              DataSendPoints_EOL_VCU_MRDrvRequestTorqueVD: accessed-variable=VCU_0x3.EOL_VCU_MRDrvRequestTorqueVD
              DataSendPoints_EOL_VCU_MCUMRMaxChargePower: accessed-variable=VCU_0x3.EOL_VCU_MCUMRMaxChargePower
              DataSendPoints_EOL_VCU_MCUMRMaxNegDampgTrq: accessed-variable=VCU_0x3.EOL_VCU_MCUMRMaxNegDampgTrq
              DataSendPoints_EOL_VCU_MRDrvRequesSpeedVD: accessed-variable=VCU_0x3.EOL_VCU_MRDrvRequesSpeedVD
              DataSendPoints_EOL_VCU_MCUMRDampgLmtFactor: accessed-variable=VCU_0x3.EOL_VCU_MCUMRDampgLmtFactor
              DataSendPoints_EOL_VCU_SuppressJitterMCUMRRequest: accessed-variable=VCU_0x3.EOL_VCU_SuppressJitterMCUMRRequest
              DataReceivePointByValues_TMS_MilLampReq: accessed-variable=TMS_0x5FE.TMS_MilLampReq
              DataReceivePointByValues_EMS_CRC_BE: accessed-variable=EMS_0xBE.EMS_CRC_BE
              DataReceivePointByValues_EMS_RollingCounter_BE: accessed-variable=EMS_0xBE.EMS_RollingCounter_BE
              DataReceivePointByValues_EMS_EngineSts: accessed-variable=EMS_0xBE.EMS_EngineSts
              DataReceivePointByValues_ECM_FaultLevel: accessed-variable=EMS_0xBE.ECM_FaultLevel
              DataReceivePointByValues_ECM_ActualEngineTorqueValid: accessed-variable=EMS_0xBE.ECM_ActualEngineTorqueValid
              DataReceivePointByValues_ECM_EngineTorqueLoss: accessed-variable=EMS_0xBE.ECM_EngineTorqueLoss
              DataReceivePointByValues_ECM_ActualEngineTorque: accessed-variable=EMS_0xBE.ECM_ActualEngineTorque
              DataReceivePointByValues_ECM_EngineTorqueMax: accessed-variable=EMS_0xBE.ECM_EngineTorqueMax
              DataReceivePointByValues_ECM_EngineTorqueMin: accessed-variable=EMS_0xBE.ECM_EngineTorqueMin
              DataReceivePointByValues_ECM_EngineSpeed: accessed-variable=EMS_0xBE.ECM_EngineSpeed
              DataReceivePointByValues_ECM_EngineSpeedValid: accessed-variable=EMS_0xBE.ECM_EngineSpeedValid
              DataReceivePointByValues_ECM_EngineStopAllow: accessed-variable=EMS_0xBE.ECM_EngineStopAllow
              DataReceivePointByValues_ECM_EngineOilPressureLow: accessed-variable=EMS_0xBE.ECM_EngineOilPressureLow
              DataReceivePointByValues_ECM_EngineFuleCutoffSts: accessed-variable=EMS_0xBE.ECM_EngineFuleCutoffSts
              DataReceivePointByValues_ECM_EngineStartedCompleted: accessed-variable=EMS_0xBE.ECM_EngineStartedCompleted
              DataReceivePointByValues_ECM_CatalystWarmUpSts: accessed-variable=EMS_0xBE.ECM_CatalystWarmUpSts
              DataReceivePointByValues_ECM_CatalystWarmUpReq: accessed-variable=EMS_0xBE.ECM_CatalystWarmUpReq
              DataReceivePointByValues_ECM_IdleTargetSpeed: accessed-variable=EMS_0xBE.ECM_IdleTargetSpeed
              DataReceivePointByValues_ECM_IdleActive: accessed-variable=EMS_0xBE.ECM_IdleActive
              DataReceivePointByValues_ECM_EngineStartReq: accessed-variable=EMS_0xBE.ECM_EngineStartReq
              DataReceivePointByValues_ECM_EngineStopInhibit: accessed-variable=EMS_0xBE.ECM_EngineStopInhibit
              DataReceivePointByValues_ECM_GPFRegenlamp: accessed-variable=EMS_0xBE.ECM_GPFRegenlamp
              DataReceivePointByValues_ECM_EngineCoolantTemp: accessed-variable=EMS_0xBE.ECM_EngineCoolantTemp
              DataReceivePointByValues_ECM_EngineCoolantTempValid: accessed-variable=EMS_0xBE.ECM_EngineCoolantTempValid
              DataReceivePointByValues_ECM_FVVSts: accessed-variable=EMS_0xBE.ECM_FVVSts
              DataReceivePointByValues_ECM_learningReq: accessed-variable=EMS_0xBE.ECM_learningReq
              DataReceivePointByValues_ECM_EngineIdleStateRequest: accessed-variable=EMS_0xBE.ECM_EngineIdleStateRequest
              DataReceivePointByValues_ECM_EngineDFCOConditionRequest: accessed-variable=EMS_0xBE.ECM_EngineDFCOConditionRequest
              DataReceivePointByValues_ECM_GPFRegenReq: accessed-variable=EMS_0xBE.ECM_GPFRegenReq
              DataReceivePointByValues_ECM_SVSLampRequest: accessed-variable=EMS_0xBE.ECM_SVSLampRequest
              DataReceivePointByValues_ECM_TankPressure: accessed-variable=EMS_0xBE.ECM_TankPressure
              DataReceivePointByValues_ECM_TankPressureValid: accessed-variable=EMS_0xBE.ECM_TankPressureValid
              DataReceivePointByValues_ECM_MilLampRequest: accessed-variable=EMS_0xBE.ECM_MilLampRequest
              DataReceivePointByValues_ECM_ToothlearningSucValid: accessed-variable=EMS_0xBE.ECM_ToothlearningSucValid
              DataReceivePointByValues_ECM_FuelCloseLoopSts: accessed-variable=EMS_0xBE.ECM_FuelCloseLoopSts
              DataReceivePointByValues_ECM_RestrictorOpenValue: accessed-variable=EMS_0xBE.ECM_RestrictorOpenValue
              DataReceivePointByValues_ECM_FuelLevelSensorValid: accessed-variable=EMS_0xBE.ECM_FuelLevelSensorValid
              DataReceivePointByValues_ECM_FuelLevel: accessed-variable=EMS_0xBE.ECM_FuelLevel
              DataReceivePointByValues_ECM_SelfCheckSt: accessed-variable=EMS_0xBE.ECM_SelfCheckSt
              DataReceivePointByValues_ECM_PCVPipeDiagReq: accessed-variable=EMS_0xBE.ECM_PCVPipeDiagReq
              DataReceivePointByValues_ECM_CalculatedLoad: accessed-variable=EMS_0xBE.ECM_CalculatedLoad
              DataReceivePointByValues_ECM_AirPressure: accessed-variable=EMS_0xBE.ECM_AirPressure
              DataReceivePointByValues_ECM_FanSts: accessed-variable=EMS_0xBE.ECM_FanSts
              DataReceivePointByValues_EPS_CRC_18D: accessed-variable=EPS_0x18D.EPS_CRC_18D
              DataReceivePointByValues_EPS_RollingCounter_18D: accessed-variable=EPS_0x18D.EPS_RollingCounter_18D
              DataReceivePointByValues_EPS_Fault: accessed-variable=EPS_0x18D.EPS_Fault
              DataReceivePointByValues_EPS_CalibrationSts: accessed-variable=EPS_0x18D.EPS_CalibrationSts
              DataReceivePointByValues_EPS_FailureSts: accessed-variable=EPS_0x18D.EPS_FailureSts
              DataReceivePointByValues_EPS_SteeringAngleValidData: accessed-variable=EPS_0x18D.EPS_SteeringAngleValidData
              DataReceivePointByValues_EPS_SteeringAngleSpeedValidData: accessed-variable=EPS_0x18D.EPS_SteeringAngleSpeedValidData
              DataReceivePointByValues_EPS_SteerWheelAngle: accessed-variable=EPS_0x18D.EPS_SteerWheelAngle
              DataReceivePointByValues_EPS_SteerWheelRotSpd: accessed-variable=EPS_0x18D.EPS_SteerWheelRotSpd
              DataReceivePointByValues_EPS_SelfCheckSt: accessed-variable=EPS_0x18D.EPS_SelfCheckSt
              DataReceivePointByValues_EPS_AssistanceSts: accessed-variable=EPS_0x18D.EPS_AssistanceSts
              DataReceivePointByValues_GCU_CRC_BD: accessed-variable=GCU_0xBD.GCU_CRC_BD
              DataReceivePointByValues_GCU_EngineCylinderDeactivationStatus: accessed-variable=GCU_0xBD.GCU_EngineCylinderDeactivationStatus
              DataReceivePointByValues_GCU_EngineFuelInhibitReq: accessed-variable=GCU_0xBD.GCU_EngineFuelInhibitReq
              DataReceivePointByValues_GCU_RollingCounter_BD: accessed-variable=GCU_0xBD.GCU_RollingCounter_BD
              DataReceivePointByValues_GCU_MainWireCurr: accessed-variable=GCU_0xBD.GCU_MainWireCurr
              DataReceivePointByValues_GCU_MainWireVolt: accessed-variable=GCU_0xBD.GCU_MainWireVolt
              DataReceivePointByValues_GCU_SystemWarning: accessed-variable=GCU_0xBD.GCU_SystemWarning
              DataReceivePointByValues_GCU_MILlampReq: accessed-variable=GCU_0xBD.GCU_MILlampReq
              DataReceivePointByValues_GCU_MoterTemp: accessed-variable=GCU_0xBD.GCU_MoterTemp
              DataReceivePointByValues_GCU_Temp: accessed-variable=GCU_0xBD.GCU_Temp
              DataReceivePointByValues_GCU_SelfCheck: accessed-variable=GCU_0xBD.GCU_SelfCheck
              DataReceivePointByValues_GCU_Warning_Level: accessed-variable=GCU_0xBD.GCU_Warning_Level
              DataReceivePointByValues_GCU_HVILSts: accessed-variable=GCU_0xBD.GCU_HVILSts
              DataReceivePointByValues_GCU__PowerReduceSts: accessed-variable=GCU_0xBD.GCU__PowerReduceSts
              DataReceivePointByValues_GCU_ActualMotorRPM_VD: accessed-variable=GCU_0xBD.GCU_ActualMotorRPM_VD
              DataReceivePointByValues_GCU_ActualMotorTorque_VD: accessed-variable=GCU_0xBD.GCU_ActualMotorTorque_VD
              DataReceivePointByValues_GCU_ActualMotorTorque: accessed-variable=GCU_0xBD.GCU_ActualMotorTorque
              DataReceivePointByValues_GCU_MaxTorque: accessed-variable=GCU_0xBD.GCU_MaxTorque
              DataReceivePointByValues_GCU_ActiveReleaseFB: accessed-variable=GCU_0xBD.GCU_ActiveReleaseFB
              DataReceivePointByValues_GCU_MAXPower: accessed-variable=GCU_0xBD.GCU_MAXPower
              DataReceivePointByValues_GCU_TransientPower: accessed-variable=GCU_0xBD.GCU_TransientPower
              DataReceivePointByValues_GCU_HVOffReq: accessed-variable=GCU_0xBD.GCU_HVOffReq
              DataReceivePointByValues_GCU_ControlMode: accessed-variable=GCU_0xBD.GCU_ControlMode
              DataReceivePointByValues_GCU_Operating_Mode: accessed-variable=GCU_0xBD.GCU_Operating_Mode
              DataReceivePointByValues_GCU_ActualMotorRPM: accessed-variable=GCU_0xBD.GCU_ActualMotorRPM
              DataReceivePointByValues_BMS_WkupVolt_DC12V: accessed-variable=BMS_0x5B5.BMS_WkupVolt_DC12V
              DataReceivePointByValues_BMS_WkupVolt_AC12V: accessed-variable=BMS_0x5B5.BMS_WkupVolt_AC12V
              DataReceivePointByValues_BMS_HVPackPosRelayExternalVolt: accessed-variable=BMS_0x5B5.BMS_HVPackPosRelayExternalVolt
              DataReceivePointByValues_BMS_SOC_target: accessed-variable=BMS_0x5B5.BMS_SOC_target
              DataReceivePointByValues_BMS_CorrectSOEPer: accessed-variable=BMS_0x5B5.BMS_CorrectSOEPer
              DataReceivePointByValues_BMS_SOCModifyFlag: accessed-variable=BMS_0x5B5.BMS_SOCModifyFlag
              DataReceivePointByValues_BMS_BMU_SoftwareVersion: accessed-variable=BMS_0x5B5.BMS_BMU_SoftwareVersion
              DataReceivePointByValues_ICU_CRC_332: accessed-variable=ICU_0x332.ICU_CRC_332
              DataReceivePointByValues_ICU_RollingCounter_332: accessed-variable=ICU_0x332.ICU_RollingCounter_332
              DataReceivePointByValues_ICU_AEB_SW: accessed-variable=ICU_0x332.ICU_AEB_SW
              DataReceivePointByValues_ICU_ISA_controlSW: accessed-variable=ICU_0x332.ICU_ISA_controlSW
              DataReceivePointByValues_ICU_SLIF_SW: accessed-variable=ICU_0x332.ICU_SLIF_SW
              DataReceivePointByValues_ICU_SLWF_SW: accessed-variable=ICU_0x332.ICU_SLWF_SW
              DataReceivePointByValues_TMS_MainMotPumpSpdResp: accessed-variable=TMS_0x5A2.TMS_MainMotPumpSpdResp
              DataReceivePointByValues_TMS_MainMotPump_Operation_Temp: accessed-variable=TMS_0x5A2.TMS_MainMotPump_Operation_Temp
              DataReceivePointByValues_TMS_MainMotPump_Operation_Current: accessed-variable=TMS_0x5A2.TMS_MainMotPump_Operation_Current
              DataReceivePointByValues_TMS_MainMotPump_Supplied_Voltage: accessed-variable=TMS_0x5A2.TMS_MainMotPump_Supplied_Voltage
              DataReceivePointByValues_TMS_MainMotPumpErrSts: accessed-variable=TMS_0x5A2.TMS_MainMotPumpErrSts
              DataReceivePointByValues_IBC_CRC_184: accessed-variable=IBC_0x184.IBC_CRC_184
              DataReceivePointByValues_IBC_RollingCounter_184: accessed-variable=IBC_0x184.IBC_RollingCounter_184
              DataReceivePointByValues_IBC_FLWheelSpeedKPH: accessed-variable=IBC_0x184.IBC_FLWheelSpeedKPH
              DataReceivePointByValues_IBC_FRWheelSpeedKPH: accessed-variable=IBC_0x184.IBC_FRWheelSpeedKPH
              DataReceivePointByValues_IBC_RLWheelSpeedKPH: accessed-variable=IBC_0x184.IBC_RLWheelSpeedKPH
              DataReceivePointByValues_IBC_RRWheelSpeedKPH: accessed-variable=IBC_0x184.IBC_RRWheelSpeedKPH
              DataReceivePointByValues_IBC_FLWheelDirection: accessed-variable=IBC_0x184.IBC_FLWheelDirection
              DataReceivePointByValues_IBC_FRWheelDirection: accessed-variable=IBC_0x184.IBC_FRWheelDirection
              DataReceivePointByValues_IBC_RLWheelDirection: accessed-variable=IBC_0x184.IBC_RLWheelDirection
              DataReceivePointByValues_IBC_RRWheelDirection: accessed-variable=IBC_0x184.IBC_RRWheelDirection
              DataReceivePointByValues_IBC_FLWheelSpeedVD: accessed-variable=IBC_0x184.IBC_FLWheelSpeedVD
              DataReceivePointByValues_IBC_FRWheelSpeedVD: accessed-variable=IBC_0x184.IBC_FRWheelSpeedVD
              DataReceivePointByValues_IBC_RLWheelSpeedVD: accessed-variable=IBC_0x184.IBC_RLWheelSpeedVD
              DataReceivePointByValues_IBC_RRWheelSpeedVD: accessed-variable=IBC_0x184.IBC_RRWheelSpeedVD
              DataReceivePointByValues_IBC_FLWheelSpeedRC: accessed-variable=IBC_0x184.IBC_FLWheelSpeedRC
              DataReceivePointByValues_IBC_FRWheelSpeedRC: accessed-variable=IBC_0x184.IBC_FRWheelSpeedRC
              DataReceivePointByValues_IBC_RLWheelSpeedRC: accessed-variable=IBC_0x184.IBC_RLWheelSpeedRC
              DataReceivePointByValues_IBC_RRWheelSpeedRC: accessed-variable=IBC_0x184.IBC_RRWheelSpeedRC
              DataReceivePointByValues_IBC_DiscTemperatureFL: accessed-variable=IBC_0x184.IBC_DiscTemperatureFL
              DataReceivePointByValues_IBC_DiscTemperatureFLVD: accessed-variable=IBC_0x184.IBC_DiscTemperatureFLVD
              DataReceivePointByValues_IBC_DiscTemperatureFR: accessed-variable=IBC_0x184.IBC_DiscTemperatureFR
              DataReceivePointByValues_IBC_DiscTemperatureFRVD: accessed-variable=IBC_0x184.IBC_DiscTemperatureFRVD
              DataReceivePointByValues_IBC_DiscTemperatureRL: accessed-variable=IBC_0x184.IBC_DiscTemperatureRL
              DataReceivePointByValues_IBC_DiscTemperatureRLVD: accessed-variable=IBC_0x184.IBC_DiscTemperatureRLVD
              DataReceivePointByValues_IBC_DiscTemperatureRR: accessed-variable=IBC_0x184.IBC_DiscTemperatureRR
              DataReceivePointByValues_IBC_DiscTemperatureRRVD: accessed-variable=IBC_0x184.IBC_DiscTemperatureRRVD
              DataReceivePointByValues_IBC_CRC_183: accessed-variable=IBC_0x183.IBC_CRC_183
              DataReceivePointByValues_IBC_RollingCounter_183: accessed-variable=IBC_0x183.IBC_RollingCounter_183
              DataReceivePointByValues_IBC_RecuBrakeTorqueRequest: accessed-variable=IBC_0x183.IBC_RecuBrakeTorqueRequest
              DataReceivePointByValues_IBC_RecuBrakeTorqueRequest_Q: accessed-variable=IBC_0x183.IBC_RecuBrakeTorqueRequest_Q
              DataReceivePointByValues_IBC_sOutputRodDriverPer_Q: accessed-variable=IBC_0x183.IBC_sOutputRodDriverPer_Q
              DataReceivePointByValues_IBC_BrakePedalApplied_Q: accessed-variable=IBC_0x183.IBC_BrakePedalApplied_Q
              DataReceivePointByValues_IBC_HydraTorqTgtAct_Q: accessed-variable=IBC_0x183.IBC_HydraTorqTgtAct_Q
              DataReceivePointByValues_IBC_HydraTorqTgtAct: accessed-variable=IBC_0x183.IBC_HydraTorqTgtAct
              DataReceivePointByValues_IBC_BrakePedalApplied: accessed-variable=IBC_0x183.IBC_BrakePedalApplied
              DataReceivePointByValues_IBC_sOutputRodDriverPer: accessed-variable=IBC_0x183.IBC_sOutputRodDriverPer
              DataReceivePointByValues_IBC_HydraTorqAvailable: accessed-variable=IBC_0x183.IBC_HydraTorqAvailable
              DataReceivePointByValues_IBC_CtrlMode: accessed-variable=IBC_0x183.IBC_CtrlMode
              DataReceivePointByValues_IBC_QDC_HydraTorqTgt: accessed-variable=IBC_0x183.IBC_QDC_HydraTorqTgt
              DataReceivePointByValues_IBC_InPutRodDriver: accessed-variable=IBC_0x183.IBC_InPutRodDriver
              DataReceivePointByValues_IBC_InPutRodDriver_Q: accessed-variable=IBC_0x183.IBC_InPutRodDriver_Q
              DataReceivePointByValues_IBC_SystemAssistedStatus: accessed-variable=IBC_0x183.IBC_SystemAssistedStatus
              DataReceivePointByValues_IBC_EngTorq_VLC_Vaild: accessed-variable=IBC_0x183.IBC_EngTorq_VLC_Vaild
              DataReceivePointByValues_IBC_EngTorq_VLC: accessed-variable=IBC_0x183.IBC_EngTorq_VLC
              DataReceivePointByValues_IBC_BrkTorq_VLC: accessed-variable=IBC_0x183.IBC_BrkTorq_VLC
              DataReceivePointByValues_IBC_BrkTorq_VLC_Vaild: accessed-variable=IBC_0x183.IBC_BrkTorq_VLC_Vaild
              DataReceivePointByValues_IBC_CRC_186: accessed-variable=IBC_0x186.IBC_CRC_186
              DataReceivePointByValues_IBC_RollingCounter_186: accessed-variable=IBC_0x186.IBC_RollingCounter_186
              DataReceivePointByValues_IBC_WheelPressureReliabilityFL: accessed-variable=IBC_0x186.IBC_WheelPressureReliabilityFL
              DataReceivePointByValues_IBC_WheelPressureReliabilityFR: accessed-variable=IBC_0x186.IBC_WheelPressureReliabilityFR
              DataReceivePointByValues_IBC_WheelPressureReliabilityRL: accessed-variable=IBC_0x186.IBC_WheelPressureReliabilityRL
              DataReceivePointByValues_IBC_WheelPressureReliabilityRR: accessed-variable=IBC_0x186.IBC_WheelPressureReliabilityRR
              DataReceivePointByValues_IBC_WheelCylinderPressure_FL: accessed-variable=IBC_0x186.IBC_WheelCylinderPressure_FL
              DataReceivePointByValues_IBC_WheelCylinderPressure_FR: accessed-variable=IBC_0x186.IBC_WheelCylinderPressure_FR
              DataReceivePointByValues_IBC_WheelCylinderPressure_RL: accessed-variable=IBC_0x186.IBC_WheelCylinderPressure_RL
              DataReceivePointByValues_IBC_WheelCylinderPressure_RR: accessed-variable=IBC_0x186.IBC_WheelCylinderPressure_RR
              DataReceivePointByValues_IBC_WheelSlipFLVD: accessed-variable=IBC_0x186.IBC_WheelSlipFLVD
              DataReceivePointByValues_IBC_WheelSlipFRVD: accessed-variable=IBC_0x186.IBC_WheelSlipFRVD
              DataReceivePointByValues_IBC_WheelSlipRLVD: accessed-variable=IBC_0x186.IBC_WheelSlipRLVD
              DataReceivePointByValues_IBC_WheelSlipRRVD: accessed-variable=IBC_0x186.IBC_WheelSlipRRVD
              DataReceivePointByValues_IBC_WheelSlipFL: accessed-variable=IBC_0x186.IBC_WheelSlipFL
              DataReceivePointByValues_IBC_WheelSlipFR: accessed-variable=IBC_0x186.IBC_WheelSlipFR
              DataReceivePointByValues_IBC_WheelSlipRL: accessed-variable=IBC_0x186.IBC_WheelSlipRL
              DataReceivePointByValues_IBC_WheelSlipRR: accessed-variable=IBC_0x186.IBC_WheelSlipRR
              DataReceivePointByValues_IBC_Slop_Pencent: accessed-variable=IBC_0x186.IBC_Slop_Pencent
              DataReceivePointByValues_PTC_BscSts: accessed-variable=PTC_0x367.PTC_BscSts
              DataReceivePointByValues_PTC_RollingCounter_367: accessed-variable=PTC_0x367.PTC_RollingCounter_367
              DataReceivePointByValues_PTC_Fault: accessed-variable=PTC_0x367.PTC_Fault
              DataReceivePointByValues_PTC_Power: accessed-variable=PTC_0x367.PTC_Power
              DataReceivePointByValues_PTC_HV_interlock_faultSt: accessed-variable=PTC_0x367.PTC_HV_interlock_faultSt
              DataReceivePointByValues_GW_TCM_CRC_30B: accessed-variable=HPCGW_0x30B.GW_TCM_CRC_30B
              DataReceivePointByValues_GW_TCM_RollingCounter_30B: accessed-variable=HPCGW_0x30B.GW_TCM_RollingCounter_30B
              DataReceivePointByValues_GW_TCM_ParkingSwSts: accessed-variable=HPCGW_0x30B.GW_TCM_ParkingSwSts
              DataReceivePointByValues_GW_TCM_STATUS_Park: accessed-variable=HPCGW_0x30B.GW_TCM_STATUS_Park
              DataReceivePointByValues_GW_TCM_Counter_Park: accessed-variable=HPCGW_0x30B.GW_TCM_Counter_Park
              DataReceivePointByValues_GW_TCM_CRC_Park: accessed-variable=HPCGW_0x30B.GW_TCM_CRC_Park
              DataReceivePointByValues_GW_TCM_GearLevelSwitchSts: accessed-variable=HPCGW_0x30B.GW_TCM_GearLevelSwitchSts
              DataReceivePointByValues_GW_TCM_STATUS_RND: accessed-variable=HPCGW_0x30B.GW_TCM_STATUS_RND
              DataReceivePointByValues_GW_TCM_Counter_RND: accessed-variable=HPCGW_0x30B.GW_TCM_Counter_RND
              DataReceivePointByValues_GW_TCM_CRC_RND: accessed-variable=HPCGW_0x30B.GW_TCM_CRC_RND
              DataReceivePointByValues_GW_TCM_SelfCheckSt: accessed-variable=HPCGW_0x30B.GW_TCM_SelfCheckSt
              DataReceivePointByValues_TMS_MCUMHeatPwrReq: accessed-variable=TMS_0x5FF.TMS_MCUMHeatPwrReq
              DataReceivePointByValues_TMS_MCUMHeatModEnad: accessed-variable=TMS_0x5FF.TMS_MCUMHeatModEnad
              DataReceivePointByValues_TMS_VCU_MotSelfHeatEnReq: accessed-variable=TMS_0x5FF.TMS_VCU_MotSelfHeatEnReq
              DataReceivePointByValues_TMS_VCU_MotSelfHeatLvlReq: accessed-variable=TMS_0x5FF.TMS_VCU_MotSelfHeatLvlReq
              DataReceivePointByValues_ECM_SWVersionC: accessed-variable=ECM_0x148.ECM_SWVersionC
              DataReceivePointByValues_ECM_SWVersionB: accessed-variable=ECM_0x148.ECM_SWVersionB
              DataReceivePointByValues_ECM_SWVersionA: accessed-variable=ECM_0x148.ECM_SWVersionA
              DataReceivePointByValues_ECM_Total_fuel_consumed: accessed-variable=ECM_0x148.ECM_Total_fuel_consumed
              DataReceivePointByValues_IVI_CRC_331: accessed-variable=IVI_0x331.IVI_CRC_331
              DataReceivePointByValues_IVI_RollingCounter_331: accessed-variable=IVI_0x331.IVI_RollingCounter_331
              DataReceivePointByValues_IVI_EPBRequst: accessed-variable=IVI_0x331.IVI_EPBRequst
              DataReceivePointByValues_IVI_TerrainMatchMode: accessed-variable=IVI_0x331.IVI_TerrainMatchMode
              DataReceivePointByValues_IVI_LPedalModeSW: accessed-variable=IVI_0x331.IVI_LPedalModeSW
              DataReceivePointByValues_IVI_AVHSw_X: accessed-variable=IVI_0x331.IVI_AVHSw_X
              DataReceivePointByValues_IVI_ESCSw_X: accessed-variable=IVI_0x331.IVI_ESCSw_X
              DataReceivePointByValues_IVI_HDCSw_X: accessed-variable=IVI_0x331.IVI_HDCSw_X
              DataReceivePointByValues_IVI_CSTSw_X: accessed-variable=IVI_0x331.IVI_CSTSw_X
              DataReceivePointByValues_IVI_AutoAllRoad: accessed-variable=IVI_0x331.IVI_AutoAllRoad
              DataReceivePointByValues_IVI_CampingMode_SW: accessed-variable=IVI_0x331.IVI_CampingMode_SW
              DataReceivePointByValues_IVI_BraPedMod: accessed-variable=IVI_0x331.IVI_BraPedMod
              DataReceivePointByValues_IVI_SlowspeedSmartCtrl: accessed-variable=IVI_0x331.IVI_SlowspeedSmartCtrl
              DataReceivePointByValues_IVI_TrailerModeCtrl: accessed-variable=IVI_0x331.IVI_TrailerModeCtrl
              DataReceivePointByValues_IVI_EscapeMode_SW: accessed-variable=IVI_0x331.IVI_EscapeMode_SW
              DataReceivePointByValues_IVI_PowerSavingModeReq: accessed-variable=IVI_0x331.IVI_PowerSavingModeReq
              DataReceivePointByValues_IVI_SelfAdaptionDriveSW: accessed-variable=IVI_0x331.IVI_SelfAdaptionDriveSW
              DataReceivePointByValues_IVI_CmpUTurnStartUI: accessed-variable=IVI_0x331.IVI_CmpUTurnStartUI
              DataReceivePointByValues_IVI_CmpUTurnLockWhlUI: accessed-variable=IVI_0x331.IVI_CmpUTurnLockWhlUI
              DataReceivePointByValues_IVI_CmpUTurnTarDirUI: accessed-variable=IVI_0x331.IVI_CmpUTurnTarDirUI
              DataReceivePointByValues_IVI_CmpUTurnTarAngleUI: accessed-variable=IVI_0x331.IVI_CmpUTurnTarAngleUI
              DataReceivePointByValues_IVI_CmpUTurnReq: accessed-variable=IVI_0x331.IVI_CmpUTurnReq
              DataReceivePointByValues_IVI_InventerLimitOdometerkm: accessed-variable=IVI_0x3D8.IVI_InventerLimitOdometerkm
              DataReceivePointByValues_IVI_FuelDetMode: accessed-variable=IVI_0x3D8.IVI_FuelDetMode
              DataReceivePointByValues_IVI_EngineIdlingMode: accessed-variable=IVI_0x3D8.IVI_EngineIdlingMode
              DataReceivePointByValues_IVI_CarWashMode: accessed-variable=IVI_0x3D8.IVI_CarWashMode
              DataReceivePointByValues_IVI_CampingModeSW: accessed-variable=IVI_0x3D8.IVI_CampingModeSW
              DataReceivePointByValues_IVI_SpeedLimitModeSW: accessed-variable=IVI_0x3D8.IVI_SpeedLimitModeSW
              DataReceivePointByValues_IVI_FuelupReq: accessed-variable=IVI_0x3D8.IVI_FuelupReq
              DataReceivePointByValues_IVI_FuelChgLevel: accessed-variable=IVI_0x3D8.IVI_FuelChgLevel
              DataReceivePointByValues_IVI_FuelChgMode: accessed-variable=IVI_0x3D8.IVI_FuelChgMode
              DataReceivePointByValues_IVI_InventerLimitOdometerkmVD: accessed-variable=IVI_0x3D8.IVI_InventerLimitOdometerkmVD
              DataReceivePointByValues_IVI_EMSRepairModeReq: accessed-variable=IVI_0x3D8.IVI_EMSRepairModeReq
              DataReceivePointByValues_IVI_ForceChgModeReq: accessed-variable=IVI_0x3D8.IVI_ForceChgModeReq
              DataReceivePointByValues_IVI_ForceChgTargetSOCVD: accessed-variable=IVI_0x3D8.IVI_ForceChgTargetSOCVD
              DataReceivePointByValues_IVI_SpeedLimitModeSpeed: accessed-variable=IVI_0x3D8.IVI_SpeedLimitModeSpeed
              DataReceivePointByValues_IVI_AWDModeSW: accessed-variable=IVI_0x3D8.IVI_AWDModeSW
              DataReceivePointByValues_IVI_ForceChgTargetSOC: accessed-variable=IVI_0x3D8.IVI_ForceChgTargetSOC
              DataReceivePointByValues_BCM_VCU_Authentication_Sts: accessed-variable=HPCBCM_0x292.BCM_VCU_Authentication_Sts
              DataReceivePointByValues_BCM_PTCLossMissErr: accessed-variable=HPCBCM_0x292.BCM_PTCLossMissErr
              DataReceivePointByValues_BCM_PTCRollCntErr: accessed-variable=HPCBCM_0x292.BCM_PTCRollCntErr
              DataReceivePointByValues_BCM_PTCChksumErr: accessed-variable=HPCBCM_0x292.BCM_PTCChksumErr
              DataReceivePointByValues_BCM_PDUHVIL_STs: accessed-variable=HPCBCM_0x292.BCM_PDUHVIL_STs
              DataReceivePointByValues_BCM_Cab220VHVIL_STs: accessed-variable=HPCBCM_0x292.BCM_Cab220VHVIL_STs
              DataReceivePointByValues_BCM_Cabin220VHVIL_STs: accessed-variable=HPCBCM_0x292.BCM_Cabin220VHVIL_STs
              DataReceivePointByValues_IBC_CRC_185: accessed-variable=IBC_0x185.IBC_CRC_185
              DataReceivePointByValues_IBC_RollingCounter_185: accessed-variable=IBC_0x185.IBC_RollingCounter_185
              DataReceivePointByValues_IBC_PlungerPressure: accessed-variable=IBC_0x185.IBC_PlungerPressure
              DataReceivePointByValues_IBC_PlungerPressure_Q: accessed-variable=IBC_0x185.IBC_PlungerPressure_Q
              DataReceivePointByValues_IBC_SimulatorPressure: accessed-variable=IBC_0x185.IBC_SimulatorPressure
              DataReceivePointByValues_IBC_SimulatorPressure_Q: accessed-variable=IBC_0x185.IBC_SimulatorPressure_Q
              DataReceivePointByValues_IBC_HMI_WarningOn: accessed-variable=IBC_0x185.IBC_HMI_WarningOn
              DataReceivePointByValues_IBC_MIL_WarningOn: accessed-variable=IBC_0x185.IBC_MIL_WarningOn
              DataReceivePointByValues_IBC_LongitAcceAct: accessed-variable=IBC_0x185.IBC_LongitAcceAct
              DataReceivePointByValues_IBC_LongitAcceActValid: accessed-variable=IBC_0x185.IBC_LongitAcceActValid
              DataReceivePointByValues_IBC_brakeFluidWarning: accessed-variable=IBC_0x185.IBC_brakeFluidWarning
              DataReceivePointByValues_IBC_SCM_Active: accessed-variable=IBC_0x185.IBC_SCM_Active
              DataReceivePointByValues_IBC_SCM_Failed: accessed-variable=IBC_0x185.IBC_SCM_Failed
              DataReceivePointByValues_IBC_CDPAvailable: accessed-variable=IBC_0x185.IBC_CDPAvailable
              DataReceivePointByValues_IBC_CDPIntervention: accessed-variable=IBC_0x185.IBC_CDPIntervention
              DataReceivePointByValues_IBC_AEB_active: accessed-variable=IBC_0x185.IBC_AEB_active
              DataReceivePointByValues_IBC_AEBdecAvailable: accessed-variable=IBC_0x185.IBC_AEBdecAvailable
              DataReceivePointByValues_IBC_AVHStatus: accessed-variable=IBC_0x185.IBC_AVHStatus
              DataReceivePointByValues_IBC_AVHAvailable: accessed-variable=IBC_0x185.IBC_AVHAvailable
              DataReceivePointByValues_IBC_HHCActive: accessed-variable=IBC_0x185.IBC_HHCActive
              DataReceivePointByValues_IBC_HHCFailed: accessed-variable=IBC_0x185.IBC_HHCFailed
              DataReceivePointByValues_IBC_CDD_Available_APA: accessed-variable=IBC_0x185.IBC_CDD_Available_APA
              DataReceivePointByValues_IBC_CDD_Active_APA: accessed-variable=IBC_0x185.IBC_CDD_Active_APA
              DataReceivePointByValues_IBC_CDD_Available_ACC: accessed-variable=IBC_0x185.IBC_CDD_Available_ACC
              DataReceivePointByValues_IBC_CDD_Active_ACC: accessed-variable=IBC_0x185.IBC_CDD_Active_ACC
              DataReceivePointByValues_IBC_HDCStatus: accessed-variable=IBC_0x185.IBC_HDCStatus
              DataReceivePointByValues_IBC_HDCAvailable: accessed-variable=IBC_0x185.IBC_HDCAvailable
              DataReceivePointByValues_IBC_CSTStatus: accessed-variable=IBC_0x185.IBC_CSTStatus
              DataReceivePointByValues_IBC_CSTAvailable: accessed-variable=IBC_0x185.IBC_CSTAvailable
              DataReceivePointByValues_IBC_VLC_Available_ACC: accessed-variable=IBC_0x185.IBC_VLC_Available_ACC
              DataReceivePointByValues_IBC_VLC_Active_ACC: accessed-variable=IBC_0x185.IBC_VLC_Active_ACC
              DataReceivePointByValues_IBC_VLC_Available_APA: accessed-variable=IBC_0x185.IBC_VLC_Available_APA
              DataReceivePointByValues_IBC_VLC_Active_APA: accessed-variable=IBC_0x185.IBC_VLC_Active_APA
              DataReceivePointByValues_IBC_VehicleHoldStatus: accessed-variable=IBC_0x185.IBC_VehicleHoldStatus
              DataReceivePointByValues_IBC_DrvrBrkTqAtWhlsReqd: accessed-variable=IBC_0x185.IBC_DrvrBrkTqAtWhlsReqd
              DataReceivePointByValues_TMS_RollingCounter_363: accessed-variable=TMS_0x363.TMS_RollingCounter_363
              DataReceivePointByValues_TMS_AC_Command: accessed-variable=TMS_0x363.TMS_AC_Command
              DataReceivePointByValues_TMS_PTCHeatingReq: accessed-variable=TMS_0x363.TMS_PTCHeatingReq
              DataReceivePointByValues_TMS_PTCPowerSet: accessed-variable=TMS_0x363.TMS_PTCPowerSet
              DataReceivePointByValues_TMS_OutsideTempVD: accessed-variable=TMS_0x363.TMS_OutsideTempVD
              DataReceivePointByValues_TMS_OutsideTemp_Corrected: accessed-variable=TMS_0x363.TMS_OutsideTemp_Corrected
              DataReceivePointByValues_BMS_SOC_Real: accessed-variable=BMS_0x5B1.BMS_SOC_Real
              DataReceivePointByValues_BMS_MODE_t: accessed-variable=BMS_0x5B1.BMS_MODE_t
              DataReceivePointByValues_BMS_VoltLoDeratLevel_NA: accessed-variable=BMS_0x5B1.BMS_VoltLoDeratLevel_NA
              DataReceivePointByValues_BMS_VoltHiDeratLevel_NA: accessed-variable=BMS_0x5B1.BMS_VoltHiDeratLevel_NA
              DataReceivePointByValues_TMS_MCUOutTemp: accessed-variable=TMS_0x561.TMS_MCUOutTemp
              DataReceivePointByValues_TMS_MCUMIntelTemp: accessed-variable=TMS_0x561.TMS_MCUMIntelTemp
              DataReceivePointByValues_TMS_MCUSIntelTemp: accessed-variable=TMS_0x561.TMS_MCUSIntelTemp
              DataReceivePointByValues_BCM_VCU_Authentication_Challenge_A{0..3}: accessed-variable=HPCBCM_0x1E4.BCM_VCU_Authentication_Challenge_A{0..3}
              DataReceivePointByValues_ECM_EngineWorktime: accessed-variable=ECM_0x5EC.ECM_EngineWorktime
              DataReceivePointByValues_ECM_FuelConsumption: accessed-variable=ECM_0x147.ECM_FuelConsumption
              DataReceivePointByValues_IBC_CRC_182: accessed-variable=IBC_0x182.IBC_CRC_182
              DataReceivePointByValues_IBC_RollingCounter_182: accessed-variable=IBC_0x182.IBC_RollingCounter_182
              DataReceivePointByValues_IBC_VehicleSpeed: accessed-variable=IBC_0x182.IBC_VehicleSpeed
              DataReceivePointByValues_IBC_VehicleSpeedVD: accessed-variable=IBC_0x182.IBC_VehicleSpeedVD
              DataReceivePointByValues_IBC_ABSActive: accessed-variable=IBC_0x182.IBC_ABSActive
              DataReceivePointByValues_IBC_ABSFailed: accessed-variable=IBC_0x182.IBC_ABSFailed
              DataReceivePointByValues_IBC_TCSActive: accessed-variable=IBC_0x182.IBC_TCSActive
              DataReceivePointByValues_IBC_TCSFailed: accessed-variable=IBC_0x182.IBC_TCSFailed
              DataReceivePointByValues_IBC_ESCFunctionStatus: accessed-variable=IBC_0x182.IBC_ESCFunctionStatus
              DataReceivePointByValues_IBC_BrakeForce: accessed-variable=IBC_0x182.IBC_BrakeForce
              DataReceivePointByValues_IBC_Vehiclestandstill: accessed-variable=IBC_0x182.IBC_Vehiclestandstill
              DataReceivePointByValues_IBC_EBDFailed: accessed-variable=IBC_0x182.IBC_EBDFailed
              DataReceivePointByValues_IBC_EBDActive: accessed-variable=IBC_0x182.IBC_EBDActive
              DataReceivePointByValues_IBC_VDCActive: accessed-variable=IBC_0x182.IBC_VDCActive
              DataReceivePointByValues_IBC_VDCFailed: accessed-variable=IBC_0x182.IBC_VDCFailed
              DataReceivePointByValues_IBC_EDCActive: accessed-variable=IBC_0x182.IBC_EDCActive
              DataReceivePointByValues_IBC_EDCFailed: accessed-variable=IBC_0x182.IBC_EDCFailed
              DataReceivePointByValues_IBC_SystemInitializeStatus: accessed-variable=IBC_0x182.IBC_SystemInitializeStatus
              DataReceivePointByValues_IBC_BTCSActive: accessed-variable=IBC_0x182.IBC_BTCSActive
              DataReceivePointByValues_IBC_ETCSActive: accessed-variable=IBC_0x182.IBC_ETCSActive
              DataReceivePointByValues_IBC_ARPActive: accessed-variable=IBC_0x182.IBC_ARPActive
              DataReceivePointByValues_IBC_VCU_DrumMode: accessed-variable=IBC_0x182.IBC_VCU_DrumMode
              DataReceivePointByValues_IBC_EscapeModeSts: accessed-variable=IBC_0x182.IBC_EscapeModeSts
              DataReceivePointByValues_IBC_TSAActive: accessed-variable=IBC_0x182.IBC_TSAActive
              DataReceivePointByValues_IBC_TSAStatus: accessed-variable=IBC_0x182.IBC_TSAStatus
              DataReceivePointByValues_ICU_CRC_24D: accessed-variable=ICU_0x24D.ICU_CRC_24D
              DataReceivePointByValues_ICU_SpeedConversionCoefficient: accessed-variable=ICU_0x24D.ICU_SpeedConversionCoefficient
              DataReceivePointByValues_ICU_RollingCounter_24D: accessed-variable=ICU_0x24D.ICU_RollingCounter_24D
              DataReceivePointByValues_ICU_CCSFunctionStatus: accessed-variable=ICU_0x24D.ICU_CCSFunctionStatus
              DataReceivePointByValues_ICU_CruiseVehicleSpeedCtl: accessed-variable=ICU_0x24D.ICU_CruiseVehicleSpeedCtl
              DataReceivePointByValues_ICU_VehicleScreenSpeed: accessed-variable=ICU_0x24D.ICU_VehicleScreenSpeed
              DataReceivePointByValues_ICU_VehicleSpeedUnit: accessed-variable=ICU_0x24D.ICU_VehicleSpeedUnit
              DataReceivePointByValues_ICU_ACCFunctionStatus: accessed-variable=ICU_0x24D.ICU_ACCFunctionStatus
              DataReceivePointByValues_ICU_LCCFunctionStatus: accessed-variable=ICU_0x24D.ICU_LCCFunctionStatus
              DataReceivePointByValues_IVI_LPedalMode: accessed-variable=ICU_0x24D.IVI_LPedalMode
              DataReceivePointByValues_ICU_TotalOilmeterkm: accessed-variable=ICU_0x249.ICU_TotalOilmeterkm
              DataReceivePointByValues_ICU_CLTCoilMileage: accessed-variable=ICU_0x249.ICU_CLTCoilMileage
              DataReceivePointByValues_ICU_WLTC_oilMileage: accessed-variable=ICU_0x249.ICU_WLTC_oilMileage
              DataReceivePointByValues_ICU_CLTC_ElectticityMileage: accessed-variable=ICU_0x249.ICU_CLTC_ElectticityMileage
              DataReceivePointByValues_ICU_WLTC_ElectticityMileage: accessed-variable=ICU_0x249.ICU_WLTC_ElectticityMileage
              DataReceivePointByValues_ICU_Switch_CLTCOrWLTC: accessed-variable=ICU_0x249.ICU_Switch_CLTCOrWLTC
              DataReceivePointByValues_ICU_FuelPercent: accessed-variable=ICU_0x249.ICU_FuelPercent
              DataReceivePointByValues_ACU_CRC_233: accessed-variable=ACU_0x233.ACU_CRC_233
              DataReceivePointByValues_ACU_RollingCounter_233: accessed-variable=ACU_0x233.ACU_RollingCounter_233
              DataReceivePointByValues_ACU_LateralAcce: accessed-variable=ACU_0x233.ACU_LateralAcce
              DataReceivePointByValues_ACU_LongitAcce: accessed-variable=ACU_0x233.ACU_LongitAcce
              DataReceivePointByValues_ACU_LateralAcceValid: accessed-variable=ACU_0x233.ACU_LateralAcceValid
              DataReceivePointByValues_ACU_LongitAcceValid: accessed-variable=ACU_0x233.ACU_LongitAcceValid
              DataReceivePointByValues_ACU_SensorCalSt: accessed-variable=ACU_0x233.ACU_SensorCalSt
              DataReceivePointByValues_ACU_YawRate: accessed-variable=ACU_0x233.ACU_YawRate
              DataReceivePointByValues_ACU_YawRateValid: accessed-variable=ACU_0x233.ACU_YawRateValid
              DataReceivePointByValues_BMS_CRC_1A1: accessed-variable=BMS_0x1A1.BMS_CRC_1A1
              DataReceivePointByValues_BMS_RollingCounter_1A1: accessed-variable=BMS_0x1A1.BMS_RollingCounter_1A1
              DataReceivePointByValues_BMS_Warning_Level: accessed-variable=BMS_0x1A1.BMS_Warning_Level
              DataReceivePointByValues_BMS_SelfCheck: accessed-variable=BMS_0x1A1.BMS_SelfCheck
              DataReceivePointByValues_BMS_BattChargerSts: accessed-variable=BMS_0x1A1.BMS_BattChargerSts
              DataReceivePointByValues_BMS_RHighVolSts: accessed-variable=BMS_0x1A1.BMS_RHighVolSts
              DataReceivePointByValues_BMS_RPreChargeRelayFB: accessed-variable=BMS_0x1A1.BMS_RPreChargeRelayFB
              DataReceivePointByValues_BMS_RPositiveRelayFB: accessed-variable=BMS_0x1A1.BMS_RPositiveRelayFB
              DataReceivePointByValues_BMS_RNegativeRelayFB: accessed-variable=BMS_0x1A1.BMS_RNegativeRelayFB
              DataReceivePointByValues_BMS_RPositiveRelay_F: accessed-variable=BMS_0x1A1.BMS_RPositiveRelay_F
              DataReceivePointByValues_BMS_RNegativeRelay_F: accessed-variable=BMS_0x1A1.BMS_RNegativeRelay_F
              DataReceivePointByValues_BMS_RPreChargeFinishSts: accessed-variable=BMS_0x1A1.BMS_RPreChargeFinishSts
              DataReceivePointByValues_BMS_MCUMHVILSts: accessed-variable=BMS_0x1A1.BMS_MCUMHVILSts
              DataReceivePointByValues_BMS_ACPTCHVILSts: accessed-variable=BMS_0x1A1.BMS_ACPTCHVILSts
              DataReceivePointByValues_BMS_PTCHVILSts: accessed-variable=BMS_0x1A1.BMS_PTCHVILSts
              DataReceivePointByValues_BMS_CCMHVILSts: accessed-variable=BMS_0x1A1.BMS_CCMHVILSts
              DataReceivePointByValues_BMS_CDUHVILSts: accessed-variable=BMS_0x1A1.BMS_CDUHVILSts
              DataReceivePointByValues_BMS_DCChgHVILSts: accessed-variable=BMS_0x1A1.BMS_DCChgHVILSts
              DataReceivePointByValues_BMS_MCUSHVILSts: accessed-variable=BMS_0x1A1.BMS_MCUSHVILSts
              DataReceivePointByValues_BMS_HVOffSts: accessed-variable=BMS_0x1A1.BMS_HVOffSts
              DataReceivePointByValues_BMS_SeriousWarning_Level: accessed-variable=BMS_0x1A1.BMS_SeriousWarning_Level
              DataReceivePointByValues_BMS_DCChgRelayCloseReq: accessed-variable=BMS_0x1A1.BMS_DCChgRelayCloseReq
              DataReceivePointByValues_BMS_DCChgRelayFB: accessed-variable=BMS_0x1A1.BMS_DCChgRelayFB
              DataReceivePointByValues_BMS_ChgStopReason: accessed-variable=BMS_0x1A1.BMS_ChgStopReason
              DataReceivePointByValues_BMS_GCUHVILSts: accessed-variable=BMS_0x1A1.BMS_GCUHVILSts
              DataReceivePointByValues_BMS_MILlampReq: accessed-variable=BMS_0x1A1.BMS_MILlampReq
              DataReceivePointByValues_BMS_IsoRessistanceSts: accessed-variable=BMS_0x1A1.BMS_IsoRessistanceSts
              DataReceivePointByValues_BMS_Integrity_Check: accessed-variable=BMS_0x1A1.BMS_Integrity_Check
              DataReceivePointByValues_BMS_BattVolt: accessed-variable=BMS_0x1A1.BMS_BattVolt
              DataReceivePointByValues_BMS_BattCurr: accessed-variable=BMS_0x1A1.BMS_BattCurr
              DataReceivePointByValues_BMS_BatDyn_Dchgpwr: accessed-variable=BMS_0x1A1.BMS_BatDyn_Dchgpwr
              DataReceivePointByValues_BMS_BatDyn_Chgpwr: accessed-variable=BMS_0x1A1.BMS_BatDyn_Chgpwr
              DataReceivePointByValues_BMS_Precharge_CoolingSts: accessed-variable=BMS_0x1A1.BMS_Precharge_CoolingSts
              DataReceivePointByValues_IBC_CRC_B1: accessed-variable=IBC_0xB1.IBC_CRC_B1
              DataReceivePointByValues_IBC_RollingCounter_B1: accessed-variable=IBC_0xB1.IBC_RollingCounter_B1
              DataReceivePointByValues_IBC_EngTorqDec_Main: accessed-variable=IBC_0xB1.IBC_EngTorqDec_Main
              DataReceivePointByValues_IBC_EngTorqDecActive_Main: accessed-variable=IBC_0xB1.IBC_EngTorqDecActive_Main
              DataReceivePointByValues_IBC_EngTorqInc_Main: accessed-variable=IBC_0xB1.IBC_EngTorqInc_Main
              DataReceivePointByValues_IBC_EngTorqIncActive_Main: accessed-variable=IBC_0xB1.IBC_EngTorqIncActive_Main
              DataReceivePointByValues_IBC_EngTorqDec_Sub: accessed-variable=IBC_0xB1.IBC_EngTorqDec_Sub
              DataReceivePointByValues_IBC_EngTorqDecActive_Sub: accessed-variable=IBC_0xB1.IBC_EngTorqDecActive_Sub
              DataReceivePointByValues_IBC_EngTorqInc_Sub: accessed-variable=IBC_0xB1.IBC_EngTorqInc_Sub
              DataReceivePointByValues_IBC_EngTorqIncActive_Sub: accessed-variable=IBC_0xB1.IBC_EngTorqIncActive_Sub
              DataReceivePointByValues_IBC_EngTorqDec_MainR: accessed-variable=IBC_0xB1.IBC_EngTorqDec_MainR
              DataReceivePointByValues_IBC_EngTorqDecActive_MainR: accessed-variable=IBC_0xB1.IBC_EngTorqDecActive_MainR
              DataReceivePointByValues_IBC_EngTorqInc_MainR: accessed-variable=IBC_0xB1.IBC_EngTorqInc_MainR
              DataReceivePointByValues_IBC_EngTorqIncActive_MainR: accessed-variable=IBC_0xB1.IBC_EngTorqIncActive_MainR
              DataReceivePointByValues_ADDC_CRC_83: accessed-variable=ADDC_0x83.ADDC_CRC_83
              DataReceivePointByValues_ADDC_ACC_AVHReq: accessed-variable=ADDC_0x83.ADDC_ACC_AVHReq
              DataReceivePointByValues_ADDC_ACC_HoldSts: accessed-variable=ADDC_0x83.ADDC_ACC_HoldSts
              DataReceivePointByValues_ADDC_ACCTargetTrq: accessed-variable=ADDC_0x83.ADDC_ACCTargetTrq
              DataReceivePointByValues_ADDC_ACCTargetTrqVD: accessed-variable=ADDC_0x83.ADDC_ACCTargetTrqVD
              DataReceivePointByValues_ADDC_ACCTargetTrqBrkVD: accessed-variable=ADDC_0x83.ADDC_ACCTargetTrqBrkVD
              DataReceivePointByValues_ADDC_ACCTargetTrqBrk: accessed-variable=ADDC_0x83.ADDC_ACCTargetTrqBrk
              DataReceivePointByValues_ADDC_MAIWarnTrqCtrlFlg: accessed-variable=ADDC_0x83.ADDC_MAIWarnTrqCtrlFlg
              DataReceivePointByValues_ADDC_RollingCounter_83: accessed-variable=ADDC_0x83.ADDC_RollingCounter_83
              DataReceivePointByValues_ADDC_ACC_FunType: accessed-variable=ADDC_0x83.ADDC_ACC_FunType
              DataReceivePointByValues_ADDC_ACCMode: accessed-variable=ADDC_0x83.ADDC_ACCMode
              DataReceivePointByValues_ADDC_Driveoff_Request: accessed-variable=ADDC_0x83.ADDC_Driveoff_Request
              DataReceivePointByValues_ADDC_DecToStop: accessed-variable=ADDC_0x83.ADDC_DecToStop
              DataReceivePointByValues_ADDC_ACCAvailable: accessed-variable=ADDC_0x83.ADDC_ACCAvailable
              DataReceivePointByValues_ADDC_ACCTargetAcc: accessed-variable=ADDC_0x83.ADDC_ACCTargetAcc
              DataReceivePointByValues_ADDC_ACCTargetAccVD: accessed-variable=ADDC_0x83.ADDC_ACCTargetAccVD
              DataReceivePointByValues_ADDC_ACC_RecordingPulse: accessed-variable=ADDC_0x83.ADDC_ACC_RecordingPulse
              DataReceivePointByValues_ADDC_VehicleSpeedCtlVD: accessed-variable=ADDC_0x83.ADDC_VehicleSpeedCtlVD
              DataReceivePointByValues_ADDC_VehicleSpeedCtl: accessed-variable=ADDC_0x83.ADDC_VehicleSpeedCtl
              DataReceivePointByValues_ADDC_ACC_EPBReq: accessed-variable=ADDC_0x83.ADDC_ACC_EPBReq
              DataReceivePointByValues_ADDC_ACC_VehicleDirectCtl: accessed-variable=ADDC_0x83.ADDC_ACC_VehicleDirectCtl
              DataReceivePointByValues_ADDC_ACC_VehicleDirectCtlVD: accessed-variable=ADDC_0x83.ADDC_ACC_VehicleDirectCtlVD
              DataReceivePointByValues_ADDC_AEBTargetDec: accessed-variable=ADDC_0x83.ADDC_AEBTargetDec
              DataReceivePointByValues_ADDC_AEBDecCtrl: accessed-variable=ADDC_0x83.ADDC_AEBDecCtrl
              DataReceivePointByValues_ADDC_AEBMode: accessed-variable=ADDC_0x83.ADDC_AEBMode
              DataReceivePointByValues_ADDC_AEBAvailable: accessed-variable=ADDC_0x83.ADDC_AEBAvailable
              DataReceivePointByValues_ADDC_ACC_VLCCtlReq: accessed-variable=ADDC_0x83.ADDC_ACC_VLCCtlReq
              DataReceivePointByValues_ADDC_ACC_OvrdSts: accessed-variable=ADDC_0x83.ADDC_ACC_OvrdSts
              DataReceivePointByValues_ADDC_RCTB_DecReq: accessed-variable=ADDC_0x83.ADDC_RCTB_DecReq
              DataReceivePointByValues_ADDC_RAEB_DecReq: accessed-variable=ADDC_0x83.ADDC_RAEB_DecReq
              DataReceivePointByValues_ADDC_MEB_DecReq: accessed-variable=ADDC_0x83.ADDC_MEB_DecReq
              DataReceivePointByValues_BMS_InverterPower: accessed-variable=BMS_0x310.BMS_InverterPower
              DataReceivePointByValues_BMS_MaxChargeVolt: accessed-variable=BMS_0x310.BMS_MaxChargeVolt
              DataReceivePointByValues_BMS_MaxChargeCurr: accessed-variable=BMS_0x310.BMS_MaxChargeCurr
              DataReceivePointByValues_BMS_OBCWorkModeCtrl: accessed-variable=BMS_0x310.BMS_OBCWorkModeCtrl
              DataReceivePointByValues_BMS_MaxPower: accessed-variable=BMS_0x310.BMS_MaxPower
              DataReceivePointByValues_BMS_ChargerACInput: accessed-variable=BMS_0x310.BMS_ChargerACInput
              DataReceivePointByValues_BMS_ChargerDCInput: accessed-variable=BMS_0x310.BMS_ChargerDCInput
              DataReceivePointByValues_BMS_ChargeRequest: accessed-variable=BMS_0x310.BMS_ChargeRequest
              DataReceivePointByValues_BMS_InverterRequest: accessed-variable=BMS_0x310.BMS_InverterRequest
              DataReceivePointByValues_BMS_ChargeQuantity: accessed-variable=BMS_0x310.BMS_ChargeQuantity
              DataReceivePointByValues_BMS_BattMaxTemp: accessed-variable=BMS_0x310.BMS_BattMaxTemp
              DataReceivePointByValues_BMS_BattMinTemp: accessed-variable=BMS_0x310.BMS_BattMinTemp
              DataReceivePointByValues_BMS_BattIntakeTemp: accessed-variable=BMS_0x310.BMS_BattIntakeTemp
              DataReceivePointByValues_BMS_BattIOutletTemp: accessed-variable=BMS_0x310.BMS_BattIOutletTemp
              DataReceivePointByValues_BMS_BattSOC_Display: accessed-variable=BMS_0x310.BMS_BattSOC_Display
              DataReceivePointByValues_BMS_Req_Cab220VInverter_Sts: accessed-variable=BMS_0x310.BMS_Req_Cab220VInverter_Sts
              DataReceivePointByValues_BMS_Req_Cabin220VInverter_Sts: accessed-variable=BMS_0x310.BMS_Req_Cabin220VInverter_Sts
              DataReceivePointByValues_BMS_RemainEnergy: accessed-variable=BMS_0x310.BMS_RemainEnergy
              DataReceivePointByValues_BMS_StateOfEngeryMax: accessed-variable=BMS_0x310.BMS_StateOfEngeryMax
              DataReceivePointByValues_BMS_ThermalManageRequest: accessed-variable=BMS_0x310.BMS_ThermalManageRequest
              DataReceivePointByValues_BMS_PreHeatingState: accessed-variable=BMS_0x310.BMS_PreHeatingState
              DataReceivePointByValues_GCU_SWVersionC: accessed-variable=GCU_0x2C1.GCU_SWVersionC
              DataReceivePointByValues_GCU_SWVersionB: accessed-variable=GCU_0x2C1.GCU_SWVersionB
              DataReceivePointByValues_GCU_SWVersionA: accessed-variable=GCU_0x2C1.GCU_SWVersionA
              DataReceivePointByValues_BCM_CRC_291: accessed-variable=HPCBCM_0x291.BCM_CRC_291
              DataReceivePointByValues_BCM_ShutdownMode: accessed-variable=HPCBCM_0x291.BCM_ShutdownMode
              DataReceivePointByValues_BCM_NM_PNC_ON_1ADr_Sts: accessed-variable=HPCBCM_0x291.BCM_NM_PNC_ON_1ADr_Sts
              DataReceivePointByValues_BCM_RollingCounter_291: accessed-variable=HPCBCM_0x291.BCM_RollingCounter_291
              DataReceivePointByValues_BCM_KeyPosition_ON2A: accessed-variable=HPCBCM_0x291.BCM_KeyPosition_ON2A
              DataReceivePointByValues_BCM_CcmHvilSts_ID291: accessed-variable=HPCBCM_0x291.BCM_CcmHvilSts_ID291
              DataReceivePointByValues_BCM_DriverDoorSts: accessed-variable=HPCBCM_0x291.BCM_DriverDoorSts
              DataReceivePointByValues_BCM_FLDoorSts: accessed-variable=HPCBCM_0x291.BCM_FLDoorSts
              DataReceivePointByValues_BCM_FRDoorSts: accessed-variable=HPCBCM_0x291.BCM_FRDoorSts
              DataReceivePointByValues_BCM_RLDoorSts: accessed-variable=HPCBCM_0x291.BCM_RLDoorSts
              DataReceivePointByValues_BCM_RRDoorSts: accessed-variable=HPCBCM_0x291.BCM_RRDoorSts
              DataReceivePointByValues_BCM_BackDoorSts: accessed-variable=HPCBCM_0x291.BCM_BackDoorSts
              DataReceivePointByValues_BCM_ON2BRelaySts: accessed-variable=HPCBCM_0x291.BCM_ON2BRelaySts
              DataReceivePointByValues_BCM_ON2CRelaySts: accessed-variable=HPCBCM_0x291.BCM_ON2CRelaySts
              DataReceivePointByValues_BCM_ON2InitiativeSts: accessed-variable=HPCBCM_0x291.BCM_ON2InitiativeSts
              DataReceivePointByValues_BCM_VehicleRepairMode: accessed-variable=HPCBCM_0x291.BCM_VehicleRepairMode
              DataReceivePointByValues_BCM_VehlockCtrl: accessed-variable=HPCBCM_0x291.BCM_VehlockCtrl
              DataReceivePointByValues_BCM_VehLockSts: accessed-variable=HPCBCM_0x291.BCM_VehLockSts
              DataReceivePointByValues_BCM_FuelTankLockReq: accessed-variable=HPCBCM_0x291.BCM_FuelTankLockReq
              DataReceivePointByValues_BCM_ACChgLockCtrl: accessed-variable=HPCBCM_0x291.BCM_ACChgLockCtrl
              DataReceivePointByValues_BCM_ChargeLockCtrl: accessed-variable=HPCBCM_0x291.BCM_ChargeLockCtrl
              DataReceivePointByValues_BCM_DCChrgPwr_Sts_ID291: accessed-variable=HPCBCM_0x291.BCM_DCChrgPwr_Sts_ID291
              DataReceivePointByValues_BCM_ACChrgPwr_Sts_ID291: accessed-variable=HPCBCM_0x291.BCM_ACChrgPwr_Sts_ID291
              DataReceivePointByValues_BCM_DCChrgPwr_Volt_ID291: accessed-variable=HPCBCM_0x291.BCM_DCChrgPwr_Volt_ID291
              DataReceivePointByValues_BCM_ACChrgPwr_Volt_ID291: accessed-variable=HPCBCM_0x291.BCM_ACChrgPwr_Volt_ID291
              DataReceivePointByValues_BCM_KeyPosition_ON2B: accessed-variable=HPCBCM_0x291.BCM_KeyPosition_ON2B
              DataReceivePointByValues_BCM_NM_PNC_ON_3Ch_Sts: accessed-variable=HPCBCM_0x291.BCM_NM_PNC_ON_3Ch_Sts
              DataReceivePointByValues_BCM_HighVoltageReq: accessed-variable=HPCBCM_0x291.BCM_HighVoltageReq
              DataReceivePointByValues_ACU_CRC_2A3: accessed-variable=ACU_0x2A3.ACU_CRC_2A3
              DataReceivePointByValues_ACU_Trigger: accessed-variable=ACU_0x2A3.ACU_Trigger
              DataReceivePointByValues_ACU_RollingCounter_2A3: accessed-variable=ACU_0x2A3.ACU_RollingCounter_2A3
              DataReceivePointByValues_ACU_TotalCrashOutputSts: accessed-variable=ACU_0x2A3.ACU_TotalCrashOutputSts
              DataReceivePointByValues_ACU_SelfCheckSt: accessed-variable=ACU_0x2A3.ACU_SelfCheckSt
              DataReceivePointByValues_ACU_FLSeatBeltRSt: accessed-variable=ACU_0x2A3.ACU_FLSeatBeltRSt
              DataReceivePointByValues_ACU_FRSeatBeltRSt: accessed-variable=ACU_0x2A3.ACU_FRSeatBeltRSt
              DataReceivePointByValues_IVI_DeliveryModeReq: accessed-variable=IVI_0x34A.IVI_DeliveryModeReq
              DataReceivePointByValues_IVI_ShowCarModeReq: accessed-variable=IVI_0x34A.IVI_ShowCarModeReq
              DRPA_LMC_SysSt_0: accessed-variable=LMC_0xFA.LMC_SysSt
              DRPA_LMC_HSPC_ActiveSt_0: accessed-variable=LMC_0xFA.LMC_HSPC_ActiveSt
              DRPA_LMC_FTSC_ActiveSt_0: accessed-variable=LMC_0xFA.LMC_FTSC_ActiveSt
              DRPA_LMC_SDRM_ActiveSt_0: accessed-variable=LMC_0xFA.LMC_SDRM_ActiveSt
              DRPA_LMC_NSPC_ActiveSt_0: accessed-variable=LMC_0xFA.LMC_NSPC_ActiveSt
              DRPA_LMC_EAF_ActiveSt_0: accessed-variable=LMC_0xFA.LMC_EAF_ActiveSt
              DRPA_LMC_SelfCheckSt_0: accessed-variable=LMC_0xFA.LMC_SelfCheckSt
              DRPA_LMC_WBDC_ActiveSt_0: accessed-variable=LMC_0xFA.LMC_WBDC_ActiveSt
              DRPA_LMC_LSFCActiveSt_0: accessed-variable=LMC_0xFA.LMC_LSFCActiveSt
              DRPA_LMC_EngTorqDec_Main_R: accessed-variable=LMC_0xFA.LMC_EngTorqDec_Main_R
              DRPA_LMC_EngTorqDecActive_Main_R: accessed-variable=LMC_0xFA.LMC_EngTorqDecActive_Main_R
              DRPA_LMC_EngTorqInc_Main_R: accessed-variable=LMC_0xFA.LMC_EngTorqInc_Main_R
              DRPA_LMC_EngTorqIncActive_Main_R: accessed-variable=LMC_0xFA.LMC_EngTorqIncActive_Main_R
              DRPA_ECM_ClearingSparkcarbonedRequest_0: accessed-variable=EMS_0xBE.ECM_ClearingSparkcarbonedRequest
              DRPA_ICU_CRC_DF_0: accessed-variable=ICU_0xDF.ICU_CRC_DF
              DRPA_ICU_RollingCounter_DF_0: accessed-variable=ICU_0xDF.ICU_RollingCounter_DF
              DRPA_ICU_IMU_ACC_x_0: accessed-variable=ICU_0xDF.ICU_IMU_ACC_x
              DRPA_ICU_IMU_ACC_y_0: accessed-variable=ICU_0xDF.ICU_IMU_ACC_y
              DRPA_ICU_IMU_ACC_z_0: accessed-variable=ICU_0xDF.ICU_IMU_ACC_z
              DRPA_ICU_IMU_ACC_Roll_Rate_0: accessed-variable=ICU_0xDF.ICU_IMU_ACC_Roll_Rate
              DRPA_ICU_IMU_ACC_Pitch_Rate_0: accessed-variable=ICU_0xDF.ICU_IMU_ACC_Pitch_Rate
              DRPA_ICU_IMU_ACC_Yaw_Rate_0: accessed-variable=ICU_0xDF.ICU_IMU_ACC_Yaw_Rate
              DRPA_ICU_IMU_Calibrated_0: accessed-variable=ICU_0xDF.ICU_IMU_Calibrated
              DRPA_ICU_IMU_Valid_0: accessed-variable=ICU_0xDF.ICU_IMU_Valid
              DRPA_TMS_RAPTC_ModOprtgStsFrt_0: accessed-variable=TMS_0x362.TMS_RAPTC_ModOprtgStsFrt
              DRPA_TMS_RAPTC_ModOpEnblCmd_0: accessed-variable=TMS_0x362.TMS_RAPTC_ModOpEnblCmd
              DRPA_TMS_RAPTC_MsrdPwrFrt_0: accessed-variable=TMS_0x362.TMS_RAPTC_MsrdPwrFrt
              DRPA_ACU_IMU_CRC_15_0: accessed-variable=ACU_0x15.ACU_IMU_CRC_15
              DRPA_ACU_IMU_RollingCounter_15_0: accessed-variable=ACU_0x15.ACU_IMU_RollingCounter_15
              DRPA_ACU_IMU_ACC_x_0: accessed-variable=ACU_0x15.ACU_IMU_ACC_x
              DRPA_ACU_IMU_ACC_y_0: accessed-variable=ACU_0x15.ACU_IMU_ACC_y
              DRPA_ACU_IMU_ACC_z_0: accessed-variable=ACU_0x15.ACU_IMU_ACC_z
              DRPA_ACU_IMU_Roll_Rate_0: accessed-variable=ACU_0x15.ACU_IMU_Roll_Rate
              DRPA_ACU_IMU_Pitch_Rate_0: accessed-variable=ACU_0x15.ACU_IMU_Pitch_Rate
              DRPA_ACU_IMU_Yaw_Rate_0: accessed-variable=ACU_0x15.ACU_IMU_Yaw_Rate
              DRPA_ACU_IMU_Calibrated_0: accessed-variable=ACU_0x15.ACU_IMU_Calibrated
              DRPA_ACU_IMU_Valid_0: accessed-variable=ACU_0x15.ACU_IMU_Valid
              DRPA_ACU_IMU_Fault_Status_0: accessed-variable=ACU_0x15.ACU_IMU_Fault_Status
              DRPA_ACU_IMU_MessageStatus_0: accessed-variable=ACU_0x15.ACU_IMU_MessageStatus
              DRPA_ACU_IMU_FunctionSafetyStatus_0: accessed-variable=ACU_0x15.ACU_IMU_FunctionSafetyStatus
              DRPA_ACU_IMU_Temperature_0: accessed-variable=ACU_0x15.ACU_IMU_Temperature
              DRPA_BCM_CRC_DA_0: accessed-variable=HPCBCM_0xDA.BCM_CRC_DA
              DRPA_BCM_RollingCounter_DA_0: accessed-variable=HPCBCM_0xDA.BCM_RollingCounter_DA
              DRPA_BCM_IMU_ACC_x_0: accessed-variable=HPCBCM_0xDA.BCM_IMU_ACC_x
              DRPA_BCM_IMU_ACC_y_0: accessed-variable=HPCBCM_0xDA.BCM_IMU_ACC_y
              DRPA_BCM_IMU_ACC_z_0: accessed-variable=HPCBCM_0xDA.BCM_IMU_ACC_z
              DRPA_BCM_IMU_ACC_Roll_Rate_0: accessed-variable=HPCBCM_0xDA.BCM_IMU_ACC_Roll_Rate
              DRPA_BCM_IMU_ACC_Pitch_Rate_0: accessed-variable=HPCBCM_0xDA.BCM_IMU_ACC_Pitch_Rate
              DRPA_BCM_IMU_ACC_Yaw_Rate_0: accessed-variable=HPCBCM_0xDA.BCM_IMU_ACC_Yaw_Rate
              DRPA_BCM_IMU_Valid_0: accessed-variable=HPCBCM_0xDA.BCM_IMU_Valid
              DRPA_LMC_CRC_133_0: accessed-variable=LMC_0x133.LMC_CRC_133
              DRPA_LMC_DrvReqTorque_0: accessed-variable=LMC_0x133.LMC_DrvReqTorque
              DRPA_LMC_RollingCounter_133_0: accessed-variable=LMC_0x133.LMC_RollingCounter_133
              DRPA_LMC_CRC_25A_0: accessed-variable=LMCSSU_0x25A.LMC_CRC_25A
              DRPA_LMC_ECAS_DriveModeFb_0: accessed-variable=LMCSSU_0x25A.LMC_ECAS_DriveModeFb
              DRPA_LMC_CDC_DriveModeFb_0: accessed-variable=LMCSSU_0x25A.LMC_CDC_DriveModeFb
              DRPA_LMC_RollingCounter_25A_0: accessed-variable=LMCSSU_0x25A.LMC_RollingCounter_25A
              DRPA_BCM_CRC_4A_0: accessed-variable=HPCBCM_0x4A.BCM_CRC_4A
              DRPA_BCM_IBCLimphomeSts_0: accessed-variable=HPCBCM_0x4A.BCM_IBCLimphomeSts
              DRPA_BCM_EOLAutomaticActiveSts_C_0: accessed-variable=HPCBCM_0x4A.BCM_EOLAutomaticActiveSts_C
              DRPA_BCM_TorqueLimte_0: accessed-variable=HPCBCM_0x4A.BCM_TorqueLimte
              DRPA_BCM_RollingCounter_4A_0: accessed-variable=HPCBCM_0x4A.BCM_RollingCounter_4A
              DRPA_ICU_RollingCounter_5BE_0: accessed-variable=ICU_0x5BE.ICU_RollingCounter_5BE
              DRPA_ICU_Imu_Cal_Staus_0: accessed-variable=ICU_0x5BE.ICU_Imu_Cal_Staus
              DRPA_ICU_Imu_Cal_Gyro_0: accessed-variable=ICU_0x5BE.ICU_Imu_Cal_Gyro
              DRPA_ICU_Imu_Cal_Pitch_0: accessed-variable=ICU_0x5BE.ICU_Imu_Cal_Pitch
              DRPA_ICU_Imu_Cal_Roll_0: accessed-variable=ICU_0x5BE.ICU_Imu_Cal_Roll
          data-send-points:
            1096 x access:
              DataSendPoints_MCUM_CRC_135: accessed-variable=MCUM_0x135.MCUM_CRC_135
              DataSendPoints_MCUM_RollingCounter_135: accessed-variable=MCUM_0x135.MCUM_RollingCounter_135
              DataSendPoints_MCUM_LDC_SWInfo: accessed-variable=MCUM_0x135.MCUM_LDC_SWInfo
              DataSendPoints_MCUM_LDC_MTarOut_FA: accessed-variable=MCUM_0x135.MCUM_LDC_MTarOut_FA
              DataSendPoints_MCUM_LDC_MTarOut_RA: accessed-variable=MCUM_0x135.MCUM_LDC_MTarOut_RA
              DataSendPoints_MCUM_LDC_Available_FA: accessed-variable=MCUM_0x135.MCUM_LDC_Available_FA
              DataSendPoints_MCUM_LDC_OperationMode_FA: accessed-variable=MCUM_0x135.MCUM_LDC_OperationMode_FA
              DataSendPoints_MCUM_LDC_Available_RA: accessed-variable=MCUM_0x135.MCUM_LDC_Available_RA
              DataSendPoints_MCUM_LDC_OperationMode_RA: accessed-variable=MCUM_0x135.MCUM_LDC_OperationMode_RA
              DataSendPoints_MCUM_RTE_Exchange_Signal_Status: accessed-variable=MCUM_0x135.MCUM_RTE_Exchange_Signal_Status
              DataSendPoints_MCUM_MTarIn_FA: accessed-variable=MCUM_0x135.MCUM_MTarIn_FA
              DataSendPoints_MCUM_MTarIn_RA: accessed-variable=MCUM_0x135.MCUM_MTarIn_RA
              DataSendPoints_MCUM_InputQF_FA: accessed-variable=MCUM_0x135.MCUM_InputQF_FA
              DataSendPoints_MCUM_InputQF_RA: accessed-variable=MCUM_0x135.MCUM_InputQF_RA
              DataSendPoints_DelayIden_Rslt_Avg: accessed-variable=MCU_0x5C9.DelayIden_Rslt_Avg
              DataSendPoints_DelayIden_OverRange: accessed-variable=MCU_0x5C9.DelayIden_OverRange
              DataSendPoints_DelayIden_Iden_Finish: accessed-variable=MCU_0x5C9.DelayIden_Iden_Finish
              DataSendPoints_DelayIden_Write_Finish: accessed-variable=MCU_0x5C9.DelayIden_Write_Finish
              DataSendPoints_DelayIden_Rslt_U: accessed-variable=MCU_0x5C9.DelayIden_Rslt_U
              DataSendPoints_DelayIden_Rslt_V: accessed-variable=MCU_0x5C9.DelayIden_Rslt_V
              DataSendPoints_DelayIden_Rslt_W: accessed-variable=MCU_0x5C9.DelayIden_Rslt_W
              DataSendPoints_GainIden_Is_Samp_U: accessed-variable=MCU_0x5C9.GainIden_Is_Samp_U
              DataSendPoints_GainIden_Rslt_U: accessed-variable=MCU_0x5C9.GainIden_Rslt_U
              DataSendPoints_GainIden_OverRange: accessed-variable=MCU_0x5C9.GainIden_OverRange
              DataSendPoints_GainIden_Is_Samp_V: accessed-variable=MCU_0x5C9.GainIden_Is_Samp_V
              DataSendPoints_GainIden_Rslt_V: accessed-variable=MCU_0x5C9.GainIden_Rslt_V
              DataSendPoints_GainIden_Iden_Finish: accessed-variable=MCU_0x5C9.GainIden_Iden_Finish
              DataSendPoints_GainIden_Is_Samp_W: accessed-variable=MCU_0x5C9.GainIden_Is_Samp_W
              DataSendPoints_GainIden_Rslt_W: accessed-variable=MCU_0x5C9.GainIden_Rslt_W
              DataSendPoints_GainIden_Write_Finish: accessed-variable=MCU_0x5C9.GainIden_Write_Finish
              DataSendPoints_GainIden_Curr_Peak_U: accessed-variable=MCU_0x5C9.GainIden_Curr_Peak_U
              DataSendPoints_GainIden_Curr_Peak_V: accessed-variable=MCU_0x5C9.GainIden_Curr_Peak_V
              DataSendPoints_GainIden_Curr_Peak_W: accessed-variable=MCU_0x5C9.GainIden_Curr_Peak_W
              DataSendPoints_CurrLoad_CurExt_U: accessed-variable=MCU_0x5C9.CurrLoad_CurExt_U
              DataSendPoints_CurrLoad_CurExt_V: accessed-variable=MCU_0x5C9.CurrLoad_CurExt_V
              DataSendPoints_CurrLoad_CurExt_W: accessed-variable=MCU_0x5C9.CurrLoad_CurExt_W
              DataSendPoints_CurrLoad_offset_Iu: accessed-variable=MCU_0x5C9.CurrLoad_offset_Iu
              DataSendPoints_CurrLoad_offset_Iv: accessed-variable=MCU_0x5C9.CurrLoad_offset_Iv
              DataSendPoints_CurrLoad_offset_Iw: accessed-variable=MCU_0x5C9.CurrLoad_offset_Iw
              DataSendPoints_MCUMR_DelayIden_Rslt_Avg: accessed-variable=MCU_0x5C9.MCUMR_DelayIden_Rslt_Avg
              DataSendPoints_MCUMR_DelayIden_OverRange: accessed-variable=MCU_0x5C9.MCUMR_DelayIden_OverRange
              DataSendPoints_MCUMR_DelayIden_Iden_Finish: accessed-variable=MCU_0x5C9.MCUMR_DelayIden_Iden_Finish
              DataSendPoints_MCUMR_DelayIden_Write_Finish: accessed-variable=MCU_0x5C9.MCUMR_DelayIden_Write_Finish
              DataSendPoints_MCUMR_DelayIden_Rslt_U: accessed-variable=MCU_0x5C9.MCUMR_DelayIden_Rslt_U
              DataSendPoints_MCUMR_DelayIden_Rslt_V: accessed-variable=MCU_0x5C9.MCUMR_DelayIden_Rslt_V
              DataSendPoints_MCUMR_DelayIden_Rslt_W: accessed-variable=MCU_0x5C9.MCUMR_DelayIden_Rslt_W
              DataSendPoints_MCUMR_GainIden_Is_Samp_U: accessed-variable=MCU_0x5C9.MCUMR_GainIden_Is_Samp_U
              DataSendPoints_MCUMR_GainIden_Rslt_U: accessed-variable=MCU_0x5C9.MCUMR_GainIden_Rslt_U
              DataSendPoints_MCUMR_GainIden_OverRange: accessed-variable=MCU_0x5C9.MCUMR_GainIden_OverRange
              DataSendPoints_MCUMR_GainIden_Is_Samp_V: accessed-variable=MCU_0x5C9.MCUMR_GainIden_Is_Samp_V
              DataSendPoints_MCUMR_GainIden_Rslt_V: accessed-variable=MCU_0x5C9.MCUMR_GainIden_Rslt_V
              DataSendPoints_MCUMR_GainIden_Iden_Finish: accessed-variable=MCU_0x5C9.MCUMR_GainIden_Iden_Finish
              DataSendPoints_MCUMR_GainIden_Is_Samp_W: accessed-variable=MCU_0x5C9.MCUMR_GainIden_Is_Samp_W
              DataSendPoints_MCUMR_GainIden_Rslt_W: accessed-variable=MCU_0x5C9.MCUMR_GainIden_Rslt_W
              DataSendPoints_MCUMR_GainIden_Write_Finish: accessed-variable=MCU_0x5C9.MCUMR_GainIden_Write_Finish
              DataSendPoints_MCUMR_GainIden_Curr_Peak_U: accessed-variable=MCU_0x5C9.MCUMR_GainIden_Curr_Peak_U
              DataSendPoints_MCUMR_GainIden_Curr_Peak_V: accessed-variable=MCU_0x5C9.MCUMR_GainIden_Curr_Peak_V
              DataSendPoints_MCUMR_GainIden_Curr_Peak_W: accessed-variable=MCU_0x5C9.MCUMR_GainIden_Curr_Peak_W
              DataSendPoints_MCUMR_CurrLoad_CurExt_U: accessed-variable=MCU_0x5C9.MCUMR_CurrLoad_CurExt_U
              DataSendPoints_MCUMR_CurrLoad_CurExt_V: accessed-variable=MCU_0x5C9.MCUMR_CurrLoad_CurExt_V
              DataSendPoints_MCUMR_CurrLoad_CurExt_W: accessed-variable=MCU_0x5C9.MCUMR_CurrLoad_CurExt_W
              DataSendPoints_MCUMR_CurrLoad_offset_Iu: accessed-variable=MCU_0x5C9.MCUMR_CurrLoad_offset_Iu
              DataSendPoints_MCUMR_CurrLoad_offset_Iv: accessed-variable=MCU_0x5C9.MCUMR_CurrLoad_offset_Iv
              DataSendPoints_MCUMR_CurrLoad_offset_Iw: accessed-variable=MCU_0x5C9.MCUMR_CurrLoad_offset_Iw
              DataSendPoints_MCUM_Id_Ref: accessed-variable=MCUM_0x5D0.MCUM_Id_Ref
              DataSendPoints_MCUM_Iq_Ref: accessed-variable=MCUM_0x5D0.MCUM_Iq_Ref
              DataSendPoints_MCUM_Id_Fb: accessed-variable=MCUM_0x5D0.MCUM_Id_Fb
              DataSendPoints_MCUM_Iq_Fb: accessed-variable=MCUM_0x5D0.MCUM_Iq_Fb
              DataSendPoints_MCUM_Torque_Ref: accessed-variable=MCUM_0x5D0.MCUM_Torque_Ref
              DataSendPoints_MCUM_R_Id_Ref: accessed-variable=MCUM_0x5D0.MCUM_R_Id_Ref
              DataSendPoints_MCUM_R_Iq_Ref: accessed-variable=MCUM_0x5D0.MCUM_R_Iq_Ref
              DataSendPoints_MCUM_R_Id_Fb: accessed-variable=MCUM_0x5D0.MCUM_R_Id_Fb
              DataSendPoints_MCUM_R_Iq_Fb: accessed-variable=MCUM_0x5D0.MCUM_R_Iq_Fb
              DataSendPoints_MCUM_R_Torque_Ref: accessed-variable=MCUM_0x5D0.MCUM_R_Torque_Ref
              DataSendPoints_MCUM_Vd_Ref: accessed-variable=MCUM_0x5D1.MCUM_Vd_Ref
              DataSendPoints_MCUM_Vq_Ref: accessed-variable=MCUM_0x5D1.MCUM_Vq_Ref
              DataSendPoints_MCUM_Id_LookUp: accessed-variable=MCUM_0x5D1.MCUM_Id_LookUp
              DataSendPoints_MCUM_Iq_LookUp: accessed-variable=MCUM_0x5D1.MCUM_Iq_LookUp
              DataSendPoints_MCUM_Spd_Delta: accessed-variable=MCUM_0x5D1.MCUM_Spd_Delta
              DataSendPoints_MCUM_Us_Out: accessed-variable=MCUM_0x5D1.MCUM_Us_Out
              DataSendPoints_MCUM_Torque_PwrEst: accessed-variable=MCUM_0x5D1.MCUM_Torque_PwrEst
              DataSendPoints_MCUM_UserDefine_50ms: accessed-variable=MCUM_0x5D1.MCUM_UserDefine_50ms
              DataSendPoints_MCUM_Torque_ExtChar: accessed-variable=MCUM_0x5D1.MCUM_Torque_ExtChar
              DataSendPoints_MCUM_Damp_CompTorque: accessed-variable=MCUM_0x5D1.MCUM_Damp_CompTorque
              DataSendPoints_MCUM_Damp_CompCoeff: accessed-variable=MCUM_0x5D1.MCUM_Damp_CompCoeff
              DataSendPoints_MCUM_Damp_State: accessed-variable=MCUM_0x5D1.MCUM_Damp_State
              DataSendPoints_MCUM_PWM_State: accessed-variable=MCUM_0x5D1.MCUM_PWM_State
              DataSendPoints_MCUM_JuncTemp_Max: accessed-variable=MCUM_0x5D1.MCUM_JuncTemp_Max
              DataSendPoints_MCUM_JuncLoss_Max: accessed-variable=MCUM_0x5D1.MCUM_JuncLoss_Max
              DataSendPoints_MCUM_CurrAmp_Comp: accessed-variable=MCUM_0x5D1.MCUM_CurrAmp_Comp
              DataSendPoints_MCUM_CurrTheta_Comp: accessed-variable=MCUM_0x5D1.MCUM_CurrTheta_Comp
              DataSendPoints_MCUM_RawSinCorr: accessed-variable=MCUM_0x5D1.MCUM_RawSinCorr
              DataSendPoints_MCUM_RawCosCorr: accessed-variable=MCUM_0x5D1.MCUM_RawCosCorr
              DataSendPoints_MCUM_LUT_Spd: accessed-variable=MCUM_0x5D1.MCUM_LUT_Spd
              DataSendPoints_MCUM_R_HighVoltPowerOffReq: accessed-variable=MCUM_0x5D1.MCUM_R_HighVoltPowerOffReq
              DataSendPoints_MCUM_R_MaxTorqueAllow: accessed-variable=MCUM_0x5D1.MCUM_R_MaxTorqueAllow
              DataSendPoints_MCUM_R_MaxSpeedAllow: accessed-variable=MCUM_0x5D1.MCUM_R_MaxSpeedAllow
              DataSendPoints_MCUM_R_MinTorqueAllow: accessed-variable=MCUM_0x5D1.MCUM_R_MinTorqueAllow
              DataSendPoints_MCUM_R_MotorTemp: accessed-variable=MCUM_0x5D1.MCUM_R_MotorTemp
              DataSendPoints_MCUM_R_IGBTTemp: accessed-variable=MCUM_0x5D1.MCUM_R_IGBTTemp
              DataSendPoints_MCUM_R_InletTemp: accessed-variable=MCUM_0x5D1.MCUM_R_InletTemp
              DataSendPoints_MCUM_R_HeatPwrAllwd: accessed-variable=MCUM_0x5D1.MCUM_R_HeatPwrAllwd
              DataSendPoints_MCUM_R_HeatFdBck: accessed-variable=MCUM_0x5D1.MCUM_R_HeatFdBck
              DataSendPoints_MCUM_R_HeatPwrAct: accessed-variable=MCUM_0x5D1.MCUM_R_HeatPwrAct
              DataSendPoints_MCUM_R_HeatPwrMax: accessed-variable=MCUM_0x5D1.MCUM_R_HeatPwrMax
              DataSendPoints_MCUM_R_HeatPwrAval: accessed-variable=MCUM_0x5D1.MCUM_R_HeatPwrAval
              DataSendPoints_MCUM_R_Vd_Ref: accessed-variable=MCUM_0x5D1.MCUM_R_Vd_Ref
              DataSendPoints_MCUM_R_Vq_Ref: accessed-variable=MCUM_0x5D1.MCUM_R_Vq_Ref
              DataSendPoints_MCUM_R_Id_LookUp: accessed-variable=MCUM_0x5D1.MCUM_R_Id_LookUp
              DataSendPoints_MCUM_R_Iq_LookUp: accessed-variable=MCUM_0x5D1.MCUM_R_Iq_LookUp
              DataSendPoints_MCUM_R_Spd_Delta: accessed-variable=MCUM_0x5D1.MCUM_R_Spd_Delta
              DataSendPoints_MCUM_R_Us_Out: accessed-variable=MCUM_0x5D1.MCUM_R_Us_Out
              DataSendPoints_MCUM_R_Torque_PwrEst: accessed-variable=MCUM_0x5D1.MCUM_R_Torque_PwrEst
              DataSendPoints_MCUM_R_UserDefine_50ms: accessed-variable=MCUM_0x5D1.MCUM_R_UserDefine_50ms
              DataSendPoints_MCUM_R_Torque_ExtChar: accessed-variable=MCUM_0x5D1.MCUM_R_Torque_ExtChar
              DataSendPoints_MCUM_R_Damp_CompTorque: accessed-variable=MCUM_0x5D1.MCUM_R_Damp_CompTorque
              DataSendPoints_MCUM_R_Damp_CompCoeff: accessed-variable=MCUM_0x5D1.MCUM_R_Damp_CompCoeff
              DataSendPoints_MCUM_R_Damp_State: accessed-variable=MCUM_0x5D1.MCUM_R_Damp_State
              DataSendPoints_MCUM_R_PWM_State: accessed-variable=MCUM_0x5D1.MCUM_R_PWM_State
              DataSendPoints_MCUM_R_JuncTemp_Max: accessed-variable=MCUM_0x5D1.MCUM_R_JuncTemp_Max
              DataSendPoints_MCUM_R_JuncLoss_Max: accessed-variable=MCUM_0x5D1.MCUM_R_JuncLoss_Max
              DataSendPoints_MCUM_R_CurrAmp_Comp: accessed-variable=MCUM_0x5D1.MCUM_R_CurrAmp_Comp
              DataSendPoints_MCUM_R_CurrTheta_Comp: accessed-variable=MCUM_0x5D1.MCUM_R_CurrTheta_Comp
              DataSendPoints_MCUM_R_RawSinCorr: accessed-variable=MCUM_0x5D1.MCUM_R_RawSinCorr
              DataSendPoints_MCUM_R_RawCosCorr: accessed-variable=MCUM_0x5D1.MCUM_R_RawCosCorr
              DataSendPoints_MCUM_R_LUT_Spd: accessed-variable=MCUM_0x5D1.MCUM_R_LUT_Spd
              DataSendPoints_MCUM_R_StatorTemp_1: accessed-variable=MCUM_0x5D2.MCUM_R_StatorTemp_1
              DataSendPoints_MCUM_R_L2TqAct: accessed-variable=MCUM_0x5D2.MCUM_R_L2TqAct
              DataSendPoints_MCUM_R_EOPSw: accessed-variable=MCUM_0x5D2.MCUM_R_EOPSw
              DataSendPoints_MCUM_R_StatorTemp_2: accessed-variable=MCUM_0x5D2.MCUM_R_StatorTemp_2
              DataSendPoints_MCUM_R_IGBTTemp_U: accessed-variable=MCUM_0x5D2.MCUM_R_IGBTTemp_U
              DataSendPoints_MCUM_R_IGBTTemp_V: accessed-variable=MCUM_0x5D2.MCUM_R_IGBTTemp_V
              DataSendPoints_MCUM_R_IGBTTemp_W: accessed-variable=MCUM_0x5D2.MCUM_R_IGBTTemp_W
              DataSendPoints_MCUM_R_Power_15V: accessed-variable=MCUM_0x5D2.MCUM_R_Power_15V
              DataSendPoints_MCUM_R_Offset_IU: accessed-variable=MCUM_0x5D2.MCUM_R_Offset_IU
              DataSendPoints_MCUM_R_Offset_IV: accessed-variable=MCUM_0x5D2.MCUM_R_Offset_IV
              DataSendPoints_MCUM_R_Offset_IW: accessed-variable=MCUM_0x5D2.MCUM_R_Offset_IW
              DataSendPoints_MCUM_R_MainSt_State: accessed-variable=MCUM_0x5D2.MCUM_R_MainSt_State
              DataSendPoints_MCUM_R_Derate_Reason: accessed-variable=MCUM_0x5D2.MCUM_R_Derate_Reason
              DataSendPoints_MCUM_R_PWM_Freq_kHz: accessed-variable=MCUM_0x5D2.MCUM_R_PWM_Freq_kHz
              DataSendPoints_MCUM_R_PWMEn_State: accessed-variable=MCUM_0x5D2.MCUM_R_PWMEn_State
              DataSendPoints_MCUM_R_DrvPwrEn_Out_State: accessed-variable=MCUM_0x5D2.MCUM_R_DrvPwrEn_Out_State
              DataSendPoints_MCUM_R_NVM_RslvrZeroRFault: accessed-variable=MCUM_0x5D2.MCUM_R_NVM_RslvrZeroRFault
              DataSendPoints_MCUM_R_Rotor_Position: accessed-variable=MCUM_0x5D2.MCUM_R_Rotor_Position
              DataSendPoints_MCUM_R_PosTransduserFaultCode: accessed-variable=MCUM_0x5D2.MCUM_R_PosTransduserFaultCode
              DataSendPoints_MCUM_R_NVM_RslvrDirRFault: accessed-variable=MCUM_0x5D2.MCUM_R_NVM_RslvrDirRFault
              DataSendPoints_MCUM_R_NVM_RslvrDelayRFault: accessed-variable=MCUM_0x5D2.MCUM_R_NVM_RslvrDelayRFault
              DataSendPoints_MCUM_R_NVM_RslvrParamRFault: accessed-variable=MCUM_0x5D2.MCUM_R_NVM_RslvrParamRFault
              DataSendPoints_MCUM_R_NVM_HallGainRFault: accessed-variable=MCUM_0x5D2.MCUM_R_NVM_HallGainRFault
              DataSendPoints_MCUM_R_NVM_HallDelayRFault: accessed-variable=MCUM_0x5D2.MCUM_R_NVM_HallDelayRFault
              DataSendPoints_MCUM_R_NVM_IGBTTypeRFault: accessed-variable=MCUM_0x5D2.MCUM_R_NVM_IGBTTypeRFault
              DataSendPoints_MCUM_R_ASC_EntryCount: accessed-variable=MCUM_0x5D2.MCUM_R_ASC_EntryCount
              DataSendPoints_MCUM_R_Spd_Turn: accessed-variable=MCUM_0x5D2.MCUM_R_Spd_Turn
              DataSendPoints_MCUM_R_LUT_Spd_Max: accessed-variable=MCUM_0x5D2.MCUM_R_LUT_Spd_Max
              DataSendPoints_MCUM_R_EOP_Speed: accessed-variable=MCUM_0x5D2.MCUM_R_EOP_Speed
              DataSendPoints_MCUM_R_EOP_IqFb: accessed-variable=MCUM_0x5D2.MCUM_R_EOP_IqFb
              DataSendPoints_MCUM_R_EOP_IqRef: accessed-variable=MCUM_0x5D2.MCUM_R_EOP_IqRef
              DataSendPoints_MCUM_R_EOP_DCVolt: accessed-variable=MCUM_0x5D2.MCUM_R_EOP_DCVolt
              DataSendPoints_MCUM_R_EOP_DCCurr: accessed-variable=MCUM_0x5D2.MCUM_R_EOP_DCCurr
              DataSendPoints_MCUM_R_EOP_Temp: accessed-variable=MCUM_0x5D2.MCUM_R_EOP_Temp
              DataSendPoints_MCUM_R_EOP_State: accessed-variable=MCUM_0x5D2.MCUM_R_EOP_State
              DataSendPoints_MCUM_R_EOP_FaultCode: accessed-variable=MCUM_0x5D2.MCUM_R_EOP_FaultCode
              DataSendPoints_MCUM_R_HWFault_RstCnt: accessed-variable=MCUM_0x5D2.MCUM_R_HWFault_RstCnt
              DataSendPoints_MCUM_R_HWFoB_RstCnt: accessed-variable=MCUM_0x5D2.MCUM_R_HWFoB_RstCnt
              DataSendPoints_MCUM_R_HWFoT_RstCnt: accessed-variable=MCUM_0x5D2.MCUM_R_HWFoT_RstCnt
              DataSendPoints_MCUM_R_HWDrvUV_RstCnt: accessed-variable=MCUM_0x5D2.MCUM_R_HWDrvUV_RstCnt
              DataSendPoints_MCUM_R_HWRdc_RstCnt: accessed-variable=MCUM_0x5D2.MCUM_R_HWRdc_RstCnt
              DataSendPoints_MCUM_R_HWOC_RstCnt: accessed-variable=MCUM_0x5D2.MCUM_R_HWOC_RstCnt
              DataSendPoints_MCUM_R_HWOV_RstCnt: accessed-variable=MCUM_0x5D2.MCUM_R_HWOV_RstCnt
              DataSendPoints_MCUM_R_L2agRtrElecDiff: accessed-variable=MCUM_0x5D2.MCUM_R_L2agRtrElecDiff
              DataSendPoints_MCUM_R_500usOverTime_Cnt: accessed-variable=MCUM_0x5D2.MCUM_R_500usOverTime_Cnt
              DataSendPoints_MCUM_R_5msOverTime_Cnt: accessed-variable=MCUM_0x5D2.MCUM_R_5msOverTime_Cnt
              DataSendPoints_MCUM_R_CpldRest_TimeOut_flag: accessed-variable=MCUM_0x5D2.MCUM_R_CpldRest_TimeOut_flag
              DataSendPoints_MCUM_R_DrvPCBCurr: accessed-variable=MCUM_0x5D2.MCUM_R_DrvPCBCurr
              DataSendPoints_MCUM_R_EOL_StateMachine: accessed-variable=MCUM_0x5D2.MCUM_R_EOL_StateMachine
              DataSendPoints_MCUM_R_CpldRest_ASC_Flag: accessed-variable=MCUM_0x5D2.MCUM_R_CpldRest_ASC_Flag
              DataSendPoints_MCUM_R_LimSpdTorFlag: accessed-variable=MCUM_0x5D2.MCUM_R_LimSpdTorFlag
              DataSendPoints_MCUM_R_PWM_Err_Count: accessed-variable=MCUM_0x5D2.MCUM_R_PWM_Err_Count
              DataSendPoints_MCUM_R_RDC_Reset_Count: accessed-variable=MCUM_0x5D2.MCUM_R_RDC_Reset_Count
              DataSendPoints_MCUM_R_ASC_Stop_Flag: accessed-variable=MCUM_0x5D2.MCUM_R_ASC_Stop_Flag
              DataSendPoints_MCUM_R_ASC_Soft_Exiting_Flag: accessed-variable=MCUM_0x5D2.MCUM_R_ASC_Soft_Exiting_Flag
              DataSendPoints_MCUM_R_Vbus_ServeLowChkEn: accessed-variable=MCUM_0x5D2.MCUM_R_Vbus_ServeLowChkEn
              DataSendPoints_MCUM_R_EOP_BlockErr_IsLim_Flag: accessed-variable=MCUM_0x5D2.MCUM_R_EOP_BlockErr_IsLim_Flag
              DataSendPoints_MCUM_R_IdqErrCount: accessed-variable=MCUM_0x5D2.MCUM_R_IdqErrCount
              DataSendPoints_MCUM_R_MotSelfHeat_EnSts: accessed-variable=MCUM_0x5D2.MCUM_R_MotSelfHeat_EnSts
              DataSendPoints_MCUM_R_MotBlockHeat_LvlFb: accessed-variable=MCUM_0x5D2.MCUM_R_MotBlockHeat_LvlFb
              DataSendPoints_MCUM_R_MotRotaryHeat_LvlFb: accessed-variable=MCUM_0x5D2.MCUM_R_MotRotaryHeat_LvlFb
              DataSendPoints_MCUM_R_MotSelfHeat_DropLvlFb: accessed-variable=MCUM_0x5D2.MCUM_R_MotSelfHeat_DropLvlFb
              DataSendPoints_MCUM_R_MotSelfHeat_DropLvlRsn: accessed-variable=MCUM_0x5D2.MCUM_R_MotSelfHeat_DropLvlRsn
              DataSendPoints_MCUM_R_MotBlockHeat_CurAngle: accessed-variable=MCUM_0x5D2.MCUM_R_MotBlockHeat_CurAngle
              DataSendPoints_MCUM_R_MotBlockHeat_CurMag: accessed-variable=MCUM_0x5D2.MCUM_R_MotBlockHeat_CurMag
              DataSendPoints_MCUM_R_UserDefine_Byte{1..4}: accessed-variable=MCUM_0x5D2.MCUM_R_UserDefine_Byte{1..4}
              DataSendPoints_MCUM_R_UserDefine_Word{1..3}: accessed-variable=MCUM_0x5D2.MCUM_R_UserDefine_Word{1..3}
              DataSendPoints_VCU_MotSelfHeatPwrFb: accessed-variable=VCU_0x358.VCU_MotSelfHeatPwrFb
              DataSendPoints_VCU_MotSelfHeatLvlFb: accessed-variable=VCU_0x358.VCU_MotSelfHeatLvlFb
              DataSendPoints_VCU_MCUMWaterPumpLevlReq: accessed-variable=VCU_0x358.VCU_MCUMWaterPumpLevlReq
              DataSendPoints_VCU_MCUSWaterPumpLevlReq: accessed-variable=VCU_0x358.VCU_MCUSWaterPumpLevlReq
              DataSendPoints_VCU_HeatPwrAval: accessed-variable=VCU_0x358.VCU_HeatPwrAval
              DataSendPoints_VCU_MotSelfHeatAllwd: accessed-variable=VCU_0x358.VCU_MotSelfHeatAllwd
              DataSendPoints_VCU_MMotSelfHeatEnReq: accessed-variable=VCU_0x358.VCU_MMotSelfHeatEnReq
              DataSendPoints_VCU_MMotSelfHeatLvlReq: accessed-variable=VCU_0x358.VCU_MMotSelfHeatLvlReq
              DataSendPoints_VCU_SMotSelfHeatEnReq: accessed-variable=VCU_0x358.VCU_SMotSelfHeatEnReq
              DataSendPoints_VCU_SMotSelfHeatLvlReq: accessed-variable=VCU_0x358.VCU_SMotSelfHeatLvlReq
              DataSendPoints_MotClb_FaultCode{1..8}: accessed-variable=MCU_0x5C6.MotClb_FaultCode{1..8}
              DataSendPoints_MotClb_OfsApply: accessed-variable=MCU_0x5C6.MotClb_OfsApply
              DataSendPoints_MCUMR_MotClb_FaultCode{1..8}: accessed-variable=MCU_0x5C6.MCUMR_MotClb_FaultCode{1..8}
              DataSendPoints_MCUMR_MotClb_OfsApply: accessed-variable=MCU_0x5C6.MCUMR_MotClb_OfsApply
              DataSendPoints_VCU_EolCfg_ESC: accessed-variable=VCU_0x359.VCU_EolCfg_ESC
              DataSendPoints_VCU_IMMOKeyWriteCnt: accessed-variable=VCU_0x359.VCU_IMMOKeyWriteCnt
              DataSendPoints_VCU_AbStartupFlag: accessed-variable=VCU_0x359.VCU_AbStartupFlag
              DataSendPoints_VCU_AbResetFlag: accessed-variable=VCU_0x359.VCU_AbResetFlag
              DataSendPoints_VCU_AbResetlnitFinish: accessed-variable=VCU_0x359.VCU_AbResetlnitFinish
              DataSendPoints_VCU_EolCfg_EPB: accessed-variable=VCU_0x359.VCU_EolCfg_EPB
              DataSendPoints_VCU_EolCfg_AEB: accessed-variable=VCU_0x359.VCU_EolCfg_AEB
              DataSendPoints_VCU_EolCfg_InverterFunc: accessed-variable=VCU_0x359.VCU_EolCfg_InverterFunc
              DataSendPoints_VCU_EolCfg_APS: accessed-variable=VCU_0x359.VCU_EolCfg_APS
              DataSendPoints_VCU_EolCfg_VehiModels: accessed-variable=VCU_0x359.VCU_EolCfg_VehiModels
              DataSendPoints_VCU_EolCfg_SpdLmtVal: accessed-variable=VCU_0x359.VCU_EolCfg_SpdLmtVal
              DataSendPoints_VCU_EolCfg_WheelType: accessed-variable=VCU_0x359.VCU_EolCfg_WheelType
              DataSendPoints_VCU_EolCfg_Curise: accessed-variable=VCU_0x359.VCU_EolCfg_Curise
              DataSendPoints_VCU_REStartReq: accessed-variable=VCU_0x359.VCU_REStartReq
              DataSendPoints_VCU_REStopReq: accessed-variable=VCU_0x359.VCU_REStopReq
              DataSendPoints_VCU_EolCfg_VehiType: accessed-variable=VCU_0x359.VCU_EolCfg_VehiType
              DataSendPoints_VCU_EolCfg_MotPwr: accessed-variable=VCU_0x359.VCU_EolCfg_MotPwr
              DataSendPoints_VCU_Vehicle_NVHPwrLimitVal: accessed-variable=VCU_0x359.VCU_Vehicle_NVHPwrLimitVal
              DataSendPoints_VCU_EolCfg_MotDrvStructure: accessed-variable=VCU_0x359.VCU_EolCfg_MotDrvStructure
              DataSendPoints_VCU_WLTCModeFlag: accessed-variable=VCU_0x359.VCU_WLTCModeFlag
              DataSendPoints_VCU_EolCfg_RudderDir: accessed-variable=VCU_0x359.VCU_EolCfg_RudderDir
              DataSendPoints_VCU_EolCfg_DCChgRelayPos: accessed-variable=VCU_0x359.VCU_EolCfg_DCChgRelayPos
              DataSendPoints_VCU_EolCfg_FPTCIL: accessed-variable=VCU_0x359.VCU_EolCfg_FPTCIL
              DataSendPoints_VCU_PWakeupSt: accessed-variable=VCU_0x359.VCU_PWakeupSt
              DataSendPoints_VCU_SpdLimitReason: accessed-variable=VCU_0x359.VCU_SpdLimitReason
              DataSendPoints_BSW_VertifySts: accessed-variable=VCU_0x359.BSW_VertifySts
              DataSendPoints_VCU_InterAllowEngStart: accessed-variable=VCU_0x359.VCU_InterAllowEngStart
              DataSendPoints_VCU_EngineOff_Flag: accessed-variable=VCU_0x359.VCU_EngineOff_Flag
              DataSendPoints_VCU_EngineStopAllow: accessed-variable=VCU_0x359.VCU_EngineStopAllow
              DataSendPoints_VCU_EmergencyStopReq: accessed-variable=VCU_0x359.VCU_EmergencyStopReq
              DataSendPoints_VCU_EngineAllowStop: accessed-variable=VCU_0x359.VCU_EngineAllowStop
              DataSendPoints_VCU_REVehiWheelTrqReq: accessed-variable=VCU_0x359.VCU_REVehiWheelTrqReq
              DataSendPoints_VCU_REHighPerformVehiPwr: accessed-variable=VCU_0x359.VCU_REHighPerformVehiPwr
              DataSendPoints_VCU_REPwrDampingFactor: accessed-variable=VCU_0x359.VCU_REPwrDampingFactor
              DataSendPoints_VCU_REDrvTarPwrFit: accessed-variable=VCU_0x359.VCU_REDrvTarPwrFit
              DataSendPoints_VCU_AdditionalPwrVal: accessed-variable=VCU_0x359.VCU_AdditionalPwrVal
              DataSendPoints_VCU_VehichRealPwDown: accessed-variable=VCU_0x359.VCU_VehichRealPwDown
              DataSendPoints_VCU_IMMOStsResult: accessed-variable=VCU_0x359.VCU_IMMOStsResult
              DataSendPoints_VCU_IMMOStateMachine: accessed-variable=VCU_0x359.VCU_IMMOStateMachine
              DataSendPoints_VCU_ShowCarModeNvmResult: accessed-variable=VCU_0x359.VCU_ShowCarModeNvmResult
              DataSendPoints_VCU_DeliveryModeNvmData: accessed-variable=VCU_0x359.VCU_DeliveryModeNvmData
              DataSendPoints_VCU_AccPedFaultLvNvmResult: accessed-variable=VCU_0x359.VCU_AccPedFaultLvNvmResult
              DataSendPoints_VCU_VehicleConfigNvmResult: accessed-variable=VCU_0x359.VCU_VehicleConfigNvmResult
              DataSendPoints_VCU_EngRunTimeNvmResult: accessed-variable=VCU_0x359.VCU_EngRunTimeNvmResult
              DataSendPoints_VCU_FuelConsumption: accessed-variable=VCU_0x514.VCU_FuelConsumption
              DataSendPoints_VCU_SVSLamp: accessed-variable=VCU_0x514.VCU_SVSLamp
              DataSendPoints_VCU_MilLamp: accessed-variable=VCU_0x514.VCU_MilLamp
              DataSendPoints_VCU_SinglePedalSts_ID514: accessed-variable=VCU_0x514.VCU_SinglePedalSts_ID514
              DataSendPoints_VCU_GearLevelPosFault_ID514: accessed-variable=VCU_0x514.VCU_GearLevelPosFault_ID514
              DataSendPoints_VCU_EngineStartFailure_ID514: accessed-variable=VCU_0x514.VCU_EngineStartFailure_ID514
              DataSendPoints_VCU_ParkBeforeFuelup: accessed-variable=VCU_0x514.VCU_ParkBeforeFuelup
              DataSendPoints_VCU_REsystemFaultSts_ID514: accessed-variable=VCU_0x514.VCU_REsystemFaultSts_ID514
              DataSendPoints_VCU_EngineRunAllowFlg_ID514: accessed-variable=VCU_0x514.VCU_EngineRunAllowFlg_ID514
              DataSendPoints_VCU_InverterTip: accessed-variable=VCU_0x514.VCU_InverterTip
              DataSendPoints_VCU_EMSRepairModeSts: accessed-variable=VCU_0x514.VCU_EMSRepairModeSts
              DataSendPoints_VCU_FuelTankFlapSts: accessed-variable=VCU_0x514.VCU_FuelTankFlapSts
              DataSendPoints_VCU_REsystemSts_ID514: accessed-variable=VCU_0x514.VCU_REsystemSts_ID514
              DataSendPoints_VCU_PowerModeAllow: accessed-variable=VCU_0x514.VCU_PowerModeAllow
              DataSendPoints_VCU_PowerModeSwitchMsg: accessed-variable=VCU_0x514.VCU_PowerModeSwitchMsg
              DataSendPoints_VCU_HighVoltFailed_M: accessed-variable=VCU_0x514.VCU_HighVoltFailed_M
              DataSendPoints_VCU_HighVoltFailed_S: accessed-variable=VCU_0x514.VCU_HighVoltFailed_S
              DataSendPoints_VCU_BrakeBeforeGear: accessed-variable=VCU_0x514.VCU_BrakeBeforeGear
              DataSendPoints_VCU_ParkBeforeGear: accessed-variable=VCU_0x514.VCU_ParkBeforeGear
              DataSendPoints_VCU_GearBeforDriving: accessed-variable=VCU_0x514.VCU_GearBeforDriving
              DataSendPoints_VCU_UnlockBeforeDriving: accessed-variable=VCU_0x514.VCU_UnlockBeforeDriving
              DataSendPoints_VCU_PreventSliding: accessed-variable=VCU_0x514.VCU_PreventSliding
              DataSendPoints_VCU_MMErrorSts: accessed-variable=VCU_0x514.VCU_MMErrorSts
              DataSendPoints_VCU_ShowCarModeSts: accessed-variable=VCU_0x514.VCU_ShowCarModeSts
              DataSendPoints_VCU_PGearFlashSts: accessed-variable=VCU_0x514.VCU_PGearFlashSts
              DataSendPoints_VCU_ACConnectSts: accessed-variable=VCU_0x514.VCU_ACConnectSts
              DataSendPoints_VCU_DcChgPwrSts: accessed-variable=VCU_0x514.VCU_DcChgPwrSts
              DataSendPoints_VCU_DriverAssistProhibitSts_ID514: accessed-variable=VCU_0x514.VCU_DriverAssistProhibitSts_ID514
              DataSendPoints_VCU_MilLampRequest_ID514: accessed-variable=VCU_0x514.VCU_MilLampRequest_ID514
              DataSendPoints_VCU_CcmHvilInSigFreq_FB: accessed-variable=VCU_0x514.VCU_CcmHvilInSigFreq_FB
              DataSendPoints_VCU_CcmHvilInSigDuty_FB: accessed-variable=VCU_0x514.VCU_CcmHvilInSigDuty_FB
              DataSendPoints_VCU_FuelDectionModeSts: accessed-variable=VCU_0x514.VCU_FuelDectionModeSts
              DataSendPoints_VCU_EnergyCtrlMode: accessed-variable=VCU_0x514.VCU_EnergyCtrlMode
              DataSendPoints_VCU_VehSpdLimtRemind_ID514: accessed-variable=VCU_0x514.VCU_VehSpdLimtRemind_ID514
              DataSendPoints_VCU_TurtleLamp: accessed-variable=VCU_0x514.VCU_TurtleLamp
              DataSendPoints_VCU_EngLongTimeStartReq: accessed-variable=VCU_0x514.VCU_EngLongTimeStartReq
              DataSendPoints_Harness_igbt_temp{1..3}: accessed-variable=MCU_0x5C8.Harness_igbt_temp{1..3}
              DataSendPoints_Harness_CoolWaterTemp: accessed-variable=MCU_0x5C8.Harness_CoolWaterTemp
              DataSendPoints_Harness_V_DC: accessed-variable=MCU_0x5C8.Harness_V_DC
              DataSendPoints_Harness_PWM_DIR: accessed-variable=MCU_0x5C8.Harness_PWM_DIR
              DataSendPoints_Harness_HVIL_State: accessed-variable=MCU_0x5C8.Harness_HVIL_State
              DataSendPoints_Harness_crash_err_flag: accessed-variable=MCU_0x5C8.Harness_crash_err_flag
              DataSendPoints_Harness_KeyON: accessed-variable=MCU_0x5C8.Harness_KeyON
              DataSendPoints_Harness_HWRdc: accessed-variable=MCU_0x5C8.Harness_HWRdc
              DataSendPoints_Harness_HWFoT: accessed-variable=MCU_0x5C8.Harness_HWFoT
              DataSendPoints_Harness_HWVoltLower: accessed-variable=MCU_0x5C8.Harness_HWVoltLower
              DataSendPoints_Harness_HWFoB: accessed-variable=MCU_0x5C8.Harness_HWFoB
              DataSendPoints_Harness_MotorTemp1: accessed-variable=MCU_0x5C8.Harness_MotorTemp1
              DataSendPoints_Harness_MotorTemp2: accessed-variable=MCU_0x5C8.Harness_MotorTemp2
              DataSendPoints_Harness_I_U: accessed-variable=MCU_0x5C8.Harness_I_U
              DataSendPoints_Harness_I_W: accessed-variable=MCU_0x5C8.Harness_I_W
              DataSendPoints_Harness_I_V: accessed-variable=MCU_0x5C8.Harness_I_V
              DataSendPoints_Harness_HVRelayPosVolt: accessed-variable=MCU_0x5C8.Harness_HVRelayPosVolt
              DataSendPoints_MCUMR_Harness_igbt_temp{1..3}: accessed-variable=MCU_0x5C8.MCUMR_Harness_igbt_temp{1..3}
              DataSendPoints_MCUMR_Harness_CoolWaterTemp: accessed-variable=MCU_0x5C8.MCUMR_Harness_CoolWaterTemp
              DataSendPoints_MCUMR_Harness_V_DC: accessed-variable=MCU_0x5C8.MCUMR_Harness_V_DC
              DataSendPoints_MCUMR_Harness_PWM_DIR: accessed-variable=MCU_0x5C8.MCUMR_Harness_PWM_DIR
              DataSendPoints_MCUMR_Harness_HWRdc: accessed-variable=MCU_0x5C8.MCUMR_Harness_HWRdc
              DataSendPoints_MCUMR_Harness_HWFoT: accessed-variable=MCU_0x5C8.MCUMR_Harness_HWFoT
              DataSendPoints_MCUMR_Harness_HWVoltLower: accessed-variable=MCU_0x5C8.MCUMR_Harness_HWVoltLower
              DataSendPoints_MCUMR_Harness_HWFoB: accessed-variable=MCU_0x5C8.MCUMR_Harness_HWFoB
              DataSendPoints_MCUMR_Harness_MotorTemp1: accessed-variable=MCU_0x5C8.MCUMR_Harness_MotorTemp1
              DataSendPoints_MCUMR_Harness_MotorTemp2: accessed-variable=MCU_0x5C8.MCUMR_Harness_MotorTemp2
              DataSendPoints_MCUMR_Harness_I_U: accessed-variable=MCU_0x5C8.MCUMR_Harness_I_U
              DataSendPoints_MCUMR_Harness_I_W: accessed-variable=MCU_0x5C8.MCUMR_Harness_I_W
              DataSendPoints_MCUMR_Harness_I_V: accessed-variable=MCU_0x5C8.MCUMR_Harness_I_V
              DataSendPoints_VCU_CRC_13: accessed-variable=VCU_0x13.VCU_CRC_13
              DataSendPoints_VCU_RollingCounter_13: accessed-variable=VCU_0x13.VCU_RollingCounter_13
              DataSendPoints_VCU_SDrvRequestTorque_prvt: accessed-variable=VCU_0x13.VCU_SDrvRequestTorque_prvt
              DataSendPoints_VCU_SDrvRequestTorqueVD_prvt: accessed-variable=VCU_0x13.VCU_SDrvRequestTorqueVD_prvt
              DataSendPoints_VCU_MCUSDampgLmtFactor_prvt: accessed-variable=VCU_0x13.VCU_MCUSDampgLmtFactor_prvt
              DataSendPoints_VCU_VehicleDirectS_prvt: accessed-variable=VCU_0x13.VCU_VehicleDirectS_prvt
              DataSendPoints_VCU_VehicleDirectS_VD_prvt: accessed-variable=VCU_0x13.VCU_VehicleDirectS_VD_prvt
              DataSendPoints_VCU_MCUSMaxPosDampgTrq_prvt: accessed-variable=VCU_0x13.VCU_MCUSMaxPosDampgTrq_prvt
              DataSendPoints_VCU_MCUSMaxNegDampgTrq_prvt: accessed-variable=VCU_0x13.VCU_MCUSMaxNegDampgTrq_prvt
              DataSendPoints_VCU_VehicleSpdDirect: accessed-variable=VCU_0xBC.VCU_VehicleSpdDirect
              DataSendPoints_VCU_ADM_ActualMode: accessed-variable=VCU_0xBC.VCU_ADM_ActualMode
              DataSendPoints_VCU_ADM_MainMode: accessed-variable=VCU_0xBC.VCU_ADM_MainMode
              DataSendPoints_VCU_DeliveryModeSts: accessed-variable=VCU_0xBC.VCU_DeliveryModeSts
              DataSendPoints_VCU_VehSpdLimtRemind: accessed-variable=VCU_0xBC.VCU_VehSpdLimtRemind
              DataSendPoints_VCU_SinglePedalSts: accessed-variable=VCU_0xBC.VCU_SinglePedalSts
              DataSendPoints_VCU_GearLvrChangeSts: accessed-variable=VCU_0xBC.VCU_GearLvrChangeSts
              DataSendPoints_VCU_HighVoltSysSts: accessed-variable=VCU_0xBC.VCU_HighVoltSysSts
              DataSendPoints_VCU_ChrgDischrgFunSts: accessed-variable=VCU_0xBC.VCU_ChrgDischrgFunSts
              DataSendPoints_VCU_CalibrationVersion: accessed-variable=VCU_0xBC.VCU_CalibrationVersion
              DataSendPoints_VCU_CalibrationNumber: accessed-variable=VCU_0xBC.VCU_CalibrationNumber
              DataSendPoints_VCU_VehicleNegTrqRspdSts: accessed-variable=VCU_0xBC.VCU_VehicleNegTrqRspdSts
              DataSendPoints_VCU_SlopeEst: accessed-variable=VCU_0xBC.VCU_SlopeEst
              DataSendPoints_VCU_SlopeEst_Valid: accessed-variable=VCU_0xBC.VCU_SlopeEst_Valid
              DataSendPoints_VCU_WheelTrqType: accessed-variable=VCU_0xBC.VCU_WheelTrqType
              DataSendPoints_VCU_DriverAssistProhibitSts: accessed-variable=VCU_0xBC.VCU_DriverAssistProhibitSts
              DataSendPoints_VCU_VacumRlySts: accessed-variable=VCU_0xBC.VCU_VacumRlySts
              DataSendPoints_VCU_DriveSHVILSts: accessed-variable=VCU_0xBC.VCU_DriveSHVILSts
              DataSendPoints_VCU_DriveMHVILSts: accessed-variable=VCU_0xBC.VCU_DriveMHVILSts
              DataSendPoints_VCU_DCChgHVILSts: accessed-variable=VCU_0xBC.VCU_DCChgHVILSts
              DataSendPoints_VCU_ACChgHVILSts: accessed-variable=VCU_0xBC.VCU_ACChgHVILSts
              DataSendPoints_VCU_CCMHVILSts: accessed-variable=VCU_0xBC.VCU_CCMHVILSts
              DataSendPoints_VCU_SystemError: accessed-variable=VCU_0xBC.VCU_SystemError
              DataSendPoints_VCU_AccPedalFaultLV: accessed-variable=VCU_0xBC.VCU_AccPedalFaultLV
              DataSendPoints_VCU_HVILSysSts: accessed-variable=VCU_0xBC.VCU_HVILSysSts
              DataSendPoints_VCU_VacuumDegree: accessed-variable=VCU_0xBC.VCU_VacuumDegree
              DataSendPoints_VCU_LPedalModeSts: accessed-variable=VCU_0xBC.VCU_LPedalModeSts
              DataSendPoints_VCU_LVSystemError: accessed-variable=VCU_0xBC.VCU_LVSystemError
              DataSendPoints_VCU_HVSystemError: accessed-variable=VCU_0xBC.VCU_HVSystemError
              DataSendPoints_VCU_OpeartingMode: accessed-variable=VCU_0xBC.VCU_OpeartingMode
              DataSendPoints_VCU_EnergyMode: accessed-variable=VCU_0xBC.VCU_EnergyMode
              DataSendPoints_VCU_GearLevelPosFault: accessed-variable=VCU_0xBC.VCU_GearLevelPosFault
              DataSendPoints_VCU_BrakeSwitchSts: accessed-variable=VCU_0xBC.VCU_BrakeSwitchSts
              DataSendPoints_VCU_SpdLimModeSts: accessed-variable=VCU_0xBC.VCU_SpdLimModeSts
              DataSendPoints_VCU_TrqDstrbutnPrio: accessed-variable=VCU_0xBC.VCU_TrqDstrbutnPrio
              DataSendPoints_VCU_TrqDstrbutnTransferSts: accessed-variable=VCU_0xBC.VCU_TrqDstrbutnTransferSts
              DataSendPoints_VCU_MCUMDiffProtectSts: accessed-variable=VCU_0xBC.VCU_MCUMDiffProtectSts
              DataSendPoints_VCU_MCUSDiffProtectSts: accessed-variable=VCU_0xBC.VCU_MCUSDiffProtectSts
              DataSendPoints_VCU_FaultData{0..31}: accessed-variable=VCU_0x600.VCU_FaultData{0..31}
              DataSendPoints_VCU_CRC_B7: accessed-variable=VCU_0xB7.VCU_CRC_B7
              DataSendPoints_VCU_KeepWorkModeFlag: accessed-variable=VCU_0xB7.VCU_KeepWorkModeFlag
              DataSendPoints_VCU_MAI_Active: accessed-variable=VCU_0xB7.VCU_MAI_Active
              DataSendPoints_VCU_MAI_Available: accessed-variable=VCU_0xB7.VCU_MAI_Available
              DataSendPoints_VCU_GetCrashStsReq: accessed-variable=VCU_0xB7.VCU_GetCrashStsReq
              DataSendPoints_VCU_ADASPosTorqueCap_VD: accessed-variable=VCU_0xB7.VCU_ADASPosTorqueCap_VD
              DataSendPoints_VCU_ADASPosTorqueCap: accessed-variable=VCU_0xB7.VCU_ADASPosTorqueCap
              DataSendPoints_VCU_RollingCounter_B7: accessed-variable=VCU_0xB7.VCU_RollingCounter_B7
              DataSendPoints_VCU_Vehicle_Warning_IDB7_CCAN: accessed-variable=VCU_0xB7.VCU_Vehicle_Warning_IDB7_CCAN
              DataSendPoints_VCU_VehicleSts_IDB7_CCAN: accessed-variable=VCU_0xB7.VCU_VehicleSts_IDB7_CCAN
              DataSendPoints_VCU_PowerReduceReq: accessed-variable=VCU_0xB7.VCU_PowerReduceReq
              DataSendPoints_VCU_ParkingReqToEPB_VD: accessed-variable=VCU_0xB7.VCU_ParkingReqToEPB_VD
              DataSendPoints_VCU_ParkingReqToEPB: accessed-variable=VCU_0xB7.VCU_ParkingReqToEPB
              DataSendPoints_VCU_ACCAvailable: accessed-variable=VCU_0xB7.VCU_ACCAvailable
              DataSendPoints_VCU_ACCActiveSts: accessed-variable=VCU_0xB7.VCU_ACCActiveSts
              DataSendPoints_VCU_Active_APS: accessed-variable=VCU_0xB7.VCU_Active_APS
              DataSendPoints_VCU_Available_APS: accessed-variable=VCU_0xB7.VCU_Available_APS
              DataSendPoints_VCU_ESCActive: accessed-variable=VCU_0xB7.VCU_ESCActive
              DataSendPoints_VCU_ESCTorqReqAvailability_Rear: accessed-variable=VCU_0xB7.VCU_ESCTorqReqAvailability_Rear
              DataSendPoints_VCU_AutoHold_ibit: accessed-variable=VCU_0xB7.VCU_AutoHold_ibit
              DataSendPoints_VCU_VehicleSpeedVD: accessed-variable=VCU_0xB7.VCU_VehicleSpeedVD
              DataSendPoints_VCU_CCSStatus: accessed-variable=VCU_0xB7.VCU_CCSStatus
              DataSendPoints_VCU_AutoDriveRequest: accessed-variable=VCU_0xB7.VCU_AutoDriveRequest
              DataSendPoints_VCU_CCSAllow: accessed-variable=VCU_0xB7.VCU_CCSAllow
              DataSendPoints_VCU_VlcHoldSts: accessed-variable=VCU_0xB7.VCU_VlcHoldSts
              DataSendPoints_VCU_HoldReqSts: accessed-variable=VCU_0xB7.VCU_HoldReqSts
              DataSendPoints_VCU_HoldReqStsValid: accessed-variable=VCU_0xB7.VCU_HoldReqStsValid
              DataSendPoints_VCU_DriverAssistProhibitSts_IDB7_CCAN: accessed-variable=VCU_0xB7.VCU_DriverAssistProhibitSts_IDB7_CCAN
              DataSendPoints_VCU_SpeedLimitedSts: accessed-variable=VCU_0xB7.VCU_SpeedLimitedSts
              DataSendPoints_VCU_SpeedLimitedValue: accessed-variable=VCU_0xB7.VCU_SpeedLimitedValue
              DataSendPoints_VCU_TheoAccePedalPercent: accessed-variable=VCU_0xB7.VCU_TheoAccePedalPercent
              DataSendPoints_VCU_RecuBrakeTorqueCap: accessed-variable=VCU_0xB7.VCU_RecuBrakeTorqueCap
              DataSendPoints_VCU_RecuBrakeTorqueAct: accessed-variable=VCU_0xB7.VCU_RecuBrakeTorqueAct
              DataSendPoints_VCU_TheoAccePedalValid: accessed-variable=VCU_0xB7.VCU_TheoAccePedalValid
              DataSendPoints_VCU_HydraTorqTgt: accessed-variable=VCU_0xB7.VCU_HydraTorqTgt
              DataSendPoints_VCU_RecuBrakeTorqueActDrag: accessed-variable=VCU_0xB7.VCU_RecuBrakeTorqueActDrag
              DataSendPoints_VCU_ESCTorqReqAvailability_Frnt: accessed-variable=VCU_0xB7.VCU_ESCTorqReqAvailability_Frnt
              DataSendPoints_VCU_RecuBrakeTorqueCap_Q: accessed-variable=VCU_0xB7.VCU_RecuBrakeTorqueCap_Q
              DataSendPoints_VCU_RecuBrakeTorqueAct_Q: accessed-variable=VCU_0xB7.VCU_RecuBrakeTorqueAct_Q
              DataSendPoints_VCU_HydraTorqTgt_Q: accessed-variable=VCU_0xB7.VCU_HydraTorqTgt_Q
              DataSendPoints_VCU_RecuBrakeTorqueActDrag_Q: accessed-variable=VCU_0xB7.VCU_RecuBrakeTorqueActDrag_Q
              DataSendPoints_VCU_RecuBrakeTorqueTarget_Drag: accessed-variable=VCU_0xB7.VCU_RecuBrakeTorqueTarget_Drag
              DataSendPoints_VCU_PreventVehSlipSts: accessed-variable=VCU_0xB7.VCU_PreventVehSlipSts
              DataSendPoints_VCU_RecuBrakeTorqueTarget_Drag_Q: accessed-variable=VCU_0xB7.VCU_RecuBrakeTorqueTarget_Drag_Q
              DataSendPoints_VCU_AllMotWhlTrqFB: accessed-variable=VCU_0xB7.VCU_AllMotWhlTrqFB
              DataSendPoints_VCU_AllMotWhlTrqFB_VD: accessed-variable=VCU_0xB7.VCU_AllMotWhlTrqFB_VD
              DataSendPoints_VCU_LSFC_Allow: accessed-variable=VCU_0xB7.VCU_LSFC_Allow
              DataSendPoints_VCU_LSFC_Active: accessed-variable=VCU_0xB7.VCU_LSFC_Active
              DataSendPoints_VCU_MGCUWorkMode_C: accessed-variable=VCU_0xB7.VCU_MGCUWorkMode_C
              DataSendPoints_VCU_AllRoadSts: accessed-variable=VCU_0xB7.VCU_AllRoadSts
              DataSendPoints_VCU_CmpUTurnAllow: accessed-variable=VCU_0xB7.VCU_CmpUTurnAllow
              DataSendPoints_VCU_CmpUTurnSts: accessed-variable=VCU_0xB7.VCU_CmpUTurnSts
              DataSendPoints_VCU_AllowCmpUTurnStartFlag: accessed-variable=VCU_0xB7.VCU_AllowCmpUTurnStartFlag
              DataSendPoints_VCU_CmpUTurnLockWhl: accessed-variable=VCU_0xB7.VCU_CmpUTurnLockWhl
              DataSendPoints_VCU_CmpUTurnActAngle: accessed-variable=VCU_0xB7.VCU_CmpUTurnActAngle
              DataSendPoints_VCU_CmpUTurnActSpinSpd: accessed-variable=VCU_0xB7.VCU_CmpUTurnActSpinSpd
              DataSendPoints_VCU_CmpUTurnFltHMI: accessed-variable=VCU_0xB7.VCU_CmpUTurnFltHMI
              DataSendPoints_VCU_EscapeModeSts: accessed-variable=VCU_0xB7.VCU_EscapeModeSts
              DataSendPoints_VCU_MCUSWorkFailMsg: accessed-variable=VCU_0xB7.VCU_MCUSWorkFailMsg
              DataSendPoints_VCU_EscapeWorkFailMsg: accessed-variable=VCU_0xB7.VCU_EscapeWorkFailMsg
              DataSendPoints_VCU_REClutchFltMsg: accessed-variable=VCU_0xB7.VCU_REClutchFltMsg
              DataSendPoints_VCU_BoostMode_Fail_C: accessed-variable=VCU_0xB7.VCU_BoostMode_Fail_C
              DataSendPoints_VCU_BoostModeSts_C: accessed-variable=VCU_0xB7.VCU_BoostModeSts_C
              DataSendPoints_DbgSignal{1..12}_FA: accessed-variable=VCU_0xE6.DbgSignal{1..12}_FA
              DataSendPoints_DbgSignal{1..12}_RA: accessed-variable=VCU_0xE6.DbgSignal{1..12}_RA
              DataSendPoints_ECM_UDS_Res_Byte{0..7}: accessed-variable=UDS_Phy_Tx_7E8_ECM.ECM_UDS_Res_Byte{0..7}
              DataSendPoints_VCU_BCM_Authentication_MAC_A{0..15}: accessed-variable=VCU_0x1E5.VCU_BCM_Authentication_MAC_A{0..15}
              DataSendPoints_VCU_BCM_Authentication_Challenge_B{0..3}: accessed-variable=VCU_0x1E5.VCU_BCM_Authentication_Challenge_B{0..3}
              DataSendPoints_EddyCur_Para_Cos_m: accessed-variable=MCU_0x5CA.EddyCur_Para_Cos_m
              DataSendPoints_EddyCur_Stage: accessed-variable=MCU_0x5CA.EddyCur_Stage
              DataSendPoints_EddyCur_IdenFinish_Flag: accessed-variable=MCU_0x5CA.EddyCur_IdenFinish_Flag
              DataSendPoints_EddyCur_Para_Sin_m: accessed-variable=MCU_0x5CA.EddyCur_Para_Sin_m
              DataSendPoints_EddyCur_Write_Flag: accessed-variable=MCU_0x5CA.EddyCur_Write_Flag
              DataSendPoints_EddyCur_FauPro_IDEL_OTime_Flag: accessed-variable=MCU_0x5CA.EddyCur_FauPro_IDEL_OTime_Flag
              DataSendPoints_EddyCur_FauPro_SpdInstab_Flag: accessed-variable=MCU_0x5CA.EddyCur_FauPro_SpdInstab_Flag
              DataSendPoints_EddyCur_FauPro_IDPara_OVal_Flag: accessed-variable=MCU_0x5CA.EddyCur_FauPro_IDPara_OVal_Flag
              DataSendPoints_EddyCur_Para_Cos_k: accessed-variable=MCU_0x5CA.EddyCur_Para_Cos_k
              DataSendPoints_EddyCur_Enable: accessed-variable=MCU_0x5CA.EddyCur_Enable
              DataSendPoints_EddyCur_Para_Sin_k: accessed-variable=MCU_0x5CA.EddyCur_Para_Sin_k
              DataSendPoints_EddyCur_IdenFail_Flag: accessed-variable=MCU_0x5CA.EddyCur_IdenFail_Flag
              DataSendPoints_EddyCur_Para_Cos_Pha: accessed-variable=MCU_0x5CA.EddyCur_Para_Cos_Pha
              DataSendPoints_EddyCur_Para_Sin_Pha: accessed-variable=MCU_0x5CA.EddyCur_Para_Sin_Pha
              DataSendPoints_EddyCur_ReadSuccess_Flag: accessed-variable=MCU_0x5CA.EddyCur_ReadSuccess_Flag
              DataSendPoints_OfsIden_ReadSuccess_Flag: accessed-variable=MCU_0x5CA.OfsIden_ReadSuccess_Flag
              DataSendPoints_OfsIden_SpdUp_Overtime: accessed-variable=MCU_0x5CA.OfsIden_SpdUp_Overtime
              DataSendPoints_OfsIden_SpdUp_OverSpd: accessed-variable=MCU_0x5CA.OfsIden_SpdUp_OverSpd
              DataSendPoints_OfsIden_IdenDiverge: accessed-variable=MCU_0x5CA.OfsIden_IdenDiverge
              DataSendPoints_OfsIden_IdenCntOver: accessed-variable=MCU_0x5CA.OfsIden_IdenCntOver
              DataSendPoints_OfsIden_MtrLock: accessed-variable=MCU_0x5CA.OfsIden_MtrLock
              DataSendPoints_OfsIden_OfsRslt: accessed-variable=MCU_0x5CA.OfsIden_OfsRslt
              DataSendPoints_OfsIden_Sts: accessed-variable=MCU_0x5CA.OfsIden_Sts
              DataSendPoints_OfsIden_Finish: accessed-variable=MCU_0x5CA.OfsIden_Finish
              DataSendPoints_OfsIden_OfsWrite_Finish: accessed-variable=MCU_0x5CA.OfsIden_OfsWrite_Finish
              DataSendPoints_OfsIden_DirWrite_Finish: accessed-variable=MCU_0x5CA.OfsIden_DirWrite_Finish
              DataSendPoints_OfsIden_DirIden_Rslt: accessed-variable=MCU_0x5CA.OfsIden_DirIden_Rslt
              DataSendPoints_OfsIden_ZeroAlign_OverTime: accessed-variable=MCU_0x5CA.OfsIden_ZeroAlign_OverTime
              DataSendPoints_OfsIden_ZeroAlign_Fail: accessed-variable=MCU_0x5CA.OfsIden_ZeroAlign_Fail
              DataSendPoints_OfsIden_IFStart_Overtime: accessed-variable=MCU_0x5CA.OfsIden_IFStart_Overtime
              DataSendPoints_OfsIden_IFStart_Fail: accessed-variable=MCU_0x5CA.OfsIden_IFStart_Fail
              DataSendPoints_PosDly_Cal_RslvDelayTime: accessed-variable=MCU_0x5CA.PosDly_Cal_RslvDelayTime
              DataSendPoints_PosDly_Theta_k_Std: accessed-variable=MCU_0x5CA.PosDly_Theta_k_Std
              DataSendPoints_PosDly_Supplier: accessed-variable=MCU_0x5CA.PosDly_Supplier
              DataSendPoints_PosDly_FauPro_Ident_OTm_Flag: accessed-variable=MCU_0x5CA.PosDly_FauPro_Ident_OTm_Flag
              DataSendPoints_PosDly_FauPro_SpdDn_OTm_Flag: accessed-variable=MCU_0x5CA.PosDly_FauPro_SpdDn_OTm_Flag
              DataSendPoints_PosDly_RslvOffsetComp: accessed-variable=MCU_0x5CA.PosDly_RslvOffsetComp
              DataSendPoints_PosDly_Enable: accessed-variable=MCU_0x5CA.PosDly_Enable
              DataSendPoints_PosDly_IdentFail_Flag: accessed-variable=MCU_0x5CA.PosDly_IdentFail_Flag
              DataSendPoints_PosDly_IdentFinish_Flag: accessed-variable=MCU_0x5CA.PosDly_IdentFinish_Flag
              DataSendPoints_PosDly_Write_Flag: accessed-variable=MCU_0x5CA.PosDly_Write_Flag
              DataSendPoints_PosDly_FauPro_Chk_DlyTime_OVal: accessed-variable=MCU_0x5CA.PosDly_FauPro_Chk_DlyTime_OVal
              DataSendPoints_PosDly_FauPro_Chk_RslvOfst_OVal: accessed-variable=MCU_0x5CA.PosDly_FauPro_Chk_RslvOfst_OVal
              DataSendPoints_PosDly_FauPro_Check_Divergence: accessed-variable=MCU_0x5CA.PosDly_FauPro_Check_Divergence
              DataSendPoints_PosDly_FauPro_SpdUp_OTm_Flag: accessed-variable=MCU_0x5CA.PosDly_FauPro_SpdUp_OTm_Flag
              DataSendPoints_PosDly_Stage: accessed-variable=MCU_0x5CA.PosDly_Stage
              DataSendPoints_IMParaIdent_ParEstMainStep: accessed-variable=MCU_0x5CA.IMParaIdent_ParEstMainStep
              DataSendPoints_IMParaIdent_Rs: accessed-variable=MCU_0x5CA.IMParaIdent_Rs
              DataSendPoints_IMParaIdent_Rr: accessed-variable=MCU_0x5CA.IMParaIdent_Rr
              DataSendPoints_IMParaIdent_Ll: accessed-variable=MCU_0x5CA.IMParaIdent_Ll
              DataSendPoints_IMParaIdent_Lm: accessed-variable=MCU_0x5CA.IMParaIdent_Lm
              DataSendPoints_IMParaIdent_TotalLo: accessed-variable=MCU_0x5CA.IMParaIdent_TotalLo
              DataSendPoints_IMParaIdent_IdentSubStep: accessed-variable=MCU_0x5CA.IMParaIdent_IdentSubStep
              DataSendPoints_MCUMR_EddyCur_Para_Cos_m: accessed-variable=MCU_0x5CA.MCUMR_EddyCur_Para_Cos_m
              DataSendPoints_MCUMR_EddyCur_Stage: accessed-variable=MCU_0x5CA.MCUMR_EddyCur_Stage
              DataSendPoints_MCUMR_EddyCur_IdenFinish_Flag: accessed-variable=MCU_0x5CA.MCUMR_EddyCur_IdenFinish_Flag
              DataSendPoints_MCUMR_EddyCur_Para_Sin_m: accessed-variable=MCU_0x5CA.MCUMR_EddyCur_Para_Sin_m
              DataSendPoints_MCUMR_EddyCur_Write_Flag: accessed-variable=MCU_0x5CA.MCUMR_EddyCur_Write_Flag
              DataSendPoints_MCUMR_EddyCur_FauPro_IDEL_OTime_Flag: accessed-variable=MCU_0x5CA.MCUMR_EddyCur_FauPro_IDEL_OTime_Flag
              DataSendPoints_MCUMR_EddyCur_FauPro_SpdInstab_Flag: accessed-variable=MCU_0x5CA.MCUMR_EddyCur_FauPro_SpdInstab_Flag
              DataSendPoints_MCUMR_EddyCur_FauPro_IDPara_OVal_Flag: accessed-variable=MCU_0x5CA.MCUMR_EddyCur_FauPro_IDPara_OVal_Flag
              DataSendPoints_MCUMR_EddyCur_Para_Cos_k: accessed-variable=MCU_0x5CA.MCUMR_EddyCur_Para_Cos_k
              DataSendPoints_MCUMR_EddyCur_Enable: accessed-variable=MCU_0x5CA.MCUMR_EddyCur_Enable
              DataSendPoints_MCUMR_EddyCur_Para_Sin_k: accessed-variable=MCU_0x5CA.MCUMR_EddyCur_Para_Sin_k
              DataSendPoints_MCUMR_EddyCur_IdenFail_Flag: accessed-variable=MCU_0x5CA.MCUMR_EddyCur_IdenFail_Flag
              DataSendPoints_MCUMR_EddyCur_Para_Cos_Pha: accessed-variable=MCU_0x5CA.MCUMR_EddyCur_Para_Cos_Pha
              DataSendPoints_MCUMR_EddyCur_Para_Sin_Pha: accessed-variable=MCU_0x5CA.MCUMR_EddyCur_Para_Sin_Pha
              DataSendPoints_MCUMR_EddyCur_ReadSuccess_Flag: accessed-variable=MCU_0x5CA.MCUMR_EddyCur_ReadSuccess_Flag
              DataSendPoints_MCUMR_OfsIden_ReadSuccess_Flag: accessed-variable=MCU_0x5CA.MCUMR_OfsIden_ReadSuccess_Flag
              DataSendPoints_MCUMR_OfsIden_SpdUp_Overtime: accessed-variable=MCU_0x5CA.MCUMR_OfsIden_SpdUp_Overtime
              DataSendPoints_MCUMR_OfsIden_SpdUp_OverSpd: accessed-variable=MCU_0x5CA.MCUMR_OfsIden_SpdUp_OverSpd
              DataSendPoints_MCUMR_OfsIden_IdenDiverge: accessed-variable=MCU_0x5CA.MCUMR_OfsIden_IdenDiverge
              DataSendPoints_MCUMR_OfsIden_IdenCntOver: accessed-variable=MCU_0x5CA.MCUMR_OfsIden_IdenCntOver
              DataSendPoints_MCUMR_OfsIden_MtrLock: accessed-variable=MCU_0x5CA.MCUMR_OfsIden_MtrLock
              DataSendPoints_MCUMR_OfsIden_OfsRslt: accessed-variable=MCU_0x5CA.MCUMR_OfsIden_OfsRslt
              DataSendPoints_MCUMR_OfsIden_Sts: accessed-variable=MCU_0x5CA.MCUMR_OfsIden_Sts
              DataSendPoints_MCUMR_OfsIden_Finish: accessed-variable=MCU_0x5CA.MCUMR_OfsIden_Finish
              DataSendPoints_MCUMR_OfsIden_OfsWrite_Finish: accessed-variable=MCU_0x5CA.MCUMR_OfsIden_OfsWrite_Finish
              DataSendPoints_MCUMR_OfsIden_DirWrite_Finish: accessed-variable=MCU_0x5CA.MCUMR_OfsIden_DirWrite_Finish
              DataSendPoints_MCUMR_OfsIden_DirIden_Rslt: accessed-variable=MCU_0x5CA.MCUMR_OfsIden_DirIden_Rslt
              DataSendPoints_MCUMR_OfsIden_ZeroAlign_OverTime: accessed-variable=MCU_0x5CA.MCUMR_OfsIden_ZeroAlign_OverTime
              DataSendPoints_MCUMR_OfsIden_ZeroAlign_Fail: accessed-variable=MCU_0x5CA.MCUMR_OfsIden_ZeroAlign_Fail
              DataSendPoints_MCUMR_OfsIden_IFStart_Overtime: accessed-variable=MCU_0x5CA.MCUMR_OfsIden_IFStart_Overtime
              DataSendPoints_MCUMR_OfsIden_IFStart_Fail: accessed-variable=MCU_0x5CA.MCUMR_OfsIden_IFStart_Fail
              DataSendPoints_MCUM_StatorTemp_1: accessed-variable=MCUM_0x5D3.MCUM_StatorTemp_1
              DataSendPoints_MCUM_L2TqAct: accessed-variable=MCUM_0x5D3.MCUM_L2TqAct
              DataSendPoints_MCUM_EOPSw: accessed-variable=MCUM_0x5D3.MCUM_EOPSw
              DataSendPoints_MCUM_StatorTemp_2: accessed-variable=MCUM_0x5D3.MCUM_StatorTemp_2
              DataSendPoints_MCUM_IGBTTemp_U: accessed-variable=MCUM_0x5D3.MCUM_IGBTTemp_U
              DataSendPoints_MCUM_IGBTTemp_V: accessed-variable=MCUM_0x5D3.MCUM_IGBTTemp_V
              DataSendPoints_MCUM_IGBTTemp_W: accessed-variable=MCUM_0x5D3.MCUM_IGBTTemp_W
              DataSendPoints_MCUM_PCBTemp: accessed-variable=MCUM_0x5D3.MCUM_PCBTemp
              DataSendPoints_MCUM_Power_12V: accessed-variable=MCUM_0x5D3.MCUM_Power_12V
              DataSendPoints_MCUM_Power_15V: accessed-variable=MCUM_0x5D3.MCUM_Power_15V
              DataSendPoints_MCUM_Offset_IU: accessed-variable=MCUM_0x5D3.MCUM_Offset_IU
              DataSendPoints_MCUM_Offset_IV: accessed-variable=MCUM_0x5D3.MCUM_Offset_IV
              DataSendPoints_MCUM_Offset_IW: accessed-variable=MCUM_0x5D3.MCUM_Offset_IW
              DataSendPoints_MCUM_MainSt_State: accessed-variable=MCUM_0x5D3.MCUM_MainSt_State
              DataSendPoints_MCUM_Derate_Reason: accessed-variable=MCUM_0x5D3.MCUM_Derate_Reason
              DataSendPoints_MCUM_PWM_Freq_kHz: accessed-variable=MCUM_0x5D3.MCUM_PWM_Freq_kHz
              DataSendPoints_MCUM_PWMEn_State: accessed-variable=MCUM_0x5D3.MCUM_PWMEn_State
              DataSendPoints_MCUM_DrvPwrEn_Out_State: accessed-variable=MCUM_0x5D3.MCUM_DrvPwrEn_Out_State
              DataSendPoints_MCUM_SBC_SelfCheckFault: accessed-variable=MCUM_0x5D3.MCUM_SBC_SelfCheckFault
              DataSendPoints_MCUM_SBC_TempOverFault: accessed-variable=MCUM_0x5D3.MCUM_SBC_TempOverFault
              DataSendPoints_MCUM_SBC_SPIFault: accessed-variable=MCUM_0x5D3.MCUM_SBC_SPIFault
              DataSendPoints_MCUM_SBC_InsideVotageFault: accessed-variable=MCUM_0x5D3.MCUM_SBC_InsideVotageFault
              DataSendPoints_MCUM_SBC_OutPutVotageFault: accessed-variable=MCUM_0x5D3.MCUM_SBC_OutPutVotageFault
              DataSendPoints_MCUM_SBC_FeedDogFault: accessed-variable=MCUM_0x5D3.MCUM_SBC_FeedDogFault
              DataSendPoints_MCUM_NVM_RslvrZeroRFault: accessed-variable=MCUM_0x5D3.MCUM_NVM_RslvrZeroRFault
              DataSendPoints_MCUM_Rotor_Position: accessed-variable=MCUM_0x5D3.MCUM_Rotor_Position
              DataSendPoints_MCUM_PosTransduserFaultCode: accessed-variable=MCUM_0x5D3.MCUM_PosTransduserFaultCode
              DataSendPoints_MCUM_NVM_RslvrDirRFault: accessed-variable=MCUM_0x5D3.MCUM_NVM_RslvrDirRFault
              DataSendPoints_MCUM_NVM_RslvrDelayRFault: accessed-variable=MCUM_0x5D3.MCUM_NVM_RslvrDelayRFault
              DataSendPoints_MCUM_NVM_RslvrParamRFault: accessed-variable=MCUM_0x5D3.MCUM_NVM_RslvrParamRFault
              DataSendPoints_MCUM_NVM_HallGainRFault: accessed-variable=MCUM_0x5D3.MCUM_NVM_HallGainRFault
              DataSendPoints_MCUM_NVM_HallDelayRFault: accessed-variable=MCUM_0x5D3.MCUM_NVM_HallDelayRFault
              DataSendPoints_MCUM_NVM_IGBTTypeRFault: accessed-variable=MCUM_0x5D3.MCUM_NVM_IGBTTypeRFault
              DataSendPoints_MCUM_NVM_MotorTypeRFault: accessed-variable=MCUM_0x5D3.MCUM_NVM_MotorTypeRFault
              DataSendPoints_MCUM_NVM_VehicleTypeRFault: accessed-variable=MCUM_0x5D3.MCUM_NVM_VehicleTypeRFault
              DataSendPoints_MCUM_ASC_EntryCount: accessed-variable=MCUM_0x5D3.MCUM_ASC_EntryCount
              DataSendPoints_MCUM_Spd_Turn: accessed-variable=MCUM_0x5D3.MCUM_Spd_Turn
              DataSendPoints_MCUM_LUT_Spd_Max: accessed-variable=MCUM_0x5D3.MCUM_LUT_Spd_Max
              DataSendPoints_MCUM_EOP_Speed: accessed-variable=MCUM_0x5D3.MCUM_EOP_Speed
              DataSendPoints_MCUM_EOP_IqFb: accessed-variable=MCUM_0x5D3.MCUM_EOP_IqFb
              DataSendPoints_MCUM_EOP_IqRef: accessed-variable=MCUM_0x5D3.MCUM_EOP_IqRef
              DataSendPoints_MCUM_EOP_DCVolt: accessed-variable=MCUM_0x5D3.MCUM_EOP_DCVolt
              DataSendPoints_MCUM_EOP_DCCurr: accessed-variable=MCUM_0x5D3.MCUM_EOP_DCCurr
              DataSendPoints_MCUM_EOP_Temp: accessed-variable=MCUM_0x5D3.MCUM_EOP_Temp
              DataSendPoints_MCUM_EOP_State: accessed-variable=MCUM_0x5D3.MCUM_EOP_State
              DataSendPoints_MCUM_EOP_FaultCode: accessed-variable=MCUM_0x5D3.MCUM_EOP_FaultCode
              DataSendPoints_MCUM_HWFault_RstCnt: accessed-variable=MCUM_0x5D3.MCUM_HWFault_RstCnt
              DataSendPoints_MCUM_HWFoB_RstCnt: accessed-variable=MCUM_0x5D3.MCUM_HWFoB_RstCnt
              DataSendPoints_MCUM_HWFoT_RstCnt: accessed-variable=MCUM_0x5D3.MCUM_HWFoT_RstCnt
              DataSendPoints_MCUM_HWDrvUV_RstCnt: accessed-variable=MCUM_0x5D3.MCUM_HWDrvUV_RstCnt
              DataSendPoints_MCUM_HWRdc_RstCnt: accessed-variable=MCUM_0x5D3.MCUM_HWRdc_RstCnt
              DataSendPoints_MCUM_HWOC_RstCnt: accessed-variable=MCUM_0x5D3.MCUM_HWOC_RstCnt
              DataSendPoints_MCUM_HWOV_RstCnt: accessed-variable=MCUM_0x5D3.MCUM_HWOV_RstCnt
              DataSendPoints_MCUM_L2agRtrElecDiff: accessed-variable=MCUM_0x5D3.MCUM_L2agRtrElecDiff
              DataSendPoints_MCUM_500usOverTime_Cnt: accessed-variable=MCUM_0x5D3.MCUM_500usOverTime_Cnt
              DataSendPoints_MCUM_5msOverTime_Cnt: accessed-variable=MCUM_0x5D3.MCUM_5msOverTime_Cnt
              DataSendPoints_MCUM_12VHop_Cnt: accessed-variable=MCUM_0x5D3.MCUM_12VHop_Cnt
              DataSendPoints_MCUM_12V_Max: accessed-variable=MCUM_0x5D3.MCUM_12V_Max
              DataSendPoints_MCUM_12V_Min: accessed-variable=MCUM_0x5D3.MCUM_12V_Min
              DataSendPoints_MCUM_NVMFail_Cnt: accessed-variable=MCUM_0x5D3.MCUM_NVMFail_Cnt
              DataSendPoints_MCUM_EOL_CANCommReq: accessed-variable=MCUM_0x5D3.MCUM_EOL_CANCommReq
              DataSendPoints_MCUM_ResetReason: accessed-variable=MCUM_0x5D3.MCUM_ResetReason
              DataSendPoints_MCUM_CpldRest_TimeOut_flag: accessed-variable=MCUM_0x5D3.MCUM_CpldRest_TimeOut_flag
              DataSendPoints_MCUM_DrvPCBCurr: accessed-variable=MCUM_0x5D3.MCUM_DrvPCBCurr
              DataSendPoints_MCUM_EOL_StateMachine: accessed-variable=MCUM_0x5D3.MCUM_EOL_StateMachine
              DataSendPoints_MCUM_CpldRest_ASC_Flag: accessed-variable=MCUM_0x5D3.MCUM_CpldRest_ASC_Flag
              DataSendPoints_MCUM_LimSpdTorFlag: accessed-variable=MCUM_0x5D3.MCUM_LimSpdTorFlag
              DataSendPoints_MCUM_PWM_Err_Count: accessed-variable=MCUM_0x5D3.MCUM_PWM_Err_Count
              DataSendPoints_MCUM_RDC_Reset_Count: accessed-variable=MCUM_0x5D3.MCUM_RDC_Reset_Count
              DataSendPoints_MCUM_ASC_Stop_Flag: accessed-variable=MCUM_0x5D3.MCUM_ASC_Stop_Flag
              DataSendPoints_MCUM_ASC_Soft_Exiting_Flag: accessed-variable=MCUM_0x5D3.MCUM_ASC_Soft_Exiting_Flag
              DataSendPoints_MCUM_Vbus_ServeLowChkEn: accessed-variable=MCUM_0x5D3.MCUM_Vbus_ServeLowChkEn
              DataSendPoints_MCUM_EOP_BlockErr_IsLim_Flag: accessed-variable=MCUM_0x5D3.MCUM_EOP_BlockErr_IsLim_Flag
              DataSendPoints_MCUM_MotSelfHeat_EnSts: accessed-variable=MCUM_0x5D3.MCUM_MotSelfHeat_EnSts
              DataSendPoints_MCUM_MotBlockHeat_LvlFb: accessed-variable=MCUM_0x5D3.MCUM_MotBlockHeat_LvlFb
              DataSendPoints_MCUM_MotRotaryHeat_LvlFb: accessed-variable=MCUM_0x5D3.MCUM_MotRotaryHeat_LvlFb
              DataSendPoints_MCUM_MotSelfHeat_DropLvlFb: accessed-variable=MCUM_0x5D3.MCUM_MotSelfHeat_DropLvlFb
              DataSendPoints_MCUM_MotSelfHeat_DropLvlRsn: accessed-variable=MCUM_0x5D3.MCUM_MotSelfHeat_DropLvlRsn
              DataSendPoints_MCUM_MotBlockHeat_CurAngle: accessed-variable=MCUM_0x5D3.MCUM_MotBlockHeat_CurAngle
              DataSendPoints_MCUM_MotBlockHeat_CurMag: accessed-variable=MCUM_0x5D3.MCUM_MotBlockHeat_CurMag
              DataSendPoints_MCUM_FaultDataRec_State: accessed-variable=MCUM_0x5D3.MCUM_FaultDataRec_State
              DataSendPoints_MCUM_UserDefine_Byte{1..4}: accessed-variable=MCUM_0x5D3.MCUM_UserDefine_Byte{1..4}
              DataSendPoints_MCUM_UserDefine_Word{1..3}: accessed-variable=MCUM_0x5D3.MCUM_UserDefine_Word{1..3}
              DataSendPoints_GTC_TestSts: accessed-variable=MCU_0x5CB.GTC_TestSts
              DataSendPoints_GTC_ThetaPos: accessed-variable=MCU_0x5CB.GTC_ThetaPos
              DataSendPoints_GTC_ThetaNeg: accessed-variable=MCU_0x5CB.GTC_ThetaNeg
              DataSendPoints_GTC_ThetaDelt: accessed-variable=MCU_0x5CB.GTC_ThetaDelt
              DataSendPoints_GTC_TestRslt: accessed-variable=MCU_0x5CB.GTC_TestRslt
              DataSendPoints_MCUMR_GTC_TestSts: accessed-variable=MCU_0x5CB.MCUMR_GTC_TestSts
              DataSendPoints_MCUMR_GTC_ThetaPos: accessed-variable=MCU_0x5CB.MCUMR_GTC_ThetaPos
              DataSendPoints_MCUMR_GTC_ThetaNeg: accessed-variable=MCU_0x5CB.MCUMR_GTC_ThetaNeg
              DataSendPoints_MCUMR_GTC_ThetaDelt: accessed-variable=MCU_0x5CB.MCUMR_GTC_ThetaDelt
              DataSendPoints_MCUMR_GTC_TestRslt: accessed-variable=MCU_0x5CB.MCUMR_GTC_TestRslt
              DataSendPoints_MCUM_CRC_CA: accessed-variable=MCUM_0xCA.MCUM_CRC_CA
              DataSendPoints_MCUM_RollingCounter_CA: accessed-variable=MCUM_0xCA.MCUM_RollingCounter_CA
              DataSendPoints_MCUM_WarningLevel: accessed-variable=MCUM_0xCA.MCUM_WarningLevel
              DataSendPoints_MCUM_SelfCheckSts: accessed-variable=MCUM_0xCA.MCUM_SelfCheckSts
              DataSendPoints_MCUM_DrvMotorWorkSts: accessed-variable=MCUM_0xCA.MCUM_DrvMotorWorkSts
              DataSendPoints_MCUM_PowerReduceSts: accessed-variable=MCUM_0xCA.MCUM_PowerReduceSts
              DataSendPoints_MCUM_SystemError: accessed-variable=MCUM_0xCA.MCUM_SystemError
              DataSendPoints_MCUM_DrvMotorRPM: accessed-variable=MCUM_0xCA.MCUM_DrvMotorRPM
              DataSendPoints_MCUM_ActualTorqueFB: accessed-variable=MCUM_0xCA.MCUM_ActualTorqueFB
              DataSendPoints_MCUM_HWRdcFault: accessed-variable=MCUM_0xCA.MCUM_HWRdcFault
              DataSendPoints_MCUM_LVSystemError: accessed-variable=MCUM_0xCA.MCUM_LVSystemError
              DataSendPoints_MCUM_HighVoltPowerOffReq: accessed-variable=MCUM_0xCA.MCUM_HighVoltPowerOffReq
              DataSendPoints_MCUM_HVILSts: accessed-variable=MCUM_0xCA.MCUM_HVILSts
              DataSendPoints_MCUM_DragSts: accessed-variable=MCUM_0xCA.MCUM_DragSts
              DataSendPoints_MCUM_CtrlMode: accessed-variable=MCUM_0xCA.MCUM_CtrlMode
              DataSendPoints_MCUM_MotorTempAlarm: accessed-variable=MCUM_0xCA.MCUM_MotorTempAlarm
              DataSendPoints_MCUM_HVSystemError: accessed-variable=MCUM_0xCA.MCUM_HVSystemError
              DataSendPoints_MCUM_MILlampReq: accessed-variable=MCUM_0xCA.MCUM_MILlampReq
              DataSendPoints_MCUM_SeriousWarning_Level: accessed-variable=MCUM_0xCA.MCUM_SeriousWarning_Level
              DataSendPoints_MCUM_DrvMotorRPMVD: accessed-variable=MCUM_0xCA.MCUM_DrvMotorRPMVD
              DataSendPoints_MCUM_ActualTorqueFBVD: accessed-variable=MCUM_0xCA.MCUM_ActualTorqueFBVD
              DataSendPoints_MCUM_CtrlModeVD: accessed-variable=MCUM_0xCA.MCUM_CtrlModeVD
              DataSendPoints_MCUM_MaxTorqueAllow: accessed-variable=MCUM_0xCA.MCUM_MaxTorqueAllow
              DataSendPoints_MCUM_MaxSpeedAllow: accessed-variable=MCUM_0xCA.MCUM_MaxSpeedAllow
              DataSendPoints_MCUM_WaterPumpLevlReq: accessed-variable=MCUM_0xCA.MCUM_WaterPumpLevlReq
              DataSendPoints_MCUM_ActiveReleaseSts: accessed-variable=MCUM_0xCA.MCUM_ActiveReleaseSts
              DataSendPoints_MCUM_DCChargRelaySts: accessed-variable=MCUM_0xCA.MCUM_DCChargRelaySts
              DataSendPoints_MCUM_Fault_DCChargRelay: accessed-variable=MCUM_0xCA.MCUM_Fault_DCChargRelay
              DataSendPoints_MCUM_MinTorqueAllow: accessed-variable=MCUM_0xCA.MCUM_MinTorqueAllow
              DataSendPoints_MCUM_MainWireVolt: accessed-variable=MCUM_0xCA.MCUM_MainWireVolt
              DataSendPoints_MCUM_MotorTemp: accessed-variable=MCUM_0xCA.MCUM_MotorTemp
              DataSendPoints_MCUM_IGBTTemp: accessed-variable=MCUM_0xCA.MCUM_IGBTTemp
              DataSendPoints_MCUM_InletTemp: accessed-variable=MCUM_0xCA.MCUM_InletTemp
              DataSendPoints_MCUM_MainWireCurr: accessed-variable=MCUM_0xCA.MCUM_MainWireCurr
              DataSendPoints_MCUM_TMS_MotSelfHeatEnSts: accessed-variable=MCUM_0xCA.MCUM_TMS_MotSelfHeatEnSts
              DataSendPoints_MCUM_TMS_MotSelfHeatLvlFb: accessed-variable=MCUM_0xCA.MCUM_TMS_MotSelfHeatLvlFb
              DataSendPoints_MCUM_HeatPwrAllwd: accessed-variable=MCUM_0xCA.MCUM_HeatPwrAllwd
              DataSendPoints_MCUM_HeatFdBck: accessed-variable=MCUM_0xCA.MCUM_HeatFdBck
              DataSendPoints_MCUM_RPowerReduceSts: accessed-variable=MCUM_0xCA.MCUM_RPowerReduceSts
              DataSendPoints_MCUM_HeatPwrAct: accessed-variable=MCUM_0xCA.MCUM_HeatPwrAct
              DataSendPoints_MCUM_HeatPwrMax: accessed-variable=MCUM_0xCA.MCUM_HeatPwrMax
              DataSendPoints_MCUM_HeatPwrAval: accessed-variable=MCUM_0xCA.MCUM_HeatPwrAval
              DataSendPoints_MCUM_RCtrlMode: accessed-variable=MCUM_0xCA.MCUM_RCtrlMode
              DataSendPoints_MCUM_RWarningLevel: accessed-variable=MCUM_0xCA.MCUM_RWarningLevel
              DataSendPoints_MCUM_RSelfCheckSts: accessed-variable=MCUM_0xCA.MCUM_RSelfCheckSts
              DataSendPoints_MCUM_RDrvMotorWorkSts: accessed-variable=MCUM_0xCA.MCUM_RDrvMotorWorkSts
              DataSendPoints_MCUM_RCtrlModeVD: accessed-variable=MCUM_0xCA.MCUM_RCtrlModeVD
              DataSendPoints_MCUM_RHWRdcFault: accessed-variable=MCUM_0xCA.MCUM_RHWRdcFault
              DataSendPoints_MCUM_RDrvMotorRPMVD: accessed-variable=MCUM_0xCA.MCUM_RDrvMotorRPMVD
              DataSendPoints_MCUM_RActualTorqueFBVD: accessed-variable=MCUM_0xCA.MCUM_RActualTorqueFBVD
              DataSendPoints_MCUM_RDrvMotorRPM: accessed-variable=MCUM_0xCA.MCUM_RDrvMotorRPM
              DataSendPoints_MCUM_RActualTorqueFB: accessed-variable=MCUM_0xCA.MCUM_RActualTorqueFB
              DataSendPoints_MCUM_FaultData{0..14}: accessed-variable=MCUM_0x605.MCUM_FaultData{0..14}
              DataSendPoints_MCUM_R_FaultData{0..14}: accessed-variable=MCUM_0x607.MCUM_R_FaultData{0..14}
              DataSendPoints_MotClb_UdFb: accessed-variable=MCU_0x5C4.MotClb_UdFb
              DataSendPoints_MotClb_UqFb: accessed-variable=MCU_0x5C4.MotClb_UqFb
              DataSendPoints_MotClb_IdSet: accessed-variable=MCU_0x5C4.MotClb_IdSet
              DataSendPoints_MotClb_IqSet: accessed-variable=MCU_0x5C4.MotClb_IqSet
              DataSendPoints_MotClb_IsCMD_Fb: accessed-variable=MCU_0x5C4.MotClb_IsCMD_Fb
              DataSendPoints_MotClb_ThetaCMD_Fb: accessed-variable=MCU_0x5C4.MotClb_ThetaCMD_Fb
              DataSendPoints_MotClb_Id_Fb: accessed-variable=MCU_0x5C4.MotClb_Id_Fb
              DataSendPoints_MotClb_Iq_Fb: accessed-variable=MCU_0x5C4.MotClb_Iq_Fb
              DataSendPoints_MotClb_Spd_rpm_Flt: accessed-variable=MCU_0x5C4.MotClb_Spd_rpm_Flt
              DataSendPoints_MotClb_ThtSetReal: accessed-variable=MCU_0x5C4.MotClb_ThtSetReal
              DataSendPoints_MotClb_Power_Inverter: accessed-variable=MCU_0x5C4.MotClb_Power_Inverter
              DataSendPoints_MotClb_Volt_DC: accessed-variable=MCU_0x5C4.MotClb_Volt_DC
              DataSendPoints_MotClb_UsOutFlt: accessed-variable=MCU_0x5C4.MotClb_UsOutFlt
              DataSendPoints_MotClb_CoolWater_Temp: accessed-variable=MCU_0x5C4.MotClb_CoolWater_Temp
              DataSendPoints_MotClb_Motor_Temp1_Flt: accessed-variable=MCU_0x5C4.MotClb_Motor_Temp1_Flt
              DataSendPoints_MotClb_IGBT_Temp1: accessed-variable=MCU_0x5C4.MotClb_IGBT_Temp1
              DataSendPoints_MotClb_ErrLevel: accessed-variable=MCU_0x5C4.MotClb_ErrLevel
              DataSendPoints_MCUMR_MotClb_UdFb: accessed-variable=MCU_0x5C4.MCUMR_MotClb_UdFb
              DataSendPoints_MCUMR_MotClb_UqFb: accessed-variable=MCU_0x5C4.MCUMR_MotClb_UqFb
              DataSendPoints_MCUMR_MotClb_IdSet: accessed-variable=MCU_0x5C4.MCUMR_MotClb_IdSet
              DataSendPoints_MCUMR_MotClb_IqSet: accessed-variable=MCU_0x5C4.MCUMR_MotClb_IqSet
              DataSendPoints_MCUMR_MotClb_IsCMD_Fb: accessed-variable=MCU_0x5C4.MCUMR_MotClb_IsCMD_Fb
              DataSendPoints_MCUMR_MotClb_ThetaCMD_Fb: accessed-variable=MCU_0x5C4.MCUMR_MotClb_ThetaCMD_Fb
              DataSendPoints_MCUMR_MotClb_Id_Fb: accessed-variable=MCU_0x5C4.MCUMR_MotClb_Id_Fb
              DataSendPoints_MCUMR_MotClb_Iq_Fb: accessed-variable=MCU_0x5C4.MCUMR_MotClb_Iq_Fb
              DataSendPoints_MCUMR_MotClb_Spd_rpm_Flt: accessed-variable=MCU_0x5C4.MCUMR_MotClb_Spd_rpm_Flt
              DataSendPoints_MCUMR_MotClb_ThtSetReal: accessed-variable=MCU_0x5C4.MCUMR_MotClb_ThtSetReal
              DataSendPoints_MCUMR_MotClb_Power_Inverter: accessed-variable=MCU_0x5C4.MCUMR_MotClb_Power_Inverter
              DataSendPoints_MCUMR_MotClb_Volt_DC: accessed-variable=MCU_0x5C4.MCUMR_MotClb_Volt_DC
              DataSendPoints_MCUMR_MotClb_UsOutFlt: accessed-variable=MCU_0x5C4.MCUMR_MotClb_UsOutFlt
              DataSendPoints_MCUMR_MotClb_CoolWater_Temp: accessed-variable=MCU_0x5C4.MCUMR_MotClb_CoolWater_Temp
              DataSendPoints_MCUMR_MotClb_Motor_Temp1_Flt: accessed-variable=MCU_0x5C4.MCUMR_MotClb_Motor_Temp1_Flt
              DataSendPoints_MCUMR_MotClb_IGBT_Temp1: accessed-variable=MCU_0x5C4.MCUMR_MotClb_IGBT_Temp1
              DataSendPoints_MCUMR_MotClb_ErrLevel: accessed-variable=MCU_0x5C4.MCUMR_MotClb_ErrLevel
              DataSendPoints_VCU_CRC_13B: accessed-variable=VCU_0x13B.VCU_CRC_13B
              DataSendPoints_VCU_RollingCounter_13B: accessed-variable=VCU_0x13B.VCU_RollingCounter_13B
              DataSendPoints_VCU_Vehicle_Warning: accessed-variable=VCU_0x13B.VCU_Vehicle_Warning
              DataSendPoints_VCU_VehicleSts: accessed-variable=VCU_0x13B.VCU_VehicleSts
              DataSendPoints_VCU_GearLevelPosSts: accessed-variable=VCU_0x13B.VCU_GearLevelPosSts
              DataSendPoints_VCU_GearLeverValid: accessed-variable=VCU_0x13B.VCU_GearLeverValid
              DataSendPoints_VCU_AccPedalValid: accessed-variable=VCU_0x13B.VCU_AccPedalValid
              DataSendPoints_VCU_ThrottlePosition: accessed-variable=VCU_0x13B.VCU_ThrottlePosition
              DataSendPoints_VCU_BMSMainRelayR_Cmd: accessed-variable=VCU_0x13B.VCU_BMSMainRelayR_Cmd
              DataSendPoints_VCU_BMSMainRelayF_Cmd: accessed-variable=VCU_0x13B.VCU_BMSMainRelayF_Cmd
              DataSendPoints_VCU_BMSEmergencyCmd: accessed-variable=VCU_0x13B.VCU_BMSEmergencyCmd
              DataSendPoints_VCU_MCUMActiveReleaseCmd: accessed-variable=VCU_0x13B.VCU_MCUMActiveReleaseCmd
              DataSendPoints_VCU_MCUSActiveReleaseCmd: accessed-variable=VCU_0x13B.VCU_MCUSActiveReleaseCmd
              DataSendPoints_VCU_AlwACChargeInventerSts: accessed-variable=VCU_0x13B.VCU_AlwACChargeInventerSts
              DataSendPoints_VCU_AlwDCChargeSts: accessed-variable=VCU_0x13B.VCU_AlwDCChargeSts
              DataSendPoints_VCU_ChargePauseReq: accessed-variable=VCU_0x13B.VCU_ChargePauseReq
              DataSendPoints_VCU_SuppressJitterMCUSRequest: accessed-variable=VCU_0x13B.VCU_SuppressJitterMCUSRequest
              DataSendPoints_VCU_DCDCEnableCmd: accessed-variable=VCU_0x13B.VCU_DCDCEnableCmd
              DataSendPoints_VCU_ACOffReq: accessed-variable=VCU_0x13B.VCU_ACOffReq
              DataSendPoints_VCU_VehicleDirect: accessed-variable=VCU_0x13B.VCU_VehicleDirect
              DataSendPoints_VCU_BrakeSysFault: accessed-variable=VCU_0x13B.VCU_BrakeSysFault
              DataSendPoints_VCU_SuppressJitterMCUMRequest: accessed-variable=VCU_0x13B.VCU_SuppressJitterMCUMRequest
              DataSendPoints_VCU_MDrvControlMode: accessed-variable=VCU_0x13B.VCU_MDrvControlMode
              DataSendPoints_VCU_BrakePedalValue: accessed-variable=VCU_0x13B.VCU_BrakePedalValue
              DataSendPoints_VCU_MCUMMaxDischargePower: accessed-variable=VCU_0x13B.VCU_MCUMMaxDischargePower
              DataSendPoints_VCU_MCUMMaxChargePower: accessed-variable=VCU_0x13B.VCU_MCUMMaxChargePower
              DataSendPoints_VCU_MDrvRequestTorque: accessed-variable=VCU_0x13B.VCU_MDrvRequestTorque
              DataSendPoints_VCU_MDrvRequesSpeed: accessed-variable=VCU_0x13B.VCU_MDrvRequesSpeed
              DataSendPoints_VCU_SDrvRequestTorque: accessed-variable=VCU_0x13B.VCU_SDrvRequestTorque
              DataSendPoints_VCU_SDrvRequesSpeed: accessed-variable=VCU_0x13B.VCU_SDrvRequesSpeed
              DataSendPoints_VCU_SVehicleSts: accessed-variable=VCU_0x13B.VCU_SVehicleSts
              DataSendPoints_VCU_VehicleHighVoltModeF: accessed-variable=VCU_0x13B.VCU_VehicleHighVoltModeF
              DataSendPoints_VCU_SDrvControlMode: accessed-variable=VCU_0x13B.VCU_SDrvControlMode
              DataSendPoints_VCU_ON2BRelayReq: accessed-variable=VCU_0x13B.VCU_ON2BRelayReq
              DataSendPoints_VCU_VehPreHVPwrOffCmd: accessed-variable=VCU_0x13B.VCU_VehPreHVPwrOffCmd
              DataSendPoints_VCU_FuelTankLockReq: accessed-variable=VCU_0x13B.VCU_FuelTankLockReq
              DataSendPoints_VCU_VehicleDirectS: accessed-variable=VCU_0x13B.VCU_VehicleDirectS
              DataSendPoints_VCU_VehicleDirectS_VD: accessed-variable=VCU_0x13B.VCU_VehicleDirectS_VD
              DataSendPoints_VCU_ACPwrLimited: accessed-variable=VCU_0x13B.VCU_ACPwrLimited
              DataSendPoints_VCU_MCUSMaxDischargePower: accessed-variable=VCU_0x13B.VCU_MCUSMaxDischargePower
              DataSendPoints_VCU_VehicleDirectVD: accessed-variable=VCU_0x13B.VCU_VehicleDirectVD
              DataSendPoints_VCU_MDrvControlModeVD: accessed-variable=VCU_0x13B.VCU_MDrvControlModeVD
              DataSendPoints_VCU_MDrvRequestTorqueVD: accessed-variable=VCU_0x13B.VCU_MDrvRequestTorqueVD
              DataSendPoints_VCU_MDrvRequesSpeedVD: accessed-variable=VCU_0x13B.VCU_MDrvRequesSpeedVD
              DataSendPoints_VCU_SDrvRequestTorqueVD: accessed-variable=VCU_0x13B.VCU_SDrvRequestTorqueVD
              DataSendPoints_VCU_SDrvRequesSpeedVD: accessed-variable=VCU_0x13B.VCU_SDrvRequesSpeedVD
              DataSendPoints_VCU_SDrvControlModeVD: accessed-variable=VCU_0x13B.VCU_SDrvControlModeVD
              DataSendPoints_VCU_MCUSMaxChargePower: accessed-variable=VCU_0x13B.VCU_MCUSMaxChargePower
              DataSendPoints_VCU_VehicleHighVoltMode: accessed-variable=VCU_0x13B.VCU_VehicleHighVoltMode
              DataSendPoints_VCU_PDUHVIL_Sts: accessed-variable=VCU_0x13B.VCU_PDUHVIL_Sts
              DataSendPoints_VCU_PDU220VRelay_Req: accessed-variable=VCU_0x13B.VCU_PDU220VRelay_Req
              DataSendPoints_VCU_Cab220VRelay_Req: accessed-variable=VCU_0x13B.VCU_Cab220VRelay_Req
              DataSendPoints_VCU_Cabin220VRelay_Req: accessed-variable=VCU_0x13B.VCU_Cabin220VRelay_Req
              DataSendPoints_VCU_Alw_Cab220VInverter_Sts: accessed-variable=VCU_0x13B.VCU_Alw_Cab220VInverter_Sts
              DataSendPoints_VCU_Alw_Cabin220VInverter_Sts: accessed-variable=VCU_0x13B.VCU_Alw_Cabin220VInverter_Sts
              DataSendPoints_VCU_MCUMDampgLmtFactor: accessed-variable=VCU_0x13B.VCU_MCUMDampgLmtFactor
              DataSendPoints_VCU_MCUSDampgLmtFactor: accessed-variable=VCU_0x13B.VCU_MCUSDampgLmtFactor
              DataSendPoints_VCU_BCM_Authentication_Sts: accessed-variable=VCU_0x13B.VCU_BCM_Authentication_Sts
              DataSendPoints_VCU_AuthenticationKey_WSts: accessed-variable=VCU_0x13B.VCU_AuthenticationKey_WSts
              DataSendPoints_VCU_BrakePedalSts_P: accessed-variable=VCU_0x13B.VCU_BrakePedalSts_P
              DataSendPoints_VCU_BrakePedalStsValid_P: accessed-variable=VCU_0x13B.VCU_BrakePedalStsValid_P
              DataSendPoints_VCU_BoostMode_Fail: accessed-variable=VCU_0x13B.VCU_BoostMode_Fail
              DataSendPoints_VCU_BoostModeSts: accessed-variable=VCU_0x13B.VCU_BoostModeSts
              DataSendPoints_VCU_MCUSMaxPosDampgTrq: accessed-variable=VCU_0x13B.VCU_MCUSMaxPosDampgTrq
              DataSendPoints_VCU_MCUSMaxNegDampgTrq: accessed-variable=VCU_0x13B.VCU_MCUSMaxNegDampgTrq
              DataSendPoints_VCU_MCUMMaxPosDampgTrq: accessed-variable=VCU_0x13B.VCU_MCUMMaxPosDampgTrq
              DataSendPoints_VCU_MCUMMaxNegDampgTrq: accessed-variable=VCU_0x13B.VCU_MCUMMaxNegDampgTrq
              DataSendPoints_MCUM_UDS_SW{1..10}: accessed-variable=MCUM_0x6F8.MCUM_UDS_SW{1..10}
              DataSendPoints_MCUM_UDS_HW{1..10}: accessed-variable=MCUM_0x6F8.MCUM_UDS_HW{1..10}
              DataSendPoints_MCUM_UDS_Boot{1..10}: accessed-variable=MCUM_0x6F8.MCUM_UDS_Boot{1..10}
              DataSendPoints_MCUM_UDS_ProductModel{1..16}: accessed-variable=MCUM_0x6F8.MCUM_UDS_ProductModel{1..16}
              DataSendPoints_MCUM_UDS_Supplier{1..6}: accessed-variable=MCUM_0x6F8.MCUM_UDS_Supplier{1..6}
              DataSendPoints_VCU_BrkPedOpen: accessed-variable=VCU_0xDE.VCU_BrkPedOpen
              DataSendPoints_VCU_BrkPedClose: accessed-variable=VCU_0xDE.VCU_BrkPedClose
              DataSendPoints_VCU_ColumnShiftP: accessed-variable=VCU_0xDE.VCU_ColumnShiftP
              DataSendPoints_VCU_VehiCrashSts: accessed-variable=VCU_0xDE.VCU_VehiCrashSts
              DataSendPoints_VCU_SleepSatisfiedSts: accessed-variable=VCU_0xDE.VCU_SleepSatisfiedSts
              DataSendPoints_VCU_VehiHvCmd: accessed-variable=VCU_0xDE.VCU_VehiHvCmd
              DataSendPoints_VCU_GearQuitAps: accessed-variable=VCU_0xDE.VCU_GearQuitAps
              DataSendPoints_VCU_REOverChgPwrFlag: accessed-variable=VCU_0xDE.VCU_REOverChgPwrFlag
              DataSendPoints_VCU_VehiAccnFilt: accessed-variable=VCU_0xDE.VCU_VehiAccnFilt
              DataSendPoints_VCU_HvOffSts: accessed-variable=VCU_0xDE.VCU_HvOffSts
              DataSendPoints_VCU_ElecPwrBalanceReq: accessed-variable=VCU_0xDE.VCU_ElecPwrBalanceReq
              DataSendPoints_VCU_CDU_RecvTr: accessed-variable=VCU_0xDE.VCU_CDU_RecvTr
              DataSendPoints_VCU_BMS_RecvTr: accessed-variable=VCU_0xDE.VCU_BMS_RecvTr
              DataSendPoints_VCU_IVI_RecvTr: accessed-variable=VCU_0xDE.VCU_IVI_RecvTr
              DataSendPoints_VCU_WheelMaxDrvTrq: accessed-variable=VCU_0xDE.VCU_WheelMaxDrvTrq
              DataSendPoints_VCU_WheelMaxRecTrq: accessed-variable=VCU_0xDE.VCU_WheelMaxRecTrq
              DataSendPoints_VCU_GCU_RecvTr: accessed-variable=VCU_0xDE.VCU_GCU_RecvTr
              DataSendPoints_VCU_TCM_RecvTr: accessed-variable=VCU_0xDE.VCU_TCM_RecvTr
              DataSendPoints_VCU_PTC_RecvTr: accessed-variable=VCU_0xDE.VCU_PTC_RecvTr
              DataSendPoints_VCU_LossFctorFlgFL: accessed-variable=VCU_0xDE.VCU_LossFctorFlgFL
              DataSendPoints_VCU_LowBattVolt: accessed-variable=VCU_0xDE.VCU_LowBattVolt
              DataSendPoints_VCU_HighPerforDisable: accessed-variable=VCU_0xDE.VCU_HighPerforDisable
              DataSendPoints_VCU_AccPedHSigVolt: accessed-variable=VCU_0xDE.VCU_AccPedHSigVolt
              DataSendPoints_VCU_LossFctorFlgFR: accessed-variable=VCU_0xDE.VCU_LossFctorFlgFR
              DataSendPoints_VCU_AccPedLSigVolt: accessed-variable=VCU_0xDE.VCU_AccPedLSigVolt
              DataSendPoints_VCU_LossFctorFlgRL: accessed-variable=VCU_0xDE.VCU_LossFctorFlgRL
              DataSendPoints_VCU_AccPedHPwrVolt: accessed-variable=VCU_0xDE.VCU_AccPedHPwrVolt
              DataSendPoints_VCU_LossFctorFlgRR: accessed-variable=VCU_0xDE.VCU_LossFctorFlgRR
              DataSendPoints_VCU_AccPedLPwrVolt: accessed-variable=VCU_0xDE.VCU_AccPedLPwrVolt
              DataSendPoints_VCU_PreReqChgPwr: accessed-variable=VCU_0xDE.VCU_PreReqChgPwr
              DataSendPoints_VCU_VehPwrChageLimit: accessed-variable=VCU_0xDE.VCU_VehPwrChageLimit
              DataSendPoints_VCU_FastPwrRequest: accessed-variable=VCU_0xDE.VCU_FastPwrRequest
              DataSendPoints_VCU_On2KL15_Volt: accessed-variable=VCU_0xDE.VCU_On2KL15_Volt
              DataSendPoints_VCU_ClutchWrkModDebug: accessed-variable=VCU_0xDE.VCU_ClutchWrkModDebug
              DataSendPoints_VCU_HighPerforSwtFlg: accessed-variable=VCU_0xDE.VCU_HighPerforSwtFlg
              DataSendPoints_VCU_VehiPowrConsumption: accessed-variable=VCU_0xDE.VCU_VehiPowrConsumption
              DataSendPoints_VCU_MDrvFilterTrqRange: accessed-variable=VCU_0xDE.VCU_MDrvFilterTrqRange
              DataSendPoints_VCU_WheelPwrOvrLimitflgRE: accessed-variable=VCU_0xDE.VCU_WheelPwrOvrLimitflgRE
              DataSendPoints_VCU_MRDrvControlMode: accessed-variable=VCU_0xDE.VCU_MRDrvControlMode
              DataSendPoints_VCU_MRDrvControlModeVD: accessed-variable=VCU_0xDE.VCU_MRDrvControlModeVD
              DataSendPoints_VCU_VehicleDirectMR: accessed-variable=VCU_0xDE.VCU_VehicleDirectMR
              DataSendPoints_VCU_VehicleDirectMRVD: accessed-variable=VCU_0xDE.VCU_VehicleDirectMRVD
              DataSendPoints_VCU_MRDrvRequestTorque: accessed-variable=VCU_0xDE.VCU_MRDrvRequestTorque
              DataSendPoints_VCU_MRDrvRequesSpeed: accessed-variable=VCU_0xDE.VCU_MRDrvRequesSpeed
              DataSendPoints_VCU_MCUMRMaxDischargePower: accessed-variable=VCU_0xDE.VCU_MCUMRMaxDischargePower
              DataSendPoints_VCU_MCUMRMaxPosDampgTrq: accessed-variable=VCU_0xDE.VCU_MCUMRMaxPosDampgTrq
              DataSendPoints_VCU_MRDrvRequestTorqueVD: accessed-variable=VCU_0xDE.VCU_MRDrvRequestTorqueVD
              DataSendPoints_VCU_MCUMRMaxChargePower: accessed-variable=VCU_0xDE.VCU_MCUMRMaxChargePower
              DataSendPoints_VCU_MCUMRMaxNegDampgTrq: accessed-variable=VCU_0xDE.VCU_MCUMRMaxNegDampgTrq
              DataSendPoints_VCU_MRDrvRequesSpeedVD: accessed-variable=VCU_0xDE.VCU_MRDrvRequesSpeedVD
              DataSendPoints_VCU_MCUMRDampgLmtFactor: accessed-variable=VCU_0xDE.VCU_MCUMRDampgLmtFactor
              DataSendPoints_VCU_SuppressJitterMCUMRRequest: accessed-variable=VCU_0xDE.VCU_SuppressJitterMCUMRRequest
              DataSendPoints_VCU_CRC_B6: accessed-variable=VCU_0xB6.VCU_CRC_B6
              DataSendPoints_VCU_TVTest2: accessed-variable=VCU_0xB6.VCU_TVTest2
              DataSendPoints_VCU_VPE_Test1: accessed-variable=VCU_0xB6.VCU_VPE_Test1
              DataSendPoints_VCU_VPE_Test2: accessed-variable=VCU_0xB6.VCU_VPE_Test2
              DataSendPoints_VCU_TVTest1: accessed-variable=VCU_0xB6.VCU_TVTest1
              DataSendPoints_VCU_RollingCounter_B6: accessed-variable=VCU_0xB6.VCU_RollingCounter_B6
              DataSendPoints_VCU_MDrvRequestTorque_IDB6_CCAN: accessed-variable=VCU_0xB6.VCU_MDrvRequestTorque_IDB6_CCAN
              DataSendPoints_VCU_MDriverRequireTorque: accessed-variable=VCU_0xB6.VCU_MDriverRequireTorque
              DataSendPoints_VCU_SDrvRequestTorque_IDB6_CCAN: accessed-variable=VCU_0xB6.VCU_SDrvRequestTorque_IDB6_CCAN
              DataSendPoints_VCU_SDriverRequireTorque: accessed-variable=VCU_0xB6.VCU_SDriverRequireTorque
              DataSendPoints_VCU_ThrottlePosition_IDB6_CCAN: accessed-variable=VCU_0xB6.VCU_ThrottlePosition_IDB6_CCAN
              DataSendPoints_VCU_AccPedalValid_IDB6_CCAN: accessed-variable=VCU_0xB6.VCU_AccPedalValid_IDB6_CCAN
              DataSendPoints_VCU_BrakeSysFault_IDB6_CCAN: accessed-variable=VCU_0xB6.VCU_BrakeSysFault_IDB6_CCAN
              DataSendPoints_VCU_BrakeLightReq: accessed-variable=VCU_0xB6.VCU_BrakeLightReq
              DataSendPoints_VCU_BrakePedalSts: accessed-variable=VCU_0xB6.VCU_BrakePedalSts
              DataSendPoints_VCU_BrakePedalStsValid: accessed-variable=VCU_0xB6.VCU_BrakePedalStsValid
              DataSendPoints_VCU_GearLevelPosSts_IDB6_CCAN: accessed-variable=VCU_0xB6.VCU_GearLevelPosSts_IDB6_CCAN
              DataSendPoints_VCU_GearLeverValid_IDB6_CCAN: accessed-variable=VCU_0xB6.VCU_GearLeverValid_IDB6_CCAN
              DataSendPoints_VCU_BrakeFirstSts: accessed-variable=VCU_0xB6.VCU_BrakeFirstSts
              DataSendPoints_VCU_DeliveryModeSts_IDB6_CCAN: accessed-variable=VCU_0xB6.VCU_DeliveryModeSts_IDB6_CCAN
              DataSendPoints_VCU_MRDrvRequestTorque_IDB6_CCAN: accessed-variable=VCU_0xB6.VCU_MRDrvRequestTorque_IDB6_CCAN
              DataSendPoints_VCU_MRDriverRequireTorque: accessed-variable=VCU_0xB6.VCU_MRDriverRequireTorque
              DataSendPoints_VCU_CheckSum_BB: accessed-variable=VCU_0xBB.VCU_CheckSum_BB
              DataSendPoints_VCU_WorkModeReq_PHEV: accessed-variable=VCU_0xBB.VCU_WorkModeReq_PHEV
              DataSendPoints_VCU_WorkMode_PHEV: accessed-variable=VCU_0xBB.VCU_WorkMode_PHEV
              DataSendPoints_VCU_HEVAllow_PHEV: accessed-variable=VCU_0xBB.VCU_HEVAllow_PHEV
              DataSendPoints_VCU_REAllow_PHEV: accessed-variable=VCU_0xBB.VCU_REAllow_PHEV
              DataSendPoints_VCU_EVDualAllow_PHEV: accessed-variable=VCU_0xBB.VCU_EVDualAllow_PHEV
              DataSendPoints_VCU_EVSingleAllow_PHEV: accessed-variable=VCU_0xBB.VCU_EVSingleAllow_PHEV
              DataSendPoints_VCU_Clutch_2_RequesSpeed: accessed-variable=VCU_0xBB.VCU_Clutch_2_RequesSpeed
              DataSendPoints_VCU_Clutch_1_RequesSpeed: accessed-variable=VCU_0xBB.VCU_Clutch_1_RequesSpeed
              DataSendPoints_VCU_Clutch2Position: accessed-variable=VCU_0xBB.VCU_Clutch2Position
              DataSendPoints_VCU_Clutch1Position: accessed-variable=VCU_0xBB.VCU_Clutch1Position
              DataSendPoints_VCU_RollingCounter_BB: accessed-variable=VCU_0xBB.VCU_RollingCounter_BB
              DataSendPoints_VCU_EngPreStartFlg: accessed-variable=VCU_0xBB.VCU_EngPreStartFlg
              DataSendPoints_VCU_FuelChgModeMsg: accessed-variable=VCU_0xBB.VCU_FuelChgModeMsg
              DataSendPoints_VCU_FuelChgModeSts: accessed-variable=VCU_0xBB.VCU_FuelChgModeSts
              DataSendPoints_VCU_RoughRoadDetectionFlag: accessed-variable=VCU_0xBB.VCU_RoughRoadDetectionFlag
              DataSendPoints_VCU_Clutch_2_RequesSpeedValid: accessed-variable=VCU_0xBB.VCU_Clutch_2_RequesSpeedValid
              DataSendPoints_VCU_Clutch_1_RequesSpeedValid: accessed-variable=VCU_0xBB.VCU_Clutch_1_RequesSpeedValid
              DataSendPoints_VCU_GCURequestTorque: accessed-variable=VCU_0xBB.VCU_GCURequestTorque
              DataSendPoints_VCU_PowerReducetSts: accessed-variable=VCU_0xBB.VCU_PowerReducetSts
              DataSendPoints_VCU_GCUAassistFB: accessed-variable=VCU_0xBB.VCU_GCUAassistFB
              DataSendPoints_VCU_GCUActiveReleaseCmd: accessed-variable=VCU_0xBB.VCU_GCUActiveReleaseCmd
              DataSendPoints_VCU_PowerOverSts: accessed-variable=VCU_0xBB.VCU_PowerOverSts
              DataSendPoints_VCU_GCURequesSpeed: accessed-variable=VCU_0xBB.VCU_GCURequesSpeed
              DataSendPoints_VCU_GCUControlMode: accessed-variable=VCU_0xBB.VCU_GCUControlMode
              DataSendPoints_VCU_MotChargePower: accessed-variable=VCU_0xBB.VCU_MotChargePower
              DataSendPoints_VCU_APS1Position: accessed-variable=VCU_0xBB.VCU_APS1Position
              DataSendPoints_VCU_EngineStartReq: accessed-variable=VCU_0xBB.VCU_EngineStartReq
              DataSendPoints_VCU_EngineFuelInhibitReq: accessed-variable=VCU_0xBB.VCU_EngineFuelInhibitReq
              DataSendPoints_VCU_EngineOffRequest: accessed-variable=VCU_0xBB.VCU_EngineOffRequest
              DataSendPoints_VCU_STorqueReqValid: accessed-variable=VCU_0xBB.VCU_STorqueReqValid
              DataSendPoints_VCU_STorqueReq: accessed-variable=VCU_0xBB.VCU_STorqueReq
              DataSendPoints_VCU_FTorqueSwFb: accessed-variable=VCU_0xBB.VCU_FTorqueSwFb
              DataSendPoints_VCU_FVVOpenReq: accessed-variable=VCU_0xBB.VCU_FVVOpenReq
              DataSendPoints_VCU_WarmUpCycleIndicator: accessed-variable=VCU_0xBB.VCU_WarmUpCycleIndicator
              DataSendPoints_VCU_EngineResetSts: accessed-variable=VCU_0xBB.VCU_EngineResetSts
              DataSendPoints_VCU_EngineSts: accessed-variable=VCU_0xBB.VCU_EngineSts
              DataSendPoints_VCU_FTorqueReq: accessed-variable=VCU_0xBB.VCU_FTorqueReq
              DataSendPoints_VCU_FTorqueReqValid: accessed-variable=VCU_0xBB.VCU_FTorqueReqValid
              DataSendPoints_VCU_EngineIdleReq: accessed-variable=VCU_0xBB.VCU_EngineIdleReq
              DataSendPoints_VCU_REsystemSts: accessed-variable=VCU_0xBB.VCU_REsystemSts
              DataSendPoints_VCU_REsystemFaultSts: accessed-variable=VCU_0xBB.VCU_REsystemFaultSts
              DataSendPoints_VCU_APS2Position: accessed-variable=VCU_0xBB.VCU_APS2Position
              DataSendPoints_VCU_EngineRunAllowFlg: accessed-variable=VCU_0xBB.VCU_EngineRunAllowFlg
              DataSendPoints_VCU_EngineIdleSpeed: accessed-variable=VCU_0xBB.VCU_EngineIdleSpeed
              DataSendPoints_VCU_EngineFuleCutoffReq: accessed-variable=VCU_0xBB.VCU_EngineFuleCutoffReq
              DataSendPoints_VCU_MCUSClutchPosition: accessed-variable=VCU_0xBB.VCU_MCUSClutchPosition
              DataSendPoints_VCU_MGCUWorkMode: accessed-variable=VCU_0xBB.VCU_MGCUWorkMode
              DataSendPoints_VCU_REChgTarget: accessed-variable=VCU_0xBB.VCU_REChgTarget
              DataSendPoints_VCU_MotStartStopPowerUP: accessed-variable=VCU_0xBB.VCU_MotStartStopPowerUP
              DataSendPoints_VCU_MotStartStopPowerLOW: accessed-variable=VCU_0xBB.VCU_MotStartStopPowerLOW
              DataSendPoints_VCU_GCURequesSpeed_MGCU: accessed-variable=VCU_0xBB.VCU_GCURequesSpeed_MGCU
              DataSendPoints_VCU_DynamicChgPwr: accessed-variable=VCU_0xBB.VCU_DynamicChgPwr
              DataSendPoints_VCU_ForceChgPwr: accessed-variable=VCU_0xBB.VCU_ForceChgPwr
              DataSendPoints_VCU_REStartType: accessed-variable=VCU_0xBB.VCU_REStartType
              DataSendPoints_VCU_Pending_DTC: accessed-variable=VCU_0x515.VCU_Pending_DTC
              DataSendPoints_VCU_Comfirmed_DTC: accessed-variable=VCU_0x515.VCU_Comfirmed_DTC
              DataSendPoints_VCU_Permanent_DTC: accessed-variable=VCU_0x515.VCU_Permanent_DTC
              DataSendPoints_VCU_MilReq_DTC: accessed-variable=VCU_0x515.VCU_MilReq_DTC
              DSP_DE_0xBE_ECM_EngineCoolantTemp_0: accessed-variable=PPort_0xBE_ECM_EngineCoolantTemp.DE_0xBE_ECM_EngineCoolantTemp
              DSP_DE_0xBE_ECM_ECM_EngineSpeed_0: accessed-variable=PPort_0xBE_ECM_EngineSpd.DE_0xBE_ECM_ECM_EngineSpeed
              DSP_DE_0xBE_ECM_RestrictorOpenValue_0: accessed-variable=PPort_0xBE_ECM_RestrictorOpenValue.DE_0xBE_ECM_RestrictorOpenValue
              DSP_DE_0xBE_ECM_CalculatedLoad_0: accessed-variable=PPort_0xBE_ECM_CalculatedLoad.DE_0xBE_ECM_CalculatedLoad
              DSP_DE_0x3B1_TMS_OutsideTempVD_0: accessed-variable=PPort_0x3B1_TMS_OutsideTempVD.DE_0x3B1_TMS_OutsideTempVD
              DSP_DE_0x3B1_TMS_OutsideTemp_0: accessed-variable=PPort_0x3B1_TMS_OutsideTemp.DE_0x3B1_TMS_OutsideTemp
              DSP_DE_0x310_BMS_BattSOC_0: accessed-variable=PPort_0x310_BMS_BattSOC.DE_0x310_BMS_BattSOC
              DSP_DE_0x24C_ICU_TotalOdometerkm_0: accessed-variable=PPort_0x24C_ICU_TotalOdometer.DE_0x24C_ICU_TotalOdometerkm
              DSP_MCUM_NMControlRMR_Sts_0: accessed-variable=MCUM_0x42C.MCUM_NMControlRMR_Sts
              DSP_MCUM_WakeUpReason_0: accessed-variable=MCUM_0x42C.MCUM_WakeUpReason
              DSP_MCUM_NMControlRMR_Sts_P_0: accessed-variable=MCUM_0x42C_PCANFD.MCUM_NMControlRMR_Sts_P
              DSP_MCUM_WakeUpReason_P_0: accessed-variable=MCUM_0x42C_PCANFD.MCUM_WakeUpReason_P
          mode switch point ModeSwitchPoint_0: mode-group=PPort_DevCanComm_Req.DevCanComm_Req
          4 x sync call:
            SynchronousServerCallPoint_0: operation=RPort_GetCCANBusOffEvent.GetEventFailed
            SynchronousServerCallPoint_1: operation=RPort_GetPCANBusOffEvent.GetEventFailed
            SynchronousServerCallPoint_2: operation=RPort_MILIndicatorStatus.GetIndicatorStatus
            SynchronousServerCallPoint_3: operation=RPort_GetVCUCANBusOffEvent.GetEventFailed
        RE_APPCOM_SWC_Init: symbol=APPCOM_SWC_Init
        RE_APPCOM_Rx_10ms: symbol=APPCOM_Rx_10ms_Fuc
        RE_APPCOM_Rx_20ms: symbol=APPCOM_Rx_20ms_Fuc
        RE_APPCOM_Rx_50ms: symbol=APPCOM_Rx_50ms_Fuc
        RE_APPCOM_Rx_100ms: symbol=APPCOM_Rx_100ms_Fuc
        RE_APPCOM_Rx_200ms: symbol=APPCOM_Rx_200ms_Fuc
        RE_APPCOM_Tx_10ms: symbol=APPCOM_Tx_10ms_Fuc
        RE_APPCOM_Tx_20ms: symbol=APPCOM_Tx_20ms_Fuc
        RE_APPCOM_Tx_50ms: symbol=APPCOM_Tx_50ms_Fuc
        RE_APPCOM_Tx_100ms: symbol=APPCOM_Tx_100ms_Fuc
        RE_APPCOM_Tx_200ms: symbol=APPCOM_Tx_200ms_Fuc
        RE_APPCOM_Tx_500ms: symbol=APPCOM_Tx_500ms_Fuc
        RE_APPCOM_Rx_500ms: symbol=APPCOM_Rx_500ms_Fuc
        RE_APPCOM_Tx_1ms: symbol=APPCOM_Tx_1ms_Fuc
        RE_APPCOM_Tx_1000ms: symbol=APPCOM_Tx_1000ms_Fuc
        RE_APPCOM_Rx_1000ms: symbol=APPCOM_Rx_1000ms_Fuc
        RE_APPCOM_Tx_2ms: symbol=APPCOM_Tx_2ms_Fuc
        RE_APPCOM_Rx_2ms: symbol=APPCOM_Rx_2ms_Fuc
