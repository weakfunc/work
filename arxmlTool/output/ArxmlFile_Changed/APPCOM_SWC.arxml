[part 6 of 6: package /MVCU_AutoGenPkg/MVCU/Pck_AutoGen_Sw/ImplementationDataTypes]
AUTOSAR XML (schema 4-2-2)
package /MVCU_AutoGenPkg/MVCU/Pck_AutoGen_Sw/ImplementationDataTypes
  2051 x impl type, all with category=TYPE_REFERENCE:
    DT_MCUM_CRC_135: implementation-data-type=uint8
    DT_MCUM_RollingCounter_135: implementation-data-type=uint8
    DT_MCUM_LDC_SWInfo: implementation-data-type=uint16
    DT_MCUM_LDC_MTarOut_FA: implementation-data-type=uint16
    DT_MCUM_LDC_MTarOut_RA: implementation-data-type=uint16
    DT_MCUM_LDC_Available_FA: implementation-data-type=uint8
    DT_MCUM_LDC_OperationMode_FA: implementation-data-type=uint8
    DT_MCUM_LDC_Available_RA: implementation-data-type=uint8
    DT_MCUM_LDC_OperationMode_RA: implementation-data-type=uint8
    DT_MCUM_RTE_Exchange_Signal_Status: implementation-data-type=uint8
    DT_MCUM_MTarIn_FA: implementation-data-type=uint16
    DT_MCUM_MTarIn_RA: implementation-data-type=uint16
    DT_MCUM_InputQF_FA: implementation-data-type=uint8
    DT_MCUM_InputQF_RA: implementation-data-type=uint8
    DT_IBC_CRC_136: implementation-data-type=uint8
    DT_IBC_RollingCounter_136: implementation-data-type=uint8
    DT_IBC_ModeMinEDrvTar_FA: implementation-data-type=uint8
    DT_IBC_ModeMinEDrvTar_RA: implementation-data-type=uint8
    DT_IBC_ModeMaxEDrvTar_FA: implementation-data-type=uint8
    DT_IBC_ModeMaxEDrvTar_RA: implementation-data-type=uint8
    DT_IBC_torque_distribution_RA_Vaild: implementation-data-type=uint8
    DT_IBC_torque_distribution_RA: implementation-data-type=uint8
    DT_IBC_mTar_FA: implementation-data-type=uint16
    DT_IBC_mTar_RA: implementation-data-type=uint16
    DT_IBC_iLDC_SWInfo: implementation-data-type=uint8
    DT_IBC_Variant_Signal: implementation-data-type=uint8
    DT_IBC_nTarMax_FA: implementation-data-type=uint16
    DT_IBC_nTarMax_RA: implementation-data-type=uint16
    DT_IBC_nTarMin_FA: implementation-data-type=uint16
    DT_IBC_nTarMin_RA: implementation-data-type=uint16
    DT_EVCC_DCAC_ChgMode: implementation-data-type=uint8
    DT_EVCC_CP_status: implementation-data-type=uint8
    DT_EVCC_CPDutyCycleValue: implementation-data-type=uint8
    DT_EVCC_EVSEMaximumCurrentLimit: implementation-data-type=uint8
    DT_EVCC_EVSEMaximumPowerLimit: implementation-data-type=uint16
    DT_ICU_CRC_24C: implementation-data-type=uint8
    DT_ICU_PHEVMode: implementation-data-type=uint8
    DT_ICU_RollingCounter_24C: implementation-data-type=uint8
    DT_ICU_TotalOdometerkm: implementation-data-type=uint32_least
    DT_ICU_AccelerationMode: implementation-data-type=uint8
    DT_ICU_REMode: implementation-data-type=uint8
    DT_ICU_CreepMode: implementation-data-type=uint8
    DT_ICU_EnergyRecoveryMode: implementation-data-type=uint8
    DT_MCUS_CRC_DB: implementation-data-type=uint8
    DT_MCUS_Clutch_2_Fault: implementation-data-type=uint16
    DT_MCUS_Clutch_1_Fault: implementation-data-type=uint16
    DT_MCUS_Clutch_2_WarningLevel: implementation-data-type=uint8
    DT_MCUS_Clutch_1_WarningLevel: implementation-data-type=uint8
    DT_MCUS_Clutch_2_Pos: implementation-data-type=uint8
    DT_MCUS_Clutch_1_Pos: implementation-data-type=uint8
    DT_MCUS_RollingCounter_DB: implementation-data-type=uint8
    DT_MCUS_WarningLevel: implementation-data-type=uint8
    DT_MCUS_SelfCheckSts: implementation-data-type=uint8
    DT_MCUS_DrvMotorWorkSts: implementation-data-type=uint8
    DT_MCUS_PowerReduceSts: implementation-data-type=uint8
    DT_MCUS_SystemError: implementation-data-type=uint8
    DT_MCUS_LVSystemError: implementation-data-type=uint8
    DT_MCUS_MotorTempAlarm: implementation-data-type=uint8
    DT_MCUS_HVSystemError: implementation-data-type=uint8
    DT_MCUS_SeriousWarning_Level: implementation-data-type=uint8
    DT_MCUS_CtrlModeVD: implementation-data-type=uint8
    DT_MCUS_WaterPumpLevlReq: implementation-data-type=uint8
    DT_MCUS_MotorTemp: implementation-data-type=uint8
    DT_MCUS_IGBTTemp: implementation-data-type=uint8
    DT_MCUS_InletTemp: implementation-data-type=uint8
    DT_MCUS_DrvMotorRPM: implementation-data-type=uint16
    DT_MCUS_ActualTorqueFB: implementation-data-type=uint16
    DT_MCUS_HWRdcFault: implementation-data-type=uint8
    DT_MCUS_HighVoltPowerOffReq: implementation-data-type=uint8
    DT_MCUS_HVILSts: implementation-data-type=uint8
    DT_MCUS_DragSts: implementation-data-type=uint8
    DT_MCUS_CtrlMode: implementation-data-type=uint8
    DT_MCUS_MILlampReq: implementation-data-type=uint8
    DT_MCUS_DrvMotorRPMVD: implementation-data-type=uint8
    DT_MCUS_ActualTorqueFBVD: implementation-data-type=uint8
    DT_MCUS_MaxTorqueAllow: implementation-data-type=uint16
    DT_MCUS_MaxSpeedAllow: implementation-data-type=uint16
    DT_MCUS_ActiveReleaseSts: implementation-data-type=uint8
    DT_MCUS_MinTorqueAllow: implementation-data-type=uint16
    DT_MCUS_MainWireVolt: implementation-data-type=uint16
    DT_MCUS_MainWireCurr: implementation-data-type=uint16
    DT_MCUS_Clutch_Pos: implementation-data-type=uint8
    DT_MCUS_Clutch_Fault: implementation-data-type=uint8
    DT_MCUS_TMS_FrMotSelfHeatEnSts: implementation-data-type=uint8
    DT_MCUS_TMS_FrMotSelfHeatLvlFb: implementation-data-type=uint8
    DT_MCUS_HeatPwrAval: implementation-data-type=uint8
    DT_DelayIden_Rslt_Avg: implementation-data-type=uint16
    DT_DelayIden_OverRange: implementation-data-type=uint8
    DT_DelayIden_Iden_Finish: implementation-data-type=uint8
    DT_DelayIden_Write_Finish: implementation-data-type=uint8
    DT_DelayIden_Rslt_U: implementation-data-type=uint16
    DT_DelayIden_Rslt_V: implementation-data-type=uint16
    DT_DelayIden_Rslt_W: implementation-data-type=uint16
    DT_GainIden_Is_Samp_U: implementation-data-type=uint16
    DT_GainIden_Rslt_U: implementation-data-type=uint16
    DT_GainIden_OverRange: implementation-data-type=uint8
    DT_GainIden_Is_Samp_V: implementation-data-type=uint16
    DT_GainIden_Rslt_V: implementation-data-type=uint16
    DT_GainIden_Iden_Finish: implementation-data-type=uint8
    DT_GainIden_Is_Samp_W: implementation-data-type=uint16
    DT_GainIden_Rslt_W: implementation-data-type=uint16
    DT_GainIden_Write_Finish: implementation-data-type=uint8
    DT_GainIden_Curr_Peak_U: implementation-data-type=uint16
    DT_GainIden_Curr_Peak_V: implementation-data-type=uint16
    DT_GainIden_Curr_Peak_W: implementation-data-type=uint16
    DT_CurrLoad_CurExt_U: implementation-data-type=uint16
    DT_CurrLoad_CurExt_V: implementation-data-type=uint16
    DT_CurrLoad_CurExt_W: implementation-data-type=uint16
    DT_CurrLoad_offset_Iu: implementation-data-type=uint16
    DT_CurrLoad_offset_Iv: implementation-data-type=uint16
    DT_CurrLoad_offset_Iw: implementation-data-type=uint16
    DT_MCUMR_DelayIden_Rslt_Avg: implementation-data-type=uint16
    DT_MCUMR_DelayIden_OverRange: implementation-data-type=uint8
    DT_MCUMR_DelayIden_Iden_Finish: implementation-data-type=uint8
    DT_MCUMR_DelayIden_Write_Finish: implementation-data-type=uint8
    DT_MCUMR_DelayIden_Rslt_U: implementation-data-type=uint16
    DT_MCUMR_DelayIden_Rslt_V: implementation-data-type=uint16
    DT_MCUMR_DelayIden_Rslt_W: implementation-data-type=uint16
    DT_MCUMR_GainIden_Is_Samp_U: implementation-data-type=uint16
    DT_MCUMR_GainIden_Rslt_U: implementation-data-type=uint16
    DT_MCUMR_GainIden_OverRange: implementation-data-type=uint8
    DT_MCUMR_GainIden_Is_Samp_V: implementation-data-type=uint16
    DT_MCUMR_GainIden_Rslt_V: implementation-data-type=uint16
    DT_MCUMR_GainIden_Iden_Finish: implementation-data-type=uint8
    DT_MCUMR_GainIden_Is_Samp_W: implementation-data-type=uint16
    DT_MCUMR_GainIden_Rslt_W: implementation-data-type=uint16
    DT_MCUMR_GainIden_Write_Finish: implementation-data-type=uint8
    DT_MCUMR_GainIden_Curr_Peak_U: implementation-data-type=uint16
    DT_MCUMR_GainIden_Curr_Peak_V: implementation-data-type=uint16
    DT_MCUMR_GainIden_Curr_Peak_W: implementation-data-type=uint16
    DT_MCUMR_CurrLoad_CurExt_U: implementation-data-type=uint16
    DT_MCUMR_CurrLoad_CurExt_V: implementation-data-type=uint16
    DT_MCUMR_CurrLoad_CurExt_W: implementation-data-type=uint16
    DT_MCUMR_CurrLoad_offset_Iu: implementation-data-type=uint16
    DT_MCUMR_CurrLoad_offset_Iv: implementation-data-type=uint16
    DT_MCUMR_CurrLoad_offset_Iw: implementation-data-type=uint16
    DT_BCM_VCU_Authentication_MAC_B{0..15}: implementation-data-type=uint8
    DT_ECM_UDS_PhyReq_Byte{0..7}: implementation-data-type=uint8
    DT_MCUM_Id_Ref: implementation-data-type=uint16
    DT_MCUM_Iq_Ref: implementation-data-type=uint16
    DT_MCUM_Id_Fb: implementation-data-type=uint16
    DT_MCUM_Iq_Fb: implementation-data-type=uint16
    DT_MCUM_Torque_Ref: implementation-data-type=uint16
    DT_MCUM_R_Id_Ref: implementation-data-type=uint16
    DT_MCUM_R_Iq_Ref: implementation-data-type=uint16
    DT_MCUM_R_Id_Fb: implementation-data-type=uint16
    DT_MCUM_R_Iq_Fb: implementation-data-type=uint16
    DT_MCUM_R_Torque_Ref: implementation-data-type=uint16
    DT_MCUM_Vd_Ref: implementation-data-type=uint16
    DT_MCUM_Vq_Ref: implementation-data-type=uint16
    DT_MCUM_Id_LookUp: implementation-data-type=uint16
    DT_MCUM_Iq_LookUp: implementation-data-type=uint16
    DT_MCUM_Spd_Delta: implementation-data-type=uint16
    DT_MCUM_Us_Out: implementation-data-type=uint16
    DT_MCUM_Torque_PwrEst: implementation-data-type=uint8
    DT_MCUM_UserDefine_50ms: implementation-data-type=uint16
    DT_MCUM_Torque_ExtChar: implementation-data-type=uint16
    DT_MCUM_Damp_CompTorque: implementation-data-type=uint16
    DT_MCUM_Damp_CompCoeff: implementation-data-type=uint8
    DT_MCUM_Damp_State: implementation-data-type=uint8
    DT_MCUM_PWM_State: implementation-data-type=uint8
    DT_MCUM_JuncTemp_Max: implementation-data-type=uint16
    DT_MCUM_JuncLoss_Max: implementation-data-type=uint16
    DT_MCUM_CurrAmp_Comp: implementation-data-type=uint8
    DT_MCUM_CurrTheta_Comp: implementation-data-type=uint16
    DT_MCUM_RawSinCorr: implementation-data-type=uint16
    DT_MCUM_RawCosCorr: implementation-data-type=uint16
    DT_MCUM_LUT_Spd: implementation-data-type=uint16
    DT_MCUM_R_HighVoltPowerOffReq: implementation-data-type=uint8
    DT_MCUM_R_MaxTorqueAllow: implementation-data-type=uint16
    DT_MCUM_R_MaxSpeedAllow: implementation-data-type=uint16
    DT_MCUM_R_MinTorqueAllow: implementation-data-type=uint16
    DT_MCUM_R_MotorTemp: implementation-data-type=uint8
    DT_MCUM_R_IGBTTemp: implementation-data-type=uint8
    DT_MCUM_R_InletTemp: implementation-data-type=uint8
    DT_MCUM_R_HeatPwrAllwd: implementation-data-type=uint8
    DT_MCUM_R_HeatFdBck: implementation-data-type=uint8
    DT_MCUM_R_HeatPwrAct: implementation-data-type=uint8
    DT_MCUM_R_HeatPwrMax: implementation-data-type=uint8
    DT_MCUM_R_HeatPwrAval: implementation-data-type=uint8
    DT_MCUM_R_Vd_Ref: implementation-data-type=uint16
    DT_MCUM_R_Vq_Ref: implementation-data-type=uint16
    DT_MCUM_R_Id_LookUp: implementation-data-type=uint16
    DT_MCUM_R_Iq_LookUp: implementation-data-type=uint16
    DT_MCUM_R_Spd_Delta: implementation-data-type=uint16
    DT_MCUM_R_Us_Out: implementation-data-type=uint16
    DT_MCUM_R_Torque_PwrEst: implementation-data-type=uint16
    DT_MCUM_R_UserDefine_50ms: implementation-data-type=uint16
    DT_MCUM_R_Torque_ExtChar: implementation-data-type=uint16
    DT_MCUM_R_Damp_CompTorque: implementation-data-type=uint16
    DT_MCUM_R_Damp_CompCoeff: implementation-data-type=uint8
    DT_MCUM_R_Damp_State: implementation-data-type=uint8
    DT_MCUM_R_PWM_State: implementation-data-type=uint8
    DT_MCUM_R_JuncTemp_Max: implementation-data-type=uint16
    DT_MCUM_R_JuncLoss_Max: implementation-data-type=uint16
    DT_MCUM_R_CurrAmp_Comp: implementation-data-type=uint8
    DT_MCUM_R_CurrTheta_Comp: implementation-data-type=uint16
    DT_MCUM_R_RawSinCorr: implementation-data-type=uint16
    DT_MCUM_R_RawCosCorr: implementation-data-type=uint16
    DT_MCUM_R_LUT_Spd: implementation-data-type=uint16
    DT_MCUM_R_StatorTemp_1: implementation-data-type=uint8
    DT_MCUM_R_L2TqAct: implementation-data-type=uint16
    DT_MCUM_R_EOPSw: implementation-data-type=uint32
    DT_MCUM_R_StatorTemp_2: implementation-data-type=uint8
    DT_MCUM_R_IGBTTemp_U: implementation-data-type=uint8
    DT_MCUM_R_IGBTTemp_V: implementation-data-type=uint8
    DT_MCUM_R_IGBTTemp_W: implementation-data-type=uint8
    DT_MCUM_R_Power_15V: implementation-data-type=uint8
    DT_MCUM_R_Offset_IU: implementation-data-type=uint16
    DT_MCUM_R_Offset_IV: implementation-data-type=uint16
    DT_MCUM_R_Offset_IW: implementation-data-type=uint16
    DT_MCUM_R_MainSt_State: implementation-data-type=uint8
    DT_MCUM_R_Derate_Reason: implementation-data-type=uint8
    DT_MCUM_R_PWM_Freq_kHz: implementation-data-type=uint8
    DT_MCUM_R_PWMEn_State: implementation-data-type=uint8
    DT_MCUM_R_DrvPwrEn_Out_State: implementation-data-type=uint8
    DT_MCUM_R_NVM_RslvrZeroRFault: implementation-data-type=uint8
    DT_MCUM_R_Rotor_Position: implementation-data-type=uint16
    DT_MCUM_R_PosTransduserFaultCode: implementation-data-type=uint8
    DT_MCUM_R_NVM_RslvrDirRFault: implementation-data-type=uint8
    DT_MCUM_R_NVM_RslvrDelayRFault: implementation-data-type=uint8
    DT_MCUM_R_NVM_RslvrParamRFault: implementation-data-type=uint8
    DT_MCUM_R_NVM_HallGainRFault: implementation-data-type=uint8
    DT_MCUM_R_NVM_HallDelayRFault: implementation-data-type=uint8
    DT_MCUM_R_NVM_IGBTTypeRFault: implementation-data-type=uint8
    DT_MCUM_R_ASC_EntryCount: implementation-data-type=uint8
    DT_MCUM_R_Spd_Turn: implementation-data-type=uint16
    DT_MCUM_R_LUT_Spd_Max: implementation-data-type=uint16
    DT_MCUM_R_EOP_Speed: implementation-data-type=uint16
    DT_MCUM_R_EOP_IqFb: implementation-data-type=uint16
    DT_MCUM_R_EOP_IqRef: implementation-data-type=uint16
    DT_MCUM_R_EOP_DCVolt: implementation-data-type=uint16
    DT_MCUM_R_EOP_DCCurr: implementation-data-type=uint16
    DT_MCUM_R_EOP_Temp: implementation-data-type=uint8
    DT_MCUM_R_EOP_State: implementation-data-type=uint8
    DT_MCUM_R_EOP_FaultCode: implementation-data-type=uint8
    DT_MCUM_R_HWFault_RstCnt: implementation-data-type=uint8
    DT_MCUM_R_HWFoB_RstCnt: implementation-data-type=uint8
    DT_MCUM_R_HWFoT_RstCnt: implementation-data-type=uint8
    DT_MCUM_R_HWDrvUV_RstCnt: implementation-data-type=uint8
    DT_MCUM_R_HWRdc_RstCnt: implementation-data-type=uint8
    DT_MCUM_R_HWOC_RstCnt: implementation-data-type=uint8
    DT_MCUM_R_HWOV_RstCnt: implementation-data-type=uint8
    DT_MCUM_R_L2agRtrElecDiff: implementation-data-type=uint8
    DT_MCUM_R_500usOverTime_Cnt: implementation-data-type=uint8
    DT_MCUM_R_5msOverTime_Cnt: implementation-data-type=uint8
    DT_MCUM_R_CpldRest_TimeOut_flag: implementation-data-type=uint8
    DT_MCUM_R_DrvPCBCurr: implementation-data-type=uint8
    DT_MCUM_R_EOL_StateMachine: implementation-data-type=uint8
    DT_MCUM_R_CpldRest_ASC_Flag: implementation-data-type=uint8
    DT_MCUM_R_LimSpdTorFlag: implementation-data-type=uint8
    DT_MCUM_R_PWM_Err_Count: implementation-data-type=uint8
    DT_MCUM_R_RDC_Reset_Count: implementation-data-type=uint8
    DT_MCUM_R_ASC_Stop_Flag: implementation-data-type=uint8
    DT_MCUM_R_ASC_Soft_Exiting_Flag: implementation-data-type=uint8
    DT_MCUM_R_Vbus_ServeLowChkEn: implementation-data-type=uint8
    DT_MCUM_R_EOP_BlockErr_IsLim_Flag: implementation-data-type=uint8
    DT_MCUM_R_IdqErrCount: implementation-data-type=uint16
    DT_MCUM_R_MotSelfHeat_EnSts: implementation-data-type=uint8
    DT_MCUM_R_MotBlockHeat_LvlFb: implementation-data-type=uint8
    DT_MCUM_R_MotRotaryHeat_LvlFb: implementation-data-type=uint8
    DT_MCUM_R_MotSelfHeat_DropLvlFb: implementation-data-type=uint8
    DT_MCUM_R_MotSelfHeat_DropLvlRsn: implementation-data-type=uint8
    DT_MCUM_R_MotBlockHeat_CurAngle: implementation-data-type=uint16
    DT_MCUM_R_MotBlockHeat_CurMag: implementation-data-type=uint16
    DT_MCUM_R_UserDefine_Byte{1..4}: implementation-data-type=uint8
    DT_MCUM_R_UserDefine_Word{1..3}: implementation-data-type=uint16
    DT_VCU_MotSelfHeatPwrFb: implementation-data-type=uint8
    DT_VCU_MotSelfHeatLvlFb: implementation-data-type=uint8
    DT_VCU_MCUMWaterPumpLevlReq: implementation-data-type=uint8
    DT_VCU_MCUSWaterPumpLevlReq: implementation-data-type=uint8
    DT_VCU_HeatPwrAval: implementation-data-type=uint8
    DT_VCU_MotSelfHeatAllwd: implementation-data-type=uint8
    DT_VCU_MMotSelfHeatEnReq: implementation-data-type=uint8
    DT_VCU_MMotSelfHeatLvlReq: implementation-data-type=uint8
    DT_VCU_SMotSelfHeatEnReq: implementation-data-type=uint8
    DT_VCU_SMotSelfHeatLvlReq: implementation-data-type=uint8
    DT_Debug_MCU_CRC_CA: implementation-data-type=uint8
    DT_Debug_MCU_RollingCounter_CA: implementation-data-type=uint8
    DT_Debug_MCU_WarningLevel: implementation-data-type=uint8
    DT_Debug_MCU_SelfCheckSts: implementation-data-type=uint8
    DT_Debug_MCU_DrvMotorWorkSts: implementation-data-type=uint8
    DT_Debug_MCU_PowerReduceSts: implementation-data-type=uint8
    DT_Debug_MCU_DrvMotorRPM: implementation-data-type=uint16
    DT_Debug_MCU_ActualTorqueFB: implementation-data-type=uint16
    DT_Debug_MCU_HWRdcFault: implementation-data-type=uint8
    DT_Debug_MCU_HighVoltPowerOffReq: implementation-data-type=uint8
    DT_Debug_MCU_HVILSts: implementation-data-type=uint8
    DT_Debug_MCU_DragSts: implementation-data-type=uint8
    DT_Debug_MCU_CtrlMode: implementation-data-type=uint8
    DT_Debug_MCU_MILlampReq: implementation-data-type=uint8
    DT_Debug_MCU_DrvMotorRPMVD: implementation-data-type=uint8
    DT_Debug_MCU_ActualTorqueFBVD: implementation-data-type=uint8
    DT_Debug_MCU_MaxTorqueAllow: implementation-data-type=uint16
    DT_Debug_MCU_MaxSpeedAllow: implementation-data-type=uint16
    DT_Debug_MCU_ActiveReleaseSts: implementation-data-type=uint8
    DT_Debug_MCU_DCChargRelaySts: implementation-data-type=uint8
    DT_Debug_MCUM_MinTorqueAllow: implementation-data-type=uint16
    DT_Debug_MCU_MainWireVolt: implementation-data-type=uint16
    DT_Debug_MCU_MainWireCurr: implementation-data-type=uint16
    DT_Debug_MCUM_TMS_MotSelfHeatEnSts: implementation-data-type=uint8
    DT_Debug_MCUM_TMS_MotSelfHeatLvlFb: implementation-data-type=uint8
    DT_Debug_MCUM_RPowerReduceSts: implementation-data-type=uint8
    DT_Debug_MCUM_HeatPwrAval: implementation-data-type=uint8
    DT_Debug_MCUM_RCtrlMode: implementation-data-type=uint8
    DT_Debug_MCUM_RWarningLevel: implementation-data-type=uint8
    DT_Debug_MCUM_RSelfCheckSts: implementation-data-type=uint8
    DT_Debug_MCUM_RDrvMotorWorkSts: implementation-data-type=uint8
    DT_Debug_MCUM_RCtrlModeVD: implementation-data-type=uint8
    DT_Debug_MCUM_RHWRdcFault: implementation-data-type=uint8
    DT_Debug_MCUM_RDrvMotorRPMVD: implementation-data-type=uint8
    DT_Debug_MCUM_RActualTorqueFBVD: implementation-data-type=uint8
    DT_Debug_MCUM_RDrvMotorRPM: implementation-data-type=uint16
    DT_Debug_MCUM_RActualTorqueFB: implementation-data-type=uint16
    DT_IBS_CRC_225: implementation-data-type=uint8
    DT_IBS_RollingCounter_225: implementation-data-type=uint8
    DT_IBS_Warning_Level: implementation-data-type=uint8
    DT_ADDC_CRC_84: implementation-data-type=uint8
    DT_ADDC_APS_AVHReq: implementation-data-type=uint8
    DT_ADDC_APS_HoldSts: implementation-data-type=uint8
    DT_ADDC_APSTargetTrqBrkVD: implementation-data-type=uint8
    DT_ADDC_APSTargetTrqBrk: implementation-data-type=uint16
    DT_ADDC_APSTargetTrqVD: implementation-data-type=uint8
    DT_ADDC_APSTargetTrq: implementation-data-type=uint16
    DT_ADDC_safety_valid: implementation-data-type=uint8
    DT_ADDC_rearsafety_level: implementation-data-type=uint8
    DT_ADDC_frontsafety_level: implementation-data-type=uint8
    DT_ADDC_rightsafety_level: implementation-data-type=uint8
    DT_ADDC_leftsafety_level: implementation-data-type=uint8
    DT_ADDC_RollingCounter_84: implementation-data-type=uint8
    DT_ADDC_APS_EnableReq: implementation-data-type=uint8
    DT_ADDC_APS_WorkSts: implementation-data-type=uint8
    DT_ADDC_APS_PDCVehicleDirectCtlVD: implementation-data-type=uint8
    DT_ADDC_APS_VehicleSpeedCtlVD: implementation-data-type=uint8
    DT_ADDC_APS_PDC_VehicleDirectCtl: implementation-data-type=uint8
    DT_ADDC_APS_PDC_SWAngCtl: implementation-data-type=uint16
    DT_ADDC_APS_ParkingReq: implementation-data-type=uint8
    DT_ADDC_APS_EmergenceBrake: implementation-data-type=uint8
    DT_ADDC_APS_TargetAccVD: implementation-data-type=uint8
    DT_ADDC_APS_TargetAcc: implementation-data-type=uint8
    DT_ADDC_APS_VehicleSpeedCtl: implementation-data-type=uint8
    DT_ADDC_APS_DecToStop: implementation-data-type=uint8
    DT_ADDC_APS_Driveoff_Request: implementation-data-type=uint8
    DT_ADDC_APS_FuncType: implementation-data-type=uint8
    DT_ADDC_APS_Available: implementation-data-type=uint8
    DT_IVI_Year: implementation-data-type=uint16
    DT_IVI_Month: implementation-data-type=uint8
    DT_IVI_Data: implementation-data-type=uint8
    DT_IVI_Hour: implementation-data-type=uint8
    DT_IVI_Minute: implementation-data-type=uint8
    DT_IVI_Second: implementation-data-type=uint8
    DT_DCDC_CRC_324: implementation-data-type=uint8
    DT_DCDC_RollingCounter_324: implementation-data-type=uint8
    DT_DCDC_WorkSts: implementation-data-type=uint8
    DT_DCDC_Under_Output_Voltage: implementation-data-type=uint8
    DT_DCDC_Over_Output_Voltage: implementation-data-type=uint8
    DT_DCDC_Under_Input_Voltage: implementation-data-type=uint8
    DT_DCDC_Over_Input_Voltage: implementation-data-type=uint8
    DT_DCDC_Over_Input_Current: implementation-data-type=uint8
    DT_DCDC_Real_Output_Current: implementation-data-type=uint16
    DT_DCDC_Real_Output_Voltage: implementation-data-type=uint16
    DT_DCDC_Real_Input_Current: implementation-data-type=uint8
    DT_DCDC_Real_Input_Voltage: implementation-data-type=uint16
    DT_DCDC_Derating: implementation-data-type=uint8
    DT_DCDC_Hardware_Fault_Flag: implementation-data-type=uint8
    DT_CDU_ACChg_HIVSts: implementation-data-type=uint8
    DT_CDU_OBC_OverTemp: implementation-data-type=uint8
    DT_CDU_SelfCheckSt: implementation-data-type=uint8
    DT_CDU_HV_HIVSts: implementation-data-type=uint8
    DT_FSC_CRC_142: implementation-data-type=uint8
    DT_FSC_RollingCounter_142: implementation-data-type=uint8
    DT_FSC_LCC_Mode: implementation-data-type=uint8
    DT_MotClb_FaultCode{1..8}: implementation-data-type=uint8
    DT_MotClb_OfsApply: implementation-data-type=uint16
    DT_MCUMR_MotClb_FaultCode{1..8}: implementation-data-type=uint8
    DT_MCUMR_MotClb_OfsApply: implementation-data-type=uint16
    DT_EOL_ModeCMD_Data{0..5}: implementation-data-type=uint8
    DT_EOL_ModeCMD_Enable: implementation-data-type=uint8
    DT_EOL_ModeCMD_Check: implementation-data-type=uint8
    DT_EOL_GainIden_UsApply: implementation-data-type=uint16
    DT_EOL_MotClb_CtrlMode: implementation-data-type=uint8
    DT_MotClb_OfsSet: implementation-data-type=uint16
    DT_EOL_MotClb_IsCMD: implementation-data-type=uint16
    DT_EOL_MotClb_ThetaCMD: implementation-data-type=uint16
    DT_EOL_frqsync: implementation-data-type=uint16
    DT_EOL_MotClb_Enable: implementation-data-type=uint8
    DT_EOL_ActiveReleaseCmd: implementation-data-type=uint8
    DT_MotClb_OfsAdjEn: implementation-data-type=uint8
    DT_EOL_Asc_CMD: implementation-data-type=uint8
    DT_EOL_PosDly_SnsrSupplier: implementation-data-type=uint8
    DT_FstRcrd_Enable: implementation-data-type=uint8
    DT_GainIden_CurrRMS_Ref_U: implementation-data-type=uint16
    DT_GainIden_CurrRMS_Ref_V: implementation-data-type=uint16
    DT_GainIden_CurrRMS_Ref_W: implementation-data-type=uint16
    DT_MCUMR_EOL_GainIden_UsApply: implementation-data-type=uint16
    DT_MCUMR_EOL_MotClb_CtrlMode: implementation-data-type=uint8
    DT_MCUMR_MotClb_OfsSet: implementation-data-type=uint16
    DT_MCUMR_EOL_MotClb_IsCMD: implementation-data-type=uint16
    DT_MCUMR_EOL_MotClb_ThetaCMD: implementation-data-type=uint16
    DT_MCUMR_EOL_frqsync: implementation-data-type=uint16
    DT_MCUMR_EOL_MotClb_Enable: implementation-data-type=uint8
    DT_MCUMR_EOL_ActiveReleaseCmd: implementation-data-type=uint8
    DT_MCUMR_MotClb_OfsAdjEn: implementation-data-type=uint8
    DT_MCUMR_EOL_Asc_CMD: implementation-data-type=uint8
    DT_MCUMR_EOL_PosDly_SnsrSupplier: implementation-data-type=uint8
    DT_MCUMR_FstRcrd_Enable: implementation-data-type=uint8
    DT_MCUMR_GainIden_CurrRMS_Ref_U: implementation-data-type=uint16
    DT_MCUMR_GainIden_CurrRMS_Ref_V: implementation-data-type=uint16
    DT_MCUMR_GainIden_CurrRMS_Ref_W: implementation-data-type=uint16
    DT_MCUS_CRC_14: implementation-data-type=uint8
    DT_MCUS_RollingCounter_14: implementation-data-type=uint8
    DT_MCUS_DrvMotorRPM_prvt: implementation-data-type=uint16
    DT_MCUS_ActualTorqueFB_prvt: implementation-data-type=uint16
    DT_MCUS_DrvMotorRPMVD_prvt: implementation-data-type=uint8
    DT_MCUS_ActualTorqueFBVD_prvt: implementation-data-type=uint8
    DT_U16_CMD{1..4}: implementation-data-type=uint16
    DT_S16_CMD{1..4}: implementation-data-type=uint16
    DT_R16_CMD{1..4}: implementation-data-type=uint16
    DT_U8_CMD{1..8}: implementation-data-type=uint8
    DT_OBC_CRC_316: implementation-data-type=uint8
    DT_OBC_RollingCounter_316: implementation-data-type=uint8
    DT_OBC_WorkSts: implementation-data-type=uint8
    DT_OBC_StartSts: implementation-data-type=uint8
    DT_OBC_DCSts: implementation-data-type=uint8
    DT_OBC_ACChargeOutputSts: implementation-data-type=uint8
    DT_OBC_DCVolt: implementation-data-type=uint16
    DT_OBC_HardwareSts: implementation-data-type=uint8
    DT_OBC_DCCurr: implementation-data-type=uint16
    DT_OBC_ACVolt: implementation-data-type=uint16
    DT_OBC_ACCurr: implementation-data-type=uint16
    DT_OBC_CCConnectSts: implementation-data-type=uint8
    DT_OBC_CPDutyCycleFault: implementation-data-type=uint8
    DT_OBC_CPDutyCycleValue: implementation-data-type=uint8
    DT_OBC_ACMaxPower: implementation-data-type=uint16
    DT_OBC_ACPowerState: implementation-data-type=uint8
    DT_LMC_CRC_FA: implementation-data-type=uint8
    DT_LMC_RollingCounter_FA: implementation-data-type=uint8
    DT_LMC_EngTorqDec_Main: implementation-data-type=uint16
    DT_LMC_EngTorqDecActive_Main: implementation-data-type=uint8
    DT_LMC_AMM_St: implementation-data-type=uint8
    DT_LMC_EngTorqInc_Main: implementation-data-type=uint16
    DT_LMC_EngTorqIncActive_Main: implementation-data-type=uint8
    DT_LMC_EngTorqDec_Sub: implementation-data-type=uint16
    DT_LMC_EngTorqDecActive_Sub: implementation-data-type=uint8
    DT_LMC_EngTorqInc_Sub: implementation-data-type=uint16
    DT_LMC_EngTorqIncActive_Sub: implementation-data-type=uint8
    DT_LMC_CRC_18C: implementation-data-type=uint8
    DT_LMC_RollingCounter_18C: implementation-data-type=uint8
    DT_LMC_TqTotalBrakeTorque: implementation-data-type=uint16
    DT_LMC_TqTotalBrakeTorque_Valid: implementation-data-type=uint8
    DT_LMC_CmpUTurnLockwhists: implementation-data-type=uint8
    DT_GW_CRC_3B1: implementation-data-type=uint8
    DT_GW_RollingCounter_3B1: implementation-data-type=uint8
    DT_GW_ACU_FLSeatBeltRSt: implementation-data-type=uint8
    DT_GW_ACU_FRSeatBeltRSt: implementation-data-type=uint8
    DT_GW_IBC_EPB_Status: implementation-data-type=uint8
    DT_GW_ACU_TotalCrashOutputSts: implementation-data-type=uint8
    DT_GW_BZCU_DCChgExitTemp_Pos: implementation-data-type=uint8
    DT_GW_BZCU_DCChgExitTemp_Neg: implementation-data-type=uint8
    DT_GW_BZCU_ACChgExitTemp_Pos: implementation-data-type=uint8
    DT_GW_BZCU_FuelTankSts: implementation-data-type=uint8
    DT_GW_BZCU_LBMS_VoltA: implementation-data-type=uint8
    DT_GW_BZCU_ACChgExitTemp_Neg: implementation-data-type=uint8
    DT_GW_BZCU_FuelTankStsLockSts: implementation-data-type=uint8
    DT_GW_BZCU_FuelTankLockCtrl: implementation-data-type=uint8
    DT_GW_BZCU_ACChgLockSts: implementation-data-type=uint8
    DT_GW_RZCU_Cabin_220Vconnect_Sts: implementation-data-type=uint8
    DT_GW_BZCU_Cab_220VRelay_CtrlSts: implementation-data-type=uint8
    DT_GW_BZCU_Cab_PDU220VRelay_CtrlSts: implementation-data-type=uint8
    DT_GW_BZCU_Cabin_220VRelay_CtrlSts: implementation-data-type=uint8
    DT_GW_BZCU_Cab_220Vconnect_Sts: implementation-data-type=uint8
    DT_GW_TBOXSOC_Altitude: implementation-data-type=uint16
    DT_VCU_EolCfg_ESC: implementation-data-type=uint8
    DT_VCU_IMMOKeyWriteCnt: implementation-data-type=uint8
    DT_VCU_AbStartupFlag: implementation-data-type=uint8
    DT_VCU_AbResetFlag: implementation-data-type=uint8
    DT_VCU_AbResetlnitFinish: implementation-data-type=uint8
    DT_VCU_EolCfg_EPB: implementation-data-type=uint8
    DT_VCU_EolCfg_AEB: implementation-data-type=uint8
    DT_VCU_EolCfg_InverterFunc: implementation-data-type=uint8
    DT_VCU_EolCfg_APS: implementation-data-type=uint8
    DT_VCU_EolCfg_VehiModels: implementation-data-type=uint8
    DT_VCU_EolCfg_SpdLmtVal: implementation-data-type=uint8
    DT_VCU_EolCfg_WheelType: implementation-data-type=uint8
    DT_VCU_EolCfg_Curise: implementation-data-type=uint8
    DT_VCU_REStartReq: implementation-data-type=uint8
    DT_VCU_REStopReq: implementation-data-type=uint8
    DT_VCU_EolCfg_VehiType: implementation-data-type=uint8
    DT_VCU_EolCfg_MotPwr: implementation-data-type=uint8
    DT_VCU_Vehicle_NVHPwrLimitVal: implementation-data-type=uint8
    DT_VCU_EolCfg_MotDrvStructure: implementation-data-type=uint8
    DT_VCU_WLTCModeFlag: implementation-data-type=uint8
    DT_VCU_EolCfg_RudderDir: implementation-data-type=uint8
    DT_VCU_EolCfg_DCChgRelayPos: implementation-data-type=uint8
    DT_VCU_EolCfg_FPTCIL: implementation-data-type=uint8
    DT_VCU_PWakeupSt: implementation-data-type=uint8
    DT_VCU_SpdLimitReason: implementation-data-type=uint8
    DT_BSW_VertifySts: implementation-data-type=uint8
    DT_VCU_InterAllowEngStart: implementation-data-type=uint8
    DT_VCU_EngineOff_Flag: implementation-data-type=uint8
    DT_VCU_EngineStopAllow: implementation-data-type=uint8
    DT_VCU_EmergencyStopReq: implementation-data-type=uint8
    DT_VCU_EngineAllowStop: implementation-data-type=uint8
    DT_REHighPerformVehiPwr: implementation-data-type=uint8
    DT_VCU_REVehiWheelTrqReq: implementation-data-type=uint8
    DT_VCU_AdditionalPwrVal: implementation-data-type=uint8
    DT_VCU_VehichRealPwDown: implementation-data-type=uint8
    DT_VCU_IMMOStsResult: implementation-data-type=uint8
    DT_VCU_IMMOStateMachine: implementation-data-type=uint8
    DT_VCU_ShowCarModeNvmResult: implementation-data-type=uint8
    DT_VCU_DeliveryModeNvmData: implementation-data-type=uint8
    DT_VCU_AccPedFaultLvNvmResult: implementation-data-type=uint8
    DT_VCU_VehicleConfigNvmResult: implementation-data-type=uint8
    DT_VCU_EngRunTimeNvmResult: implementation-data-type=uint8
    DT_VCU_FuelConsumption: implementation-data-type=uint8
    DT_VCU_SVSLamp: implementation-data-type=uint8
    DT_VCU_MilLamp: implementation-data-type=uint8
    DT_VCU_SinglePedalSts_ID514: implementation-data-type=uint8
    DT_VCU_GearLevelPosFault_ID514: implementation-data-type=uint8
    DT_VCU_EngineStartFailure_ID514: implementation-data-type=uint8
    DT_VCU_ParkBeforeFuelup: implementation-data-type=uint8
    DT_VCU_REsystemFaultSts_ID514: implementation-data-type=uint8
    DT_VCU_EngineRunAllowFlg_ID514: implementation-data-type=uint8
    DT_VCU_InverterTip: implementation-data-type=uint8
    DT_VCU_EMSRepairModeSts: implementation-data-type=uint8
    DT_VCU_FuelTankFlapSts: implementation-data-type=uint8
    DT_VCU_REsystemSts_ID514: implementation-data-type=uint8
    DT_VCU_PowerModeAllow: implementation-data-type=uint8
    DT_VCU_PowerModeSwitchMsg: implementation-data-type=uint8
    DT_VCU_HighVoltFailed_M: implementation-data-type=uint8
    DT_VCU_HighVoltFailed_S: implementation-data-type=uint8
    DT_VCU_BrakeBeforeGear: implementation-data-type=uint8
    DT_VCU_ParkBeforeGear: implementation-data-type=uint8
    DT_VCU_GearBeforDriving: implementation-data-type=uint8
    DT_VCU_UnlockBeforeDriving: implementation-data-type=uint8
    DT_VCU_PreventSliding: implementation-data-type=uint8
    DT_VCU_MMErrorSts: implementation-data-type=uint8
    DT_VCU_ShowCarModeSts: implementation-data-type=uint8
    DT_VCU_PGearFlashSts: implementation-data-type=uint8
    DT_VCU_ACConnectSts: implementation-data-type=uint8
    DT_VCU_DcChgPwrSts: implementation-data-type=uint8
    DT_VCU_DriverAssistProhibitSts_ID514: implementation-data-type=uint8
    DT_VCU_MilLampRequest_ID514: implementation-data-type=uint8
    DT_VCU_CcmHvilInSigFreq_FB: implementation-data-type=uint8
    DT_VCU_CcmHvilInSigDuty_FB: implementation-data-type=uint8
    DT_VCU_FuelDectionModeSts: implementation-data-type=uint8
    DT_VCU_EnergyCtrlMode: implementation-data-type=uint8
    DT_VCU_VehSpdLimtRemind_ID514: implementation-data-type=uint8
    DT_VCU_TurtleLamp: implementation-data-type=uint8
    DT_VCU_EngLongTimeStartReq: implementation-data-type=uint8
    DT_GW_CRC_13A: implementation-data-type=uint8
    DT_GW_RollingCounter_13A: implementation-data-type=uint8
    DT_GW_IBC_VehicleSpeed: implementation-data-type=uint16
    DT_GW_IBC_VehicleSpeedVD: implementation-data-type=uint8
    DT_GW_IBC_AVHStatus: implementation-data-type=uint8
    DT_GW_IBC_RAB_Avatiable: implementation-data-type=uint8
    DT_GW_IBC_RAB_Active: implementation-data-type=uint8
    DT_GW_IBC_FLWheelSpeedKPH: implementation-data-type=uint16
    DT_GW_IBC_FRWheelSpeedKPH: implementation-data-type=uint16
    DT_GW_IBC_RLWheelSpeedKPH: implementation-data-type=uint16
    DT_GW_IBC_RRWheelSpeedKPH: implementation-data-type=uint16
    DT_GW_IBC_FLWheelDirection: implementation-data-type=uint8
    DT_GW_IBC_FRWheelDirection: implementation-data-type=uint8
    DT_GW_IBC_RLWheelDirection: implementation-data-type=uint8
    DT_GW_IBC_RRWheelDirection: implementation-data-type=uint8
    DT_GW_IBC_FLWheelSpeedVD: implementation-data-type=uint8
    DT_GW_IBC_FRWheelSpeedVD: implementation-data-type=uint8
    DT_GW_IBC_RLWheelSpeedVD: implementation-data-type=uint8
    DT_GW_IBC_RRWheelSpeedVD: implementation-data-type=uint8
    DT_GW_IBC_PlungerPressure_Q: implementation-data-type=uint8
    DT_GW_IBC_PlungerPressure: implementation-data-type=uint16
    DT_CCM_Volt: implementation-data-type=uint16
    DT_CCM_RollingCounter_36A: implementation-data-type=uint8
    DT_CCM_BaseState: implementation-data-type=uint8
    DT_CCM_Power: implementation-data-type=uint8
    DT_CCM_APTC_BscSts: implementation-data-type=uint8
    DT_CCM_APTC_Power: implementation-data-type=uint8
    DT_IBC_CRC_227: implementation-data-type=uint8
    DT_IBC_RollingCounter_227: implementation-data-type=uint8
    DT_IBC_EPB_FailStatus: implementation-data-type=uint8
    DT_IBC_EPB_Status: implementation-data-type=uint8
    DT_IBC_EPB_DrumMode: implementation-data-type=uint8
    DT_IBC_EPB_AchievedClampForce: implementation-data-type=uint8
    DT_IBC_EPB_FailureLamp: implementation-data-type=uint8
    DT_IBC_EPB_ActuatorStateLeft: implementation-data-type=uint8
    DT_IBC_EPB_ActuatorStateRight: implementation-data-type=uint8
    DT_IBC_EPB_HostAvailabilityLeft: implementation-data-type=uint8
    DT_IBC_EPB_HostAvailabilityRight: implementation-data-type=uint8
    DT_Harness_igbt_temp{1..3}: implementation-data-type=uint8
    DT_Harness_CoolWaterTemp: implementation-data-type=uint8
    DT_Harness_V_DC: implementation-data-type=uint16
    DT_Harness_PWM_DIR: implementation-data-type=uint8
    DT_Harness_HVIL_State: implementation-data-type=uint8
    DT_Harness_crash_err_flag: implementation-data-type=uint8
    DT_Harness_KeyON: implementation-data-type=uint8
    DT_Harness_HWRdc: implementation-data-type=uint8
    DT_Harness_HWFoT: implementation-data-type=uint8
    DT_Harness_HWVoltLower: implementation-data-type=uint8
    DT_Harness_HWFoB: implementation-data-type=uint8
    DT_Harness_MotorTemp1: implementation-data-type=uint16
    DT_Harness_MotorTemp2: implementation-data-type=uint16
    DT_Harness_I_U: implementation-data-type=uint8
    DT_Harness_I_W: implementation-data-type=uint8
    DT_Harness_I_V: implementation-data-type=uint8
    DT_Harness_HVRelayPosVolt: implementation-data-type=uint8
    DT_MCUMR_Harness_igbt_temp{1..3}: implementation-data-type=uint8
    DT_MCUMR_Harness_CoolWaterTemp: implementation-data-type=uint8
    DT_MCUMR_Harness_V_DC: implementation-data-type=uint16
    DT_MCUMR_Harness_PWM_DIR: implementation-data-type=uint8
    DT_MCUMR_Harness_HWRdc: implementation-data-type=uint8
    DT_MCUMR_Harness_HWFoT: implementation-data-type=uint8
    DT_MCUMR_Harness_HWVoltLower: implementation-data-type=uint8
    DT_MCUMR_Harness_HWFoB: implementation-data-type=uint8
    DT_MCUMR_Harness_MotorTemp1: implementation-data-type=uint16
    DT_MCUMR_Harness_MotorTemp2: implementation-data-type=uint16
    DT_MCUMR_Harness_I_U: implementation-data-type=uint8
    DT_MCUMR_Harness_I_W: implementation-data-type=uint8
    DT_MCUMR_Harness_I_V: implementation-data-type=uint8
    DT_BCM_CRC_290: implementation-data-type=uint8
    DT_BCM_RRDoorSts_ID290_CCAN: implementation-data-type=uint8
    DT_BCM_RLDoorSts_ID290_CCAN: implementation-data-type=uint8
    DT_BCM_RollingCounter_290: implementation-data-type=uint8
    DT_BCM_HazardSwtSts: implementation-data-type=uint8
    DT_BCM_DrOC_PPD_Status: implementation-data-type=uint8
    DT_BCM_FLOC_PPD_Status: implementation-data-type=uint8
    DT_BCM_FROC_PPD_Status: implementation-data-type=uint8
    DT_BCM_DriverDoorSts_ID290_CCAN: implementation-data-type=uint8
    DT_BCM_DriverDoorSts_VD: implementation-data-type=uint8
    DT_BCM_FLDoorSts_ID290_CCAN: implementation-data-type=uint8
    DT_BCM_FRDoorSts_ID290_CCAN: implementation-data-type=uint8
    DT_BCM_BackDoorSts_ID290_CCAN: implementation-data-type=uint8
    DT_BCM_FrontCoverSts: implementation-data-type=uint8
    DT_BCM_HazardSwtOpenSts: implementation-data-type=uint8
    DT_BCM_BrakeFluidLevel: implementation-data-type=uint8
    DT_BCM_ON2BRelaySts_ID290_CCAN: implementation-data-type=uint8
    DT_BCM_ON2CRelaySts_ID290_CCAN: implementation-data-type=uint8
    DT_BCM_AlarmMode_C: implementation-data-type=uint8
    DT_VCU_CRC_13: implementation-data-type=uint8
    DT_VCU_RollingCounter_13: implementation-data-type=uint8
    DT_VCU_SDrvRequestTorque_prvt: implementation-data-type=uint16
    DT_VCU_SDrvRequestTorqueVD_prvt: implementation-data-type=uint8
    DT_VCU_MCUSDampgLmtFactor_prvt: implementation-data-type=uint8
    DT_VCU_VehicleDirectS_prvt: implementation-data-type=uint8
    DT_VCU_VehicleDirectS_VD_prvt: implementation-data-type=uint8
    DT_VCU_MCUSMaxPosDampgTrq_prvt: implementation-data-type=uint8
    DT_VCU_MCUSMaxNegDampgTrq_prvt: implementation-data-type=uint8
    DT_EOL_CRC_13B: implementation-data-type=uint8
    DT_EOL_RollingCounter_13B: implementation-data-type=uint8
    DT_EOL_VehicleSts: implementation-data-type=uint8
    DT_EOL_GearLevelPosSts: implementation-data-type=uint8
    DT_EOL_GearLeverValid: implementation-data-type=uint8
    DT_EOL_AccPedalValid: implementation-data-type=uint8
    DT_EOL_ThrottlePosition: implementation-data-type=uint8
    DT_EOL_RMCUActiveReleaseCmd: implementation-data-type=uint8
    DT_EOL_VehicleDirect: implementation-data-type=uint8
    DT_EOL_SuppressJitterRMCURequest: implementation-data-type=uint8
    DT_EOL_RDrvControlMode: implementation-data-type=uint8
    DT_EOL_BrakePedalValue: implementation-data-type=uint8
    DT_EOL_RMCUMaxDischargePower: implementation-data-type=uint16
    DT_EOL_RMCUMaxChargePower: implementation-data-type=uint16
    DT_EOL_RDrvRequestTorque: implementation-data-type=uint16
    DT_EOL_RDrvRequesSpeed: implementation-data-type=uint16
    DT_EOL_FDrvRequestTorque: implementation-data-type=uint16
    DT_EOL_FDrvRequesSpeed: implementation-data-type=uint16
    DT_EOL_FVehicleSts: implementation-data-type=uint8
    DT_EOL_FDrvControlMode: implementation-data-type=uint8
    DT_EOL_ON2BRelayReq: implementation-data-type=uint8
    DT_EOL_VehicleDirectVD: implementation-data-type=uint8
    DT_EOL_RDrvControlModeVD: implementation-data-type=uint8
    DT_EOL_RDrvRequestTorqueVD: implementation-data-type=uint8
    DT_EOL_RDrvRequesSpeedVD: implementation-data-type=uint8
    DT_EOL_FDrvRequestTorqueVD: implementation-data-type=uint8
    DT_EOL_FDrvRequesSpeedVD: implementation-data-type=uint8
    DT_EOL_FDrvControlModeVD: implementation-data-type=uint8
    DT_EOL_MCUMDampgLmtFactor: implementation-data-type=uint8
    DT_EOL_VCU_BoostMode_Fail: implementation-data-type=uint8
    DT_EOL_VCU_BoostModeSts: implementation-data-type=uint8
    DT_EOL_MCUMMaxPosDampgTrq: implementation-data-type=uint8
    DT_EOL_MCUMMaxNegDampgTrq: implementation-data-type=uint8
    DT_TMS_MilLampReq: implementation-data-type=uint8
    DT_EMS_CRC_BE: implementation-data-type=uint8
    DT_EMS_RollingCounter_BE: implementation-data-type=uint8
    DT_EMS_EngineSts: implementation-data-type=uint8
    DT_ECM_FaultLevel: implementation-data-type=uint8
    DT_ECM_ActualEngineTorqueValid: implementation-data-type=uint8
    DT_ECM_EngineTorqueLoss: implementation-data-type=uint16
    DT_ECM_ActualEngineTorque: implementation-data-type=uint16
    DT_ECM_EngineTorqueMax: implementation-data-type=uint16
    DT_ECM_EngineTorqueMin: implementation-data-type=uint16
    DT_ECM_EngineSpeed: implementation-data-type=uint16
    DT_ECM_EngineSpeedValid: implementation-data-type=uint8
    DT_ECM_EngineStopAllow: implementation-data-type=uint8
    DT_ECM_EngineOilPressureLow: implementation-data-type=uint8
    DT_ECM_EngineFuleCutoffSts: implementation-data-type=uint8
    DT_ECM_EngineStartedCompleted: implementation-data-type=uint8
    DT_ECM_CatalystWarmUpSts: implementation-data-type=uint8
    DT_ECM_CatalystWarmUpReq: implementation-data-type=uint8
    DT_ECM_IdleTargetSpeed: implementation-data-type=uint16
    DT_ECM_IdleActive: implementation-data-type=uint8
    DT_ECM_EngineStartReq: implementation-data-type=uint8
    DT_ECM_EngineStopInhibit: implementation-data-type=uint16
    DT_ECM_GPFRegenlamp: implementation-data-type=uint8
    DT_ECM_EngineCoolantTemp: implementation-data-type=uint8
    DT_ECM_EngineCoolantTempValid: implementation-data-type=uint8
    DT_ECM_FVVSts: implementation-data-type=uint8
    DT_ECM_learningReq: implementation-data-type=uint8
    DT_ECM_EngineIdleStateRequest: implementation-data-type=uint8
    DT_ECM_EngineDFCOConditionRequest: implementation-data-type=uint8
    DT_ECM_GPFRegenReq: implementation-data-type=uint8
    DT_ECM_SVSLampRequest: implementation-data-type=uint8
    DT_ECM_TankPressure: implementation-data-type=uint16
    DT_ECM_TankPressureValid: implementation-data-type=uint8
    DT_ECM_MilLampRequest: implementation-data-type=uint8
    DT_ECM_ToothlearningSucValid: implementation-data-type=uint8
    DT_ECM_FuelCloseLoopSts: implementation-data-type=uint8
    DT_ECM_RestrictorOpenValue: implementation-data-type=uint8
    DT_ECM_FuelLevelSensorValid: implementation-data-type=uint8
    DT_ECM_FuelLevel: implementation-data-type=uint16
    DT_ECM_SelfCheckSt: implementation-data-type=uint8
    DT_ECM_PCVPipeDiagReq: implementation-data-type=uint8
    DT_ECM_CalculatedLoad: implementation-data-type=uint16
    DT_ECM_FuelConsumption: implementation-data-type=uint8
    DT_ECM_AirPressure: implementation-data-type=uint8
    DT_ECM_FanSts: implementation-data-type=uint8
    DT_EPS_CRC_18D: implementation-data-type=uint8
    DT_EPS_RollingCounter_18D: implementation-data-type=uint8
    DT_EPS_Fault: implementation-data-type=uint8
    DT_EPS_CalibrationSts: implementation-data-type=uint8
    DT_EPS_FailureSts: implementation-data-type=uint8
    DT_EPS_SteeringAngleValidData: implementation-data-type=uint8
    DT_EPS_SteeringAngleSpeedValidData: implementation-data-type=uint8
    DT_EPS_SteerWheelAngle: implementation-data-type=uint16
    DT_EPS_SteerWheelRotSpd: implementation-data-type=uint8
    DT_EPS_SelfCheckSt: implementation-data-type=uint8
    DT_EPS_AssistanceSts: implementation-data-type=uint8
    DT_GCU_CRC_BD: implementation-data-type=uint8
    DT_GCU_EngineCylinderDeactivationStatus: implementation-data-type=uint8
    DT_GCU_EngineFuelInhibitReq: implementation-data-type=uint8
    DT_GCU_RollingCounter_BD: implementation-data-type=uint8
    DT_GCU_MainWireCurr: implementation-data-type=uint16
    DT_GCU_MainWireVolt: implementation-data-type=uint16
    DT_GCU_SystemWarning: implementation-data-type=uint8
    DT_GCU_MILlampReq: implementation-data-type=uint8
    DT_GCU_MoterTemp: implementation-data-type=uint8
    DT_GCU_Temp: implementation-data-type=uint8
    DT_GCU_SelfCheck: implementation-data-type=uint8
    DT_GCU_Warning_Level: implementation-data-type=uint8
    DT_GCU_HVILSts: implementation-data-type=uint8
    DT_GCU__PowerReduceSts: implementation-data-type=uint8
    DT_GCU_ActualMotorRPM_VD: implementation-data-type=uint8
    DT_GCU_ActualMotorTorque_VD: implementation-data-type=uint8
    DT_GCU_ActualMotorTorque: implementation-data-type=uint16
    DT_GCU_MaxTorque: implementation-data-type=uint16
    DT_GCU_ActiveReleaseFB: implementation-data-type=uint8
    DT_GCU_MAXPower: implementation-data-type=uint8
    DT_GCU_TransientPower: implementation-data-type=uint16
    DT_GCU_HVOffReq: implementation-data-type=uint8
    DT_GCU_ControlMode: implementation-data-type=uint8
    DT_GCU_Operating_Mode: implementation-data-type=uint8
    DT_GCU_ActualMotorRPM: implementation-data-type=uint16
    DT_BMS_WkupVolt_DC12V: implementation-data-type=uint8
    DT_BMS_WkupVolt_AC12V: implementation-data-type=uint8
    DT_BMS_HVPackPosRelayExternalVolt: implementation-data-type=uint16
    DT_BMS_SOC_target: implementation-data-type=uint16
    DT_BMS_CorrectSOEPer: implementation-data-type=uint16
    DT_BMS_SOCModifyFlag: implementation-data-type=uint8
    DT_BMS_BMU_SoftwareVersion: implementation-data-type=uint32_least
    DT_VCU_VehicleSpdDirect: implementation-data-type=uint16
    DT_VCU_ADM_ActualMode: implementation-data-type=uint8
    DT_VCU_ADM_MainMode: implementation-data-type=uint8
    DT_VCU_DeliveryModeSts: implementation-data-type=uint8
    DT_VCU_VehSpdLimtRemind: implementation-data-type=uint8
    DT_VCU_SinglePedalSts: implementation-data-type=uint8
    DT_VCU_GearLvrChangeSts: implementation-data-type=uint8
    DT_VCU_HighVoltSysSts: implementation-data-type=uint8
    DT_VCU_ChrgDischrgFunSts: implementation-data-type=uint8
    DT_VCU_CalibrationVersion: implementation-data-type=uint8
    DT_VCU_CalibrationNumber: implementation-data-type=uint8
    DT_VCU_VehicleNegTrqRspdSts: implementation-data-type=uint8
    DT_VCU_SlopeEst: implementation-data-type=uint16
    DT_VCU_SlopeEst_Valid: implementation-data-type=uint8
    DT_VCU_WheelTrqType: implementation-data-type=uint8
    DT_VCU_DriverAssistProhibitSts: implementation-data-type=uint8
    DT_VCU_VacumRlySts: implementation-data-type=uint8
    DT_VCU_DriveSHVILSts: implementation-data-type=uint8
    DT_VCU_DriveMHVILSts: implementation-data-type=uint8
    DT_VCU_DCChgHVILSts: implementation-data-type=uint8
    DT_VCU_ACChgHVILSts: implementation-data-type=uint8
    DT_VCU_CCMHVILSts: implementation-data-type=uint8
    DT_VCU_SystemError: implementation-data-type=uint8
    DT_VCU_AccPedalFaultLV: implementation-data-type=uint8
    DT_VCU_HVILSysSts: implementation-data-type=uint8
    DT_VCU_VacuumDegree: implementation-data-type=uint8
    DT_VCU_LPedalModeSts: implementation-data-type=uint8
    DT_VCU_LVSystemError: implementation-data-type=uint8
    DT_VCU_HVSystemError: implementation-data-type=uint8
    DT_VCU_OpeartingMode: implementation-data-type=uint8
    DT_VCU_EnergyMode: implementation-data-type=uint8
    DT_VCU_GearLevelPosFault: implementation-data-type=uint8
    DT_VCU_BrakeSwitchSts: implementation-data-type=uint8
    DT_VCU_SpdLimModeSts: implementation-data-type=uint8
    DT_VCU_TrqDstrbutnPrio: implementation-data-type=uint8
    DT_VCU_TrqDstrbutnTransferSts: implementation-data-type=uint8
    DT_VCU_MCUMDiffProtectSts: implementation-data-type=uint8
    DT_VCU_MCUSDiffProtectSts: implementation-data-type=uint8
    DT_ICU_CRC_332: implementation-data-type=uint8
    DT_ICU_RollingCounter_332: implementation-data-type=uint8
    DT_ICU_AEB_SW: implementation-data-type=uint8
    DT_ICU_ISA_controlSW: implementation-data-type=uint8
    DT_ICU_SLIF_SW: implementation-data-type=uint8
    DT_ICU_SLWF_SW: implementation-data-type=uint8
    DT_TMS_MainMotPumpSpdResp: implementation-data-type=uint8
    DT_TMS_MainMotPump_Operation_Temp: implementation-data-type=uint8
    DT_TMS_MainMotPump_Operation_Current: implementation-data-type=uint8
    DT_TMS_MainMotPump_Supplied_Voltage: implementation-data-type=uint8
    DT_TMS_MainMotPumpErrSts: implementation-data-type=uint8
    DT_IBC_CRC_184: implementation-data-type=uint8
    DT_IBC_RollingCounter_184: implementation-data-type=uint8
    DT_IBC_FLWheelSpeedKPH: implementation-data-type=uint16
    DT_IBC_FRWheelSpeedKPH: implementation-data-type=uint16
    DT_IBC_RLWheelSpeedKPH: implementation-data-type=uint16
    DT_IBC_RRWheelSpeedKPH: implementation-data-type=uint16
    DT_IBC_FLWheelDirection: implementation-data-type=uint8
    DT_IBC_FRWheelDirection: implementation-data-type=uint8
    DT_IBC_RLWheelDirection: implementation-data-type=uint8
    DT_IBC_RRWheelDirection: implementation-data-type=uint8
    DT_IBC_FLWheelSpeedVD: implementation-data-type=uint8
    DT_IBC_FRWheelSpeedVD: implementation-data-type=uint8
    DT_IBC_RLWheelSpeedVD: implementation-data-type=uint8
    DT_IBC_RRWheelSpeedVD: implementation-data-type=uint8
    DT_IBC_FLWheelSpeedRC: implementation-data-type=uint16
    DT_IBC_FRWheelSpeedRC: implementation-data-type=uint16
    DT_IBC_RLWheelSpeedRC: implementation-data-type=uint16
    DT_IBC_RRWheelSpeedRC: implementation-data-type=uint16
    DT_IBC_DiscTemperatureFL: implementation-data-type=uint8
    DT_IBC_DiscTemperatureFLVD: implementation-data-type=uint8
    DT_IBC_DiscTemperatureFR: implementation-data-type=uint8
    DT_IBC_DiscTemperatureFRVD: implementation-data-type=uint8
    DT_IBC_DiscTemperatureRL: implementation-data-type=uint8
    DT_IBC_DiscTemperatureRLVD: implementation-data-type=uint8
    DT_IBC_DiscTemperatureRR: implementation-data-type=uint8
    DT_IBC_DiscTemperatureRRVD: implementation-data-type=uint8
    DT_IBC_CRC_183: implementation-data-type=uint8
    DT_IBC_RollingCounter_183: implementation-data-type=uint8
    DT_IBC_RecuBrakeTorqueRequest: implementation-data-type=uint16
    DT_IBC_RecuBrakeTorqueRequest_Q: implementation-data-type=uint8
    DT_IBC_sOutputRodDriverPer_Q: implementation-data-type=uint8
    DT_IBC_BrakePedalApplied_Q: implementation-data-type=uint8
    DT_IBC_HydraTorqTgtAct_Q: implementation-data-type=uint8
    DT_IBC_HydraTorqTgtAct: implementation-data-type=uint16
    DT_IBC_BrakePedalApplied: implementation-data-type=uint8
    DT_IBC_sOutputRodDriverPer: implementation-data-type=uint8
    DT_IBC_HydraTorqAvailable: implementation-data-type=uint8
    DT_IBC_CtrlMode: implementation-data-type=uint8
    DT_IBC_QDC_HydraTorqTgt: implementation-data-type=uint8
    DT_IBC_InPutRodDriver: implementation-data-type=uint16
    DT_IBC_InPutRodDriver_Q: implementation-data-type=uint8
    DT_IBC_SystemAssistedStatus: implementation-data-type=uint8
    DT_IBC_EngTorq_VLC_Vaild: implementation-data-type=uint8
    DT_IBC_EngTorq_VLC: implementation-data-type=uint16
    DT_IBC_BrkTorq_VLC: implementation-data-type=uint16
    DT_IBC_BrkTorq_VLC_Vaild: implementation-data-type=uint8
    DT_IBC_CRC_186: implementation-data-type=uint8
    DT_IBC_RollingCounter_186: implementation-data-type=uint8
    DT_IBC_WheelPressureReliabilityFL: implementation-data-type=uint8
    DT_IBC_WheelPressureReliabilityFR: implementation-data-type=uint8
    DT_IBC_WheelPressureReliabilityRL: implementation-data-type=uint8
    DT_IBC_WheelPressureReliabilityRR: implementation-data-type=uint8
    DT_IBC_WheelCylinderPressure_FL: implementation-data-type=uint16
    DT_IBC_WheelCylinderPressure_FR: implementation-data-type=uint16
    DT_IBC_WheelCylinderPressure_RL: implementation-data-type=uint16
    DT_IBC_WheelCylinderPressure_RR: implementation-data-type=uint16
    DT_IBC_WheelSlipFLVD: implementation-data-type=uint8
    DT_IBC_WheelSlipFRVD: implementation-data-type=uint8
    DT_IBC_WheelSlipRLVD: implementation-data-type=uint8
    DT_IBC_WheelSlipRRVD: implementation-data-type=uint8
    DT_IBC_WheelSlipFL: implementation-data-type=uint8
    DT_IBC_WheelSlipFR: implementation-data-type=uint8
    DT_IBC_WheelSlipRL: implementation-data-type=uint8
    DT_IBC_WheelSlipRR: implementation-data-type=uint8
    DT_IBC_Slop_Pencent: implementation-data-type=uint8
    DT_PTC_BscSts: implementation-data-type=uint8
    DT_PTC_RollingCounter_367: implementation-data-type=uint8
    DT_PTC_Fault: implementation-data-type=uint8
    DT_PTC_Power: implementation-data-type=uint8
    DT_PTC_HV_interlock_faultSt: implementation-data-type=uint8
    DT_VCU_FaultData{0..31}: implementation-data-type=uint8
    DT_GW_TCM_CRC_30B: implementation-data-type=uint8
    DT_GW_TCM_RollingCounter_30B: implementation-data-type=uint8
    DT_GW_TCM_ParkingSwSts: implementation-data-type=uint8
    DT_GW_TCM_STATUS_Park: implementation-data-type=uint8
    DT_GW_TCM_Counter_Park: implementation-data-type=uint8
    DT_GW_TCM_CRC_Park: implementation-data-type=uint8
    DT_GW_TCM_GearLevelSwitchSts: implementation-data-type=uint8
    DT_GW_TCM_STATUS_RND: implementation-data-type=uint8
    DT_GW_TCM_Counter_RND: implementation-data-type=uint8
    DT_GW_TCM_CRC_RND: implementation-data-type=uint8
    DT_GW_TCM_SelfCheckSt: implementation-data-type=uint8
    DT_VCU_CRC_B7: implementation-data-type=uint8
    DT_VCU_KeepWorkModeFlag: implementation-data-type=uint8
    DT_VCU_MAI_Active: implementation-data-type=uint8
    DT_VCU_MAI_Available: implementation-data-type=uint8
    DT_VCU_GetCrashStsReq: implementation-data-type=uint8
    DT_VCU_ADASPosTorqueCap_VD: implementation-data-type=uint8
    DT_VCU_ADASPosTorqueCap: implementation-data-type=uint16
    DT_VCU_RollingCounter_B7: implementation-data-type=uint8
    DT_VCU_Vehicle_Warning_IDB7_CCAN: implementation-data-type=uint8
    DT_VCU_VehicleSts_IDB7_CCAN: implementation-data-type=uint8
    DT_VCU_PowerReduceReq: implementation-data-type=uint8
    DT_VCU_ParkingReqToEPB_VD: implementation-data-type=uint8
    DT_VCU_ParkingReqToEPB: implementation-data-type=uint8
    DT_VCU_ACCAvailable: implementation-data-type=uint8
    DT_VCU_ACCActiveSts: implementation-data-type=uint8
    DT_VCU_Active_APS: implementation-data-type=uint8
    DT_VCU_Available_APS: implementation-data-type=uint8
    DT_VCU_ESCActive: implementation-data-type=uint8
    DT_VCU_ESCTorqReqAvailability_Rear: implementation-data-type=uint8
    DT_VCU_AutoHold_ibit: implementation-data-type=uint8
    DT_VCU_VehicleSpeedVD: implementation-data-type=uint8
    DT_VCU_CCSStatus: implementation-data-type=uint8
    DT_VCU_AutoDriveRequest: implementation-data-type=uint8
    DT_VCU_CCSAllow: implementation-data-type=uint8
    DT_VCU_VlcHoldSts: implementation-data-type=uint8
    DT_VCU_HoldReqSts: implementation-data-type=uint8
    DT_VCU_HoldReqStsValid: implementation-data-type=uint8
    DT_VCU_DriverAssistProhibitSts_IDB7_CCAN: implementation-data-type=uint8
    DT_VCU_SpeedLimitedSts: implementation-data-type=uint8
    DT_VCU_SpeedLimitedValue: implementation-data-type=uint8
    DT_VCU_TheoAccePedalPercent: implementation-data-type=uint8
    DT_VCU_RecuBrakeTorqueCap: implementation-data-type=uint16
    DT_VCU_RecuBrakeTorqueAct: implementation-data-type=uint16
    DT_VCU_TheoAccePedalValid: implementation-data-type=uint8
    DT_VCU_HydraTorqTgt: implementation-data-type=uint16
    DT_VCU_RecuBrakeTorqueActDrag: implementation-data-type=uint16
    DT_VCU_ESCTorqReqAvailability_Frnt: implementation-data-type=uint8
    DT_VCU_RecuBrakeTorqueCap_Q: implementation-data-type=uint8
    DT_VCU_RecuBrakeTorqueAct_Q: implementation-data-type=uint8
    DT_VCU_HydraTorqTgt_Q: implementation-data-type=uint8
    DT_VCU_RecuBrakeTorqueActDrag_Q: implementation-data-type=uint8
    DT_VCU_RecuBrakeTorqueTarget_Drag: implementation-data-type=uint16
    DT_VCU_PreventVehSlipSts: implementation-data-type=uint8
    DT_VCU_RecuBrakeTorqueTarget_Drag_Q: implementation-data-type=uint8
    DT_VCU_AllMotWhlTrqFB: implementation-data-type=uint16
    DT_VCU_AllMotWhlTrqFB_VD: implementation-data-type=uint8
    DT_VCU_LSFC_Allow: implementation-data-type=uint8
    DT_VCU_LSFC_Active: implementation-data-type=uint8
    DT_VCU_MGCUWorkMode_C: implementation-data-type=uint8
    DT_VCU_AllRoadSts: implementation-data-type=uint8
    DT_VCU_CmpUTurnAllow: implementation-data-type=uint8
    DT_VCU_CmpUTurnSts: implementation-data-type=uint8
    DT_VCU_AllowCmpUTurnStartFlag: implementation-data-type=uint8
    DT_VCU_CmpUTurnLockWhl: implementation-data-type=uint8
    DT_VCU_CmpUTurnActAngle: implementation-data-type=uint16
    DT_VCU_CmpUTurnActSpinSpd: implementation-data-type=uint8
    DT_VCU_CmpUTurnFltHMI: implementation-data-type=uint8
    DT_VCU_EscapeModeSts: implementation-data-type=uint8
    DT_VCU_BoostMode_Fail_C: implementation-data-type=uint8
    DT_VCU_BoostModeSts_C: implementation-data-type=uint8
    DT_DbgSignal{1..12}_FA: implementation-data-type=uint16
    DT_DbgSignal{1..12}_RA: implementation-data-type=uint16
    DbgSignal{1..12}_RA: implementation-data-type=uint16
    DT_VCU_MCUSWorkFailMsg: implementation-data-type=uint8
    DT_VCU_EscapeWorkFailMsg: implementation-data-type=uint8
    DT_VCU_REClutchFltMsg: implementation-data-type=uint8
    DT_ECM_UDS_Res_Byte{0..7}: implementation-data-type=uint8
    DT_VCU_BCM_Authentication_MAC_A{0..15}: implementation-data-type=uint8
    DT_VCU_BCM_Authentication_Challenge_B{0..3}: implementation-data-type=uint8
    DT_TMS_MCUMHeatPwrReq: implementation-data-type=uint8
    DT_TMS_MCUMHeatModEnad: implementation-data-type=uint8
    DT_TMS_VCU_MotSelfHeatEnReq: implementation-data-type=uint8
    DT_TMS_VCU_MotSelfHeatLvlReq: implementation-data-type=uint8
    DT_ECM_SWVersionC: implementation-data-type=uint8
    DT_ECM_SWVersionB: implementation-data-type=uint8
    DT_ECM_SWVersionA: implementation-data-type=uint8
    DT_ECM_Total_fuel_consumed: implementation-data-type=uint32_least
    DT_IVI_CRC_331: implementation-data-type=uint8
    DT_IVI_RollingCounter_331: implementation-data-type=uint8
    DT_IVI_EPBRequst: implementation-data-type=uint8
    DT_IVI_TerrainMatchMode: implementation-data-type=uint8
    DT_IVI_LPedalModeSW: implementation-data-type=uint8
    DT_IVI_AVHSw_X: implementation-data-type=uint8
    DT_IVI_ESCSw_X: implementation-data-type=uint8
    DT_IVI_HDCSw_X: implementation-data-type=uint8
    DT_IVI_CSTSw_X: implementation-data-type=uint8
    DT_IVI_AutoAllRoad: implementation-data-type=uint8
    DT_IVI_CampingMode_SW: implementation-data-type=uint8
    DT_IVI_BraPedMod: implementation-data-type=uint8
    DT_IVI_SlowspeedSmartCtrl: implementation-data-type=uint8
    DT_IVI_TrailerModeCtrl: implementation-data-type=uint8
    DT_IVI_EscapeMode_SW: implementation-data-type=uint8
    DT_IVI_PowerSavingModeReq: implementation-data-type=uint8
    DT_IVI_SelfAdaptionDriveSW: implementation-data-type=uint8
    DT_IVI_CmpUTurnStartUI: implementation-data-type=uint8
    DT_IVI_CmpUTurnLockWhlUI: implementation-data-type=uint8
    DT_IVI_CmpUTurnTarDirUI: implementation-data-type=uint8
    DT_IVI_CmpUTurnTarAngleUI: implementation-data-type=uint16
    DT_IVI_CmpUTurnReq: implementation-data-type=uint8
    DT_IVI_InventerLimitOdometerkm: implementation-data-type=uint16
    DT_IVI_FuelDetMode: implementation-data-type=uint8
    DT_IVI_EngineIdlingMode: implementation-data-type=uint8
    DT_IVI_CarWashMode: implementation-data-type=uint8
    DT_IVI_CampingModeSW: implementation-data-type=uint8
    DT_IVI_SpeedLimitModeSW: implementation-data-type=uint8
    DT_IVI_FuelupReq: implementation-data-type=uint8
    DT_IVI_FuelChgLevel: implementation-data-type=uint8
    DT_IVI_FuelChgMode: implementation-data-type=uint8
    DT_IVI_InventerLimitOdometerkmVD: implementation-data-type=uint8
    DT_IVI_EMSRepairModeReq: implementation-data-type=uint8
    DT_IVI_ForceChgModeReq: implementation-data-type=uint8
    DT_IVI_ForceChgTargetSOCVD: implementation-data-type=uint8
    DT_IVI_SpeedLimitModeSpeed: implementation-data-type=uint8
    DT_IVI_AWDModeSW: implementation-data-type=uint8
    DT_IVI_ForceChgTargetSOC: implementation-data-type=uint8
    DT_BCM_VCU_Authentication_Sts: implementation-data-type=uint8
    DT_BCM_PTCLossMissErr: implementation-data-type=uint8
    DT_BCM_PTCRollCntErr: implementation-data-type=uint8
    DT_BCM_PTCChksumErr: implementation-data-type=uint8
    DT_BCM_PDUHVIL_STs: implementation-data-type=uint8
    DT_BCM_Cab220VHVIL_STs: implementation-data-type=uint8
    DT_BCM_Cabin220VHVIL_STs: implementation-data-type=uint8
    DT_IBC_CRC_185: implementation-data-type=uint8
    DT_IBC_RollingCounter_185: implementation-data-type=uint8
    DT_IBC_PlungerPressure: implementation-data-type=uint16
    DT_IBC_PlungerPressure_Q: implementation-data-type=uint8
    DT_IBC_SimulatorPressure: implementation-data-type=uint16
    DT_IBC_SimulatorPressure_Q: implementation-data-type=uint8
    DT_IBC_HMI_WarningOn: implementation-data-type=uint8
    DT_IBC_MIL_WarningOn: implementation-data-type=uint8
    DT_IBC_LongitAcceAct: implementation-data-type=uint16
    DT_IBC_LongitAcceActValid: implementation-data-type=uint8
    DT_IBC_brakeFluidWarning: implementation-data-type=uint8
    DT_IBC_SCM_Active: implementation-data-type=uint8
    DT_IBC_SCM_Failed: implementation-data-type=uint8
    DT_IBC_CDPAvailable: implementation-data-type=uint8
    DT_IBC_CDPIntervention: implementation-data-type=uint8
    DT_IBC_AEB_active: implementation-data-type=uint8
    DT_IBC_AEBdecAvailable: implementation-data-type=uint8
    DT_IBC_AVHStatus: implementation-data-type=uint8
    DT_IBC_AVHAvailable: implementation-data-type=uint8
    DT_IBC_HHCActive: implementation-data-type=uint8
    DT_IBC_HHCFailed: implementation-data-type=uint8
    DT_IBC_CDD_Available_APA: implementation-data-type=uint8
    DT_IBC_CDD_Active_APA: implementation-data-type=uint8
    DT_IBC_CDD_Available_ACC: implementation-data-type=uint8
    DT_IBC_CDD_Active_ACC: implementation-data-type=uint8
    DT_IBC_HDCStatus: implementation-data-type=uint8
    DT_IBC_HDCAvailable: implementation-data-type=uint8
    DT_IBC_CSTStatus: implementation-data-type=uint8
    DT_IBC_CSTAvailable: implementation-data-type=uint8
    DT_IBC_VLC_Available_ACC: implementation-data-type=uint8
    DT_IBC_VLC_Active_ACC: implementation-data-type=uint8
    DT_IBC_VLC_Available_APA: implementation-data-type=uint8
    DT_IBC_VLC_Active_APA: implementation-data-type=uint8
    DT_IBC_VehicleHoldStatus: implementation-data-type=uint8
    DT_IBC_DrvrBrkTqAtWhlsReqd: implementation-data-type=uint16
    DT_TMS_RollingCounter_363: implementation-data-type=uint8
    DT_TMS_AC_Command: implementation-data-type=uint8
    DT_TMS_PTCHeatingReq: implementation-data-type=uint8
    DT_TMS_PTCPowerSet: implementation-data-type=uint8
    DT_TMS_OutsideTempVD: implementation-data-type=uint8
    DT_TMS_OutsideTemp_Corrected: implementation-data-type=uint8
    DT_BMS_SOC_Real: implementation-data-type=uint16
    DT_BMS_MODE_t: implementation-data-type=uint8
    DT_BMS_VoltLoDeratLevel_NA: implementation-data-type=uint8
    DT_BMS_VoltHiDeratLevel_NA: implementation-data-type=uint8
    DT_TMS_MCUOutTemp: implementation-data-type=uint8
    DT_TMS_MCUMIntelTemp: implementation-data-type=uint8
    DT_TMS_MCUSIntelTemp: implementation-data-type=uint8
    DT_BCM_VCU_Authentication_Challenge_A{0..3}: implementation-data-type=uint8
    DT_ICU_CRC_DF: implementation-data-type=uint8
    DT_ICU_RollingCounter_DF: implementation-data-type=uint8
    DT_ICU_IMU_ACC_x: implementation-data-type=uint16
    DT_ICU_IMU_ACC_y: implementation-data-type=uint16
    DT_ICU_IMU_ACC_z: implementation-data-type=uint16
    DT_ICU_IMU_ACC_Roll_Rate: implementation-data-type=uint16
    DT_ICU_IMU_ACC_Pitch_Rate: implementation-data-type=uint16
    DT_ICU_IMU_ACC_Yaw_Rate: implementation-data-type=uint16
    DT_ICU_IMU_Calibrated: implementation-data-type=uint8
    DT_ICU_IMU_Valid: implementation-data-type=uint8
    DT_EddyCur_Para_Cos_m: implementation-data-type=uint16
    DT_EddyCur_Stage: implementation-data-type=uint8
    DT_EddyCur_IdenFinish_Flag: implementation-data-type=uint8
    DT_EddyCur_Para_Sin_m: implementation-data-type=uint16
    DT_EddyCur_Write_Flag: implementation-data-type=uint8
    DT_EddyCur_FauPro_IDEL_OTime_Flag: implementation-data-type=uint8
    DT_EddyCur_FauPro_SpdInstab_Flag: implementation-data-type=uint8
    DT_EddyCur_FauPro_IDPara_OVal_Flag: implementation-data-type=uint8
    DT_EddyCur_Para_Cos_k: implementation-data-type=uint16
    DT_EddyCur_Enable: implementation-data-type=uint8
    DT_EddyCur_Para_Sin_k: implementation-data-type=uint16
    DT_EddyCur_IdenFail_Flag: implementation-data-type=uint8
    DT_EddyCur_Para_Cos_Pha: implementation-data-type=uint16
    DT_EddyCur_Para_Sin_Pha: implementation-data-type=uint16
    DT_EddyCur_ReadSuccess_Flag: implementation-data-type=uint8
    DT_OfsIden_ReadSuccess_Flag: implementation-data-type=uint8
    DT_OfsIden_SpdUp_Overtime: implementation-data-type=uint8
    DT_OfsIden_SpdUp_OverSpd: implementation-data-type=uint8
    DT_OfsIden_IdenDiverge: implementation-data-type=uint8
    DT_OfsIden_IdenCntOver: implementation-data-type=uint8
    DT_OfsIden_MtrLock: implementation-data-type=uint8
    DT_OfsIden_OfsRslt: implementation-data-type=uint16
    DT_OfsIden_Sts: implementation-data-type=uint8
    DT_OfsIden_Finish: implementation-data-type=uint8
    DT_OfsIden_OfsWrite_Finish: implementation-data-type=uint8
    DT_OfsIden_DirWrite_Finish: implementation-data-type=uint8
    DT_OfsIden_DirIden_Rslt: implementation-data-type=uint8
    DT_OfsIden_ZeroAlign_OverTime: implementation-data-type=uint8
    DT_OfsIden_ZeroAlign_Fail: implementation-data-type=uint8
    DT_OfsIden_IFStart_Overtime: implementation-data-type=uint8
    DT_OfsIden_IFStart_Fail: implementation-data-type=uint8
    DT_PosDly_Cal_RslvDelayTime: implementation-data-type=uint16
    DT_PosDly_Theta_k_Std: implementation-data-type=uint16
    DT_PosDly_Supplier: implementation-data-type=uint8
    DT_PosDly_FauPro_Ident_OTm_Flag: implementation-data-type=uint8
    DT_PosDly_FauPro_SpdDn_OTm_Flag: implementation-data-type=uint8
    DT_PosDly_RslvOffsetComp: implementation-data-type=uint8
    DT_PosDly_Enable: implementation-data-type=uint8
    DT_PosDly_IdentFail_Flag: implementation-data-type=uint8
    DT_PosDly_IdentFinish_Flag: implementation-data-type=uint8
    DT_PosDly_Write_Flag: implementation-data-type=uint8
    DT_PosDly_FauPro_Chk_DlyTime_OVal: implementation-data-type=uint8
    DT_PosDly_FauPro_Chk_RslvOfst_OVal: implementation-data-type=uint8
    DT_PosDly_FauPro_Check_Divergence: implementation-data-type=uint8
    DT_PosDly_FauPro_SpdUp_OTm_Flag: implementation-data-type=uint8
    DT_PosDly_Stage: implementation-data-type=uint8
    DT_IMParaIdent_ParEstMainStep: implementation-data-type=uint8
    DT_IMParaIdent_Rs: implementation-data-type=uint16
    DT_IMParaIdent_Rr: implementation-data-type=uint16
    DT_IMParaIdent_Ll: implementation-data-type=uint16
    DT_IMParaIdent_Lm: implementation-data-type=uint16
    DT_IMParaIdent_TotalLo: implementation-data-type=uint16
    DT_IMParaIdent_IdentSubStep: implementation-data-type=uint8
    DT_MCUMR_EddyCur_Para_Cos_m: implementation-data-type=uint16
    DT_MCUMR_EddyCur_Stage: implementation-data-type=uint8
    DT_MCUMR_EddyCur_IdenFinish_Flag: implementation-data-type=uint8
    DT_MCUMR_EddyCur_Para_Sin_m: implementation-data-type=uint16
    DT_MCUMR_EddyCur_Write_Flag: implementation-data-type=uint8
    DT_MCUMR_EddyCur_FauPro_IDEL_OTime_Flag: implementation-data-type=uint8
    DT_MCUMR_EddyCur_FauPro_SpdInstab_Flag: implementation-data-type=uint8
    DT_MCUMR_EddyCur_FauPro_IDPara_OVal_Flag: implementation-data-type=uint8
    DT_MCUMR_EddyCur_Para_Cos_k: implementation-data-type=uint16
    DT_MCUMR_EddyCur_Enable: implementation-data-type=uint8
    DT_MCUMR_EddyCur_Para_Sin_k: implementation-data-type=uint16
    DT_MCUMR_EddyCur_IdenFail_Flag: implementation-data-type=uint8
    DT_MCUMR_EddyCur_Para_Cos_Pha: implementation-data-type=uint16
    DT_MCUMR_EddyCur_Para_Sin_Pha: implementation-data-type=uint16
    DT_MCUMR_EddyCur_ReadSuccess_Flag: implementation-data-type=uint8
    DT_MCUMR_OfsIden_ReadSuccess_Flag: implementation-data-type=uint8
    DT_MCUMR_OfsIden_SpdUp_Overtime: implementation-data-type=uint8
    DT_MCUMR_OfsIden_SpdUp_OverSpd: implementation-data-type=uint8
    DT_MCUMR_OfsIden_IdenDiverge: implementation-data-type=uint8
    DT_MCUMR_OfsIden_IdenCntOver: implementation-data-type=uint8
    DT_MCUMR_OfsIden_MtrLock: implementation-data-type=uint8
    DT_MCUMR_OfsIden_OfsRslt: implementation-data-type=uint16
    DT_MCUMR_OfsIden_Sts: implementation-data-type=uint8
    DT_MCUMR_OfsIden_Finish: implementation-data-type=uint8
    DT_MCUMR_OfsIden_OfsWrite_Finish: implementation-data-type=uint8
    DT_MCUMR_OfsIden_DirWrite_Finish: implementation-data-type=uint8
    DT_MCUMR_OfsIden_DirIden_Rslt: implementation-data-type=uint8
    DT_MCUMR_OfsIden_ZeroAlign_OverTime: implementation-data-type=uint8
    DT_MCUMR_OfsIden_ZeroAlign_Fail: implementation-data-type=uint8
    DT_MCUMR_OfsIden_IFStart_Overtime: implementation-data-type=uint8
    DT_MCUMR_OfsIden_IFStart_Fail: implementation-data-type=uint8
    DT_MCUM_StatorTemp_1: implementation-data-type=uint8
    DT_MCUM_L2TqAct: implementation-data-type=uint16
    DT_MCUM_EOPSw: implementation-data-type=uint32
    DT_MCUM_StatorTemp_2: implementation-data-type=uint8
    DT_MCUM_IGBTTemp_U: implementation-data-type=uint8
    DT_MCUM_IGBTTemp_V: implementation-data-type=uint8
    DT_MCUM_IGBTTemp_W: implementation-data-type=uint8
    DT_MCUM_PCBTemp: implementation-data-type=uint8
    DT_MCUM_Power_12V: implementation-data-type=uint8
    DT_MCUM_Power_15V: implementation-data-type=uint8
    DT_MCUM_Offset_IU: implementation-data-type=uint16
    DT_MCUM_Offset_IV: implementation-data-type=uint16
    DT_MCUM_Offset_IW: implementation-data-type=uint16
    DT_MCUM_MainSt_State: implementation-data-type=uint8
    DT_MCUM_Derate_Reason: implementation-data-type=uint8
    DT_MCUM_PWM_Freq_kHz: implementation-data-type=uint8
    DT_MCUM_PWMEn_State: implementation-data-type=uint8
    DT_MCUM_DrvPwrEn_Out_State: implementation-data-type=uint8
    DT_MCUM_SBC_SelfCheckFault: implementation-data-type=uint8
    DT_MCUM_SBC_TempOverFault: implementation-data-type=uint8
    DT_MCUM_SBC_SPIFault: implementation-data-type=uint8
    DT_MCUM_SBC_InsideVotageFault: implementation-data-type=uint8
    DT_MCUM_SBC_OutPutVotageFault: implementation-data-type=uint8
    DT_MCUM_SBC_FeedDogFault: implementation-data-type=uint8
    DT_MCUM_NVM_RslvrZeroRFault: implementation-data-type=uint8
    DT_MCUM_Rotor_Position: implementation-data-type=uint16
    DT_MCUM_PosTransduserFaultCode: implementation-data-type=uint8
    DT_MCUM_NVM_RslvrDirRFault: implementation-data-type=uint8
    DT_MCUM_NVM_RslvrDelayRFault: implementation-data-type=uint8
    DT_MCUM_NVM_RslvrParamRFault: implementation-data-type=uint8
    DT_MCUM_NVM_HallGainRFault: implementation-data-type=uint8
    DT_MCUM_NVM_HallDelayRFault: implementation-data-type=uint8
    DT_MCUM_NVM_IGBTTypeRFault: implementation-data-type=uint8
    DT_MCUM_NVM_MotorTypeRFault: implementation-data-type=uint8
    DT_MCUM_NVM_VehicleTypeRFault: implementation-data-type=uint8
    DT_MCUM_ASC_EntryCount: implementation-data-type=uint8
    DT_MCUM_Spd_Turn: implementation-data-type=uint16
    DT_MCUM_LUT_Spd_Max: implementation-data-type=uint16
    DT_MCUM_EOP_Speed: implementation-data-type=uint16
    DT_MCUM_EOP_IqFb: implementation-data-type=uint16
    DT_MCUM_EOP_IqRef: implementation-data-type=uint16
    DT_MCUM_EOP_DCVolt: implementation-data-type=uint16
    DT_MCUM_EOP_DCCurr: implementation-data-type=uint16
    DT_MCUM_EOP_Temp: implementation-data-type=uint8
    DT_MCUM_EOP_State: implementation-data-type=uint8
    DT_MCUM_EOP_FaultCode: implementation-data-type=uint8
    DT_MCUM_HWFault_RstCnt: implementation-data-type=uint8
    DT_MCUM_HWFoB_RstCnt: implementation-data-type=uint8
    DT_MCUM_HWFoT_RstCnt: implementation-data-type=uint8
    DT_MCUM_HWDrvUV_RstCnt: implementation-data-type=uint8
    DT_MCUM_HWRdc_RstCnt: implementation-data-type=uint8
    DT_MCUM_HWOC_RstCnt: implementation-data-type=uint8
    DT_MCUM_HWOV_RstCnt: implementation-data-type=uint8
    DT_MCUM_L2agRtrElecDiff: implementation-data-type=uint8
    DT_MCUM_500usOverTime_Cnt: implementation-data-type=uint8
    DT_MCUM_5msOverTime_Cnt: implementation-data-type=uint8
    DT_MCUM_12VHop_Cnt: implementation-data-type=uint8
    DT_MCUM_12V_Max: implementation-data-type=uint8
    DT_MCUM_12V_Min: implementation-data-type=uint8
    DT_MCUM_NVMFail_Cnt: implementation-data-type=uint8
    DT_MCUM_EOL_CANCommReq: implementation-data-type=uint8
    DT_MCUM_ResetReason: implementation-data-type=uint8
    DT_MCUM_CpldRest_TimeOut_flag: implementation-data-type=uint8
    DT_MCUM_DrvPCBCurr: implementation-data-type=uint8
    DT_MCUM_EOL_StateMachine: implementation-data-type=uint8
    DT_MCUM_CpldRest_ASC_Flag: implementation-data-type=uint8
    DT_MCUM_LimSpdTorFlag: implementation-data-type=uint8
    DT_MCUM_PWM_Err_Count: implementation-data-type=uint8
    DT_MCUM_RDC_Reset_Count: implementation-data-type=uint8
    DT_MCUM_ASC_Stop_Flag: implementation-data-type=uint8
    DT_MCUM_ASC_Soft_Exiting_Flag: implementation-data-type=uint8
    DT_MCUM_Vbus_ServeLowChkEn: implementation-data-type=uint8
    DT_MCUM_EOP_BlockErr_IsLim_Flag: implementation-data-type=uint8
    DT_MCUM_MotSelfHeat_EnSts: implementation-data-type=uint8
    DT_MCUM_MotBlockHeat_LvlFb: implementation-data-type=uint8
    DT_MCUM_MotRotaryHeat_LvlFb: implementation-data-type=uint8
    DT_MCUM_MotSelfHeat_DropLvlFb: implementation-data-type=uint8
    DT_MCUM_MotSelfHeat_DropLvlRsn: implementation-data-type=uint8
    DT_MCUM_MotBlockHeat_CurAngle: implementation-data-type=uint16
    DT_MCUM_MotBlockHeat_CurMag: implementation-data-type=uint16
    DT_MCUM_FaultDataRec_State: implementation-data-type=uint8
    DT_MCUM_UserDefine_Byte{1..4}: implementation-data-type=uint8
    DT_MCUM_UserDefine_Word{1..3}: implementation-data-type=uint16
    DT_ECM_EngineWorktime: implementation-data-type=uint16
    DT_GTC_TestSts: implementation-data-type=uint8
    DT_GTC_ThetaPos: implementation-data-type=uint16
    DT_GTC_ThetaNeg: implementation-data-type=uint16
    DT_GTC_ThetaDelt: implementation-data-type=uint16
    DT_GTC_TestRslt: implementation-data-type=uint8
    DT_MCUMR_GTC_TestSts: implementation-data-type=uint8
    DT_MCUMR_GTC_ThetaPos: implementation-data-type=uint16
    DT_MCUMR_GTC_ThetaNeg: implementation-data-type=uint16
    DT_MCUMR_GTC_ThetaDelt: implementation-data-type=uint16
    DT_MCUMR_GTC_TestRslt: implementation-data-type=uint8
    DT_MCUM_CRC_CA: implementation-data-type=uint8
    DT_MCUM_RollingCounter_CA: implementation-data-type=uint8
    DT_MCUM_WarningLevel: implementation-data-type=uint8
    DT_MCUM_SelfCheckSts: implementation-data-type=uint8
    DT_MCUM_DrvMotorWorkSts: implementation-data-type=uint8
    DT_MCUM_PowerReduceSts: implementation-data-type=uint8
    DT_MCUM_SystemError: implementation-data-type=uint8
    DT_MCUM_DrvMotorRPM: implementation-data-type=uint16
    DT_MCUM_ActualTorqueFB: implementation-data-type=uint16
    DT_MCUM_HWRdcFault: implementation-data-type=uint8
    DT_MCUM_LVSystemError: implementation-data-type=uint8
    DT_MCUM_HighVoltPowerOffReq: implementation-data-type=uint8
    DT_MCUM_HVILSts: implementation-data-type=uint8
    DT_MCUM_DragSts: implementation-data-type=uint8
    DT_MCUM_CtrlMode: implementation-data-type=uint8
    DT_MCUM_MotorTempAlarm: implementation-data-type=uint8
    DT_MCUM_HVSystemError: implementation-data-type=uint8
    DT_MCUM_MILlampReq: implementation-data-type=uint8
    DT_MCUM_SeriousWarning_Level: implementation-data-type=uint8
    DT_MCUM_DrvMotorRPMVD: implementation-data-type=uint8
    DT_MCUM_ActualTorqueFBVD: implementation-data-type=uint8
    DT_MCUM_CtrlModeVD: implementation-data-type=uint8
    DT_MCUM_MaxTorqueAllow: implementation-data-type=uint16
    DT_MCUM_MaxSpeedAllow: implementation-data-type=uint16
    DT_MCUM_WaterPumpLevlReq: implementation-data-type=uint8
    DT_MCUM_ActiveReleaseSts: implementation-data-type=uint8
    DT_MCUM_DCChargRelaySts: implementation-data-type=uint8
    DT_MCUM_Fault_DCChargRelay: implementation-data-type=uint8
    DT_MCUM_MinTorqueAllow: implementation-data-type=uint16
    DT_MCUM_MainWireVolt: implementation-data-type=uint16
    DT_MCUM_MotorTemp: implementation-data-type=uint8
    DT_MCUM_IGBTTemp: implementation-data-type=uint8
    DT_MCUM_InletTemp: implementation-data-type=uint8
    DT_MCUM_MainWireCurr: implementation-data-type=uint16
    DT_MCUM_TMS_MotSelfHeatEnSts: implementation-data-type=uint8
    DT_MCUM_TMS_MotSelfHeatLvlFb: implementation-data-type=uint8
    DT_MCUM_HeatPwrAllwd: implementation-data-type=uint8
    DT_MCUM_HeatFdBck: implementation-data-type=uint8
    DT_MCUM_RPowerReduceSts: implementation-data-type=uint8
    DT_MCUM_HeatPwrAct: implementation-data-type=uint8
    DT_MCUM_HeatPwrMax: implementation-data-type=uint8
    DT_MCUM_HeatPwrAval: implementation-data-type=uint8
    DT_MCUM_RCtrlMode: implementation-data-type=uint8
    DT_MCUM_RWarningLevel: implementation-data-type=uint8
    DT_MCUM_RSelfCheckSts: implementation-data-type=uint8
    DT_MCUM_RDrvMotorWorkSts: implementation-data-type=uint8
    DT_MCUM_RCtrlModeVD: implementation-data-type=uint8
    DT_MCUM_RHWRdcFault: implementation-data-type=uint8
    DT_MCUM_RDrvMotorRPMVD: implementation-data-type=uint8
    DT_MCUM_RActualTorqueFBVD: implementation-data-type=uint8
    DT_MCUM_RDrvMotorRPM: implementation-data-type=uint16
    DT_MCUM_RActualTorqueFB: implementation-data-type=uint16
    DT_IBC_CRC_182: implementation-data-type=uint8
    DT_IBC_RollingCounter_182: implementation-data-type=uint8
    DT_IBC_VehicleSpeed: implementation-data-type=uint16
    DT_IBC_VehicleSpeedVD: implementation-data-type=uint8
    DT_IBC_ABSActive: implementation-data-type=uint8
    DT_IBC_ABSFailed: implementation-data-type=uint8
    DT_IBC_TCSActive: implementation-data-type=uint8
    DT_IBC_TCSFailed: implementation-data-type=uint8
    DT_IBC_ESCFunctionStatus: implementation-data-type=uint8
    DT_IBC_BrakeForce: implementation-data-type=uint8
    DT_IBC_Vehiclestandstill: implementation-data-type=uint8
    DT_IBC_EBDFailed: implementation-data-type=uint8
    DT_IBC_EBDActive: implementation-data-type=uint8
    DT_IBC_VDCActive: implementation-data-type=uint8
    DT_IBC_VDCFailed: implementation-data-type=uint8
    DT_IBC_EDCActive: implementation-data-type=uint8
    DT_IBC_EDCFailed: implementation-data-type=uint8
    DT_IBC_SystemInitializeStatus: implementation-data-type=uint8
    DT_IBC_BTCSActive: implementation-data-type=uint8
    DT_IBC_ETCSActive: implementation-data-type=uint8
    DT_IBC_ARPActive: implementation-data-type=uint8
    DT_IBC_VCU_DrumMode: implementation-data-type=uint8
    DT_IBC_EscapeModeSts: implementation-data-type=uint8
    DT_IBC_TSAActive: implementation-data-type=uint8
    DT_IBC_TSAStatus: implementation-data-type=uint8
    DT_MCUM_FaultData{0..7}: implementation-data-type=uint8
    DT_MCUM_FaultData{8..14}: implementation-data-type=uint64
    DT_MCUM_R_FaultData{0..7}: implementation-data-type=uint8
    DT_MCUM_R_FaultData{8..14}: implementation-data-type=uint64
    DT_ICU_CRC_24D: implementation-data-type=uint8
    DT_ICU_SpeedConversionCoefficient: implementation-data-type=uint8
    DT_ICU_RollingCounter_24D: implementation-data-type=uint8
    DT_ICU_CCSFunctionStatus: implementation-data-type=uint8
    DT_ICU_CruiseVehicleSpeedCtl: implementation-data-type=uint16
    DT_ICU_VehicleScreenSpeed: implementation-data-type=uint16
    DT_ICU_VehicleSpeedUnit: implementation-data-type=uint8
    DT_ICU_ACCFunctionStatus: implementation-data-type=uint8
    DT_ICU_LCCFunctionStatus: implementation-data-type=uint8
    DT_IVI_LPedalMode: implementation-data-type=uint8
    DT_ICU_TotalOilmeterkm: implementation-data-type=uint32_least
    DT_ICU_CLTCoilMileage: implementation-data-type=uint16
    DT_ICU_WLTC_oilMileage: implementation-data-type=uint16
    DT_ICU_CLTC_ElectticityMileage: implementation-data-type=uint16
    DT_ICU_WLTC_ElectticityMileage: implementation-data-type=uint16
    DT_ICU_Switch_CLTCOrWLTC: implementation-data-type=uint8
    DT_ICU_FuelPercent: implementation-data-type=uint16
    DT_ACU_CRC_233: implementation-data-type=uint8
    DT_ACU_RollingCounter_233: implementation-data-type=uint8
    DT_ACU_LateralAcce: implementation-data-type=uint16
    DT_ACU_LongitAcce: implementation-data-type=uint16
    DT_ACU_LateralAcceValid: implementation-data-type=uint8
    DT_ACU_LongitAcceValid: implementation-data-type=uint8
    DT_ACU_SensorCalSt: implementation-data-type=uint8
    DT_ACU_YawRate: implementation-data-type=uint16
    DT_ACU_YawRateValid: implementation-data-type=uint8
    DT_MotClb_UdFb: implementation-data-type=uint16
    DT_MotClb_UqFb: implementation-data-type=uint16
    DT_MotClb_IdSet: implementation-data-type=uint16
    DT_MotClb_IqSet: implementation-data-type=uint16
    DT_MotClb_IsCMD_Fb: implementation-data-type=uint16
    DT_MotClb_ThetaCMD_Fb: implementation-data-type=uint16
    DT_MotClb_Id_Fb: implementation-data-type=uint16
    DT_MotClb_Iq_Fb: implementation-data-type=uint16
    DT_MotClb_Spd_rpm_Flt: implementation-data-type=uint16
    DT_MotClb_ThtSetReal: implementation-data-type=uint16
    DT_MotClb_Power_Inverter: implementation-data-type=uint16
    DT_MotClb_Volt_DC: implementation-data-type=uint16
    DT_MotClb_UsOutFlt: implementation-data-type=uint16
    DT_MotClb_CoolWater_Temp: implementation-data-type=uint16
    DT_MotClb_Motor_Temp1_Flt: implementation-data-type=uint8
    DT_MotClb_IGBT_Temp1: implementation-data-type=uint8
    DT_MotClb_ErrLevel: implementation-data-type=uint8
    DT_MCUMR_MotClb_UdFb: implementation-data-type=uint16
    DT_MCUMR_MotClb_UqFb: implementation-data-type=uint16
    DT_MCUMR_MotClb_IdSet: implementation-data-type=uint16
    DT_MCUMR_MotClb_IqSet: implementation-data-type=uint16
    DT_MCUMR_MotClb_IsCMD_Fb: implementation-data-type=uint16
    DT_MCUMR_MotClb_ThetaCMD_Fb: implementation-data-type=uint16
    DT_MCUMR_MotClb_Id_Fb: implementation-data-type=uint16
    DT_MCUMR_MotClb_Iq_Fb: implementation-data-type=uint16
    DT_MCUMR_MotClb_Spd_rpm_Flt: implementation-data-type=uint16
    DT_MCUMR_MotClb_ThtSetReal: implementation-data-type=uint16
    DT_MCUMR_MotClb_Power_Inverter: implementation-data-type=uint16
    DT_MCUMR_MotClb_Volt_DC: implementation-data-type=uint16
    DT_MCUMR_MotClb_UsOutFlt: implementation-data-type=uint16
    DT_MCUMR_MotClb_CoolWater_Temp: implementation-data-type=uint16
    DT_MCUMR_MotClb_Motor_Temp1_Flt: implementation-data-type=uint8
    DT_MCUMR_MotClb_IGBT_Temp1: implementation-data-type=uint8
    DT_MCUMR_MotClb_ErrLevel: implementation-data-type=uint8
    DT_BMS_CRC_1A1: implementation-data-type=uint8
    DT_BMS_RollingCounter_1A1: implementation-data-type=uint8
    DT_BMS_Warning_Level: implementation-data-type=uint8
    DT_BMS_SelfCheck: implementation-data-type=uint8
    DT_BMS_BattChargerSts: implementation-data-type=uint8
    DT_BMS_RHighVolSts: implementation-data-type=uint8
    DT_BMS_RPreChargeRelayFB: implementation-data-type=uint8
    DT_BMS_RPositiveRelayFB: implementation-data-type=uint8
    DT_BMS_RNegativeRelayFB: implementation-data-type=uint8
    DT_BMS_RPositiveRelay_F: implementation-data-type=uint8
    DT_BMS_RNegativeRelay_F: implementation-data-type=uint8
    DT_BMS_RPreChargeFinishSts: implementation-data-type=uint8
    DT_BMS_MCUMHVILSts: implementation-data-type=uint8
    DT_BMS_ACPTCHVILSts: implementation-data-type=uint8
    DT_BMS_PTCHVILSts: implementation-data-type=uint8
    DT_BMS_CCMHVILSts: implementation-data-type=uint8
    DT_BMS_CDUHVILSts: implementation-data-type=uint8
    DT_BMS_DCChgHVILSts: implementation-data-type=uint8
    DT_BMS_MCUSHVILSts: implementation-data-type=uint8
    DT_BMS_HVOffSts: implementation-data-type=uint8
    DT_BMS_SeriousWarning_Level: implementation-data-type=uint8
    DT_BMS_DCChgRelayCloseReq: implementation-data-type=uint8
    DT_BMS_DCChgRelayFB: implementation-data-type=uint8
    DT_BMS_ChgStopReason: implementation-data-type=uint8
    DT_BMS_GCUHVILSts: implementation-data-type=uint8
    DT_BMS_MILlampReq: implementation-data-type=uint8
    DT_BMS_IsoRessistanceSts: implementation-data-type=uint8
    DT_BMS_Integrity_Check: implementation-data-type=uint8
    DT_BMS_BattVolt: implementation-data-type=uint16
    DT_BMS_BattCurr: implementation-data-type=uint16
    DT_BMS_BatDyn_Dchgpwr: implementation-data-type=uint16
    DT_BMS_BatDyn_Chgpwr: implementation-data-type=uint16
    DT_BMS_Precharge_CoolingSts: implementation-data-type=uint8
    DT_IBC_CRC_B1: implementation-data-type=uint8
    DT_IBC_RollingCounter_B1: implementation-data-type=uint8
    DT_IBC_EngTorqDec_Main: implementation-data-type=uint16
    DT_IBC_EngTorqDecActive_Main: implementation-data-type=uint8
    DT_IBC_EngTorqInc_Main: implementation-data-type=uint16
    DT_IBC_EngTorqIncActive_Main: implementation-data-type=uint8
    DT_IBC_EngTorqDec_Sub: implementation-data-type=uint16
    DT_IBC_EngTorqDecActive_Sub: implementation-data-type=uint8
    DT_IBC_EngTorqInc_Sub: implementation-data-type=uint16
    DT_IBC_EngTorqIncActive_Sub: implementation-data-type=uint8
    DT_IBC_EngTorqDec_MainR: implementation-data-type=uint16
    DT_IBC_EngTorqDecActive_MainR: implementation-data-type=uint8
    DT_IBC_EngTorqInc_MainR: implementation-data-type=uint16
    DT_IBC_EngTorqIncActive_MainR: implementation-data-type=uint8
    DT_ADDC_CRC_83: implementation-data-type=uint8
    DT_ADDC_ACC_AVHReq: implementation-data-type=uint8
    DT_ADDC_ACC_HoldSts: implementation-data-type=uint8
    DT_ADDC_ACCTargetTrq: implementation-data-type=uint16
    DT_ADDC_ACCTargetTrqVD: implementation-data-type=uint8
    DT_ADDC_ACCTargetTrqBrkVD: implementation-data-type=uint8
    DT_ADDC_ACCTargetTrqBrk: implementation-data-type=uint16
    DT_ADDC_MAIWarnTrqCtrlFlg: implementation-data-type=uint8
    DT_ADDC_RollingCounter_83: implementation-data-type=uint8
    DT_ADDC_ACC_FunType: implementation-data-type=uint8
    DT_ADDC_ACCMode: implementation-data-type=uint8
    DT_ADDC_Driveoff_Request: implementation-data-type=uint8
    DT_ADDC_DecToStop: implementation-data-type=uint8
    DT_ADDC_ACCAvailable: implementation-data-type=uint8
    DT_ADDC_ACCTargetAcc: implementation-data-type=uint8
    DT_ADDC_ACCTargetAccVD: implementation-data-type=uint8
    DT_ADDC_ACC_RecordingPulse: implementation-data-type=uint8
    DT_ADDC_VehicleSpeedCtlVD: implementation-data-type=uint8
    DT_ADDC_VehicleSpeedCtl: implementation-data-type=uint16
    DT_ADDC_ACC_EPBReq: implementation-data-type=uint8
    DT_ADDC_ACC_VehicleDirectCtl: implementation-data-type=uint8
    DT_ADDC_ACC_VehicleDirectCtlVD: implementation-data-type=uint8
    DT_ADDC_AEBTargetDec: implementation-data-type=uint16
    DT_ADDC_AEBDecCtrl: implementation-data-type=uint8
    DT_ADDC_AEBMode: implementation-data-type=uint8
    DT_ADDC_AEBAvailable: implementation-data-type=uint8
    DT_ADDC_ACC_VLCCtlReq: implementation-data-type=uint8
    DT_ADDC_ACC_OvrdSts: implementation-data-type=uint8
    DT_ADDC_RCTB_DecReq: implementation-data-type=uint8
    DT_ADDC_RAEB_DecReq: implementation-data-type=uint8
    DT_ADDC_MEB_DecReq: implementation-data-type=uint8
    DT_VCU_CRC_13B: implementation-data-type=uint8
    DT_VCU_RollingCounter_13B: implementation-data-type=uint8
    DT_VCU_Vehicle_Warning: implementation-data-type=uint8
    DT_VCU_VehicleSts: implementation-data-type=uint8
    DT_VCU_GearLevelPosSts: implementation-data-type=uint8
    DT_VCU_GearLeverValid: implementation-data-type=uint8
    DT_VCU_AccPedalValid: implementation-data-type=uint8
    DT_VCU_ThrottlePosition: implementation-data-type=uint8
    DT_VCU_BMSMainRelayR_Cmd: implementation-data-type=uint8
    DT_VCU_BMSMainRelayF_Cmd: implementation-data-type=uint8
    DT_VCU_BMSEmergencyCmd: implementation-data-type=uint8
    DT_VCU_MCUMActiveReleaseCmd: implementation-data-type=uint8
    DT_VCU_MCUSActiveReleaseCmd: implementation-data-type=uint8
    DT_VCU_AlwACChargeInventerSts: implementation-data-type=uint8
    DT_VCU_AlwDCChargeSts: implementation-data-type=uint8
    DT_VCU_ChargePauseReq: implementation-data-type=uint8
    DT_VCU_SuppressJitterMCUSRequest: implementation-data-type=uint8
    DT_VCU_DCDCEnableCmd: implementation-data-type=uint8
    DT_VCU_ACOffReq: implementation-data-type=uint8
    DT_VCU_VehicleDirect: implementation-data-type=uint8
    DT_VCU_BrakeSysFault: implementation-data-type=uint8
    DT_VCU_SuppressJitterMCUMRequest: implementation-data-type=uint8
    DT_VCU_MDrvControlMode: implementation-data-type=uint8
    DT_VCU_BrakePedalValue: implementation-data-type=uint8
    DT_VCU_MCUMMaxDischargePower: implementation-data-type=uint16
    DT_VCU_MCUMMaxChargePower: implementation-data-type=uint16
    DT_VCU_MDrvRequestTorque: implementation-data-type=uint16
    DT_VCU_MDrvRequesSpeed: implementation-data-type=uint16
    DT_VCU_SDrvRequestTorque: implementation-data-type=uint16
    DT_VCU_SDrvRequesSpeed: implementation-data-type=uint16
    DT_VCU_SVehicleSts: implementation-data-type=uint8
    DT_VCU_VehicleHighVoltModeF: implementation-data-type=uint8
    DT_VCU_SDrvControlMode: implementation-data-type=uint8
    DT_VCU_ON2BRelayReq: implementation-data-type=uint8
    DT_VCU_VehPreHVPwrOffCmd: implementation-data-type=uint8
    DT_VCU_FuelTankLockReq: implementation-data-type=uint8
    DT_VCU_VehicleDirectS: implementation-data-type=uint8
    DT_VCU_VehicleDirectS_VD: implementation-data-type=uint8
    DT_VCU_ACPwrLimited: implementation-data-type=uint8
    DT_VCU_MCUSMaxDischargePower: implementation-data-type=uint16
    DT_VCU_VehicleDirectVD: implementation-data-type=uint8
    DT_VCU_MDrvControlModeVD: implementation-data-type=uint8
    DT_VCU_MDrvRequestTorqueVD: implementation-data-type=uint8
    DT_VCU_MDrvRequesSpeedVD: implementation-data-type=uint8
    DT_VCU_SDrvRequestTorqueVD: implementation-data-type=uint8
    DT_VCU_SDrvRequesSpeedVD: implementation-data-type=uint8
    DT_VCU_SDrvControlModeVD: implementation-data-type=uint8
    DT_VCU_MCUSMaxChargePower: implementation-data-type=uint16
    DT_VCU_VehicleHighVoltMode: implementation-data-type=uint8
    DT_VCU_PDUHVIL_Sts: implementation-data-type=uint8
    DT_VCU_PDU220VRelay_Req: implementation-data-type=uint8
    DT_VCU_Cab220VRelay_Req: implementation-data-type=uint8
    DT_VCU_Cabin220VRelay_Req: implementation-data-type=uint8
    DT_VCU_Alw_Cab220VInverter_Sts: implementation-data-type=uint8
    DT_VCU_Alw_Cabin220VInverter_Sts: implementation-data-type=uint8
    DT_VCU_MCUMDampgLmtFactor: implementation-data-type=uint8
    DT_VCU_MCUSDampgLmtFactor: implementation-data-type=uint8
    DT_VCU_BCM_Authentication_Sts: implementation-data-type=uint8
    DT_VCU_AuthenticationKey_WSts: implementation-data-type=uint8
    DT_VCU_BrakePedalSts_P: implementation-data-type=uint8
    DT_VCU_BrakePedalStsValid_P: implementation-data-type=uint8
    DT_VCU_BoostMode_Fail: implementation-data-type=uint8
    DT_VCU_BoostModeSts: implementation-data-type=uint8
    DT_VCU_MCUSMaxPosDampgTrq: implementation-data-type=uint8
    DT_VCU_MCUSMaxNegDampgTrq: implementation-data-type=uint8
    DT_VCU_MCUMMaxPosDampgTrq: implementation-data-type=uint8
    DT_VCU_MCUMMaxNegDampgTrq: implementation-data-type=uint8
    DT_BMS_InverterPower: implementation-data-type=uint8
    DT_BMS_MaxChargeVolt: implementation-data-type=uint16
    DT_BMS_MaxChargeCurr: implementation-data-type=uint16
    DT_BMS_OBCWorkModeCtrl: implementation-data-type=uint8
    DT_BMS_MaxPower: implementation-data-type=uint16
    DT_BMS_ChargerACInput: implementation-data-type=uint8
    DT_BMS_ChargerDCInput: implementation-data-type=uint8
    DT_BMS_ChargeRequest: implementation-data-type=uint8
    DT_BMS_InverterRequest: implementation-data-type=uint8
    DT_BMS_ChargeQuantity: implementation-data-type=uint16
    DT_BMS_BattMaxTemp: implementation-data-type=uint8
    DT_BMS_BattMinTemp: implementation-data-type=uint8
    DT_BMS_BattIntakeTemp: implementation-data-type=uint8
    DT_BMS_BattIOutletTemp: implementation-data-type=uint8
    DT_BMS_BattSOC_Display: implementation-data-type=uint16
    DT_BMS_Req_Cab220VInverter_Sts: implementation-data-type=uint8
    DT_BMS_Req_Cabin220VInverter_Sts: implementation-data-type=uint8
    DT_BMS_RemainEnergy: implementation-data-type=uint16
    DT_BMS_StateOfEngeryMax: implementation-data-type=uint16
    DT_BMS_ThermalManageRequest: implementation-data-type=uint8
    DT_BMS_PreHeatingState: implementation-data-type=uint8
    DT_LMC_CRC_FD: implementation-data-type=uint8
    DT_LMC_RollingCounter_FD: implementation-data-type=uint8
    DT_LMC_SysSt: implementation-data-type=uint8
    DT_LMC_HSPC_ActiveSt: implementation-data-type=uint8
    DT_LMC_FTSC_ActiveSt: implementation-data-type=uint8
    DT_LMC_SDRM_ActiveSt: implementation-data-type=uint8
    DT_LMC_NSPC_ActiveSt: implementation-data-type=uint8
    DT_LMC_EAF_ActiveSt: implementation-data-type=uint8
    DT_LMC_SelfCheckSt: implementation-data-type=uint8
    DT_LMC_WBDC_ActiveSt: implementation-data-type=uint8
    DT_MCUM_UDS_SW{1..10}: implementation-data-type=uint8
    DT_MCUM_UDS_HW{1..10}: implementation-data-type=uint8
    DT_MCUM_UDS_Boot{1..10}: implementation-data-type=uint8
    DT_MCUM_UDS_ProductModel{1..16}: implementation-data-type=uint8
    DT_MCUM_UDS_Supplier{1..6}: implementation-data-type=uint8
    DT_VCU_BrkPedOpen: implementation-data-type=uint8
    DT_VCU_BrkPedClose: implementation-data-type=uint8
    DT_VCU_ColumnShiftP: implementation-data-type=uint8
    DT_VCU_VehiCrashSts: implementation-data-type=uint8
    DT_VCU_SleepSatisfiedSts: implementation-data-type=uint8
    DT_VCU_VehiHvCmd: implementation-data-type=uint8
    DT_VCU_GearQuitAps: implementation-data-type=uint8
    DT_VCU_REOverChgPwrFlag: implementation-data-type=uint8
    DT_VCU_VehiAccnFilt: implementation-data-type=uint8
    DT_VCU_HvOffSts: implementation-data-type=uint8
    DT_VCU_ElecPwrBalanceReq: implementation-data-type=uint8
    DT_VCU_CDU_RecvTr: implementation-data-type=uint8
    DT_VCU_BMS_RecvTr: implementation-data-type=uint8
    DT_VCU_IVI_RecvTr: implementation-data-type=uint8
    DT_VCU_WheelMaxDrvTrq: implementation-data-type=uint16
    DT_VCU_WheelMaxRecTrq: implementation-data-type=uint16
    DT_VCU_GCU_RecvTr: implementation-data-type=uint8
    DT_VCU_TCM_RecvTr: implementation-data-type=uint8
    DT_VCU_PTC_RecvTr: implementation-data-type=uint8
    DT_VCU_LossFctorFlgFL: implementation-data-type=uint8
    DT_VCU_LowBattVolt: implementation-data-type=uint8
    DT_VCU_HighPerforDisable: implementation-data-type=uint8
    DT_VCU_AccPedHSigVolt: implementation-data-type=uint8
    DT_VCU_LossFctorFlgFR: implementation-data-type=uint8
    DT_VCU_AccPedLSigVolt: implementation-data-type=uint8
    DT_VCU_LossFctorFlgRL: implementation-data-type=uint8
    DT_VCU_AccPedHPwrVolt: implementation-data-type=uint8
    DT_VCU_LossFctorFlgRR: implementation-data-type=uint8
    DT_VCU_AccPedLPwrVolt: implementation-data-type=uint8
    DT_VCU_PreReqChgPwr: implementation-data-type=uint8
    DT_VCU_VehPwrChageLimit: implementation-data-type=uint8
    DT_VCU_FastPwrRequest: implementation-data-type=uint8
    DT_VCU_On2KL15_Volt: implementation-data-type=uint8
    DT_VCU_ClutchWrkModDebug: implementation-data-type=uint8
    DT_VCU_HighPerforSwtFlg: implementation-data-type=uint8
    DT_VCU_VehiPowrConsumption: implementation-data-type=uint16
    DT_VCU_MDrvFilterTrqRange: implementation-data-type=uint8
    DT_VCU_WheelPwrOvrLimitflgRE: implementation-data-type=uint8
    DT_VCU_MRDrvControlMode: implementation-data-type=uint8
    DT_VCU_MRDrvControlModeVD: implementation-data-type=uint8
    DT_VCU_VehicleDirectMR: implementation-data-type=uint8
    DT_VCU_VehicleDirectMRVD: implementation-data-type=uint8
    DT_VCU_MRDrvRequestTorque: implementation-data-type=uint16
    DT_VCU_MRDrvRequesSpeed: implementation-data-type=uint16
    DT_VCU_MCUMRMaxDischargePower: implementation-data-type=uint16
    DT_VCU_MCUMRMaxPosDampgTrq: implementation-data-type=uint8
    DT_VCU_MRDrvRequestTorqueVD: implementation-data-type=uint8
    DT_VCU_MCUMRMaxChargePower: implementation-data-type=uint16
    DT_VCU_MCUMRMaxNegDampgTrq: implementation-data-type=uint8
    DT_VCU_MRDrvRequesSpeedVD: implementation-data-type=uint8
    DT_VCU_MCUMRDampgLmtFactor: implementation-data-type=uint8
    DT_VCU_SuppressJitterMCUMRRequest: implementation-data-type=uint8
    DT_EOL_VCU_BrkPedOpen: implementation-data-type=uint8
    DT_EOL_VCU_BrkPedClose: implementation-data-type=uint8
    DT_EOL_VCU_ColumnShiftP: implementation-data-type=uint8
    DT_EOL_VCU_VehiCrashSts: implementation-data-type=uint8
    DT_EOL_VCU_SleepSatisfiedSts: implementation-data-type=uint8
    DT_EOL_VCU_VehiHvCmd: implementation-data-type=uint8
    DT_EOL_VCU_GearQuitAps: implementation-data-type=uint8
    DT_EOL_VCU_REOverChgPwrFlag: implementation-data-type=uint8
    DT_EOL_VCU_VehiAccnFilt: implementation-data-type=uint8
    DT_EOL_VCU_HvOffSts: implementation-data-type=uint8
    DT_EOL_VCU_ElecPwrBalanceReq: implementation-data-type=uint8
    DT_EOL_VCU_CDU_RecvTr: implementation-data-type=uint8
    DT_EOL_VCU_BMS_RecvTr: implementation-data-type=uint8
    DT_EOL_VCU_IVI_RecvTr: implementation-data-type=uint8
    DT_EOL_VCU_WheelMaxDrvTrq: implementation-data-type=uint16
    DT_EOL_VCU_WheelMaxRecTrq: implementation-data-type=uint16
    DT_EOL_VCU_GCU_RecvTr: implementation-data-type=uint8
    DT_EOL_VCU_TCM_RecvTr: implementation-data-type=uint8
    DT_EOL_VCU_PTC_RecvTr: implementation-data-type=uint8
    DT_EOL_VCU_LossFctorFlgFL: implementation-data-type=uint8
    DT_EOL_VCU_LowBattVolt: implementation-data-type=uint8
    DT_EOL_VCU_HighPerforDisable: implementation-data-type=uint8
    DT_EOL_VCU_AccPedHSigVolt: implementation-data-type=uint8
    DT_EOL_VCU_LossFctorFlgFR: implementation-data-type=uint8
    DT_EOL_VCU_AccPedLSigVolt: implementation-data-type=uint8
    DT_EOL_VCU_LossFctorFlgRL: implementation-data-type=uint8
    DT_EOL_VCU_AccPedHPwrVolt: implementation-data-type=uint8
    DT_EOL_VCU_LossFctorFlgRR: implementation-data-type=uint8
    DT_EOL_VCU_AccPedLPwrVolt: implementation-data-type=uint8
    DT_EOL_VCU_PreReqChgPwr: implementation-data-type=uint8
    DT_EOL_VCU_VehPwrChageLimit: implementation-data-type=uint8
    DT_EOL_VCU_FastPwrRequest: implementation-data-type=uint8
    DT_EOL_VCU_On2KL15_Volt: implementation-data-type=uint8
    DT_EOL_VCU_ClutchWrkModDebug: implementation-data-type=uint8
    DT_EOL_VCU_HighPerforSwtFlg: implementation-data-type=uint8
    DT_EOL_VCU_VehiPowrConsumption: implementation-data-type=uint16
    DT_EOL_VCU_MDrvFilterTrqRange: implementation-data-type=uint8
    DT_EOL_VCU_WheelPwrOvrLimitflgRE: implementation-data-type=uint8
    DT_EOL_VCU_MRDrvControlMode: implementation-data-type=uint8
    DT_EOL_VCU_MRDrvControlModeVD: implementation-data-type=uint8
    DT_EOL_VCU_VehicleDirectMR: implementation-data-type=uint8
    DT_EOL_VCU_VehicleDirectMRVD: implementation-data-type=uint8
    DT_EOL_VCU_MRDrvRequestTorque: implementation-data-type=uint16
    DT_EOL_VCU_MRDrvRequesSpeed: implementation-data-type=uint16
    DT_EOL_VCU_MCUMRMaxDischargePower: implementation-data-type=uint16
    DT_EOL_VCU_MCUMRMaxPosDampgTrq: implementation-data-type=uint8
    DT_EOL_VCU_MRDrvRequestTorqueVD: implementation-data-type=uint8
    DT_EOL_VCU_MCUMRMaxChargePower: implementation-data-type=uint16
    DT_EOL_VCU_MCUMRMaxNegDampgTrq: implementation-data-type=uint8
    DT_EOL_VCU_MRDrvRequesSpeedVD: implementation-data-type=uint8
    DT_EOL_VCU_MCUMRDampgLmtFactor: implementation-data-type=uint8
    DT_EOL_VCU_SuppressJitterMCUMRRequest: implementation-data-type=uint8
    DT_GCU_SWVersionC: implementation-data-type=uint8
    DT_GCU_SWVersionB: implementation-data-type=uint8
    DT_GCU_SWVersionA: implementation-data-type=uint8
    DT_VCU_CRC_B6: implementation-data-type=uint8
    DT_VCU_TVTest2: implementation-data-type=uint32
    DT_VCU_VPE_Test1: implementation-data-type=uint16
    DT_VCU_VPE_Test2: implementation-data-type=uint8
    DT_VCU_TVTest1: implementation-data-type=uint16
    DT_VCU_RollingCounter_B6: implementation-data-type=uint8
    DT_VCU_MDrvRequestTorque_IDB6_CCAN: implementation-data-type=uint16
    DT_VCU_MDriverRequireTorque: implementation-data-type=uint16
    DT_VCU_SDrvRequestTorque_IDB6_CCAN: implementation-data-type=uint16
    DT_VCU_SDriverRequireTorque: implementation-data-type=uint16
    DT_VCU_ThrottlePosition_IDB6_CCAN: implementation-data-type=uint8
    DT_VCU_AccPedalValid_IDB6_CCAN: implementation-data-type=uint8
    DT_VCU_BrakeSysFault_IDB6_CCAN: implementation-data-type=uint8
    DT_VCU_BrakeLightReq: implementation-data-type=uint8
    DT_VCU_BrakePedalSts: implementation-data-type=uint8
    DT_VCU_BrakePedalStsValid: implementation-data-type=uint8
    DT_VCU_GearLevelPosSts_IDB6_CCAN: implementation-data-type=uint8
    DT_VCU_GearLeverValid_IDB6_CCAN: implementation-data-type=uint8
    DT_VCU_BrakeFirstSts: implementation-data-type=uint8
    DT_VCU_DeliveryModeSts_IDB6_CCAN: implementation-data-type=uint8
    DT_VCU_MRDrvRequestTorque_IDB6_CCAN: implementation-data-type=uint16
    DT_VCU_MRDriverRequireTorque: implementation-data-type=uint16
    DT_BCM_CRC_291: implementation-data-type=uint8
    DT_BCM_ShutdownMode: implementation-data-type=uint8
    DT_BCM_NM_PNC_ON_1ADr_Sts: implementation-data-type=uint8
    DT_BCM_RollingCounter_291: implementation-data-type=uint8
    DT_BCM_KeyPosition_ON2A: implementation-data-type=uint8
    DT_BCM_CcmHvilSts_ID291: implementation-data-type=uint8
    DT_BCM_DriverDoorSts: implementation-data-type=uint8
    DT_BCM_FLDoorSts: implementation-data-type=uint8
    DT_BCM_FRDoorSts: implementation-data-type=uint8
    DT_BCM_RLDoorSts: implementation-data-type=uint8
    DT_BCM_RRDoorSts: implementation-data-type=uint8
    DT_BCM_BackDoorSts: implementation-data-type=uint8
    DT_BCM_ON2BRelaySts: implementation-data-type=uint8
    DT_BCM_ON2CRelaySts: implementation-data-type=uint8
    DT_BCM_ON2InitiativeSts: implementation-data-type=uint8
    DT_BCM_VehicleRepairMode: implementation-data-type=uint8
    DT_BCM_VehlockCtrl: implementation-data-type=uint8
    DT_BCM_VehLockSts: implementation-data-type=uint8
    DT_BCM_FuelTankLockReq: implementation-data-type=uint8
    DT_BCM_ACChgLockCtrl: implementation-data-type=uint8
    DT_BCM_ChargeLockCtrl: implementation-data-type=uint8
    DT_BCM_DCChrgPwr_Sts_ID291: implementation-data-type=uint8
    DT_BCM_ACChrgPwr_Sts_ID291: implementation-data-type=uint8
    DT_BCM_DCChrgPwr_Volt_ID291: implementation-data-type=uint8
    DT_BCM_ACChrgPwr_Volt_ID291: implementation-data-type=uint8
    DT_BCM_KeyPosition_ON2B: implementation-data-type=uint8
    DT_BCM_NM_PNC_ON_3Ch_Sts: implementation-data-type=uint8
    DT_BCM_HighVoltageReq: implementation-data-type=uint8
    DT_LMC_CRC_25A: implementation-data-type=uint8
    DT_LMC_ECAS_DriveModeFb: implementation-data-type=uint8
    DT_LMC_CDC_DriveModeFb: implementation-data-type=uint8
    DT_LMC_RollingCounter_25A: implementation-data-type=uint8
    DT_LMC_LSFCActiveSt: implementation-data-type=uint8
    DT_LMC_EngTorqDec_Main_R: implementation-data-type=uint16
    DT_LMC_EngTorqDecActive_Main_R: implementation-data-type=uint8
    DT_LMC_EngTorqInc_Main_R: implementation-data-type=uint16
    DT_LMC_EngTorqIncActive_Main_R: implementation-data-type=uint8
    DT_ACU_CRC_2A3: implementation-data-type=uint8
    DT_ACU_Trigger: implementation-data-type=uint8
    DT_ACU_RollingCounter_2A3: implementation-data-type=uint8
    DT_ACU_TotalCrashOutputSts: implementation-data-type=uint8
    DT_ACU_SelfCheckSt: implementation-data-type=uint8
    DT_ACU_FLSeatBeltRSt: implementation-data-type=uint8
    DT_ACU_FRSeatBeltRSt: implementation-data-type=uint8
    DT_IVI_DeliveryModeReq: implementation-data-type=uint8
    DT_IVI_ShowCarModeReq: implementation-data-type=uint8
    DT_VCU_CheckSum_BB: implementation-data-type=uint8
    DT_VCU_WorkModeReq_PHEV: implementation-data-type=uint8
    DT_VCU_WorkMode_PHEV: implementation-data-type=uint8
    DT_VCU_HEVAllow_PHEV: implementation-data-type=uint8
    DT_VCU_REAllow_PHEV: implementation-data-type=uint8
    DT_VCU_EVDualAllow_PHEV: implementation-data-type=uint8
    DT_VCU_EVSingleAllow_PHEV: implementation-data-type=uint8
    DT_VCU_Clutch_2_RequesSpeed: implementation-data-type=uint16
    DT_VCU_Clutch_1_RequesSpeed: implementation-data-type=uint16
    DT_VCU_Clutch2Position: implementation-data-type=uint8
    DT_VCU_Clutch1Position: implementation-data-type=uint8
    DT_VCU_RollingCounter_BB: implementation-data-type=uint8
    DT_VCU_EngPreStartFlg: implementation-data-type=uint8
    DT_VCU_FuelChgModeMsg: implementation-data-type=uint8
    DT_VCU_FuelChgModeSts: implementation-data-type=uint8
    DT_VCU_RoughRoadDetectionFlag: implementation-data-type=uint8
    DT_VCU_Clutch_2_RequesSpeedValid: implementation-data-type=uint8
    DT_VCU_Clutch_1_RequesSpeedValid: implementation-data-type=uint8
    DT_VCU_GCURequestTorque: implementation-data-type=uint16
    DT_VCU_PowerReducetSts: implementation-data-type=uint8
    DT_VCU_GCUAassistFB: implementation-data-type=uint8
    DT_VCU_GCUActiveReleaseCmd: implementation-data-type=uint8
    DT_VCU_PowerOverSts: implementation-data-type=uint8
    DT_VCU_GCURequesSpeed: implementation-data-type=uint16
    DT_VCU_GCUControlMode: implementation-data-type=uint8
    DT_VCU_MotChargePower: implementation-data-type=uint8
    DT_VCU_APS1Position: implementation-data-type=uint8
    DT_VCU_EngineStartReq: implementation-data-type=uint8
    DT_VCU_EngineFuelInhibitReq: implementation-data-type=uint8
    DT_VCU_EngineOffRequest: implementation-data-type=uint8
    DT_VCU_STorqueReqValid: implementation-data-type=uint8
    DT_VCU_STorqueReq: implementation-data-type=uint16
    DT_VCU_FTorqueSwFb: implementation-data-type=uint8
    DT_VCU_FVVOpenReq: implementation-data-type=uint8
    DT_VCU_WarmUpCycleIndicator: implementation-data-type=uint8
    DT_VCU_EngineResetSts: implementation-data-type=uint8
    DT_VCU_EngineSts: implementation-data-type=uint8
    DT_VCU_FTorqueReq: implementation-data-type=uint16
    DT_VCU_FTorqueReqValid: implementation-data-type=uint8
    DT_VCU_EngineIdleReq: implementation-data-type=uint8
    DT_VCU_REsystemSts: implementation-data-type=uint8
    DT_VCU_REsystemFaultSts: implementation-data-type=uint8
    DT_VCU_APS2Position: implementation-data-type=uint8
    DT_VCU_EngineRunAllowFlg: implementation-data-type=uint8
    DT_VCU_EngineIdleSpeed: implementation-data-type=uint8
    DT_VCU_EngineFuleCutoffReq: implementation-data-type=uint8
    DT_VCU_MCUSClutchPosition: implementation-data-type=uint8
    DT_VCU_MGCUWorkMode: implementation-data-type=uint8
    DT_VCU_REChgTarget: implementation-data-type=uint8
    DT_VCU_MotStartStopPowerUP: implementation-data-type=uint8
    DT_VCU_MotStartStopPowerLOW: implementation-data-type=uint8
    DT_VCU_GCURequesSpeed_MGCU: implementation-data-type=uint16
    DT_VCU_DynamicChgPwr: implementation-data-type=uint8
    DT_VCU_ForceChgPwr: implementation-data-type=uint8
    DT_VCU_REStartType: implementation-data-type=uint8
    DT_VCU_Pending_DTC: implementation-data-type=uint8
    DT_VCU_Comfirmed_DTC: implementation-data-type=uint8
    DT_VCU_Permanent_DTC: implementation-data-type=uint8
    DT_VCU_MilReq_DTC: implementation-data-type=uint8
    DT_MCUM_NMControlRMR_Sts: implementation-data-type=uint8
    DT_MCUM_WakeUpReason: implementation-data-type=uint8
  data type mapping set DTMSMCUM_0x42C
    data-type-maps:
      application-data-type=DT_DT_MCUM_NMControlRMR_Sts, implementation-data-type=DT_MCUM_NMControlRMR_Sts
      application-data-type=DT_DT_MCUM_WakeUpReason, implementation-data-type=DT_MCUM_WakeUpReason
  impl type DT_MCUM_NMControlRMR_Sts_P: implementation-data-type=uint8
  impl type DT_MCUM_WakeUpReason_P: implementation-data-type=uint8
  data type mapping set DTMSMCUM_0x42C_PCANFD
    data-type-maps:
      application-data-type=DT_DT_MCUM_WakeUpReason_P, implementation-data-type=DT_MCUM_WakeUpReason_P
      application-data-type=DT_DT_MCUM_NMControlRMR_Sts_P, implementation-data-type=DT_MCUM_NMControlRMR_Sts_P
  7 x impl type, all with category=TYPE_REFERENCE:
    DT_ECM_ClearingSparkcarbonedRequest: implementation-data-type=uint8
    DT_VCU_REHighPerformVehiPwr: implementation-data-type=uint8
    DT_VCU_REPwrDampingFactor: implementation-data-type=uint8
    DT_VCU_REDrvTarPwrFit: implementation-data-type=uint16
    DT_TMS_RAPTC_ModOprtgStsFrt: implementation-data-type=uint8
    DT_TMS_RAPTC_MsrdPwrFrt: implementation-data-type=uint16
    DT_TMS_RAPTC_ModOpEnblCmd: implementation-data-type=uint8
  data type mapping set DTMSTMS_0x362
    data-type-maps:
      application-data-type=DT_DT_TMS_RAPTC_ModOprtgStsFrt, implementation-data-type=DT_TMS_RAPTC_ModOprtgStsFrt
      application-data-type=DT_DT_TMS_RAPTC_ModOpEnblCmd, implementation-data-type=DT_TMS_RAPTC_ModOpEnblCmd
      application-data-type=DT_DT_TMS_RAPTC_MsrdPwrFrt, implementation-data-type=DT_TMS_RAPTC_MsrdPwrFrt
  36 x impl type, all with category=TYPE_REFERENCE:
    DT_BCM_CRC_DA: implementation-data-type=uint8
    DT_BCM_RollingCounter_DA: implementation-data-type=uint8
    DT_BCM_IMU_ACC_x: implementation-data-type=uint16
    DT_BCM_IMU_ACC_y: implementation-data-type=uint16
    DT_BCM_IMU_ACC_z: implementation-data-type=uint16
    DT_BCM_IMU_ACC_Roll_Rate: implementation-data-type=uint16
    DT_BCM_IMU_ACC_Pitch_Rate: implementation-data-type=uint16
    DT_BCM_IMU_ACC_Yaw_Rate: implementation-data-type=uint16
    DT_BCM_IMU_Valid: implementation-data-type=uint8
    DT_ACU_IMU_CRC_15: implementation-data-type=uint8
    DT_ACU_IMU_RollingCounter_15: implementation-data-type=uint8
    DT_ACU_IMU_ACC_x: implementation-data-type=uint16
    DT_ACU_IMU_ACC_y: implementation-data-type=uint16
    DT_ACU_IMU_ACC_z: implementation-data-type=uint16
    DT_ACU_IMU_Roll_Rate: implementation-data-type=uint16
    DT_ACU_IMU_Pitch_Rate: implementation-data-type=uint16
    DT_ACU_IMU_Yaw_Rate: implementation-data-type=uint16
    DT_ACU_IMU_Calibrated: implementation-data-type=uint8
    DT_ACU_IMU_Valid: implementation-data-type=uint8
    DT_ACU_IMU_Fault_Status: implementation-data-type=uint8
    DT_ACU_IMU_MessageStatus: implementation-data-type=uint8
    DT_ACU_IMU_FunctionSafetyStatus: implementation-data-type=uint8
    DT_ACU_IMU_Temperature: implementation-data-type=uint16
    DT_LMC_CRC_133: implementation-data-type=uint8
    DT_LMC_DrvReqTorque: implementation-data-type=uint16
    DT_LMC_RollingCounter_133: implementation-data-type=uint8
    DT_BCM_CRC_4A: implementation-data-type=uint8
    DT_BCM_IBCLimphomeSts: implementation-data-type=uint8
    DT_BCM_EOLAutomaticActiveSts_C: implementation-data-type=uint8
    DT_BCM_TorqueLimte: implementation-data-type=uint16
    DT_BCM_RollingCounter_4A: implementation-data-type=uint8
    DT_ICU_RollingCounter_5BE: implementation-data-type=uint8
    DT_ICU_Imu_Cal_Staus: implementation-data-type=uint8
    DT_ICU_Imu_Cal_Gyro: implementation-data-type=uint8
    DT_ICU_Imu_Cal_Pitch: implementation-data-type=uint8
    DT_ICU_Imu_Cal_Roll: implementation-data-type=uint8
