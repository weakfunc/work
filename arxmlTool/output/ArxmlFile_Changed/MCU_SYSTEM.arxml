[part 1 of 2: package /MVCU_AutoGenPkg/MVCU/Pkg_AutoGen_Sys]
AUTOSAR XML (schema 4-2-2)
package /MVCU_AutoGenPkg/MVCU/Pkg_AutoGen_Sys
  system MCU_System: category=SYSTEM_EXTRACT
    system mapping SystemMapping_MCU_System
      data-mappings:
        data-element=CPT_APPCOM_SWC.CPT_MCU_Composition.EVCC_0x260.EVCC_DCAC_ChgMode, system-signal=EVCC_DCAC_ChgMode
        data-element=CPT_APPCOM_SWC.CPT_MCU_Composition.EVCC_0x260.EVCC_CP_status, system-signal=EVCC_CP_status
        data-element=CPT_APPCOM_SWC.CPT_MCU_Composition.EVCC_0x260.EVCC_CPDutyCycleValue, system-signal=EVCC_CPDutyCycleValue
        data-element=CPT_APPCOM_SWC.CPT_MCU_Composition.EVCC_0x260.EVCC_EVSEMaximumCurrentLimit, system-signal=EVCC_EVSEMaximumCurrentLimit
        data-element=CPT_APPCOM_SWC.CPT_MCU_Composition.EVCC_0x260.EVCC_EVSEMaximumPowerLimit, system-signal=EVCC_EVSEMaximumPowerLimit
        data-element=CPT_APPCOM_SWC.CPT_MCU_Composition.ICU_0x24C.ICU_CRC_24C, system-signal=ICU_CRC_24C
        data-element=CPT_APPCOM_SWC.CPT_MCU_Composition.ICU_0x24C.ICU_PHEVMode, system-signal=ICU_PHEVMode
        data-element=CPT_APPCOM_SWC.CPT_MCU_Composition.ICU_0x24C.ICU_RollingCounter_24C, system-signal=ICU_RollingCounter_24C
        data-element=CPT_APPCOM_SWC.CPT_MCU_Composition.ICU_0x24C.ICU_TotalOdometerkm, system-signal=ICU_TotalOdometerkm
        data-element=CPT_APPCOM_SWC.CPT_MCU_Composition.ICU_0x24C.ICU_AccelerationMode, system-signal=ICU_AccelerationMode
        data-element=CPT_APPCOM_SWC.CPT_MCU_Composition.ICU_0x24C.ICU_REMode, system-signal=ICU_REMode
        data-element=CPT_APPCOM_SWC.CPT_MCU_Composition.ICU_0x24C.ICU_CreepMode, system-signal=ICU_CreepMode
        data-element=CPT_APPCOM_SWC.CPT_MCU_Composition.ICU_0x24C.ICU_EnergyRecoveryMode, system-signal=ICU_EnergyRecoveryMode
        data-element=CPT_APPCOM_SWC.CPT_MCU_Composition.MCUS_0xDB.MCUS_CRC_DB, system-signal=MCUS_CRC_DB
        data-element=CPT_APPCOM_SWC.CPT_MCU_Composition.MCUS_0xDB.MCUS_Clutch_2_Fault, system-signal=MCUS_Clutch_2_Fault
        data-element=CPT_APPCOM_SWC.CPT_MCU_Composition.MCUS_0xDB.MCUS_Clutch_1_Fault, system-signal=MCUS_Clutch_1_Fault
        data-element=CPT_APPCOM_SWC.CPT_MCU_Composition.MCUS_0xDB.MCUS_Clutch_2_WarningLevel, system-signal=MCUS_Clutch_2_WarningLevel
        data-element=CPT_APPCOM_SWC.CPT_MCU_Composition.MCUS_0xDB.MCUS_Clutch_1_WarningLevel, system-signal=MCUS_Clutch_1_WarningLevel
        data-element=CPT_APPCOM_SWC.CPT_MCU_Composition.MCUS_0xDB.MCUS_Clutch_2_Pos, system-signal=MCUS_Clutch_2_Pos
        data-element=CPT_APPCOM_SWC.CPT_MCU_Composition.MCUS_0xDB.MCUS_Clutch_1_Pos, system-signal=MCUS_Clutch_1_Pos
        data-element=CPT_APPCOM_SWC.CPT_MCU_Composition.MCUS_0xDB.MCUS_RollingCounter_DB, system-signal=MCUS_RollingCounter_DB
        data-element=CPT_APPCOM_SWC.CPT_MCU_Composition.MCUS_0xDB.MCUS_WarningLevel, system-signal=MCUS_WarningLevel
        data-element=CPT_APPCOM_SWC.CPT_MCU_Composition.MCUS_0xDB.MCUS_SelfCheckSts, system-signal=MCUS_SelfCheckSts
        data-element=CPT_APPCOM_SWC.CPT_MCU_Composition.MCUS_0xDB.MCUS_DrvMotorWorkSts, system-signal=MCUS_DrvMotorWorkSts
        data-element=CPT_APPCOM_SWC.CPT_MCU_Composition.MCUS_0xDB.MCUS_PowerReduceSts, system-signal=MCUS_PowerReduceSts
        data-element=CPT_APPCOM_SWC.CPT_MCU_Composition.MCUS_0xDB.MCUS_DrvMotorRPM, system-signal=MCUS_DrvMotorRPM
        data-element=CPT_APPCOM_SWC.CPT_MCU_Composition.MCUS_0xDB.MCUS_ActualTorqueFB, system-signal=MCUS_ActualTorqueFB
        data-element=CPT_APPCOM_SWC.CPT_MCU_Composition.MCUS_0xDB.MCUS_HWRdcFault, system-signal=MCUS_HWRdcFault
        data-element=CPT_APPCOM_SWC.CPT_MCU_Composition.MCUS_0xDB.MCUS_HighVoltPowerOffReq, system-signal=MCUS_HighVoltPowerOffReq
        data-element=CPT_APPCOM_SWC.CPT_MCU_Composition.MCUS_0xDB.MCUS_HVILSts, system-signal=MCUS_HVILSts
        data-element=CPT_APPCOM_SWC.CPT_MCU_Composition.MCUS_0xDB.MCUS_DragSts, system-signal=MCUS_DragSts
        data-element=CPT_APPCOM_SWC.CPT_MCU_Composition.MCUS_0xDB.MCUS_CtrlMode, system-signal=MCUS_CtrlMode
        data-element=CPT_APPCOM_SWC.CPT_MCU_Composition.MCUS_0xDB.MCUS_MILlampReq, system-signal=MCUS_MILlampReq
        data-element=CPT_APPCOM_SWC.CPT_MCU_Composition.MCUS_0xDB.MCUS_DrvMotorRPMVD, system-signal=MCUS_DrvMotorRPMVD
        data-element=CPT_APPCOM_SWC.CPT_MCU_Composition.MCUS_0xDB.MCUS_ActualTorqueFBVD, system-signal=MCUS_ActualTorqueFBVD
        data-element=CPT_APPCOM_SWC.CPT_MCU_Composition.MCUS_0xDB.MCUS_MaxTorqueAllow, system-signal=MCUS_MaxTorqueAllow
        data-element=CPT_APPCOM_SWC.CPT_MCU_Composition.MCUS_0xDB.MCUS_MaxSpeedAllow, system-signal=MCUS_MaxSpeedAllow
        data-element=CPT_APPCOM_SWC.CPT_MCU_Composition.MCUS_0xDB.MCUS_ActiveReleaseSts, system-signal=MCUS_ActiveReleaseSts
        data-element=CPT_APPCOM_SWC.CPT_MCU_Composition.MCUS_0xDB.MCUS_MinTorqueAllow, system-signal=MCUS_MinTorqueAllow
        data-element=CPT_APPCOM_SWC.CPT_MCU_Composition.MCUS_0xDB.MCUS_MainWireVolt, system-signal=MCUS_MainWireVolt
        data-element=CPT_APPCOM_SWC.CPT_MCU_Composition.MCUS_0xDB.MCUS_MainWireCurr, system-signal=MCUS_MainWireCurr
        data-element=CPT_APPCOM_SWC.CPT_MCU_Composition.MCUS_0xDB.MCUS_Clutch_Pos, system-signal=MCUS_Clutch_Pos
        data-element=CPT_APPCOM_SWC.CPT_MCU_Composition.MCUS_0xDB.MCUS_Clutch_Fault, system-signal=MCUS_Clutch_Fault
        data-element=CPT_APPCOM_SWC.CPT_MCU_Composition.MCUS_0xDB.MCUS_TMS_FrMotSelfHeatEnSts, system-signal=MCUS_TMS_FrMotSelfHeatEnSts
        data-element=CPT_APPCOM_SWC.CPT_MCU_Composition.MCUS_0xDB.MCUS_TMS_FrMotSelfHeatLvlFb, system-signal=MCUS_TMS_FrMotSelfHeatLvlFb
        data-element=CPT_APPCOM_SWC.CPT_MCU_Composition.MCUS_0xDB.MCUS_HeatPwrAval, system-signal=MCUS_HeatPwrAval
        data-element=CPT_APPCOM_SWC.CPT_MCU_Composition.MCU_0x5C9.DelayIden_Rslt_Avg, system-signal=DelayIden_Rslt_Avg
        data-element=CPT_APPCOM_SWC.CPT_MCU_Composition.MCU_0x5C9.DelayIden_OverRange, system-signal=DelayIden_OverRange
        data-element=CPT_APPCOM_SWC.CPT_MCU_Composition.MCU_0x5C9.DelayIden_Iden_Finish, system-signal=DelayIden_Iden_Finish
        data-element=CPT_APPCOM_SWC.CPT_MCU_Composition.MCU_0x5C9.DelayIden_Write_Finish, system-signal=DelayIden_Write_Finish
        data-element=CPT_APPCOM_SWC.CPT_MCU_Composition.MCU_0x5C9.DelayIden_Rslt_U, system-signal=DelayIden_Rslt_U
        data-element=CPT_APPCOM_SWC.CPT_MCU_Composition.MCU_0x5C9.DelayIden_Rslt_V, system-signal=DelayIden_Rslt_V
        data-element=CPT_APPCOM_SWC.CPT_MCU_Composition.MCU_0x5C9.DelayIden_Rslt_W, system-signal=DelayIden_Rslt_W
        data-element=CPT_APPCOM_SWC.CPT_MCU_Composition.MCU_0x5C9.GainIden_Is_Samp_U, system-signal=GainIden_Is_Samp_U
        data-element=CPT_APPCOM_SWC.CPT_MCU_Composition.MCU_0x5C9.GainIden_Rslt_U, system-signal=GainIden_Rslt_U
        data-element=CPT_APPCOM_SWC.CPT_MCU_Composition.MCU_0x5C9.GainIden_OverRange, system-signal=GainIden_OverRange
        data-element=CPT_APPCOM_SWC.CPT_MCU_Composition.MCU_0x5C9.GainIden_Is_Samp_V, system-signal=GainIden_Is_Samp_V
        data-element=CPT_APPCOM_SWC.CPT_MCU_Composition.MCU_0x5C9.GainIden_Rslt_V, system-signal=GainIden_Rslt_V
        data-element=CPT_APPCOM_SWC.CPT_MCU_Composition.MCU_0x5C9.GainIden_Iden_Finish, system-signal=GainIden_Iden_Finish
        data-element=CPT_APPCOM_SWC.CPT_MCU_Composition.MCU_0x5C9.GainIden_Is_Samp_W, system-signal=GainIden_Is_Samp_W
        data-element=CPT_APPCOM_SWC.CPT_MCU_Composition.MCU_0x5C9.GainIden_Rslt_W, system-signal=GainIden_Rslt_W
        data-element=CPT_APPCOM_SWC.CPT_MCU_Composition.MCU_0x5C9.GainIden_Write_Finish, system-signal=GainIden_Write_Finish
        data-element=CPT_APPCOM_SWC.CPT_MCU_Composition.MCU_0x5C9.GainIden_Curr_Peak_U, system-signal=GainIden_Curr_Peak_U
        data-element=CPT_APPCOM_SWC.CPT_MCU_Composition.MCU_0x5C9.GainIden_Curr_Peak_V, system-signal=GainIden_Curr_Peak_V
        data-element=CPT_APPCOM_SWC.CPT_MCU_Composition.MCU_0x5C9.GainIden_Curr_Peak_W, system-signal=GainIden_Curr_Peak_W
        data-element=CPT_APPCOM_SWC.CPT_MCU_Composition.MCU_0x5C9.CurrLoad_CurExt_U, system-signal=CurrLoad_CurExt_U
        data-element=CPT_APPCOM_SWC.CPT_MCU_Composition.MCU_0x5C9.CurrLoad_CurExt_V, system-signal=CurrLoad_CurExt_V
        data-element=CPT_APPCOM_SWC.CPT_MCU_Composition.MCU_0x5C9.CurrLoad_CurExt_W, system-signal=CurrLoad_CurExt_W
        data-element=CPT_APPCOM_SWC.CPT_MCU_Composition.MCU_0x5C9.CurrLoad_offset_Iu, system-signal=CurrLoad_offset_Iu
        data-element=CPT_APPCOM_SWC.CPT_MCU_Composition.MCU_0x5C9.CurrLoad_offset_Iv, system-signal=CurrLoad_offset_Iv
        data-element=CPT_APPCOM_SWC.CPT_MCU_Composition.MCU_0x5C9.CurrLoad_offset_Iw, system-signal=CurrLoad_offset_Iw
        data-element=CPT_APPCOM_SWC.CPT_MCU_Composition.MCU_0x5C9.MCUMR_DelayIden_Rslt_Avg, system-signal=MCUMR_DelayIden_Rslt_Avg
        data-element=CPT_APPCOM_SWC.CPT_MCU_Composition.MCU_0x5C9.MCUMR_DelayIden_OverRange, system-signal=MCUMR_DelayIden_OverRange
        data-element=CPT_APPCOM_SWC.CPT_MCU_Composition.MCU_0x5C9.MCUMR_DelayIden_Iden_Finish, system-signal=MCUMR_DelayIden_Iden_Finish
        data-element=CPT_APPCOM_SWC.CPT_MCU_Composition.MCU_0x5C9.MCUMR_DelayIden_Write_Finish, system-signal=MCUMR_DelayIden_Write_Finish
        data-element=CPT_APPCOM_SWC.CPT_MCU_Composition.MCU_0x5C9.MCUMR_DelayIden_Rslt_U, system-signal=MCUMR_DelayIden_Rslt_U
        data-element=CPT_APPCOM_SWC.CPT_MCU_Composition.MCU_0x5C9.MCUMR_DelayIden_Rslt_V, system-signal=MCUMR_DelayIden_Rslt_V
        data-element=CPT_APPCOM_SWC.CPT_MCU_Composition.MCU_0x5C9.MCUMR_DelayIden_Rslt_W, system-signal=MCUMR_DelayIden_Rslt_W
        data-element=CPT_APPCOM_SWC.CPT_MCU_Composition.MCU_0x5C9.MCUMR_GainIden_Is_Samp_U, system-signal=MCUMR_GainIden_Is_Samp_U
        data-element=CPT_APPCOM_SWC.CPT_MCU_Composition.MCU_0x5C9.MCUMR_GainIden_Rslt_U, system-signal=MCUMR_GainIden_Rslt_U
        data-element=CPT_APPCOM_SWC.CPT_MCU_Composition.MCU_0x5C9.MCUMR_GainIden_OverRange, system-signal=MCUMR_GainIden_OverRange
        data-element=CPT_APPCOM_SWC.CPT_MCU_Composition.MCU_0x5C9.MCUMR_GainIden_Is_Samp_V, system-signal=MCUMR_GainIden_Is_Samp_V
        data-element=CPT_APPCOM_SWC.CPT_MCU_Composition.MCU_0x5C9.MCUMR_GainIden_Rslt_V, system-signal=MCUMR_GainIden_Rslt_V
        data-element=CPT_APPCOM_SWC.CPT_MCU_Composition.MCU_0x5C9.MCUMR_GainIden_Iden_Finish, system-signal=MCUMR_GainIden_Iden_Finish
        data-element=CPT_APPCOM_SWC.CPT_MCU_Composition.MCU_0x5C9.MCUMR_GainIden_Is_Samp_W, system-signal=MCUMR_GainIden_Is_Samp_W
        data-element=CPT_APPCOM_SWC.CPT_MCU_Composition.MCU_0x5C9.MCUMR_GainIden_Rslt_W, system-signal=MCUMR_GainIden_Rslt_W
        data-element=CPT_APPCOM_SWC.CPT_MCU_Composition.MCU_0x5C9.MCUMR_GainIden_Write_Finish, system-signal=MCUMR_GainIden_Write_Finish
        data-element=CPT_APPCOM_SWC.CPT_MCU_Composition.MCU_0x5C9.MCUMR_GainIden_Curr_Peak_U, system-signal=MCUMR_GainIden_Curr_Peak_U
        data-element=CPT_APPCOM_SWC.CPT_MCU_Composition.MCU_0x5C9.MCUMR_GainIden_Curr_Peak_V, system-signal=MCUMR_GainIden_Curr_Peak_V
        data-element=CPT_APPCOM_SWC.CPT_MCU_Composition.MCU_0x5C9.MCUMR_GainIden_Curr_Peak_W, system-signal=MCUMR_GainIden_Curr_Peak_W
        data-element=CPT_APPCOM_SWC.CPT_MCU_Composition.MCU_0x5C9.MCUMR_CurrLoad_CurExt_U, system-signal=MCUMR_CurrLoad_CurExt_U
        data-element=CPT_APPCOM_SWC.CPT_MCU_Composition.MCU_0x5C9.MCUMR_CurrLoad_CurExt_V, system-signal=MCUMR_CurrLoad_CurExt_V
        data-element=CPT_APPCOM_SWC.CPT_MCU_Composition.MCU_0x5C9.MCUMR_CurrLoad_CurExt_W, system-signal=MCUMR_CurrLoad_CurExt_W
        data-element=CPT_APPCOM_SWC.CPT_MCU_Composition.MCU_0x5C9.MCUMR_CurrLoad_offset_Iu, system-signal=MCUMR_CurrLoad_offset_Iu
        data-element=CPT_APPCOM_SWC.CPT_MCU_Composition.MCU_0x5C9.MCUMR_CurrLoad_offset_Iv, system-signal=MCUMR_CurrLoad_offset_Iv
        data-element=CPT_APPCOM_SWC.CPT_MCU_Composition.MCU_0x5C9.MCUMR_CurrLoad_offset_Iw, system-signal=MCUMR_CurrLoad_offset_Iw
        data-element=CPT_APPCOM_SWC.CPT_MCU_Composition.HPCBCM_0x1E6.BCM_VCU_Authentication_MAC_B{0..15}, system-signal=BCM_VCU_Authentication_MAC_B{0..15}
        data-element=CPT_APPCOM_SWC.CPT_MCU_Composition.UDS_Phy_Rx_7E0_ECM.ECM_UDS_PhyReq_Byte{0..7}, system-signal=ECM_UDS_PhyReq_Byte{0..7}
        data-element=CPT_APPCOM_SWC.CPT_MCU_Composition.MCUM_0x5D0.MCUM_Id_Ref, system-signal=MCUM_Id_Ref
        data-element=CPT_APPCOM_SWC.CPT_MCU_Composition.MCUM_0x5D0.MCUM_Iq_Ref, system-signal=MCUM_Iq_Ref
        data-element=CPT_APPCOM_SWC.CPT_MCU_Composition.MCUM_0x5D0.MCUM_Id_Fb, system-signal=MCUM_Id_Fb
        data-element=CPT_APPCOM_SWC.CPT_MCU_Composition.MCUM_0x5D0.MCUM_Iq_Fb, system-signal=MCUM_Iq_Fb
        data-element=CPT_APPCOM_SWC.CPT_MCU_Composition.MCUM_0x5D0.MCUM_Torque_Ref, system-signal=MCUM_Torque_Ref
        data-element=CPT_APPCOM_SWC.CPT_MCU_Composition.MCUM_0x5D0.MCUM_R_Id_Ref, system-signal=MCUM_R_Id_Ref
        data-element=CPT_APPCOM_SWC.CPT_MCU_Composition.MCUM_0x5D0.MCUM_R_Iq_Ref, system-signal=MCUM_R_Iq_Ref
        data-element=CPT_APPCOM_SWC.CPT_MCU_Composition.MCUM_0x5D0.MCUM_R_Id_Fb, system-signal=MCUM_R_Id_Fb
        data-element=CPT_APPCOM_SWC.CPT_MCU_Composition.MCUM_0x5D0.MCUM_R_Iq_Fb, system-signal=MCUM_R_Iq_Fb
        data-element=CPT_APPCOM_SWC.CPT_MCU_Composition.MCUM_0x5D0.MCUM_R_Torque_Ref, system-signal=MCUM_R_Torque_Ref
        data-element=CPT_APPCOM_SWC.CPT_MCU_Composition.MCUM_0x5D1.MCUM_Vd_Ref, system-signal=MCUM_Vd_Ref
        data-element=CPT_APPCOM_SWC.CPT_MCU_Composition.MCUM_0x5D1.MCUM_Vq_Ref, system-signal=MCUM_Vq_Ref
        data-element=CPT_APPCOM_SWC.CPT_MCU_Composition.MCUM_0x5D1.MCUM_Id_LookUp, system-signal=MCUM_Id_LookUp
        data-element=CPT_APPCOM_SWC.CPT_MCU_Composition.MCUM_0x5D1.MCUM_Iq_LookUp, system-signal=MCUM_Iq_LookUp
        data-element=CPT_APPCOM_SWC.CPT_MCU_Composition.MCUM_0x5D1.MCUM_Spd_Delta, system-signal=MCUM_Spd_Delta
        data-element=CPT_APPCOM_SWC.CPT_MCU_Composition.MCUM_0x5D1.MCUM_Us_Out, system-signal=MCUM_Us_Out
        data-element=CPT_APPCOM_SWC.CPT_MCU_Composition.MCUM_0x5D1.MCUM_Torque_PwrEst, system-signal=MCUM_Torque_PwrEst
        data-element=CPT_APPCOM_SWC.CPT_MCU_Composition.MCUM_0x5D1.MCUM_UserDefine_50ms, system-signal=MCUM_UserDefine_50ms
        data-element=CPT_APPCOM_SWC.CPT_MCU_Composition.MCUM_0x5D1.MCUM_Torque_ExtChar, system-signal=MCUM_Torque_ExtChar
        data-element=CPT_APPCOM_SWC.CPT_MCU_Composition.MCUM_0x5D1.MCUM_Damp_CompTorque, system-signal=MCUM_Damp_CompTorque
        data-element=CPT_APPCOM_SWC.CPT_MCU_Composition.MCUM_0x5D1.MCUM_Damp_CompCoeff, system-signal=MCUM_Damp_CompCoeff
        data-element=CPT_APPCOM_SWC.CPT_MCU_Composition.MCUM_0x5D1.MCUM_Damp_State, system-signal=MCUM_Damp_State
        data-element=CPT_APPCOM_SWC.CPT_MCU_Composition.MCUM_0x5D1.MCUM_PWM_State, system-signal=MCUM_PWM_State
        data-element=CPT_APPCOM_SWC.CPT_MCU_Composition.MCUM_0x5D1.MCUM_JuncTemp_Max, system-signal=MCUM_JuncTemp_Max
        data-element=CPT_APPCOM_SWC.CPT_MCU_Composition.MCUM_0x5D1.MCUM_JuncLoss_Max, system-signal=MCUM_JuncLoss_Max
        data-element=CPT_APPCOM_SWC.CPT_MCU_Composition.MCUM_0x5D1.MCUM_CurrAmp_Comp, system-signal=MCUM_CurrAmp_Comp
        data-element=CPT_APPCOM_SWC.CPT_MCU_Composition.MCUM_0x5D1.MCUM_CurrTheta_Comp, system-signal=MCUM_CurrTheta_Comp
        data-element=CPT_APPCOM_SWC.CPT_MCU_Composition.MCUM_0x5D1.MCUM_RawSinCorr, system-signal=MCUM_RawSinCorr
        data-element=CPT_APPCOM_SWC.CPT_MCU_Composition.MCUM_0x5D1.MCUM_RawCosCorr, system-signal=MCUM_RawCosCorr
        data-element=CPT_APPCOM_SWC.CPT_MCU_Composition.MCUM_0x5D1.MCUM_LUT_Spd, system-signal=MCUM_LUT_Spd
        data-element=CPT_APPCOM_SWC.CPT_MCU_Composition.MCUM_0x5D1.MCUM_R_HighVoltPowerOffReq, system-signal=MCUM_R_HighVoltPowerOffReq
        data-element=CPT_APPCOM_SWC.CPT_MCU_Composition.MCUM_0x5D1.MCUM_R_MaxTorqueAllow, system-signal=MCUM_R_MaxTorqueAllow
        data-element=CPT_APPCOM_SWC.CPT_MCU_Composition.MCUM_0x5D1.MCUM_R_MaxSpeedAllow, system-signal=MCUM_R_MaxSpeedAllow
        data-element=CPT_APPCOM_SWC.CPT_MCU_Composition.MCUM_0x5D1.MCUM_R_MinTorqueAllow, system-signal=MCUM_R_MinTorqueAllow
        data-element=CPT_APPCOM_SWC.CPT_MCU_Composition.MCUM_0x5D1.MCUM_R_MotorTemp, system-signal=MCUM_R_MotorTemp
        data-element=CPT_APPCOM_SWC.CPT_MCU_Composition.MCUM_0x5D1.MCUM_R_IGBTTemp, system-signal=MCUM_R_IGBTTemp
        data-element=CPT_APPCOM_SWC.CPT_MCU_Composition.MCUM_0x5D1.MCUM_R_InletTemp, system-signal=MCUM_R_InletTemp
        data-element=CPT_APPCOM_SWC.CPT_MCU_Composition.MCUM_0x5D1.MCUM_R_HeatPwrAllwd, system-signal=MCUM_R_HeatPwrAllwd
        data-element=CPT_APPCOM_SWC.CPT_MCU_Composition.MCUM_0x5D1.MCUM_R_HeatFdBck, system-signal=MCUM_R_HeatFdBck
        data-element=CPT_APPCOM_SWC.CPT_MCU_Composition.MCUM_0x5D1.MCUM_R_HeatPwrAct, system-signal=MCUM_R_HeatPwrAct
        data-element=CPT_APPCOM_SWC.CPT_MCU_Composition.MCUM_0x5D1.MCUM_R_HeatPwrMax, system-signal=MCUM_R_HeatPwrMax
        data-element=CPT_APPCOM_SWC.CPT_MCU_Composition.MCUM_0x5D1.MCUM_R_HeatPwrAval, system-signal=MCUM_R_HeatPwrAval
        data-element=CPT_APPCOM_SWC.CPT_MCU_Composition.MCUM_0x5D1.MCUM_R_Vd_Ref, system-signal=MCUM_R_Vd_Ref
        data-element=CPT_APPCOM_SWC.CPT_MCU_Composition.MCUM_0x5D1.MCUM_R_Vq_Ref, system-signal=MCUM_R_Vq_Ref
        data-element=CPT_APPCOM_SWC.CPT_MCU_Composition.MCUM_0x5D1.MCUM_R_Id_LookUp, system-signal=MCUM_R_Id_LookUp
        data-element=CPT_APPCOM_SWC.CPT_MCU_Composition.MCUM_0x5D1.MCUM_R_Iq_LookUp, system-signal=MCUM_R_Iq_LookUp
        data-element=CPT_APPCOM_SWC.CPT_MCU_Composition.MCUM_0x5D1.MCUM_R_Spd_Delta, system-signal=MCUM_R_Spd_Delta
        data-element=CPT_APPCOM_SWC.CPT_MCU_Composition.MCUM_0x5D1.MCUM_R_Us_Out, system-signal=MCUM_R_Us_Out
        data-element=CPT_APPCOM_SWC.CPT_MCU_Composition.MCUM_0x5D1.MCUM_R_Torque_PwrEst, system-signal=MCUM_R_Torque_PwrEst
        data-element=CPT_APPCOM_SWC.CPT_MCU_Composition.MCUM_0x5D1.MCUM_R_UserDefine_50ms, system-signal=MCUM_R_UserDefine_50ms
        data-element=CPT_APPCOM_SWC.CPT_MCU_Composition.MCUM_0x5D1.MCUM_R_Torque_ExtChar, system-signal=MCUM_R_Torque_ExtChar
        data-element=CPT_APPCOM_SWC.CPT_MCU_Composition.MCUM_0x5D1.MCUM_R_Damp_CompTorque, system-signal=MCUM_R_Damp_CompTorque
        data-element=CPT_APPCOM_SWC.CPT_MCU_Composition.MCUM_0x5D1.MCUM_R_Damp_CompCoeff, system-signal=MCUM_R_Damp_CompCoeff
        data-element=CPT_APPCOM_SWC.CPT_MCU_Composition.MCUM_0x5D1.MCUM_R_Damp_State, system-signal=MCUM_R_Damp_State
        data-element=CPT_APPCOM_SWC.CPT_MCU_Composition.MCUM_0x5D1.MCUM_R_PWM_State, system-signal=MCUM_R_PWM_State
        data-element=CPT_APPCOM_SWC.CPT_MCU_Composition.MCUM_0x5D1.MCUM_R_JuncTemp_Max, system-signal=MCUM_R_JuncTemp_Max
        data-element=CPT_APPCOM_SWC.CPT_MCU_Composition.MCUM_0x5D1.MCUM_R_JuncLoss_Max, system-signal=MCUM_R_JuncLoss_Max
        data-element=CPT_APPCOM_SWC.CPT_MCU_Composition.MCUM_0x5D1.MCUM_R_CurrAmp_Comp, system-signal=MCUM_R_CurrAmp_Comp
        data-element=CPT_APPCOM_SWC.CPT_MCU_Composition.MCUM_0x5D1.MCUM_R_CurrTheta_Comp, system-signal=MCUM_R_CurrTheta_Comp
        data-element=CPT_APPCOM_SWC.CPT_MCU_Composition.MCUM_0x5D1.MCUM_R_RawSinCorr, system-signal=MCUM_R_RawSinCorr
        data-element=CPT_APPCOM_SWC.CPT_MCU_Composition.MCUM_0x5D1.MCUM_R_RawCosCorr, system-signal=MCUM_R_RawCosCorr
        data-element=CPT_APPCOM_SWC.CPT_MCU_Composition.MCUM_0x5D1.MCUM_R_LUT_Spd, system-signal=MCUM_R_LUT_Spd
        data-element=CPT_APPCOM_SWC.CPT_MCU_Composition.MCUM_0x5D2.MCUM_R_StatorTemp_1, system-signal=MCUM_R_StatorTemp_1
        data-element=CPT_APPCOM_SWC.CPT_MCU_Composition.MCUM_0x5D2.MCUM_R_L2TqAct, system-signal=MCUM_R_L2TqAct
        data-element=CPT_APPCOM_SWC.CPT_MCU_Composition.MCUM_0x5D2.MCUM_R_EOPSw, system-signal=MCUM_R_EOPSw
        data-element=CPT_APPCOM_SWC.CPT_MCU_Composition.MCUM_0x5D2.MCUM_R_StatorTemp_2, system-signal=MCUM_R_StatorTemp_2
        data-element=CPT_APPCOM_SWC.CPT_MCU_Composition.MCUM_0x5D2.MCUM_R_IGBTTemp_U, system-signal=MCUM_R_IGBTTemp_U
        data-element=CPT_APPCOM_SWC.CPT_MCU_Composition.MCUM_0x5D2.MCUM_R_IGBTTemp_V, system-signal=MCUM_R_IGBTTemp_V
        data-element=CPT_APPCOM_SWC.CPT_MCU_Composition.MCUM_0x5D2.MCUM_R_IGBTTemp_W, system-signal=MCUM_R_IGBTTemp_W
        data-element=CPT_APPCOM_SWC.CPT_MCU_Composition.MCUM_0x5D2.MCUM_R_Power_15V, system-signal=MCUM_R_Power_15V
        data-element=CPT_APPCOM_SWC.CPT_MCU_Composition.MCUM_0x5D2.MCUM_R_Offset_IU, system-signal=MCUM_R_Offset_IU
        data-element=CPT_APPCOM_SWC.CPT_MCU_Composition.MCUM_0x5D2.MCUM_R_Offset_IV, system-signal=MCUM_R_Offset_IV
        data-element=CPT_APPCOM_SWC.CPT_MCU_Composition.MCUM_0x5D2.MCUM_R_Offset_IW, system-signal=MCUM_R_Offset_IW
        data-element=CPT_APPCOM_SWC.CPT_MCU_Composition.MCUM_0x5D2.MCUM_R_MainSt_State, system-signal=MCUM_R_MainSt_State
        data-element=CPT_APPCOM_SWC.CPT_MCU_Composition.MCUM_0x5D2.MCUM_R_Derate_Reason, system-signal=MCUM_R_Derate_Reason
        data-element=CPT_APPCOM_SWC.CPT_MCU_Composition.MCUM_0x5D2.MCUM_R_PWM_Freq_kHz, system-signal=MCUM_R_PWM_Freq_kHz
        data-element=CPT_APPCOM_SWC.CPT_MCU_Composition.MCUM_0x5D2.MCUM_R_PWMEn_State, system-signal=MCUM_R_PWMEn_State
        data-element=CPT_APPCOM_SWC.CPT_MCU_Composition.MCUM_0x5D2.MCUM_R_DrvPwrEn_Out_State, system-signal=MCUM_R_DrvPwrEn_Out_State
        data-element=CPT_APPCOM_SWC.CPT_MCU_Composition.MCUM_0x5D2.MCUM_R_NVM_RslvrZeroRFault, system-signal=MCUM_R_NVM_RslvrZeroRFault
        data-element=CPT_APPCOM_SWC.CPT_MCU_Composition.MCUM_0x5D2.MCUM_R_Rotor_Position, system-signal=MCUM_R_Rotor_Position
        data-element=CPT_APPCOM_SWC.CPT_MCU_Composition.MCUM_0x5D2.MCUM_R_PosTransduserFaultCode, system-signal=MCUM_R_PosTransduserFaultCode
        data-element=CPT_APPCOM_SWC.CPT_MCU_Composition.MCUM_0x5D2.MCUM_R_NVM_RslvrDirRFault, system-signal=MCUM_R_NVM_RslvrDirRFault
        data-element=CPT_APPCOM_SWC.CPT_MCU_Composition.MCUM_0x5D2.MCUM_R_NVM_RslvrDelayRFault, system-signal=MCUM_R_NVM_RslvrDelayRFault
        data-element=CPT_APPCOM_SWC.CPT_MCU_Composition.MCUM_0x5D2.MCUM_R_NVM_RslvrParamRFault, system-signal=MCUM_R_NVM_RslvrParamRFault
        data-element=CPT_APPCOM_SWC.CPT_MCU_Composition.MCUM_0x5D2.MCUM_R_NVM_HallGainRFault, system-signal=MCUM_R_NVM_HallGainRFault
        data-element=CPT_APPCOM_SWC.CPT_MCU_Composition.MCUM_0x5D2.MCUM_R_NVM_HallDelayRFault, system-signal=MCUM_R_NVM_HallDelayRFault
        data-element=CPT_APPCOM_SWC.CPT_MCU_Composition.MCUM_0x5D2.MCUM_R_NVM_IGBTTypeRFault, system-signal=MCUM_R_NVM_IGBTTypeRFault
        data-element=CPT_APPCOM_SWC.CPT_MCU_Composition.MCUM_0x5D2.MCUM_R_ASC_EntryCount, system-signal=MCUM_R_ASC_EntryCount
        data-element=CPT_APPCOM_SWC.CPT_MCU_Composition.MCUM_0x5D2.MCUM_R_Spd_Turn, system-signal=MCUM_R_Spd_Turn
        data-element=CPT_APPCOM_SWC.CPT_MCU_Composition.MCUM_0x5D2.MCUM_R_LUT_Spd_Max, system-signal=MCUM_R_LUT_Spd_Max
        data-element=CPT_APPCOM_SWC.CPT_MCU_Composition.MCUM_0x5D2.MCUM_R_EOP_Speed, system-signal=MCUM_R_EOP_Speed
        data-element=CPT_APPCOM_SWC.CPT_MCU_Composition.MCUM_0x5D2.MCUM_R_EOP_IqFb, system-signal=MCUM_R_EOP_IqFb
        data-element=CPT_APPCOM_SWC.CPT_MCU_Composition.MCUM_0x5D2.MCUM_R_EOP_IqRef, system-signal=MCUM_R_EOP_IqRef
        data-element=CPT_APPCOM_SWC.CPT_MCU_Composition.MCUM_0x5D2.MCUM_R_EOP_DCVolt, system-signal=MCUM_R_EOP_DCVolt
        data-element=CPT_APPCOM_SWC.CPT_MCU_Composition.MCUM_0x5D2.MCUM_R_EOP_DCCurr, system-signal=MCUM_R_EOP_DCCurr
        data-element=CPT_APPCOM_SWC.CPT_MCU_Composition.MCUM_0x5D2.MCUM_R_EOP_Temp, system-signal=MCUM_R_EOP_Temp
        data-element=CPT_APPCOM_SWC.CPT_MCU_Composition.MCUM_0x5D2.MCUM_R_EOP_State, system-signal=MCUM_R_EOP_State
        data-element=CPT_APPCOM_SWC.CPT_MCU_Composition.MCUM_0x5D2.MCUM_R_EOP_FaultCode, system-signal=MCUM_R_EOP_FaultCode
        data-element=CPT_APPCOM_SWC.CPT_MCU_Composition.MCUM_0x5D2.MCUM_R_HWFault_RstCnt, system-signal=MCUM_R_HWFault_RstCnt
        data-element=CPT_APPCOM_SWC.CPT_MCU_Composition.MCUM_0x5D2.MCUM_R_HWFoB_RstCnt, system-signal=MCUM_R_HWFoB_RstCnt
        data-element=CPT_APPCOM_SWC.CPT_MCU_Composition.MCUM_0x5D2.MCUM_R_HWFoT_RstCnt, system-signal=MCUM_R_HWFoT_RstCnt
        data-element=CPT_APPCOM_SWC.CPT_MCU_Composition.MCUM_0x5D2.MCUM_R_HWDrvUV_RstCnt, system-signal=MCUM_R_HWDrvUV_RstCnt
        data-element=CPT_APPCOM_SWC.CPT_MCU_Composition.MCUM_0x5D2.MCUM_R_HWRdc_RstCnt, system-signal=MCUM_R_HWRdc_RstCnt
        data-element=CPT_APPCOM_SWC.CPT_MCU_Composition.MCUM_0x5D2.MCUM_R_HWOC_RstCnt, system-signal=MCUM_R_HWOC_RstCnt
        data-element=CPT_APPCOM_SWC.CPT_MCU_Composition.MCUM_0x5D2.MCUM_R_HWOV_RstCnt, system-signal=MCUM_R_HWOV_RstCnt
        data-element=CPT_APPCOM_SWC.CPT_MCU_Composition.MCUM_0x5D2.MCUM_R_L2agRtrElecDiff, system-signal=MCUM_R_L2agRtrElecDiff
        data-element=CPT_APPCOM_SWC.CPT_MCU_Composition.MCUM_0x5D2.MCUM_R_500usOverTime_Cnt, system-signal=MCUM_R_500usOverTime_Cnt
        data-element=CPT_APPCOM_SWC.CPT_MCU_Composition.MCUM_0x5D2.MCUM_R_5msOverTime_Cnt, system-signal=MCUM_R_5msOverTime_Cnt
        data-element=CPT_APPCOM_SWC.CPT_MCU_Composition.MCUM_0x5D2.MCUM_R_CpldRest_TimeOut_flag, system-signal=MCUM_R_CpldRest_TimeOut_flag
        data-element=CPT_APPCOM_SWC.CPT_MCU_Composition.MCUM_0x5D2.MCUM_R_DrvPCBCurr, system-signal=MCUM_R_DrvPCBCurr
        data-element=CPT_APPCOM_SWC.CPT_MCU_Composition.MCUM_0x5D2.MCUM_R_EOL_StateMachine, system-signal=MCUM_R_EOL_StateMachine
        data-element=CPT_APPCOM_SWC.CPT_MCU_Composition.MCUM_0x5D2.MCUM_R_CpldRest_ASC_Flag, system-signal=MCUM_R_CpldRest_ASC_Flag
        data-element=CPT_APPCOM_SWC.CPT_MCU_Composition.MCUM_0x5D2.MCUM_R_LimSpdTorFlag, system-signal=MCUM_R_LimSpdTorFlag
        data-element=CPT_APPCOM_SWC.CPT_MCU_Composition.MCUM_0x5D2.MCUM_R_PWM_Err_Count, system-signal=MCUM_R_PWM_Err_Count
        data-element=CPT_APPCOM_SWC.CPT_MCU_Composition.MCUM_0x5D2.MCUM_R_RDC_Reset_Count, system-signal=MCUM_R_RDC_Reset_Count
        data-element=CPT_APPCOM_SWC.CPT_MCU_Composition.MCUM_0x5D2.MCUM_R_ASC_Stop_Flag, system-signal=MCUM_R_ASC_Stop_Flag
        data-element=CPT_APPCOM_SWC.CPT_MCU_Composition.MCUM_0x5D2.MCUM_R_ASC_Soft_Exiting_Flag, system-signal=MCUM_R_ASC_Soft_Exiting_Flag
        data-element=CPT_APPCOM_SWC.CPT_MCU_Composition.MCUM_0x5D2.MCUM_R_Vbus_ServeLowChkEn, system-signal=MCUM_R_Vbus_ServeLowChkEn
        data-element=CPT_APPCOM_SWC.CPT_MCU_Composition.MCUM_0x5D2.MCUM_R_EOP_BlockErr_IsLim_Flag, system-signal=MCUM_R_EOP_BlockErr_IsLim_Flag
        data-element=CPT_APPCOM_SWC.CPT_MCU_Composition.MCUM_0x5D2.MCUM_R_IdqErrCount, system-signal=MCUM_R_IdqErrCount
        data-element=CPT_APPCOM_SWC.CPT_MCU_Composition.MCUM_0x5D2.MCUM_R_MotSelfHeat_EnSts, system-signal=MCUM_R_MotSelfHeat_EnSts
        data-element=CPT_APPCOM_SWC.CPT_MCU_Composition.MCUM_0x5D2.MCUM_R_MotBlockHeat_LvlFb, system-signal=MCUM_R_MotBlockHeat_LvlFb
        data-element=CPT_APPCOM_SWC.CPT_MCU_Composition.MCUM_0x5D2.MCUM_R_MotRotaryHeat_LvlFb, system-signal=MCUM_R_MotRotaryHeat_LvlFb
        data-element=CPT_APPCOM_SWC.CPT_MCU_Composition.MCUM_0x5D2.MCUM_R_MotSelfHeat_DropLvlFb, system-signal=MCUM_R_MotSelfHeat_DropLvlFb
        data-element=CPT_APPCOM_SWC.CPT_MCU_Composition.MCUM_0x5D2.MCUM_R_MotSelfHeat_DropLvlRsn, system-signal=MCUM_R_MotSelfHeat_DropLvlRsn
        data-element=CPT_APPCOM_SWC.CPT_MCU_Composition.MCUM_0x5D2.MCUM_R_MotBlockHeat_CurAngle, system-signal=MCUM_R_MotBlockHeat_CurAngle
        data-element=CPT_APPCOM_SWC.CPT_MCU_Composition.MCUM_0x5D2.MCUM_R_MotBlockHeat_CurMag, system-signal=MCUM_R_MotBlockHeat_CurMag
        data-element=CPT_APPCOM_SWC.CPT_MCU_Composition.MCUM_0x5D2.MCUM_R_UserDefine_Byte{1..4}, system-signal=MCUM_R_UserDefine_Byte{1..4}
        data-element=CPT_APPCOM_SWC.CPT_MCU_Composition.MCUM_0x5D2.MCUM_R_UserDefine_Word{1..3}, system-signal=MCUM_R_UserDefine_Word{1..3}
        data-element=CPT_APPCOM_SWC.CPT_MCU_Composition.VCU_0x358.VCU_MotSelfHeatPwrFb, system-signal=VCU_MotSelfHeatPwrFb
        data-element=CPT_APPCOM_SWC.CPT_MCU_Composition.VCU_0x358.VCU_MotSelfHeatLvlFb, system-signal=VCU_MotSelfHeatLvlFb
        data-element=CPT_APPCOM_SWC.CPT_MCU_Composition.VCU_0x358.VCU_MCUMWaterPumpLevlReq, system-signal=VCU_MCUMWaterPumpLevlReq
        data-element=CPT_APPCOM_SWC.CPT_MCU_Composition.VCU_0x358.VCU_MCUSWaterPumpLevlReq, system-signal=VCU_MCUSWaterPumpLevlReq
        data-element=CPT_APPCOM_SWC.CPT_MCU_Composition.VCU_0x358.VCU_HeatPwrAval, system-signal=VCU_HeatPwrAval
        data-element=CPT_APPCOM_SWC.CPT_MCU_Composition.VCU_0x358.VCU_MotSelfHeatAllwd, system-signal=VCU_MotSelfHeatAllwd
        data-element=CPT_APPCOM_SWC.CPT_MCU_Composition.VCU_0x358.VCU_MMotSelfHeatEnReq, system-signal=VCU_MMotSelfHeatEnReq
        data-element=CPT_APPCOM_SWC.CPT_MCU_Composition.VCU_0x358.VCU_MMotSelfHeatLvlReq, system-signal=VCU_MMotSelfHeatLvlReq
        data-element=CPT_APPCOM_SWC.CPT_MCU_Composition.VCU_0x358.VCU_SMotSelfHeatEnReq, system-signal=VCU_SMotSelfHeatEnReq
        data-element=CPT_APPCOM_SWC.CPT_MCU_Composition.VCU_0x358.VCU_SMotSelfHeatLvlReq, system-signal=VCU_SMotSelfHeatLvlReq
        data-element=CPT_APPCOM_SWC.CPT_MCU_Composition.RMCU_0x2.Debug_MCU_CRC_CA, system-signal=Debug_MCU_CRC_CA
        data-element=CPT_APPCOM_SWC.CPT_MCU_Composition.RMCU_0x2.Debug_MCU_RollingCounter_CA, system-signal=Debug_MCU_RollingCounter_CA
        data-element=CPT_APPCOM_SWC.CPT_MCU_Composition.RMCU_0x2.Debug_MCU_WarningLevel, system-signal=Debug_MCU_WarningLevel
        data-element=CPT_APPCOM_SWC.CPT_MCU_Composition.RMCU_0x2.Debug_MCU_SelfCheckSts, system-signal=Debug_MCU_SelfCheckSts
        data-element=CPT_APPCOM_SWC.CPT_MCU_Composition.RMCU_0x2.Debug_MCU_DrvMotorWorkSts, system-signal=Debug_MCU_DrvMotorWorkSts
        data-element=CPT_APPCOM_SWC.CPT_MCU_Composition.RMCU_0x2.Debug_MCU_PowerReduceSts, system-signal=Debug_MCU_PowerReduceSts
        data-element=CPT_APPCOM_SWC.CPT_MCU_Composition.RMCU_0x2.Debug_MCU_DrvMotorRPM, system-signal=Debug_MCU_DrvMotorRPM
        data-element=CPT_APPCOM_SWC.CPT_MCU_Composition.RMCU_0x2.Debug_MCU_ActualTorqueFB, system-signal=Debug_MCU_ActualTorqueFB
        data-element=CPT_APPCOM_SWC.CPT_MCU_Composition.RMCU_0x2.Debug_MCU_HWRdcFault, system-signal=Debug_MCU_HWRdcFault
        data-element=CPT_APPCOM_SWC.CPT_MCU_Composition.RMCU_0x2.Debug_MCU_HighVoltPowerOffReq, system-signal=Debug_MCU_HighVoltPowerOffReq
        data-element=CPT_APPCOM_SWC.CPT_MCU_Composition.RMCU_0x2.Debug_MCU_HVILSts, system-signal=Debug_MCU_HVILSts
        data-element=CPT_APPCOM_SWC.CPT_MCU_Composition.RMCU_0x2.Debug_MCU_DragSts, system-signal=Debug_MCU_DragSts
        data-element=CPT_APPCOM_SWC.CPT_MCU_Composition.RMCU_0x2.Debug_MCU_CtrlMode, system-signal=Debug_MCU_CtrlMode
        data-element=CPT_APPCOM_SWC.CPT_MCU_Composition.RMCU_0x2.Debug_MCU_MILlampReq, system-signal=Debug_MCU_MILlampReq
        data-element=CPT_APPCOM_SWC.CPT_MCU_Composition.RMCU_0x2.Debug_MCU_DrvMotorRPMVD, system-signal=Debug_MCU_DrvMotorRPMVD
        data-element=CPT_APPCOM_SWC.CPT_MCU_Composition.RMCU_0x2.Debug_MCU_ActualTorqueFBVD, system-signal=Debug_MCU_ActualTorqueFBVD
        data-element=CPT_APPCOM_SWC.CPT_MCU_Composition.RMCU_0x2.Debug_MCU_MaxTorqueAllow, system-signal=Debug_MCU_MaxTorqueAllow
        data-element=CPT_APPCOM_SWC.CPT_MCU_Composition.RMCU_0x2.Debug_MCU_MaxSpeedAllow, system-signal=Debug_MCU_MaxSpeedAllow
        data-element=CPT_APPCOM_SWC.CPT_MCU_Composition.RMCU_0x2.Debug_MCU_ActiveReleaseSts, system-signal=Debug_MCU_ActiveReleaseSts
        data-element=CPT_APPCOM_SWC.CPT_MCU_Composition.RMCU_0x2.Debug_MCU_DCChargRelaySts, system-signal=Debug_MCU_DCChargRelaySts
        data-element=CPT_APPCOM_SWC.CPT_MCU_Composition.RMCU_0x2.Debug_MCUM_MinTorqueAllow, system-signal=Debug_MCUM_MinTorqueAllow
        data-element=CPT_APPCOM_SWC.CPT_MCU_Composition.RMCU_0x2.Debug_MCU_MainWireVolt, system-signal=Debug_MCU_MainWireVolt
        data-element=CPT_APPCOM_SWC.CPT_MCU_Composition.RMCU_0x2.Debug_MCU_MainWireCurr, system-signal=Debug_MCU_MainWireCurr
        data-element=CPT_APPCOM_SWC.CPT_MCU_Composition.RMCU_0x2.Debug_MCUM_TMS_MotSelfHeatEnSts, system-signal=Debug_MCUM_TMS_MotSelfHeatEnSts
        data-element=CPT_APPCOM_SWC.CPT_MCU_Composition.RMCU_0x2.Debug_MCUM_TMS_MotSelfHeatLvlFb, system-signal=Debug_MCUM_TMS_MotSelfHeatLvlFb
        data-element=CPT_APPCOM_SWC.CPT_MCU_Composition.RMCU_0x2.Debug_MCUM_RPowerReduceSts, system-signal=Debug_MCUM_RPowerReduceSts
        data-element=CPT_APPCOM_SWC.CPT_MCU_Composition.RMCU_0x2.Debug_MCUM_HeatPwrAval, system-signal=Debug_MCUM_HeatPwrAval
        data-element=CPT_APPCOM_SWC.CPT_MCU_Composition.RMCU_0x2.Debug_MCUM_RCtrlMode, system-signal=Debug_MCUM_RCtrlMode
        data-element=CPT_APPCOM_SWC.CPT_MCU_Composition.RMCU_0x2.Debug_MCUM_RWarningLevel, system-signal=Debug_MCUM_RWarningLevel
        data-element=CPT_APPCOM_SWC.CPT_MCU_Composition.RMCU_0x2.Debug_MCUM_RSelfCheckSts, system-signal=Debug_MCUM_RSelfCheckSts
        data-element=CPT_APPCOM_SWC.CPT_MCU_Composition.RMCU_0x2.Debug_MCUM_RDrvMotorWorkSts, system-signal=Debug_MCUM_RDrvMotorWorkSts
        data-element=CPT_APPCOM_SWC.CPT_MCU_Composition.RMCU_0x2.Debug_MCUM_RCtrlModeVD, system-signal=Debug_MCUM_RCtrlModeVD
        data-element=CPT_APPCOM_SWC.CPT_MCU_Composition.RMCU_0x2.Debug_MCUM_RHWRdcFault, system-signal=Debug_MCUM_RHWRdcFault
        data-element=CPT_APPCOM_SWC.CPT_MCU_Composition.RMCU_0x2.Debug_MCUM_RDrvMotorRPMVD, system-signal=Debug_MCUM_RDrvMotorRPMVD
        data-element=CPT_APPCOM_SWC.CPT_MCU_Composition.RMCU_0x2.Debug_MCUM_RActualTorqueFBVD, system-signal=Debug_MCUM_RActualTorqueFBVD
        data-element=CPT_APPCOM_SWC.CPT_MCU_Composition.RMCU_0x2.Debug_MCUM_RDrvMotorRPM, system-signal=Debug_MCUM_RDrvMotorRPM
        data-element=CPT_APPCOM_SWC.CPT_MCU_Composition.RMCU_0x2.Debug_MCUM_RActualTorqueFB, system-signal=Debug_MCUM_RActualTorqueFB
        data-element=CPT_APPCOM_SWC.CPT_MCU_Composition.IBS_0x225.IBS_CRC_225, system-signal=IBS_CRC_225
        data-element=CPT_APPCOM_SWC.CPT_MCU_Composition.IBS_0x225.IBS_RollingCounter_225, system-signal=IBS_RollingCounter_225
        data-element=CPT_APPCOM_SWC.CPT_MCU_Composition.IBS_0x225.IBS_Warning_Level, system-signal=IBS_Warning_Level
        data-element=CPT_APPCOM_SWC.CPT_MCU_Composition.ADDC_0x84.ADDC_CRC_84, system-signal=ADDC_CRC_84
        data-element=CPT_APPCOM_SWC.CPT_MCU_Composition.ADDC_0x84.ADDC_APS_AVHReq, system-signal=ADDC_APS_AVHReq
        data-element=CPT_APPCOM_SWC.CPT_MCU_Composition.ADDC_0x84.ADDC_APS_HoldSts, system-signal=ADDC_APS_HoldSts
        data-element=CPT_APPCOM_SWC.CPT_MCU_Composition.ADDC_0x84.ADDC_APSTargetTrqBrkVD, system-signal=ADDC_APSTargetTrqBrkVD
        data-element=CPT_APPCOM_SWC.CPT_MCU_Composition.ADDC_0x84.ADDC_APSTargetTrqBrk, system-signal=ADDC_APSTargetTrqBrk
        data-element=CPT_APPCOM_SWC.CPT_MCU_Composition.ADDC_0x84.ADDC_APSTargetTrqVD, system-signal=ADDC_APSTargetTrqVD
        data-element=CPT_APPCOM_SWC.CPT_MCU_Composition.ADDC_0x84.ADDC_APSTargetTrq, system-signal=ADDC_APSTargetTrq
        data-element=CPT_APPCOM_SWC.CPT_MCU_Composition.ADDC_0x84.ADDC_safety_valid, system-signal=ADDC_safety_valid
        data-element=CPT_APPCOM_SWC.CPT_MCU_Composition.ADDC_0x84.ADDC_rearsafety_level, system-signal=ADDC_rearsafety_level
        data-element=CPT_APPCOM_SWC.CPT_MCU_Composition.ADDC_0x84.ADDC_frontsafety_level, system-signal=ADDC_frontsafety_level
        data-element=CPT_APPCOM_SWC.CPT_MCU_Composition.ADDC_0x84.ADDC_rightsafety_level, system-signal=ADDC_rightsafety_level
        data-element=CPT_APPCOM_SWC.CPT_MCU_Composition.ADDC_0x84.ADDC_leftsafety_level, system-signal=ADDC_leftsafety_level
        data-element=CPT_APPCOM_SWC.CPT_MCU_Composition.ADDC_0x84.ADDC_RollingCounter_84, system-signal=ADDC_RollingCounter_84
        data-element=CPT_APPCOM_SWC.CPT_MCU_Composition.ADDC_0x84.ADDC_APS_EnableReq, system-signal=ADDC_APS_EnableReq
        data-element=CPT_APPCOM_SWC.CPT_MCU_Composition.ADDC_0x84.ADDC_APS_WorkSts, system-signal=ADDC_APS_WorkSts
        data-element=CPT_APPCOM_SWC.CPT_MCU_Composition.ADDC_0x84.ADDC_APS_PDCVehicleDirectCtlVD, system-signal=ADDC_APS_PDCVehicleDirectCtlVD
        data-element=CPT_APPCOM_SWC.CPT_MCU_Composition.ADDC_0x84.ADDC_APS_VehicleSpeedCtlVD, system-signal=ADDC_APS_VehicleSpeedCtlVD
        data-element=CPT_APPCOM_SWC.CPT_MCU_Composition.ADDC_0x84.ADDC_APS_PDC_VehicleDirectCtl, system-signal=ADDC_APS_PDC_VehicleDirectCtl
        data-element=CPT_APPCOM_SWC.CPT_MCU_Composition.ADDC_0x84.ADDC_APS_PDC_SWAngCtl, system-signal=ADDC_APS_PDC_SWAngCtl
        data-element=CPT_APPCOM_SWC.CPT_MCU_Composition.ADDC_0x84.ADDC_APS_ParkingReq, system-signal=ADDC_APS_ParkingReq
        data-element=CPT_APPCOM_SWC.CPT_MCU_Composition.ADDC_0x84.ADDC_APS_EmergenceBrake, system-signal=ADDC_APS_EmergenceBrake
        data-element=CPT_APPCOM_SWC.CPT_MCU_Composition.ADDC_0x84.ADDC_APS_TargetAccVD, system-signal=ADDC_APS_TargetAccVD
        data-element=CPT_APPCOM_SWC.CPT_MCU_Composition.ADDC_0x84.ADDC_APS_TargetAcc, system-signal=ADDC_APS_TargetAcc
        data-element=CPT_APPCOM_SWC.CPT_MCU_Composition.ADDC_0x84.ADDC_APS_VehicleSpeedCtl, system-signal=ADDC_APS_VehicleSpeedCtl
        data-element=CPT_APPCOM_SWC.CPT_MCU_Composition.ADDC_0x84.ADDC_APS_DecToStop, system-signal=ADDC_APS_DecToStop
        data-element=CPT_APPCOM_SWC.CPT_MCU_Composition.ADDC_0x84.ADDC_APS_Driveoff_Request, system-signal=ADDC_APS_Driveoff_Request
        data-element=CPT_APPCOM_SWC.CPT_MCU_Composition.ADDC_0x84.ADDC_APS_FuncType, system-signal=ADDC_APS_FuncType
        data-element=CPT_APPCOM_SWC.CPT_MCU_Composition.ADDC_0x84.ADDC_APS_Available, system-signal=ADDC_APS_Available
        data-element=CPT_APPCOM_SWC.CPT_MCU_Composition.IVI_0x5F6.IVI_Year, system-signal=IVI_Year
        data-element=CPT_APPCOM_SWC.CPT_MCU_Composition.IVI_0x5F6.IVI_Month, system-signal=IVI_Month
        data-element=CPT_APPCOM_SWC.CPT_MCU_Composition.IVI_0x5F6.IVI_Data, system-signal=IVI_Data
        data-element=CPT_APPCOM_SWC.CPT_MCU_Composition.IVI_0x5F6.IVI_Hour, system-signal=IVI_Hour
        data-element=CPT_APPCOM_SWC.CPT_MCU_Composition.IVI_0x5F6.IVI_Minute, system-signal=IVI_Minute
        data-element=CPT_APPCOM_SWC.CPT_MCU_Composition.IVI_0x5F6.IVI_Second, system-signal=IVI_Second
        data-element=CPT_APPCOM_SWC.CPT_MCU_Composition.DCDC_0x324.DCDC_CRC_324, system-signal=DCDC_CRC_324
        data-element=CPT_APPCOM_SWC.CPT_MCU_Composition.DCDC_0x324.DCDC_RollingCounter_324, system-signal=DCDC_RollingCounter_324
        data-element=CPT_APPCOM_SWC.CPT_MCU_Composition.DCDC_0x324.DCDC_WorkSts, system-signal=DCDC_WorkSts
        data-element=CPT_APPCOM_SWC.CPT_MCU_Composition.DCDC_0x324.DCDC_Under_Output_Voltage, system-signal=DCDC_Under_Output_Voltage
        data-element=CPT_APPCOM_SWC.CPT_MCU_Composition.DCDC_0x324.DCDC_Over_Output_Voltage, system-signal=DCDC_Over_Output_Voltage
        data-element=CPT_APPCOM_SWC.CPT_MCU_Composition.DCDC_0x324.DCDC_Under_Input_Voltage, system-signal=DCDC_Under_Input_Voltage
        data-element=CPT_APPCOM_SWC.CPT_MCU_Composition.DCDC_0x324.DCDC_Over_Input_Voltage, system-signal=DCDC_Over_Input_Voltage
        data-element=CPT_APPCOM_SWC.CPT_MCU_Composition.DCDC_0x324.DCDC_Over_Input_Current, system-signal=DCDC_Over_Input_Current
        data-element=CPT_APPCOM_SWC.CPT_MCU_Composition.DCDC_0x324.DCDC_Real_Output_Current, system-signal=DCDC_Real_Output_Current
        data-element=CPT_APPCOM_SWC.CPT_MCU_Composition.DCDC_0x324.DCDC_Real_Output_Voltage, system-signal=DCDC_Real_Output_Voltage
        data-element=CPT_APPCOM_SWC.CPT_MCU_Composition.DCDC_0x324.DCDC_Real_Input_Current, system-signal=DCDC_Real_Input_Current
        data-element=CPT_APPCOM_SWC.CPT_MCU_Composition.DCDC_0x324.DCDC_Real_Input_Voltage, system-signal=DCDC_Real_Input_Voltage
        data-element=CPT_APPCOM_SWC.CPT_MCU_Composition.DCDC_0x324.DCDC_Derating, system-signal=DCDC_Derating
        data-element=CPT_APPCOM_SWC.CPT_MCU_Composition.DCDC_0x324.DCDC_Hardware_Fault_Flag, system-signal=DCDC_Hardware_Fault_Flag
        data-element=CPT_APPCOM_SWC.CPT_MCU_Composition.DCDC_0x324.CDU_ACChg_HIVSts, system-signal=CDU_ACChg_HIVSts
        data-element=CPT_APPCOM_SWC.CPT_MCU_Composition.DCDC_0x324.CDU_OBC_OverTemp, system-signal=CDU_OBC_OverTemp
        data-element=CPT_APPCOM_SWC.CPT_MCU_Composition.DCDC_0x324.CDU_SelfCheckSt, system-signal=CDU_SelfCheckSt
        data-element=CPT_APPCOM_SWC.CPT_MCU_Composition.DCDC_0x324.CDU_HV_HIVSts, system-signal=CDU_HV_HIVSts
        data-element=CPT_APPCOM_SWC.CPT_MCU_Composition.FSC_0x142.FSC_CRC_142, system-signal=FSC_CRC_142
        data-element=CPT_APPCOM_SWC.CPT_MCU_Composition.FSC_0x142.FSC_RollingCounter_142, system-signal=FSC_RollingCounter_142
        data-element=CPT_APPCOM_SWC.CPT_MCU_Composition.FSC_0x142.FSC_LCC_Mode, system-signal=FSC_LCC_Mode
        data-element=CPT_APPCOM_SWC.CPT_MCU_Composition.MCU_0x5C6.MotClb_FaultCode{1..8}, system-signal=MotClb_FaultCode{1..8}
        data-element=CPT_APPCOM_SWC.CPT_MCU_Composition.MCU_0x5C6.MotClb_OfsApply, system-signal=MotClb_OfsApply
        data-element=CPT_APPCOM_SWC.CPT_MCU_Composition.MCU_0x5C6.MCUMR_MotClb_FaultCode{1..8}, system-signal=MCUMR_MotClb_FaultCode{1..8}
        data-element=CPT_APPCOM_SWC.CPT_MCU_Composition.MCU_0x5C6.MCUMR_MotClb_OfsApply, system-signal=MCUMR_MotClb_OfsApply
        data-element=CPT_APPCOM_SWC.CPT_MCU_Composition.MCU_0x5C5.EOL_ModeCMD_Data{0..5}, system-signal=EOL_ModeCMD_Data{0..5}
        data-element=CPT_APPCOM_SWC.CPT_MCU_Composition.MCU_0x5C5.EOL_ModeCMD_Enable, system-signal=EOL_ModeCMD_Enable
        data-element=CPT_APPCOM_SWC.CPT_MCU_Composition.MCU_0x5C5.EOL_ModeCMD_Check, system-signal=EOL_ModeCMD_Check
        data-element=CPT_APPCOM_SWC.CPT_MCU_Composition.MCU_0x5C5.EOL_GainIden_UsApply, system-signal=EOL_GainIden_UsApply
        data-element=CPT_APPCOM_SWC.CPT_MCU_Composition.MCU_0x5C5.EOL_MotClb_CtrlMode, system-signal=EOL_MotClb_CtrlMode
        data-element=CPT_APPCOM_SWC.CPT_MCU_Composition.MCU_0x5C5.MotClb_OfsSet, system-signal=MotClb_OfsSet
        data-element=CPT_APPCOM_SWC.CPT_MCU_Composition.MCU_0x5C5.EOL_MotClb_IsCMD, system-signal=EOL_MotClb_IsCMD
        data-element=CPT_APPCOM_SWC.CPT_MCU_Composition.MCU_0x5C5.EOL_MotClb_ThetaCMD, system-signal=EOL_MotClb_ThetaCMD
        data-element=CPT_APPCOM_SWC.CPT_MCU_Composition.MCU_0x5C5.EOL_frqsync, system-signal=EOL_frqsync
        data-element=CPT_APPCOM_SWC.CPT_MCU_Composition.MCU_0x5C5.EOL_MotClb_Enable, system-signal=EOL_MotClb_Enable
        data-element=CPT_APPCOM_SWC.CPT_MCU_Composition.MCU_0x5C5.EOL_ActiveReleaseCmd, system-signal=EOL_ActiveReleaseCmd
        data-element=CPT_APPCOM_SWC.CPT_MCU_Composition.MCU_0x5C5.MotClb_OfsAdjEn, system-signal=MotClb_OfsAdjEn
        data-element=CPT_APPCOM_SWC.CPT_MCU_Composition.MCU_0x5C5.EOL_Asc_CMD, system-signal=EOL_Asc_CMD
        data-element=CPT_APPCOM_SWC.CPT_MCU_Composition.MCU_0x5C5.EOL_PosDly_SnsrSupplier, system-signal=EOL_PosDly_SnsrSupplier
        data-element=CPT_APPCOM_SWC.CPT_MCU_Composition.MCU_0x5C5.FstRcrd_Enable, system-signal=FstRcrd_Enable
        data-element=CPT_APPCOM_SWC.CPT_MCU_Composition.MCU_0x5C5.GainIden_CurrRMS_Ref_U, system-signal=GainIden_CurrRMS_Ref_U
        data-element=CPT_APPCOM_SWC.CPT_MCU_Composition.MCU_0x5C5.GainIden_CurrRMS_Ref_V, system-signal=GainIden_CurrRMS_Ref_V
        data-element=CPT_APPCOM_SWC.CPT_MCU_Composition.MCU_0x5C5.GainIden_CurrRMS_Ref_W, system-signal=GainIden_CurrRMS_Ref_W
        data-element=CPT_APPCOM_SWC.CPT_MCU_Composition.MCU_0x5C5.MCUMR_EOL_GainIden_UsApply, system-signal=MCUMR_EOL_GainIden_UsApply
        data-element=CPT_APPCOM_SWC.CPT_MCU_Composition.MCU_0x5C5.MCUMR_EOL_MotClb_CtrlMode, system-signal=MCUMR_EOL_MotClb_CtrlMode
        data-element=CPT_APPCOM_SWC.CPT_MCU_Composition.MCU_0x5C5.MCUMR_MotClb_OfsSet, system-signal=MCUMR_MotClb_OfsSet
        data-element=CPT_APPCOM_SWC.CPT_MCU_Composition.MCU_0x5C5.MCUMR_EOL_MotClb_IsCMD, system-signal=MCUMR_EOL_MotClb_IsCMD
        data-element=CPT_APPCOM_SWC.CPT_MCU_Composition.MCU_0x5C5.MCUMR_EOL_MotClb_ThetaCMD, system-signal=MCUMR_EOL_MotClb_ThetaCMD
        data-element=CPT_APPCOM_SWC.CPT_MCU_Composition.MCU_0x5C5.MCUMR_EOL_frqsync, system-signal=MCUMR_EOL_frqsync
        data-element=CPT_APPCOM_SWC.CPT_MCU_Composition.MCU_0x5C5.MCUMR_EOL_MotClb_Enable, system-signal=MCUMR_EOL_MotClb_Enable
        data-element=CPT_APPCOM_SWC.CPT_MCU_Composition.MCU_0x5C5.MCUMR_EOL_ActiveReleaseCmd, system-signal=MCUMR_EOL_ActiveReleaseCmd
        data-element=CPT_APPCOM_SWC.CPT_MCU_Composition.MCU_0x5C5.MCUMR_MotClb_OfsAdjEn, system-signal=MCUMR_MotClb_OfsAdjEn
        data-element=CPT_APPCOM_SWC.CPT_MCU_Composition.MCU_0x5C5.MCUMR_EOL_Asc_CMD, system-signal=MCUMR_EOL_Asc_CMD
        data-element=CPT_APPCOM_SWC.CPT_MCU_Composition.MCU_0x5C5.MCUMR_EOL_PosDly_SnsrSupplier, system-signal=MCUMR_EOL_PosDly_SnsrSupplier
        data-element=CPT_APPCOM_SWC.CPT_MCU_Composition.MCU_0x5C5.MCUMR_FstRcrd_Enable, system-signal=MCUMR_FstRcrd_Enable
        data-element=CPT_APPCOM_SWC.CPT_MCU_Composition.MCU_0x5C5.MCUMR_GainIden_CurrRMS_Ref_U, system-signal=MCUMR_GainIden_CurrRMS_Ref_U
        data-element=CPT_APPCOM_SWC.CPT_MCU_Composition.MCU_0x5C5.MCUMR_GainIden_CurrRMS_Ref_V, system-signal=MCUMR_GainIden_CurrRMS_Ref_V
        data-element=CPT_APPCOM_SWC.CPT_MCU_Composition.MCU_0x5C5.MCUMR_GainIden_CurrRMS_Ref_W, system-signal=MCUMR_GainIden_CurrRMS_Ref_W
        data-element=CPT_APPCOM_SWC.CPT_MCU_Composition.MCUS_0x14.MCUS_CRC_14, system-signal=MCUS_CRC_14
        data-element=CPT_APPCOM_SWC.CPT_MCU_Composition.MCUS_0x14.MCUS_RollingCounter_14, system-signal=MCUS_RollingCounter_14
        data-element=CPT_APPCOM_SWC.CPT_MCU_Composition.MCUS_0x14.MCUS_DrvMotorRPM_prvt, system-signal=MCUS_DrvMotorRPM_prvt
        data-element=CPT_APPCOM_SWC.CPT_MCU_Composition.MCUS_0x14.MCUS_ActualTorqueFB_prvt, system-signal=MCUS_ActualTorqueFB_prvt
        data-element=CPT_APPCOM_SWC.CPT_MCU_Composition.MCUS_0x14.MCUS_DrvMotorRPMVD_prvt, system-signal=MCUS_DrvMotorRPMVD_prvt
        data-element=CPT_APPCOM_SWC.CPT_MCU_Composition.MCUS_0x14.MCUS_ActualTorqueFBVD_prvt, system-signal=MCUS_ActualTorqueFBVD_prvt
        data-element=CPT_APPCOM_SWC.CPT_MCU_Composition.MCU_0x5C7.U16_CMD{1..4}, system-signal=U16_CMD{1..4}
        data-element=CPT_APPCOM_SWC.CPT_MCU_Composition.MCU_0x5C7.S16_CMD{1..4}, system-signal=S16_CMD{1..4}
        data-element=CPT_APPCOM_SWC.CPT_MCU_Composition.MCU_0x5C7.R16_CMD{1..4}, system-signal=R16_CMD{1..4}
        data-element=CPT_APPCOM_SWC.CPT_MCU_Composition.MCU_0x5C7.U8_CMD{1..8}, system-signal=U8_CMD{1..8}
        data-element=CPT_APPCOM_SWC.CPT_MCU_Composition.OBC_0x316.OBC_CRC_316, system-signal=OBC_CRC_316
        data-element=CPT_APPCOM_SWC.CPT_MCU_Composition.OBC_0x316.OBC_RollingCounter_316, system-signal=OBC_RollingCounter_316
        data-element=CPT_APPCOM_SWC.CPT_MCU_Composition.OBC_0x316.OBC_WorkSts, system-signal=OBC_WorkSts
        data-element=CPT_APPCOM_SWC.CPT_MCU_Composition.OBC_0x316.OBC_StartSts, system-signal=OBC_StartSts
        data-element=CPT_APPCOM_SWC.CPT_MCU_Composition.OBC_0x316.OBC_DCSts, system-signal=OBC_DCSts
        data-element=CPT_APPCOM_SWC.CPT_MCU_Composition.OBC_0x316.OBC_ACChargeOutputSts, system-signal=OBC_ACChargeOutputSts
        data-element=CPT_APPCOM_SWC.CPT_MCU_Composition.OBC_0x316.OBC_DCVolt, system-signal=OBC_DCVolt
        data-element=CPT_APPCOM_SWC.CPT_MCU_Composition.OBC_0x316.OBC_HardwareSts, system-signal=OBC_HardwareSts
        data-element=CPT_APPCOM_SWC.CPT_MCU_Composition.OBC_0x316.OBC_DCCurr, system-signal=OBC_DCCurr
        data-element=CPT_APPCOM_SWC.CPT_MCU_Composition.OBC_0x316.OBC_ACVolt, system-signal=OBC_ACVolt
        data-element=CPT_APPCOM_SWC.CPT_MCU_Composition.OBC_0x316.OBC_ACCurr, system-signal=OBC_ACCurr
        data-element=CPT_APPCOM_SWC.CPT_MCU_Composition.OBC_0x316.OBC_CCConnectSts, system-signal=OBC_CCConnectSts
        data-element=CPT_APPCOM_SWC.CPT_MCU_Composition.OBC_0x316.OBC_CPDutyCycleFault, system-signal=OBC_CPDutyCycleFault
        data-element=CPT_APPCOM_SWC.CPT_MCU_Composition.OBC_0x316.OBC_CPDutyCycleValue, system-signal=OBC_CPDutyCycleValue
        data-element=CPT_APPCOM_SWC.CPT_MCU_Composition.OBC_0x316.OBC_ACMaxPower, system-signal=OBC_ACMaxPower
        data-element=CPT_APPCOM_SWC.CPT_MCU_Composition.OBC_0x316.OBC_ACPowerState, system-signal=OBC_ACPowerState
        data-element=CPT_APPCOM_SWC.CPT_MCU_Composition.LMC_0xFA.LMC_CRC_FA, system-signal=LMC_CRC_FA
        data-element=CPT_APPCOM_SWC.CPT_MCU_Composition.LMC_0xFA.LMC_RollingCounter_FA, system-signal=LMC_RollingCounter_FA
        data-element=CPT_APPCOM_SWC.CPT_MCU_Composition.LMC_0xFA.LMC_EngTorqDec_Main, system-signal=LMC_EngTorqDec_Main
        data-element=CPT_APPCOM_SWC.CPT_MCU_Composition.LMC_0xFA.LMC_EngTorqDecActive_Main, system-signal=LMC_EngTorqDecActive_Main
        data-element=CPT_APPCOM_SWC.CPT_MCU_Composition.LMC_0xFA.LMC_AMM_St, system-signal=LMC_AMM_St
        data-element=CPT_APPCOM_SWC.CPT_MCU_Composition.LMC_0xFA.LMC_EngTorqInc_Main, system-signal=LMC_EngTorqInc_Main
        data-element=CPT_APPCOM_SWC.CPT_MCU_Composition.LMC_0xFA.LMC_EngTorqIncActive_Main, system-signal=LMC_EngTorqIncActive_Main
        data-element=CPT_APPCOM_SWC.CPT_MCU_Composition.LMC_0xFA.LMC_EngTorqDec_Sub, system-signal=LMC_EngTorqDec_Sub
        data-element=CPT_APPCOM_SWC.CPT_MCU_Composition.LMC_0xFA.LMC_EngTorqDecActive_Sub, system-signal=LMC_EngTorqDecActive_Sub
        data-element=CPT_APPCOM_SWC.CPT_MCU_Composition.LMC_0xFA.LMC_EngTorqInc_Sub, system-signal=LMC_EngTorqInc_Sub
        data-element=CPT_APPCOM_SWC.CPT_MCU_Composition.LMC_0xFA.LMC_EngTorqIncActive_Sub, system-signal=LMC_EngTorqIncActive_Sub
        data-element=CPT_APPCOM_SWC.CPT_MCU_Composition.LMC_0x18C.LMC_CRC_18C, system-signal=LMC_CRC_18C
        data-element=CPT_APPCOM_SWC.CPT_MCU_Composition.LMC_0x18C.LMC_RollingCounter_18C, system-signal=LMC_RollingCounter_18C
        data-element=CPT_APPCOM_SWC.CPT_MCU_Composition.LMC_0x18C.LMC_TqTotalBrakeTorque, system-signal=LMC_TqTotalBrakeTorque
        data-element=CPT_APPCOM_SWC.CPT_MCU_Composition.LMC_0x18C.LMC_TqTotalBrakeTorque_Valid, system-signal=LMC_TqTotalBrakeTorque_Valid
        data-element=CPT_APPCOM_SWC.CPT_MCU_Composition.LMC_0x18C.LMC_CmpUTurnLockwhists, system-signal=LMC_CmpUTurnLockwhists
        data-element=CPT_APPCOM_SWC.CPT_MCU_Composition.HPCGW_0x3B1.GW_CRC_3B1, system-signal=GW_CRC_3B1
        data-element=CPT_APPCOM_SWC.CPT_MCU_Composition.HPCGW_0x3B1.GW_RollingCounter_3B1, system-signal=GW_RollingCounter_3B1
        data-element=CPT_APPCOM_SWC.CPT_MCU_Composition.HPCGW_0x3B1.GW_ACU_FLSeatBeltRSt, system-signal=GW_ACU_FLSeatBeltRSt
        data-element=CPT_APPCOM_SWC.CPT_MCU_Composition.HPCGW_0x3B1.GW_ACU_FRSeatBeltRSt, system-signal=GW_ACU_FRSeatBeltRSt
        data-element=CPT_APPCOM_SWC.CPT_MCU_Composition.HPCGW_0x3B1.GW_IBC_EPB_Status, system-signal=GW_IBC_EPB_Status
        data-element=CPT_APPCOM_SWC.CPT_MCU_Composition.HPCGW_0x3B1.GW_ACU_TotalCrashOutputSts, system-signal=GW_ACU_TotalCrashOutputSts
        data-element=CPT_APPCOM_SWC.CPT_MCU_Composition.HPCGW_0x3B1.GW_BZCU_DCChgExitTemp_Pos, system-signal=GW_BZCU_DCChgExitTemp_Pos
        data-element=CPT_APPCOM_SWC.CPT_MCU_Composition.HPCGW_0x3B1.GW_BZCU_DCChgExitTemp_Neg, system-signal=GW_BZCU_DCChgExitTemp_Neg
        data-element=CPT_APPCOM_SWC.CPT_MCU_Composition.HPCGW_0x3B1.GW_BZCU_ACChgExitTemp_Pos, system-signal=GW_BZCU_ACChgExitTemp_Pos
        data-element=CPT_APPCOM_SWC.CPT_MCU_Composition.HPCGW_0x3B1.GW_BZCU_FuelTankSts, system-signal=GW_BZCU_FuelTankSts
        data-element=CPT_APPCOM_SWC.CPT_MCU_Composition.HPCGW_0x3B1.GW_BZCU_LBMS_VoltA, system-signal=GW_BZCU_LBMS_VoltA
        data-element=CPT_APPCOM_SWC.CPT_MCU_Composition.HPCGW_0x3B1.GW_BZCU_ACChgExitTemp_Neg, system-signal=GW_BZCU_ACChgExitTemp_Neg
        data-element=CPT_APPCOM_SWC.CPT_MCU_Composition.HPCGW_0x3B1.GW_BZCU_FuelTankStsLockSts, system-signal=GW_BZCU_FuelTankStsLockSts
        data-element=CPT_APPCOM_SWC.CPT_MCU_Composition.HPCGW_0x3B1.GW_BZCU_FuelTankLockCtrl, system-signal=GW_BZCU_FuelTankLockCtrl
        data-element=CPT_APPCOM_SWC.CPT_MCU_Composition.HPCGW_0x3B1.GW_BZCU_ACChgLockSts, system-signal=GW_BZCU_ACChgLockSts
        data-element=CPT_APPCOM_SWC.CPT_MCU_Composition.HPCGW_0x3B1.GW_RZCU_Cabin_220Vconnect_Sts, system-signal=GW_RZCU_Cabin_220Vconnect_Sts
        data-element=CPT_APPCOM_SWC.CPT_MCU_Composition.HPCGW_0x3B1.GW_BZCU_Cab_220VRelay_CtrlSts, system-signal=GW_BZCU_Cab_220VRelay_CtrlSts
        data-element=CPT_APPCOM_SWC.CPT_MCU_Composition.HPCGW_0x3B1.GW_BZCU_Cab_PDU220VRelay_CtrlSts, system-signal=GW_BZCU_Cab_PDU220VRelay_CtrlSts
        data-element=CPT_APPCOM_SWC.CPT_MCU_Composition.HPCGW_0x3B1.GW_BZCU_Cabin_220VRelay_CtrlSts, system-signal=GW_BZCU_Cabin_220VRelay_CtrlSts
        data-element=CPT_APPCOM_SWC.CPT_MCU_Composition.HPCGW_0x3B1.GW_BZCU_Cab_220Vconnect_Sts, system-signal=GW_BZCU_Cab_220Vconnect_Sts
        data-element=CPT_APPCOM_SWC.CPT_MCU_Composition.HPCGW_0x3B1.GW_TBOXSOC_Altitude, system-signal=GW_TBOXSOC_Altitude
        data-element=CPT_APPCOM_SWC.CPT_MCU_Composition.VCU_0x359.VCU_EolCfg_ESC, system-signal=VCU_EolCfg_ESC
        data-element=CPT_APPCOM_SWC.CPT_MCU_Composition.VCU_0x359.VCU_IMMOKeyWriteCnt, system-signal=VCU_IMMOKeyWriteCnt
        data-element=CPT_APPCOM_SWC.CPT_MCU_Composition.VCU_0x359.VCU_AbStartupFlag, system-signal=VCU_AbStartupFlag
        data-element=CPT_APPCOM_SWC.CPT_MCU_Composition.VCU_0x359.VCU_AbResetFlag, system-signal=VCU_AbResetFlag
        data-element=CPT_APPCOM_SWC.CPT_MCU_Composition.VCU_0x359.VCU_AbResetlnitFinish, system-signal=VCU_AbResetlnitFinish
        data-element=CPT_APPCOM_SWC.CPT_MCU_Composition.VCU_0x359.VCU_EolCfg_EPB, system-signal=VCU_EolCfg_EPB
        data-element=CPT_APPCOM_SWC.CPT_MCU_Composition.VCU_0x359.VCU_EolCfg_AEB, system-signal=VCU_EolCfg_AEB
        data-element=CPT_APPCOM_SWC.CPT_MCU_Composition.VCU_0x359.VCU_EolCfg_InverterFunc, system-signal=VCU_EolCfg_InverterFunc
        data-element=CPT_APPCOM_SWC.CPT_MCU_Composition.VCU_0x359.VCU_EolCfg_APS, system-signal=VCU_EolCfg_APS
        data-element=CPT_APPCOM_SWC.CPT_MCU_Composition.VCU_0x359.VCU_EolCfg_VehiModels, system-signal=VCU_EolCfg_VehiModels
        data-element=CPT_APPCOM_SWC.CPT_MCU_Composition.VCU_0x359.VCU_EolCfg_SpdLmtVal, system-signal=VCU_EolCfg_SpdLmtVal
        data-element=CPT_APPCOM_SWC.CPT_MCU_Composition.VCU_0x359.VCU_EolCfg_WheelType, system-signal=VCU_EolCfg_WheelType
        data-element=CPT_APPCOM_SWC.CPT_MCU_Composition.VCU_0x359.VCU_EolCfg_Curise, system-signal=VCU_EolCfg_Curise
        data-element=CPT_APPCOM_SWC.CPT_MCU_Composition.VCU_0x359.VCU_REStartReq, system-signal=VCU_REStartReq
        data-element=CPT_APPCOM_SWC.CPT_MCU_Composition.VCU_0x359.VCU_REStopReq, system-signal=VCU_REStopReq
        data-element=CPT_APPCOM_SWC.CPT_MCU_Composition.VCU_0x359.VCU_EolCfg_VehiType, system-signal=VCU_EolCfg_VehiType
        data-element=CPT_APPCOM_SWC.CPT_MCU_Composition.VCU_0x359.VCU_EolCfg_MotPwr, system-signal=VCU_EolCfg_MotPwr
        data-element=CPT_APPCOM_SWC.CPT_MCU_Composition.VCU_0x359.VCU_Vehicle_NVHPwrLimitVal, system-signal=VCU_Vehicle_NVHPwrLimitVal
        data-element=CPT_APPCOM_SWC.CPT_MCU_Composition.VCU_0x359.VCU_EolCfg_MotDrvStructure, system-signal=VCU_EolCfg_MotDrvStructure
        data-element=CPT_APPCOM_SWC.CPT_MCU_Composition.VCU_0x359.VCU_WLTCModeFlag, system-signal=VCU_WLTCModeFlag
        data-element=CPT_APPCOM_SWC.CPT_MCU_Composition.VCU_0x359.VCU_EolCfg_RudderDir, system-signal=VCU_EolCfg_RudderDir
        data-element=CPT_APPCOM_SWC.CPT_MCU_Composition.VCU_0x359.VCU_EolCfg_DCChgRelayPos, system-signal=VCU_EolCfg_DCChgRelayPos
        data-element=CPT_APPCOM_SWC.CPT_MCU_Composition.VCU_0x359.VCU_EolCfg_FPTCIL, system-signal=VCU_EolCfg_FPTCIL
        data-element=CPT_APPCOM_SWC.CPT_MCU_Composition.VCU_0x359.VCU_PWakeupSt, system-signal=VCU_PWakeupSt
        data-element=CPT_APPCOM_SWC.CPT_MCU_Composition.VCU_0x359.VCU_SpdLimitReason, system-signal=VCU_SpdLimitReason
        data-element=CPT_APPCOM_SWC.CPT_MCU_Composition.VCU_0x359.BSW_VertifySts, system-signal=BSW_VertifySts
        data-element=CPT_APPCOM_SWC.CPT_MCU_Composition.VCU_0x359.VCU_InterAllowEngStart, system-signal=VCU_InterAllowEngStart
        data-element=CPT_APPCOM_SWC.CPT_MCU_Composition.VCU_0x359.VCU_EngineOff_Flag, system-signal=VCU_EngineOff_Flag
        data-element=CPT_APPCOM_SWC.CPT_MCU_Composition.VCU_0x359.VCU_EngineStopAllow, system-signal=VCU_EngineStopAllow
        data-element=CPT_APPCOM_SWC.CPT_MCU_Composition.VCU_0x359.VCU_EmergencyStopReq, system-signal=VCU_EmergencyStopReq
        data-element=CPT_APPCOM_SWC.CPT_MCU_Composition.VCU_0x359.VCU_EngineAllowStop, system-signal=VCU_EngineAllowStop
        data-element=CPT_APPCOM_SWC.CPT_MCU_Composition.VCU_0x359.VCU_REVehiWheelTrqReq, system-signal=VCU_REVehiWheelTrqReq
        data-element=CPT_APPCOM_SWC.CPT_MCU_Composition.VCU_0x359.VCU_REHighPerformVehiPwr, system-signal=VCU_REHighPerformVehiPwr
        data-element=CPT_APPCOM_SWC.CPT_MCU_Composition.VCU_0x359.VCU_REPwrDampingFactor, system-signal=VCU_REPwrDampingFactor
        data-element=CPT_APPCOM_SWC.CPT_MCU_Composition.VCU_0x359.VCU_REDrvTarPwrFit, system-signal=VCU_REDrvTarPwrFit
        data-element=CPT_APPCOM_SWC.CPT_MCU_Composition.VCU_0x359.VCU_AdditionalPwrVal, system-signal=VCU_AdditionalPwrVal
        data-element=CPT_APPCOM_SWC.CPT_MCU_Composition.VCU_0x359.VCU_VehichRealPwDown, system-signal=VCU_VehichRealPwDown
        data-element=CPT_APPCOM_SWC.CPT_MCU_Composition.VCU_0x359.VCU_IMMOStsResult, system-signal=VCU_IMMOStsResult
        data-element=CPT_APPCOM_SWC.CPT_MCU_Composition.VCU_0x359.VCU_IMMOStateMachine, system-signal=VCU_IMMOStateMachine
        data-element=CPT_APPCOM_SWC.CPT_MCU_Composition.VCU_0x359.VCU_ShowCarModeNvmResult, system-signal=VCU_ShowCarModeNvmResult
        data-element=CPT_APPCOM_SWC.CPT_MCU_Composition.VCU_0x359.VCU_DeliveryModeNvmData, system-signal=VCU_DeliveryModeNvmData
        data-element=CPT_APPCOM_SWC.CPT_MCU_Composition.VCU_0x359.VCU_AccPedFaultLvNvmResult, system-signal=VCU_AccPedFaultLvNvmResult
        data-element=CPT_APPCOM_SWC.CPT_MCU_Composition.VCU_0x359.VCU_VehicleConfigNvmResult, system-signal=VCU_VehicleConfigNvmResult
        data-element=CPT_APPCOM_SWC.CPT_MCU_Composition.VCU_0x359.VCU_EngRunTimeNvmResult, system-signal=VCU_EngRunTimeNvmResult
        data-element=CPT_APPCOM_SWC.CPT_MCU_Composition.VCU_0x514.VCU_FuelConsumption, system-signal=VCU_FuelConsumption
        data-element=CPT_APPCOM_SWC.CPT_MCU_Composition.VCU_0x514.VCU_SVSLamp, system-signal=VCU_SVSLamp
        data-element=CPT_APPCOM_SWC.CPT_MCU_Composition.VCU_0x514.VCU_MilLamp, system-signal=VCU_MilLamp
        data-element=CPT_APPCOM_SWC.CPT_MCU_Composition.VCU_0x514.VCU_SinglePedalSts_ID514, system-signal=VCU_SinglePedalSts_ID514
        data-element=CPT_APPCOM_SWC.CPT_MCU_Composition.VCU_0x514.VCU_GearLevelPosFault_ID514, system-signal=VCU_GearLevelPosFault_ID514
        data-element=CPT_APPCOM_SWC.CPT_MCU_Composition.VCU_0x514.VCU_EngineStartFailure_ID514, system-signal=VCU_EngineStartFailure_ID514
        data-element=CPT_APPCOM_SWC.CPT_MCU_Composition.VCU_0x514.VCU_ParkBeforeFuelup, system-signal=VCU_ParkBeforeFuelup
        data-element=CPT_APPCOM_SWC.CPT_MCU_Composition.VCU_0x514.VCU_REsystemFaultSts_ID514, system-signal=VCU_REsystemFaultSts_ID514
        data-element=CPT_APPCOM_SWC.CPT_MCU_Composition.VCU_0x514.VCU_EngineRunAllowFlg_ID514, system-signal=VCU_EngineRunAllowFlg_ID514
        data-element=CPT_APPCOM_SWC.CPT_MCU_Composition.VCU_0x514.VCU_InverterTip, system-signal=VCU_InverterTip
        data-element=CPT_APPCOM_SWC.CPT_MCU_Composition.VCU_0x514.VCU_EMSRepairModeSts, system-signal=VCU_EMSRepairModeSts
        data-element=CPT_APPCOM_SWC.CPT_MCU_Composition.VCU_0x514.VCU_FuelTankFlapSts, system-signal=VCU_FuelTankFlapSts
        data-element=CPT_APPCOM_SWC.CPT_MCU_Composition.VCU_0x514.VCU_REsystemSts_ID514, system-signal=VCU_REsystemSts_ID514
        data-element=CPT_APPCOM_SWC.CPT_MCU_Composition.VCU_0x514.VCU_PowerModeAllow, system-signal=VCU_PowerModeAllow
        data-element=CPT_APPCOM_SWC.CPT_MCU_Composition.VCU_0x514.VCU_PowerModeSwitchMsg, system-signal=VCU_PowerModeSwitchMsg
        data-element=CPT_APPCOM_SWC.CPT_MCU_Composition.VCU_0x514.VCU_HighVoltFailed_M, system-signal=VCU_HighVoltFailed_M
        data-element=CPT_APPCOM_SWC.CPT_MCU_Composition.VCU_0x514.VCU_HighVoltFailed_S, system-signal=VCU_HighVoltFailed_S
        data-element=CPT_APPCOM_SWC.CPT_MCU_Composition.VCU_0x514.VCU_BrakeBeforeGear, system-signal=VCU_BrakeBeforeGear
        data-element=CPT_APPCOM_SWC.CPT_MCU_Composition.VCU_0x514.VCU_ParkBeforeGear, system-signal=VCU_ParkBeforeGear
        data-element=CPT_APPCOM_SWC.CPT_MCU_Composition.VCU_0x514.VCU_GearBeforDriving, system-signal=VCU_GearBeforDriving
        data-element=CPT_APPCOM_SWC.CPT_MCU_Composition.VCU_0x514.VCU_UnlockBeforeDriving, system-signal=VCU_UnlockBeforeDriving
        data-element=CPT_APPCOM_SWC.CPT_MCU_Composition.VCU_0x514.VCU_PreventSliding, system-signal=VCU_PreventSliding
        data-element=CPT_APPCOM_SWC.CPT_MCU_Composition.VCU_0x514.VCU_MMErrorSts, system-signal=VCU_MMErrorSts
        data-element=CPT_APPCOM_SWC.CPT_MCU_Composition.VCU_0x514.VCU_ShowCarModeSts, system-signal=VCU_ShowCarModeSts
        data-element=CPT_APPCOM_SWC.CPT_MCU_Composition.VCU_0x514.VCU_PGearFlashSts, system-signal=VCU_PGearFlashSts
        data-element=CPT_APPCOM_SWC.CPT_MCU_Composition.VCU_0x514.VCU_ACConnectSts, system-signal=VCU_ACConnectSts
        data-element=CPT_APPCOM_SWC.CPT_MCU_Composition.VCU_0x514.VCU_DcChgPwrSts, system-signal=VCU_DcChgPwrSts
        data-element=CPT_APPCOM_SWC.CPT_MCU_Composition.VCU_0x514.VCU_DriverAssistProhibitSts_ID514, system-signal=VCU_DriverAssistProhibitSts_ID514
        data-element=CPT_APPCOM_SWC.CPT_MCU_Composition.VCU_0x514.VCU_MilLampRequest_ID514, system-signal=VCU_MilLampRequest_ID514
        data-element=CPT_APPCOM_SWC.CPT_MCU_Composition.VCU_0x514.VCU_CcmHvilInSigFreq_FB, system-signal=VCU_CcmHvilInSigFreq_FB
        data-element=CPT_APPCOM_SWC.CPT_MCU_Composition.VCU_0x514.VCU_CcmHvilInSigDuty_FB, system-signal=VCU_CcmHvilInSigDuty_FB
        data-element=CPT_APPCOM_SWC.CPT_MCU_Composition.VCU_0x514.VCU_FuelDectionModeSts, system-signal=VCU_FuelDectionModeSts
        data-element=CPT_APPCOM_SWC.CPT_MCU_Composition.VCU_0x514.VCU_EnergyCtrlMode, system-signal=VCU_EnergyCtrlMode
        data-element=CPT_APPCOM_SWC.CPT_MCU_Composition.VCU_0x514.VCU_VehSpdLimtRemind_ID514, system-signal=VCU_VehSpdLimtRemind_ID514
        data-element=CPT_APPCOM_SWC.CPT_MCU_Composition.VCU_0x514.VCU_TurtleLamp, system-signal=VCU_TurtleLamp
        data-element=CPT_APPCOM_SWC.CPT_MCU_Composition.HPCGW_0x13A.GW_CRC_13A, system-signal=GW_CRC_13A
        data-element=CPT_APPCOM_SWC.CPT_MCU_Composition.HPCGW_0x13A.GW_RollingCounter_13A, system-signal=GW_RollingCounter_13A
        data-element=CPT_APPCOM_SWC.CPT_MCU_Composition.HPCGW_0x13A.GW_IBC_VehicleSpeed, system-signal=GW_IBC_VehicleSpeed
        data-element=CPT_APPCOM_SWC.CPT_MCU_Composition.HPCGW_0x13A.GW_IBC_VehicleSpeedVD, system-signal=GW_IBC_VehicleSpeedVD
        data-element=CPT_APPCOM_SWC.CPT_MCU_Composition.HPCGW_0x13A.GW_IBC_AVHStatus, system-signal=GW_IBC_AVHStatus
        data-element=CPT_APPCOM_SWC.CPT_MCU_Composition.HPCGW_0x13A.GW_IBC_RAB_Avatiable, system-signal=GW_IBC_RAB_Avatiable
        data-element=CPT_APPCOM_SWC.CPT_MCU_Composition.HPCGW_0x13A.GW_IBC_RAB_Active, system-signal=GW_IBC_RAB_Active
        data-element=CPT_APPCOM_SWC.CPT_MCU_Composition.HPCGW_0x13A.GW_IBC_FLWheelSpeedKPH, system-signal=GW_IBC_FLWheelSpeedKPH
        data-element=CPT_APPCOM_SWC.CPT_MCU_Composition.HPCGW_0x13A.GW_IBC_FRWheelSpeedKPH, system-signal=GW_IBC_FRWheelSpeedKPH
        data-element=CPT_APPCOM_SWC.CPT_MCU_Composition.HPCGW_0x13A.GW_IBC_RLWheelSpeedKPH, system-signal=GW_IBC_RLWheelSpeedKPH
        data-element=CPT_APPCOM_SWC.CPT_MCU_Composition.HPCGW_0x13A.GW_IBC_RRWheelSpeedKPH, system-signal=GW_IBC_RRWheelSpeedKPH
        data-element=CPT_APPCOM_SWC.CPT_MCU_Composition.HPCGW_0x13A.GW_IBC_FLWheelDirection, system-signal=GW_IBC_FLWheelDirection
        data-element=CPT_APPCOM_SWC.CPT_MCU_Composition.HPCGW_0x13A.GW_IBC_FRWheelDirection, system-signal=GW_IBC_FRWheelDirection
        data-element=CPT_APPCOM_SWC.CPT_MCU_Composition.HPCGW_0x13A.GW_IBC_RLWheelDirection, system-signal=GW_IBC_RLWheelDirection
        data-element=CPT_APPCOM_SWC.CPT_MCU_Composition.HPCGW_0x13A.GW_IBC_RRWheelDirection, system-signal=GW_IBC_RRWheelDirection
        data-element=CPT_APPCOM_SWC.CPT_MCU_Composition.HPCGW_0x13A.GW_IBC_FLWheelSpeedVD, system-signal=GW_IBC_FLWheelSpeedVD
        data-element=CPT_APPCOM_SWC.CPT_MCU_Composition.HPCGW_0x13A.GW_IBC_FRWheelSpeedVD, system-signal=GW_IBC_FRWheelSpeedVD
        data-element=CPT_APPCOM_SWC.CPT_MCU_Composition.HPCGW_0x13A.GW_IBC_RLWheelSpeedVD, system-signal=GW_IBC_RLWheelSpeedVD
        data-element=CPT_APPCOM_SWC.CPT_MCU_Composition.HPCGW_0x13A.GW_IBC_RRWheelSpeedVD, system-signal=GW_IBC_RRWheelSpeedVD
        data-element=CPT_APPCOM_SWC.CPT_MCU_Composition.HPCGW_0x13A.GW_IBC_PlungerPressure_Q, system-signal=GW_IBC_PlungerPressure_Q
        data-element=CPT_APPCOM_SWC.CPT_MCU_Composition.HPCGW_0x13A.GW_IBC_PlungerPressure, system-signal=GW_IBC_PlungerPressure
        data-element=CPT_APPCOM_SWC.CPT_MCU_Composition.CCM_0x36A.CCM_Volt, system-signal=CCM_Volt
        data-element=CPT_APPCOM_SWC.CPT_MCU_Composition.CCM_0x36A.CCM_RollingCounter_36A, system-signal=CCM_RollingCounter_36A
        data-element=CPT_APPCOM_SWC.CPT_MCU_Composition.CCM_0x36A.CCM_BaseState, system-signal=CCM_BaseState
        data-element=CPT_APPCOM_SWC.CPT_MCU_Composition.CCM_0x36A.CCM_Power, system-signal=CCM_Power
        data-element=CPT_APPCOM_SWC.CPT_MCU_Composition.CCM_0x36A.CCM_APTC_BscSts, system-signal=CCM_APTC_BscSts
        data-element=CPT_APPCOM_SWC.CPT_MCU_Composition.CCM_0x36A.CCM_APTC_Power, system-signal=CCM_APTC_Power
        data-element=CPT_APPCOM_SWC.CPT_MCU_Composition.IBC_0x227.IBC_CRC_227, system-signal=IBC_CRC_227
        data-element=CPT_APPCOM_SWC.CPT_MCU_Composition.IBC_0x227.IBC_RollingCounter_227, system-signal=IBC_RollingCounter_227
        data-element=CPT_APPCOM_SWC.CPT_MCU_Composition.IBC_0x227.IBC_EPB_FailStatus, system-signal=IBC_EPB_FailStatus
        data-element=CPT_APPCOM_SWC.CPT_MCU_Composition.IBC_0x227.IBC_EPB_Status, system-signal=IBC_EPB_Status
        data-element=CPT_APPCOM_SWC.CPT_MCU_Composition.IBC_0x227.IBC_EPB_DrumMode, system-signal=IBC_EPB_DrumMode
        data-element=CPT_APPCOM_SWC.CPT_MCU_Composition.IBC_0x227.IBC_EPB_AchievedClampForce, system-signal=IBC_EPB_AchievedClampForce
        data-element=CPT_APPCOM_SWC.CPT_MCU_Composition.IBC_0x227.IBC_EPB_FailureLamp, system-signal=IBC_EPB_FailureLamp
        data-element=CPT_APPCOM_SWC.CPT_MCU_Composition.IBC_0x227.IBC_EPB_ActuatorStateLeft, system-signal=IBC_EPB_ActuatorStateLeft
        data-element=CPT_APPCOM_SWC.CPT_MCU_Composition.IBC_0x227.IBC_EPB_ActuatorStateRight, system-signal=IBC_EPB_ActuatorStateRight
        data-element=CPT_APPCOM_SWC.CPT_MCU_Composition.IBC_0x227.IBC_EPB_HostAvailabilityLeft, system-signal=IBC_EPB_HostAvailabilityLeft
        data-element=CPT_APPCOM_SWC.CPT_MCU_Composition.IBC_0x227.IBC_EPB_HostAvailabilityRight, system-signal=IBC_EPB_HostAvailabilityRight
        data-element=CPT_APPCOM_SWC.CPT_MCU_Composition.MCU_0x5C8.Harness_igbt_temp{1..3}, system-signal=Harness_igbt_temp{1..3}
        data-element=CPT_APPCOM_SWC.CPT_MCU_Composition.MCU_0x5C8.Harness_CoolWaterTemp, system-signal=Harness_CoolWaterTemp
        data-element=CPT_APPCOM_SWC.CPT_MCU_Composition.MCU_0x5C8.Harness_V_DC, system-signal=Harness_V_DC
        data-element=CPT_APPCOM_SWC.CPT_MCU_Composition.MCU_0x5C8.Harness_PWM_DIR, system-signal=Harness_PWM_DIR
        data-element=CPT_APPCOM_SWC.CPT_MCU_Composition.MCU_0x5C8.Harness_HVIL_State, system-signal=Harness_HVIL_State
        data-element=CPT_APPCOM_SWC.CPT_MCU_Composition.MCU_0x5C8.Harness_crash_err_flag, system-signal=Harness_crash_err_flag
        data-element=CPT_APPCOM_SWC.CPT_MCU_Composition.MCU_0x5C8.Harness_KeyON, system-signal=Harness_KeyON
        data-element=CPT_APPCOM_SWC.CPT_MCU_Composition.MCU_0x5C8.Harness_HWRdc, system-signal=Harness_HWRdc
        data-element=CPT_APPCOM_SWC.CPT_MCU_Composition.MCU_0x5C8.Harness_HWFoT, system-signal=Harness_HWFoT
        data-element=CPT_APPCOM_SWC.CPT_MCU_Composition.MCU_0x5C8.Harness_HWVoltLower, system-signal=Harness_HWVoltLower
        data-element=CPT_APPCOM_SWC.CPT_MCU_Composition.MCU_0x5C8.Harness_HWFoB, system-signal=Harness_HWFoB
        data-element=CPT_APPCOM_SWC.CPT_MCU_Composition.MCU_0x5C8.Harness_MotorTemp1, system-signal=Harness_MotorTemp1
        data-element=CPT_APPCOM_SWC.CPT_MCU_Composition.MCU_0x5C8.Harness_MotorTemp2, system-signal=Harness_MotorTemp2
        data-element=CPT_APPCOM_SWC.CPT_MCU_Composition.MCU_0x5C8.Harness_I_U, system-signal=Harness_I_U
        data-element=CPT_APPCOM_SWC.CPT_MCU_Composition.MCU_0x5C8.Harness_I_W, system-signal=Harness_I_W
        data-element=CPT_APPCOM_SWC.CPT_MCU_Composition.MCU_0x5C8.Harness_I_V, system-signal=Harness_I_V
        data-element=CPT_APPCOM_SWC.CPT_MCU_Composition.MCU_0x5C8.Harness_HVRelayPosVolt, system-signal=Harness_HVRelayPosVolt
        data-element=CPT_APPCOM_SWC.CPT_MCU_Composition.MCU_0x5C8.MCUMR_Harness_igbt_temp{1..3}, system-signal=MCUMR_Harness_igbt_temp{1..3}
        data-element=CPT_APPCOM_SWC.CPT_MCU_Composition.MCU_0x5C8.MCUMR_Harness_CoolWaterTemp, system-signal=MCUMR_Harness_CoolWaterTemp
        data-element=CPT_APPCOM_SWC.CPT_MCU_Composition.MCU_0x5C8.MCUMR_Harness_V_DC, system-signal=MCUMR_Harness_V_DC
        data-element=CPT_APPCOM_SWC.CPT_MCU_Composition.MCU_0x5C8.MCUMR_Harness_PWM_DIR, system-signal=MCUMR_Harness_PWM_DIR
        data-element=CPT_APPCOM_SWC.CPT_MCU_Composition.MCU_0x5C8.MCUMR_Harness_HWRdc, system-signal=MCUMR_Harness_HWRdc
        data-element=CPT_APPCOM_SWC.CPT_MCU_Composition.MCU_0x5C8.MCUMR_Harness_HWFoT, system-signal=MCUMR_Harness_HWFoT
        data-element=CPT_APPCOM_SWC.CPT_MCU_Composition.MCU_0x5C8.MCUMR_Harness_HWVoltLower, system-signal=MCUMR_Harness_HWVoltLower
        data-element=CPT_APPCOM_SWC.CPT_MCU_Composition.MCU_0x5C8.MCUMR_Harness_HWFoB, system-signal=MCUMR_Harness_HWFoB
        data-element=CPT_APPCOM_SWC.CPT_MCU_Composition.MCU_0x5C8.MCUMR_Harness_MotorTemp1, system-signal=MCUMR_Harness_MotorTemp1
        data-element=CPT_APPCOM_SWC.CPT_MCU_Composition.MCU_0x5C8.MCUMR_Harness_MotorTemp2, system-signal=MCUMR_Harness_MotorTemp2
        data-element=CPT_APPCOM_SWC.CPT_MCU_Composition.MCU_0x5C8.MCUMR_Harness_I_U, system-signal=MCUMR_Harness_I_U
        data-element=CPT_APPCOM_SWC.CPT_MCU_Composition.MCU_0x5C8.MCUMR_Harness_I_W, system-signal=MCUMR_Harness_I_W
        data-element=CPT_APPCOM_SWC.CPT_MCU_Composition.MCU_0x5C8.MCUMR_Harness_I_V, system-signal=MCUMR_Harness_I_V
        data-element=CPT_APPCOM_SWC.CPT_MCU_Composition.HPCBCM_0x290.BCM_CRC_290, system-signal=BCM_CRC_290
        data-element=CPT_APPCOM_SWC.CPT_MCU_Composition.HPCBCM_0x290.BCM_RRDoorSts_ID290_CCAN, system-signal=BCM_RRDoorSts_ID290_CCAN
        data-element=CPT_APPCOM_SWC.CPT_MCU_Composition.HPCBCM_0x290.BCM_RLDoorSts_ID290_CCAN, system-signal=BCM_RLDoorSts_ID290_CCAN
        data-element=CPT_APPCOM_SWC.CPT_MCU_Composition.HPCBCM_0x290.BCM_RollingCounter_290, system-signal=BCM_RollingCounter_290
        data-element=CPT_APPCOM_SWC.CPT_MCU_Composition.HPCBCM_0x290.BCM_HazardSwtSts, system-signal=BCM_HazardSwtSts
        data-element=CPT_APPCOM_SWC.CPT_MCU_Composition.HPCBCM_0x290.BCM_DrOC_PPD_Status, system-signal=BCM_DrOC_PPD_Status
        data-element=CPT_APPCOM_SWC.CPT_MCU_Composition.HPCBCM_0x290.BCM_FLOC_PPD_Status, system-signal=BCM_FLOC_PPD_Status
        data-element=CPT_APPCOM_SWC.CPT_MCU_Composition.HPCBCM_0x290.BCM_FROC_PPD_Status, system-signal=BCM_FROC_PPD_Status
        data-element=CPT_APPCOM_SWC.CPT_MCU_Composition.HPCBCM_0x290.BCM_DriverDoorSts_ID290_CCAN, system-signal=BCM_DriverDoorSts_ID290_CCAN
        data-element=CPT_APPCOM_SWC.CPT_MCU_Composition.HPCBCM_0x290.BCM_DriverDoorSts_VD, system-signal=BCM_DriverDoorSts_VD
        data-element=CPT_APPCOM_SWC.CPT_MCU_Composition.HPCBCM_0x290.BCM_FLDoorSts_ID290_CCAN, system-signal=BCM_FLDoorSts_ID290_CCAN
        data-element=CPT_APPCOM_SWC.CPT_MCU_Composition.HPCBCM_0x290.BCM_FRDoorSts_ID290_CCAN, system-signal=BCM_FRDoorSts_ID290_CCAN
        data-element=CPT_APPCOM_SWC.CPT_MCU_Composition.HPCBCM_0x290.BCM_BackDoorSts_ID290_CCAN, system-signal=BCM_BackDoorSts_ID290_CCAN
        data-element=CPT_APPCOM_SWC.CPT_MCU_Composition.HPCBCM_0x290.BCM_FrontCoverSts, system-signal=BCM_FrontCoverSts
        data-element=CPT_APPCOM_SWC.CPT_MCU_Composition.HPCBCM_0x290.BCM_HazardSwtOpenSts, system-signal=BCM_HazardSwtOpenSts
        data-element=CPT_APPCOM_SWC.CPT_MCU_Composition.HPCBCM_0x290.BCM_BrakeFluidLevel, system-signal=BCM_BrakeFluidLevel
        data-element=CPT_APPCOM_SWC.CPT_MCU_Composition.HPCBCM_0x290.BCM_ON2BRelaySts_ID290_CCAN, system-signal=BCM_ON2BRelaySts_ID290_CCAN
        data-element=CPT_APPCOM_SWC.CPT_MCU_Composition.HPCBCM_0x290.BCM_ON2CRelaySts_ID290_CCAN, system-signal=BCM_ON2CRelaySts_ID290_CCAN
        data-element=CPT_APPCOM_SWC.CPT_MCU_Composition.HPCBCM_0x290.BCM_AlarmMode_C, system-signal=BCM_AlarmMode_C
        data-element=CPT_APPCOM_SWC.CPT_MCU_Composition.VCU_0x13.VCU_CRC_13, system-signal=VCU_CRC_13
        data-element=CPT_APPCOM_SWC.CPT_MCU_Composition.VCU_0x13.VCU_RollingCounter_13, system-signal=VCU_RollingCounter_13
        data-element=CPT_APPCOM_SWC.CPT_MCU_Composition.VCU_0x13.VCU_SDrvRequestTorque_prvt, system-signal=VCU_SDrvRequestTorque_prvt
        data-element=CPT_APPCOM_SWC.CPT_MCU_Composition.VCU_0x13.VCU_SDrvRequestTorqueVD_prvt, system-signal=VCU_SDrvRequestTorqueVD_prvt
        data-element=CPT_APPCOM_SWC.CPT_MCU_Composition.VCU_0x13.VCU_MCUSDampgLmtFactor_prvt, system-signal=VCU_MCUSDampgLmtFactor_prvt
        data-element=CPT_APPCOM_SWC.CPT_MCU_Composition.VCU_0x13.VCU_VehicleDirectS_prvt, system-signal=VCU_VehicleDirectS_prvt
        data-element=CPT_APPCOM_SWC.CPT_MCU_Composition.VCU_0x13.VCU_VehicleDirectS_VD_prvt, system-signal=VCU_VehicleDirectS_VD_prvt
        data-element=CPT_APPCOM_SWC.CPT_MCU_Composition.VCU_0x13.VCU_MCUSMaxPosDampgTrq_prvt, system-signal=VCU_MCUSMaxPosDampgTrq_prvt
        data-element=CPT_APPCOM_SWC.CPT_MCU_Composition.VCU_0x13.VCU_MCUSMaxNegDampgTrq_prvt, system-signal=VCU_MCUSMaxNegDampgTrq_prvt
        data-element=CPT_APPCOM_SWC.CPT_MCU_Composition.VCU_0x1.EOL_CRC_13B, system-signal=EOL_CRC_13B
        data-element=CPT_APPCOM_SWC.CPT_MCU_Composition.VCU_0x1.EOL_RollingCounter_13B, system-signal=EOL_RollingCounter_13B
        data-element=CPT_APPCOM_SWC.CPT_MCU_Composition.VCU_0x1.EOL_VehicleSts, system-signal=EOL_VehicleSts
        data-element=CPT_APPCOM_SWC.CPT_MCU_Composition.VCU_0x1.EOL_GearLevelPosSts, system-signal=EOL_GearLevelPosSts
        data-element=CPT_APPCOM_SWC.CPT_MCU_Composition.VCU_0x1.EOL_GearLeverValid, system-signal=EOL_GearLeverValid
        data-element=CPT_APPCOM_SWC.CPT_MCU_Composition.VCU_0x1.EOL_AccPedalValid, system-signal=EOL_AccPedalValid
        data-element=CPT_APPCOM_SWC.CPT_MCU_Composition.VCU_0x1.EOL_ThrottlePosition, system-signal=EOL_ThrottlePosition
        data-element=CPT_APPCOM_SWC.CPT_MCU_Composition.VCU_0x1.EOL_RMCUActiveReleaseCmd, system-signal=EOL_RMCUActiveReleaseCmd
        data-element=CPT_APPCOM_SWC.CPT_MCU_Composition.VCU_0x1.EOL_VehicleDirect, system-signal=EOL_VehicleDirect
        data-element=CPT_APPCOM_SWC.CPT_MCU_Composition.VCU_0x1.EOL_SuppressJitterRMCURequest, system-signal=EOL_SuppressJitterRMCURequest
        data-element=CPT_APPCOM_SWC.CPT_MCU_Composition.VCU_0x1.EOL_RDrvControlMode, system-signal=EOL_RDrvControlMode
        data-element=CPT_APPCOM_SWC.CPT_MCU_Composition.VCU_0x1.EOL_BrakePedalValue, system-signal=EOL_BrakePedalValue
        data-element=CPT_APPCOM_SWC.CPT_MCU_Composition.VCU_0x1.EOL_RMCUMaxDischargePower, system-signal=EOL_RMCUMaxDischargePower
        data-element=CPT_APPCOM_SWC.CPT_MCU_Composition.VCU_0x1.EOL_RMCUMaxChargePower, system-signal=EOL_RMCUMaxChargePower
        data-element=CPT_APPCOM_SWC.CPT_MCU_Composition.VCU_0x1.EOL_RDrvRequestTorque, system-signal=EOL_RDrvRequestTorque
        data-element=CPT_APPCOM_SWC.CPT_MCU_Composition.VCU_0x1.EOL_RDrvRequesSpeed, system-signal=EOL_RDrvRequesSpeed
        data-element=CPT_APPCOM_SWC.CPT_MCU_Composition.VCU_0x1.EOL_FDrvRequestTorque, system-signal=EOL_FDrvRequestTorque
        data-element=CPT_APPCOM_SWC.CPT_MCU_Composition.VCU_0x1.EOL_FDrvRequesSpeed, system-signal=EOL_FDrvRequesSpeed
        data-element=CPT_APPCOM_SWC.CPT_MCU_Composition.VCU_0x1.EOL_FVehicleSts, system-signal=EOL_FVehicleSts
        data-element=CPT_APPCOM_SWC.CPT_MCU_Composition.VCU_0x1.EOL_FDrvControlMode, system-signal=EOL_FDrvControlMode
        data-element=CPT_APPCOM_SWC.CPT_MCU_Composition.VCU_0x1.EOL_ON2BRelayReq, system-signal=EOL_ON2BRelayReq
        data-element=CPT_APPCOM_SWC.CPT_MCU_Composition.VCU_0x1.EOL_VehicleDirectVD, system-signal=EOL_VehicleDirectVD
        data-element=CPT_APPCOM_SWC.CPT_MCU_Composition.VCU_0x1.EOL_RDrvControlModeVD, system-signal=EOL_RDrvControlModeVD
        data-element=CPT_APPCOM_SWC.CPT_MCU_Composition.VCU_0x1.EOL_RDrvRequestTorqueVD, system-signal=EOL_RDrvRequestTorqueVD
        data-element=CPT_APPCOM_SWC.CPT_MCU_Composition.VCU_0x1.EOL_RDrvRequesSpeedVD, system-signal=EOL_RDrvRequesSpeedVD
        data-element=CPT_APPCOM_SWC.CPT_MCU_Composition.VCU_0x1.EOL_FDrvRequestTorqueVD, system-signal=EOL_FDrvRequestTorqueVD
        data-element=CPT_APPCOM_SWC.CPT_MCU_Composition.VCU_0x1.EOL_FDrvRequesSpeedVD, system-signal=EOL_FDrvRequesSpeedVD
        data-element=CPT_APPCOM_SWC.CPT_MCU_Composition.VCU_0x1.EOL_FDrvControlModeVD, system-signal=EOL_FDrvControlModeVD
        data-element=CPT_APPCOM_SWC.CPT_MCU_Composition.VCU_0x1.EOL_MCUMDampgLmtFactor, system-signal=EOL_MCUMDampgLmtFactor
        data-element=CPT_APPCOM_SWC.CPT_MCU_Composition.VCU_0x1.EOL_VCU_BoostMode_Fail, system-signal=EOL_VCU_BoostMode_Fail
        data-element=CPT_APPCOM_SWC.CPT_MCU_Composition.VCU_0x1.EOL_VCU_BoostModeSts, system-signal=EOL_VCU_BoostModeSts
        data-element=CPT_APPCOM_SWC.CPT_MCU_Composition.VCU_0x1.EOL_MCUMMaxPosDampgTrq, system-signal=EOL_MCUMMaxPosDampgTrq
        data-element=CPT_APPCOM_SWC.CPT_MCU_Composition.VCU_0x1.EOL_MCUMMaxNegDampgTrq, system-signal=EOL_MCUMMaxNegDampgTrq
        data-element=CPT_APPCOM_SWC.CPT_MCU_Composition.TMS_0x5FE.TMS_MilLampReq, system-signal=TMS_MilLampReq
        data-element=CPT_APPCOM_SWC.CPT_MCU_Composition.EMS_0xBE.EMS_CRC_BE, system-signal=EMS_CRC_BE
        data-element=CPT_APPCOM_SWC.CPT_MCU_Composition.EMS_0xBE.EMS_RollingCounter_BE, system-signal=EMS_RollingCounter_BE
        data-element=CPT_APPCOM_SWC.CPT_MCU_Composition.EMS_0xBE.EMS_EngineSts, system-signal=EMS_EngineSts
        data-element=CPT_APPCOM_SWC.CPT_MCU_Composition.EMS_0xBE.ECM_FaultLevel, system-signal=ECM_FaultLevel
        data-element=CPT_APPCOM_SWC.CPT_MCU_Composition.EMS_0xBE.ECM_ActualEngineTorqueValid, system-signal=ECM_ActualEngineTorqueValid
        data-element=CPT_APPCOM_SWC.CPT_MCU_Composition.EMS_0xBE.ECM_EngineTorqueLoss, system-signal=ECM_EngineTorqueLoss
        data-element=CPT_APPCOM_SWC.CPT_MCU_Composition.EMS_0xBE.ECM_ActualEngineTorque, system-signal=ECM_ActualEngineTorque
        data-element=CPT_APPCOM_SWC.CPT_MCU_Composition.EMS_0xBE.ECM_EngineTorqueMax, system-signal=ECM_EngineTorqueMax
        data-element=CPT_APPCOM_SWC.CPT_MCU_Composition.EMS_0xBE.ECM_EngineTorqueMin, system-signal=ECM_EngineTorqueMin
        data-element=CPT_APPCOM_SWC.CPT_MCU_Composition.EMS_0xBE.ECM_EngineSpeed, system-signal=ECM_EngineSpeed
        data-element=CPT_APPCOM_SWC.CPT_MCU_Composition.EMS_0xBE.ECM_EngineSpeedValid, system-signal=ECM_EngineSpeedValid
        data-element=CPT_APPCOM_SWC.CPT_MCU_Composition.EMS_0xBE.ECM_EngineStopAllow, system-signal=ECM_EngineStopAllow
        data-element=CPT_APPCOM_SWC.CPT_MCU_Composition.EMS_0xBE.ECM_EngineOilPressureLow, system-signal=ECM_EngineOilPressureLow
        data-element=CPT_APPCOM_SWC.CPT_MCU_Composition.EMS_0xBE.ECM_EngineFuleCutoffSts, system-signal=ECM_EngineFuleCutoffSts
        data-element=CPT_APPCOM_SWC.CPT_MCU_Composition.EMS_0xBE.ECM_EngineStartedCompleted, system-signal=ECM_EngineStartedCompleted
        data-element=CPT_APPCOM_SWC.CPT_MCU_Composition.EMS_0xBE.ECM_CatalystWarmUpSts, system-signal=ECM_CatalystWarmUpSts
        data-element=CPT_APPCOM_SWC.CPT_MCU_Composition.EMS_0xBE.ECM_CatalystWarmUpReq, system-signal=ECM_CatalystWarmUpReq
        data-element=CPT_APPCOM_SWC.CPT_MCU_Composition.EMS_0xBE.ECM_IdleTargetSpeed, system-signal=ECM_IdleTargetSpeed
        data-element=CPT_APPCOM_SWC.CPT_MCU_Composition.EMS_0xBE.ECM_IdleActive, system-signal=ECM_IdleActive
        data-element=CPT_APPCOM_SWC.CPT_MCU_Composition.EMS_0xBE.ECM_EngineStartReq, system-signal=ECM_EngineStartReq
        data-element=CPT_APPCOM_SWC.CPT_MCU_Composition.EMS_0xBE.ECM_EngineStopInhibit, system-signal=ECM_EngineStopInhibit
        data-element=CPT_APPCOM_SWC.CPT_MCU_Composition.EMS_0xBE.ECM_GPFRegenlamp, system-signal=ECM_GPFRegenlamp
        data-element=CPT_APPCOM_SWC.CPT_MCU_Composition.EMS_0xBE.ECM_EngineCoolantTemp, system-signal=ECM_EngineCoolantTemp
        data-element=CPT_APPCOM_SWC.CPT_MCU_Composition.EMS_0xBE.ECM_EngineCoolantTempValid, system-signal=ECM_EngineCoolantTempValid
        data-element=CPT_APPCOM_SWC.CPT_MCU_Composition.EMS_0xBE.ECM_FVVSts, system-signal=ECM_FVVSts
        data-element=CPT_APPCOM_SWC.CPT_MCU_Composition.EMS_0xBE.ECM_learningReq, system-signal=ECM_learningReq
        data-element=CPT_APPCOM_SWC.CPT_MCU_Composition.EMS_0xBE.ECM_EngineIdleStateRequest, system-signal=ECM_EngineIdleStateRequest
        data-element=CPT_APPCOM_SWC.CPT_MCU_Composition.EMS_0xBE.ECM_EngineDFCOConditionRequest, system-signal=ECM_EngineDFCOConditionRequest
        data-element=CPT_APPCOM_SWC.CPT_MCU_Composition.EMS_0xBE.ECM_GPFRegenReq, system-signal=ECM_GPFRegenReq
        data-element=CPT_APPCOM_SWC.CPT_MCU_Composition.EMS_0xBE.ECM_SVSLampRequest, system-signal=ECM_SVSLampRequest
        data-element=CPT_APPCOM_SWC.CPT_MCU_Composition.EMS_0xBE.ECM_TankPressure, system-signal=ECM_TankPressure
        data-element=CPT_APPCOM_SWC.CPT_MCU_Composition.EMS_0xBE.ECM_TankPressureValid, system-signal=ECM_TankPressureValid
        data-element=CPT_APPCOM_SWC.CPT_MCU_Composition.EMS_0xBE.ECM_MilLampRequest, system-signal=ECM_MilLampRequest
        data-element=CPT_APPCOM_SWC.CPT_MCU_Composition.EMS_0xBE.ECM_ToothlearningSucValid, system-signal=ECM_ToothlearningSucValid
        data-element=CPT_APPCOM_SWC.CPT_MCU_Composition.EMS_0xBE.ECM_FuelCloseLoopSts, system-signal=ECM_FuelCloseLoopSts
        data-element=CPT_APPCOM_SWC.CPT_MCU_Composition.EMS_0xBE.ECM_RestrictorOpenValue, system-signal=ECM_RestrictorOpenValue
        data-element=CPT_APPCOM_SWC.CPT_MCU_Composition.EMS_0xBE.ECM_FuelLevelSensorValid, system-signal=ECM_FuelLevelSensorValid
        data-element=CPT_APPCOM_SWC.CPT_MCU_Composition.EMS_0xBE.ECM_FuelLevel, system-signal=ECM_FuelLevel
        data-element=CPT_APPCOM_SWC.CPT_MCU_Composition.EMS_0xBE.ECM_SelfCheckSt, system-signal=ECM_SelfCheckSt
        data-element=CPT_APPCOM_SWC.CPT_MCU_Composition.EMS_0xBE.ECM_PCVPipeDiagReq, system-signal=ECM_PCVPipeDiagReq
        data-element=CPT_APPCOM_SWC.CPT_MCU_Composition.EMS_0xBE.ECM_CalculatedLoad, system-signal=ECM_CalculatedLoad
        data-element=CPT_APPCOM_SWC.CPT_MCU_Composition.EMS_0xBE.ECM_AirPressure, system-signal=ECM_AirPressure
        data-element=CPT_APPCOM_SWC.CPT_MCU_Composition.EMS_0xBE.ECM_FanSts, system-signal=ECM_FanSts
        data-element=CPT_APPCOM_SWC.CPT_MCU_Composition.EPS_0x18D.EPS_CRC_18D, system-signal=EPS_CRC_18D
        data-element=CPT_APPCOM_SWC.CPT_MCU_Composition.EPS_0x18D.EPS_RollingCounter_18D, system-signal=EPS_RollingCounter_18D
        data-element=CPT_APPCOM_SWC.CPT_MCU_Composition.EPS_0x18D.EPS_Fault, system-signal=EPS_Fault
        data-element=CPT_APPCOM_SWC.CPT_MCU_Composition.EPS_0x18D.EPS_CalibrationSts, system-signal=EPS_CalibrationSts
        data-element=CPT_APPCOM_SWC.CPT_MCU_Composition.EPS_0x18D.EPS_FailureSts, system-signal=EPS_FailureSts
        data-element=CPT_APPCOM_SWC.CPT_MCU_Composition.EPS_0x18D.EPS_SteeringAngleValidData, system-signal=EPS_SteeringAngleValidData
        data-element=CPT_APPCOM_SWC.CPT_MCU_Composition.EPS_0x18D.EPS_SteeringAngleSpeedValidData, system-signal=EPS_SteeringAngleSpeedValidData
        data-element=CPT_APPCOM_SWC.CPT_MCU_Composition.EPS_0x18D.EPS_SteerWheelAngle, system-signal=EPS_SteerWheelAngle
        data-element=CPT_APPCOM_SWC.CPT_MCU_Composition.EPS_0x18D.EPS_SteerWheelRotSpd, system-signal=EPS_SteerWheelRotSpd
        data-element=CPT_APPCOM_SWC.CPT_MCU_Composition.EPS_0x18D.EPS_SelfCheckSt, system-signal=EPS_SelfCheckSt
        data-element=CPT_APPCOM_SWC.CPT_MCU_Composition.EPS_0x18D.EPS_AssistanceSts, system-signal=EPS_AssistanceSts
        data-element=CPT_APPCOM_SWC.CPT_MCU_Composition.GCU_0xBD.GCU_CRC_BD, system-signal=GCU_CRC_BD
        data-element=CPT_APPCOM_SWC.CPT_MCU_Composition.GCU_0xBD.GCU_EngineCylinderDeactivationStatus, system-signal=GCU_EngineCylinderDeactivationStatus
        data-element=CPT_APPCOM_SWC.CPT_MCU_Composition.GCU_0xBD.GCU_EngineFuelInhibitReq, system-signal=GCU_EngineFuelInhibitReq
        data-element=CPT_APPCOM_SWC.CPT_MCU_Composition.GCU_0xBD.GCU_RollingCounter_BD, system-signal=GCU_RollingCounter_BD
        data-element=CPT_APPCOM_SWC.CPT_MCU_Composition.GCU_0xBD.GCU_MainWireCurr, system-signal=GCU_MainWireCurr
        data-element=CPT_APPCOM_SWC.CPT_MCU_Composition.GCU_0xBD.GCU_MainWireVolt, system-signal=GCU_MainWireVolt
        data-element=CPT_APPCOM_SWC.CPT_MCU_Composition.GCU_0xBD.GCU_SystemWarning, system-signal=GCU_SystemWarning
        data-element=CPT_APPCOM_SWC.CPT_MCU_Composition.GCU_0xBD.GCU_MILlampReq, system-signal=GCU_MILlampReq
        data-element=CPT_APPCOM_SWC.CPT_MCU_Composition.GCU_0xBD.GCU_MoterTemp, system-signal=GCU_MoterTemp
        data-element=CPT_APPCOM_SWC.CPT_MCU_Composition.GCU_0xBD.GCU_Temp, system-signal=GCU_Temp
        data-element=CPT_APPCOM_SWC.CPT_MCU_Composition.GCU_0xBD.GCU_SelfCheck, system-signal=GCU_SelfCheck
        data-element=CPT_APPCOM_SWC.CPT_MCU_Composition.GCU_0xBD.GCU_Warning_Level, system-signal=GCU_Warning_Level
        data-element=CPT_APPCOM_SWC.CPT_MCU_Composition.GCU_0xBD.GCU_HVILSts, system-signal=GCU_HVILSts
        data-element=CPT_APPCOM_SWC.CPT_MCU_Composition.GCU_0xBD.GCU__PowerReduceSts, system-signal=GCU__PowerReduceSts
        data-element=CPT_APPCOM_SWC.CPT_MCU_Composition.GCU_0xBD.GCU_ActualMotorRPM_VD, system-signal=GCU_ActualMotorRPM_VD
        data-element=CPT_APPCOM_SWC.CPT_MCU_Composition.GCU_0xBD.GCU_ActualMotorTorque_VD, system-signal=GCU_ActualMotorTorque_VD
        data-element=CPT_APPCOM_SWC.CPT_MCU_Composition.GCU_0xBD.GCU_ActualMotorTorque, system-signal=GCU_ActualMotorTorque
        data-element=CPT_APPCOM_SWC.CPT_MCU_Composition.GCU_0xBD.GCU_MaxTorque, system-signal=GCU_MaxTorque
        data-element=CPT_APPCOM_SWC.CPT_MCU_Composition.GCU_0xBD.GCU_ActiveReleaseFB, system-signal=GCU_ActiveReleaseFB
        data-element=CPT_APPCOM_SWC.CPT_MCU_Composition.GCU_0xBD.GCU_MAXPower, system-signal=GCU_MAXPower
        data-element=CPT_APPCOM_SWC.CPT_MCU_Composition.GCU_0xBD.GCU_TransientPower, system-signal=GCU_TransientPower
        data-element=CPT_APPCOM_SWC.CPT_MCU_Composition.GCU_0xBD.GCU_HVOffReq, system-signal=GCU_HVOffReq
        data-element=CPT_APPCOM_SWC.CPT_MCU_Composition.GCU_0xBD.GCU_ControlMode, system-signal=GCU_ControlMode
        data-element=CPT_APPCOM_SWC.CPT_MCU_Composition.GCU_0xBD.GCU_Operating_Mode, system-signal=GCU_Operating_Mode
        data-element=CPT_APPCOM_SWC.CPT_MCU_Composition.GCU_0xBD.GCU_ActualMotorRPM, system-signal=GCU_ActualMotorRPM
        data-element=CPT_APPCOM_SWC.CPT_MCU_Composition.BMS_0x5B5.BMS_WkupVolt_DC12V, system-signal=BMS_WkupVolt_DC12V
        data-element=CPT_APPCOM_SWC.CPT_MCU_Composition.BMS_0x5B5.BMS_WkupVolt_AC12V, system-signal=BMS_WkupVolt_AC12V
        data-element=CPT_APPCOM_SWC.CPT_MCU_Composition.BMS_0x5B5.BMS_HVPackPosRelayExternalVolt, system-signal=BMS_HVPackPosRelayExternalVolt
        data-element=CPT_APPCOM_SWC.CPT_MCU_Composition.BMS_0x5B5.BMS_SOC_target, system-signal=BMS_SOC_target
        data-element=CPT_APPCOM_SWC.CPT_MCU_Composition.BMS_0x5B5.BMS_CorrectSOEPer, system-signal=BMS_CorrectSOEPer
        data-element=CPT_APPCOM_SWC.CPT_MCU_Composition.BMS_0x5B5.BMS_SOCModifyFlag, system-signal=BMS_SOCModifyFlag
        data-element=CPT_APPCOM_SWC.CPT_MCU_Composition.BMS_0x5B5.BMS_BMU_SoftwareVersion, system-signal=BMS_BMU_SoftwareVersion
        data-element=CPT_APPCOM_SWC.CPT_MCU_Composition.VCU_0xBC.VCU_VehicleSpdDirect, system-signal=VCU_VehicleSpdDirect
        data-element=CPT_APPCOM_SWC.CPT_MCU_Composition.VCU_0xBC.VCU_ADM_ActualMode, system-signal=VCU_ADM_ActualMode
        data-element=CPT_APPCOM_SWC.CPT_MCU_Composition.VCU_0xBC.VCU_ADM_MainMode, system-signal=VCU_ADM_MainMode
        data-element=CPT_APPCOM_SWC.CPT_MCU_Composition.VCU_0xBC.VCU_DeliveryModeSts, system-signal=VCU_DeliveryModeSts
        data-element=CPT_APPCOM_SWC.CPT_MCU_Composition.VCU_0xBC.VCU_VehSpdLimtRemind, system-signal=VCU_VehSpdLimtRemind
        data-element=CPT_APPCOM_SWC.CPT_MCU_Composition.VCU_0xBC.VCU_SinglePedalSts, system-signal=VCU_SinglePedalSts
        data-element=CPT_APPCOM_SWC.CPT_MCU_Composition.VCU_0xBC.VCU_GearLvrChangeSts, system-signal=VCU_GearLvrChangeSts
        data-element=CPT_APPCOM_SWC.CPT_MCU_Composition.VCU_0xBC.VCU_HighVoltSysSts, system-signal=VCU_HighVoltSysSts
        data-element=CPT_APPCOM_SWC.CPT_MCU_Composition.VCU_0xBC.VCU_ChrgDischrgFunSts, system-signal=VCU_ChrgDischrgFunSts
        data-element=CPT_APPCOM_SWC.CPT_MCU_Composition.VCU_0xBC.VCU_CalibrationVersion, system-signal=VCU_CalibrationVersion
        data-element=CPT_APPCOM_SWC.CPT_MCU_Composition.VCU_0xBC.VCU_CalibrationNumber, system-signal=VCU_CalibrationNumber
        data-element=CPT_APPCOM_SWC.CPT_MCU_Composition.VCU_0xBC.VCU_VehicleNegTrqRspdSts, system-signal=VCU_VehicleNegTrqRspdSts
        data-element=CPT_APPCOM_SWC.CPT_MCU_Composition.VCU_0xBC.VCU_SlopeEst, system-signal=VCU_SlopeEst
        data-element=CPT_APPCOM_SWC.CPT_MCU_Composition.VCU_0xBC.VCU_SlopeEst_Valid, system-signal=VCU_SlopeEst_Valid
        data-element=CPT_APPCOM_SWC.CPT_MCU_Composition.VCU_0xBC.VCU_WheelTrqType, system-signal=VCU_WheelTrqType
        data-element=CPT_APPCOM_SWC.CPT_MCU_Composition.VCU_0xBC.VCU_DriverAssistProhibitSts, system-signal=VCU_DriverAssistProhibitSts
        data-element=CPT_APPCOM_SWC.CPT_MCU_Composition.VCU_0xBC.VCU_VacumRlySts, system-signal=VCU_VacumRlySts
        data-element=CPT_APPCOM_SWC.CPT_MCU_Composition.VCU_0xBC.VCU_DriveSHVILSts, system-signal=VCU_DriveSHVILSts
        data-element=CPT_APPCOM_SWC.CPT_MCU_Composition.VCU_0xBC.VCU_DriveMHVILSts, system-signal=VCU_DriveMHVILSts
        data-element=CPT_APPCOM_SWC.CPT_MCU_Composition.VCU_0xBC.VCU_DCChgHVILSts, system-signal=VCU_DCChgHVILSts
        data-element=CPT_APPCOM_SWC.CPT_MCU_Composition.VCU_0xBC.VCU_ACChgHVILSts, system-signal=VCU_ACChgHVILSts
        data-element=CPT_APPCOM_SWC.CPT_MCU_Composition.VCU_0xBC.VCU_CCMHVILSts, system-signal=VCU_CCMHVILSts
        data-element=CPT_APPCOM_SWC.CPT_MCU_Composition.VCU_0xBC.VCU_SystemError, system-signal=VCU_SystemError
        data-element=CPT_APPCOM_SWC.CPT_MCU_Composition.VCU_0xBC.VCU_AccPedalFaultLV, system-signal=VCU_AccPedalFaultLV
        data-element=CPT_APPCOM_SWC.CPT_MCU_Composition.VCU_0xBC.VCU_HVILSysSts, system-signal=VCU_HVILSysSts
        data-element=CPT_APPCOM_SWC.CPT_MCU_Composition.VCU_0xBC.VCU_VacuumDegree, system-signal=VCU_VacuumDegree
        data-element=CPT_APPCOM_SWC.CPT_MCU_Composition.VCU_0xBC.VCU_LPedalModeSts, system-signal=VCU_LPedalModeSts
        data-element=CPT_APPCOM_SWC.CPT_MCU_Composition.VCU_0xBC.VCU_LVSystemError, system-signal=VCU_LVSystemError
        data-element=CPT_APPCOM_SWC.CPT_MCU_Composition.VCU_0xBC.VCU_HVSystemError, system-signal=VCU_HVSystemError
        data-element=CPT_APPCOM_SWC.CPT_MCU_Composition.VCU_0xBC.VCU_OpeartingMode, system-signal=VCU_OpeartingMode
        data-element=CPT_APPCOM_SWC.CPT_MCU_Composition.VCU_0xBC.VCU_EnergyMode, system-signal=VCU_EnergyMode
        data-element=CPT_APPCOM_SWC.CPT_MCU_Composition.VCU_0xBC.VCU_GearLevelPosFault, system-signal=VCU_GearLevelPosFault
        data-element=CPT_APPCOM_SWC.CPT_MCU_Composition.VCU_0xBC.VCU_BrakeSwitchSts, system-signal=VCU_BrakeSwitchSts
        data-element=CPT_APPCOM_SWC.CPT_MCU_Composition.VCU_0xBC.VCU_SpdLimModeSts, system-signal=VCU_SpdLimModeSts
        data-element=CPT_APPCOM_SWC.CPT_MCU_Composition.VCU_0xBC.VCU_TrqDstrbutnPrio, system-signal=VCU_TrqDstrbutnPrio
        data-element=CPT_APPCOM_SWC.CPT_MCU_Composition.VCU_0xBC.VCU_TrqDstrbutnTransferSts, system-signal=VCU_TrqDstrbutnTransferSts
        data-element=CPT_APPCOM_SWC.CPT_MCU_Composition.VCU_0xBC.VCU_MCUMDiffProtectSts, system-signal=VCU_MCUMDiffProtectSts
        data-element=CPT_APPCOM_SWC.CPT_MCU_Composition.VCU_0xBC.VCU_MCUSDiffProtectSts, system-signal=VCU_MCUSDiffProtectSts
        data-element=CPT_APPCOM_SWC.CPT_MCU_Composition.ICU_0x332.ICU_CRC_332, system-signal=ICU_CRC_332
        data-element=CPT_APPCOM_SWC.CPT_MCU_Composition.ICU_0x332.ICU_RollingCounter_332, system-signal=ICU_RollingCounter_332
        data-element=CPT_APPCOM_SWC.CPT_MCU_Composition.ICU_0x332.ICU_AEB_SW, system-signal=ICU_AEB_SW
        data-element=CPT_APPCOM_SWC.CPT_MCU_Composition.ICU_0x332.ICU_ISA_controlSW, system-signal=ICU_ISA_controlSW
        data-element=CPT_APPCOM_SWC.CPT_MCU_Composition.ICU_0x332.ICU_SLIF_SW, system-signal=ICU_SLIF_SW
        data-element=CPT_APPCOM_SWC.CPT_MCU_Composition.ICU_0x332.ICU_SLWF_SW, system-signal=ICU_SLWF_SW
        data-element=CPT_APPCOM_SWC.CPT_MCU_Composition.TMS_0x5A2.TMS_MainMotPumpSpdResp, system-signal=TMS_MainMotPumpSpdResp
        data-element=CPT_APPCOM_SWC.CPT_MCU_Composition.TMS_0x5A2.TMS_MainMotPump_Operation_Temp, system-signal=TMS_MainMotPump_Operation_Temp
        data-element=CPT_APPCOM_SWC.CPT_MCU_Composition.TMS_0x5A2.TMS_MainMotPump_Operation_Current, system-signal=TMS_MainMotPump_Operation_Current
        data-element=CPT_APPCOM_SWC.CPT_MCU_Composition.TMS_0x5A2.TMS_MainMotPump_Supplied_Voltage, system-signal=TMS_MainMotPump_Supplied_Voltage
        data-element=CPT_APPCOM_SWC.CPT_MCU_Composition.TMS_0x5A2.TMS_MainMotPumpErrSts, system-signal=TMS_MainMotPumpErrSts
        data-element=CPT_APPCOM_SWC.CPT_MCU_Composition.IBC_0x184.IBC_CRC_184, system-signal=IBC_CRC_184
        data-element=CPT_APPCOM_SWC.CPT_MCU_Composition.IBC_0x184.IBC_RollingCounter_184, system-signal=IBC_RollingCounter_184
        data-element=CPT_APPCOM_SWC.CPT_MCU_Composition.IBC_0x184.IBC_FLWheelSpeedKPH, system-signal=IBC_FLWheelSpeedKPH
        data-element=CPT_APPCOM_SWC.CPT_MCU_Composition.IBC_0x184.IBC_FRWheelSpeedKPH, system-signal=IBC_FRWheelSpeedKPH
        data-element=CPT_APPCOM_SWC.CPT_MCU_Composition.IBC_0x184.IBC_RLWheelSpeedKPH, system-signal=IBC_RLWheelSpeedKPH
        data-element=CPT_APPCOM_SWC.CPT_MCU_Composition.IBC_0x184.IBC_RRWheelSpeedKPH, system-signal=IBC_RRWheelSpeedKPH
        data-element=CPT_APPCOM_SWC.CPT_MCU_Composition.IBC_0x184.IBC_FLWheelDirection, system-signal=IBC_FLWheelDirection
        data-element=CPT_APPCOM_SWC.CPT_MCU_Composition.IBC_0x184.IBC_FRWheelDirection, system-signal=IBC_FRWheelDirection
        data-element=CPT_APPCOM_SWC.CPT_MCU_Composition.IBC_0x184.IBC_RLWheelDirection, system-signal=IBC_RLWheelDirection
        data-element=CPT_APPCOM_SWC.CPT_MCU_Composition.IBC_0x184.IBC_RRWheelDirection, system-signal=IBC_RRWheelDirection
        data-element=CPT_APPCOM_SWC.CPT_MCU_Composition.IBC_0x184.IBC_FLWheelSpeedVD, system-signal=IBC_FLWheelSpeedVD
        data-element=CPT_APPCOM_SWC.CPT_MCU_Composition.IBC_0x184.IBC_FRWheelSpeedVD, system-signal=IBC_FRWheelSpeedVD
        data-element=CPT_APPCOM_SWC.CPT_MCU_Composition.IBC_0x184.IBC_RLWheelSpeedVD, system-signal=IBC_RLWheelSpeedVD
        data-element=CPT_APPCOM_SWC.CPT_MCU_Composition.IBC_0x184.IBC_RRWheelSpeedVD, system-signal=IBC_RRWheelSpeedVD
        data-element=CPT_APPCOM_SWC.CPT_MCU_Composition.IBC_0x184.IBC_FLWheelSpeedRC, system-signal=IBC_FLWheelSpeedRC
        data-element=CPT_APPCOM_SWC.CPT_MCU_Composition.IBC_0x184.IBC_FRWheelSpeedRC, system-signal=IBC_FRWheelSpeedRC
        data-element=CPT_APPCOM_SWC.CPT_MCU_Composition.IBC_0x184.IBC_RLWheelSpeedRC, system-signal=IBC_RLWheelSpeedRC
        data-element=CPT_APPCOM_SWC.CPT_MCU_Composition.IBC_0x184.IBC_RRWheelSpeedRC, system-signal=IBC_RRWheelSpeedRC
        data-element=CPT_APPCOM_SWC.CPT_MCU_Composition.IBC_0x184.IBC_DiscTemperatureFL, system-signal=IBC_DiscTemperatureFL
        data-element=CPT_APPCOM_SWC.CPT_MCU_Composition.IBC_0x184.IBC_DiscTemperatureFLVD, system-signal=IBC_DiscTemperatureFLVD
        data-element=CPT_APPCOM_SWC.CPT_MCU_Composition.IBC_0x184.IBC_DiscTemperatureFR, system-signal=IBC_DiscTemperatureFR
        data-element=CPT_APPCOM_SWC.CPT_MCU_Composition.IBC_0x184.IBC_DiscTemperatureFRVD, system-signal=IBC_DiscTemperatureFRVD
        data-element=CPT_APPCOM_SWC.CPT_MCU_Composition.IBC_0x184.IBC_DiscTemperatureRL, system-signal=IBC_DiscTemperatureRL
        data-element=CPT_APPCOM_SWC.CPT_MCU_Composition.IBC_0x184.IBC_DiscTemperatureRLVD, system-signal=IBC_DiscTemperatureRLVD
        data-element=CPT_APPCOM_SWC.CPT_MCU_Composition.IBC_0x184.IBC_DiscTemperatureRR, system-signal=IBC_DiscTemperatureRR
        data-element=CPT_APPCOM_SWC.CPT_MCU_Composition.IBC_0x184.IBC_DiscTemperatureRRVD, system-signal=IBC_DiscTemperatureRRVD
        data-element=CPT_APPCOM_SWC.CPT_MCU_Composition.IBC_0x183.IBC_CRC_183, system-signal=IBC_CRC_183
        data-element=CPT_APPCOM_SWC.CPT_MCU_Composition.IBC_0x183.IBC_RollingCounter_183, system-signal=IBC_RollingCounter_183
        data-element=CPT_APPCOM_SWC.CPT_MCU_Composition.IBC_0x183.IBC_RecuBrakeTorqueRequest, system-signal=IBC_RecuBrakeTorqueRequest
        data-element=CPT_APPCOM_SWC.CPT_MCU_Composition.IBC_0x183.IBC_RecuBrakeTorqueRequest_Q, system-signal=IBC_RecuBrakeTorqueRequest_Q
        data-element=CPT_APPCOM_SWC.CPT_MCU_Composition.IBC_0x183.IBC_sOutputRodDriverPer_Q, system-signal=IBC_sOutputRodDriverPer_Q
        data-element=CPT_APPCOM_SWC.CPT_MCU_Composition.IBC_0x183.IBC_BrakePedalApplied_Q, system-signal=IBC_BrakePedalApplied_Q
        data-element=CPT_APPCOM_SWC.CPT_MCU_Composition.IBC_0x183.IBC_HydraTorqTgtAct_Q, system-signal=IBC_HydraTorqTgtAct_Q
        data-element=CPT_APPCOM_SWC.CPT_MCU_Composition.IBC_0x183.IBC_HydraTorqTgtAct, system-signal=IBC_HydraTorqTgtAct
        data-element=CPT_APPCOM_SWC.CPT_MCU_Composition.IBC_0x183.IBC_BrakePedalApplied, system-signal=IBC_BrakePedalApplied
        data-element=CPT_APPCOM_SWC.CPT_MCU_Composition.IBC_0x183.IBC_sOutputRodDriverPer, system-signal=IBC_sOutputRodDriverPer
        data-element=CPT_APPCOM_SWC.CPT_MCU_Composition.IBC_0x183.IBC_HydraTorqAvailable, system-signal=IBC_HydraTorqAvailable
        data-element=CPT_APPCOM_SWC.CPT_MCU_Composition.IBC_0x183.IBC_CtrlMode, system-signal=IBC_CtrlMode
        data-element=CPT_APPCOM_SWC.CPT_MCU_Composition.IBC_0x183.IBC_QDC_HydraTorqTgt, system-signal=IBC_QDC_HydraTorqTgt
        data-element=CPT_APPCOM_SWC.CPT_MCU_Composition.IBC_0x183.IBC_InPutRodDriver, system-signal=IBC_InPutRodDriver
        data-element=CPT_APPCOM_SWC.CPT_MCU_Composition.IBC_0x183.IBC_InPutRodDriver_Q, system-signal=IBC_InPutRodDriver_Q
        data-element=CPT_APPCOM_SWC.CPT_MCU_Composition.IBC_0x183.IBC_SystemAssistedStatus, system-signal=IBC_SystemAssistedStatus
        data-element=CPT_APPCOM_SWC.CPT_MCU_Composition.IBC_0x183.IBC_EngTorq_VLC_Vaild, system-signal=IBC_EngTorq_VLC_Vaild
        data-element=CPT_APPCOM_SWC.CPT_MCU_Composition.IBC_0x183.IBC_EngTorq_VLC, system-signal=IBC_EngTorq_VLC
        data-element=CPT_APPCOM_SWC.CPT_MCU_Composition.IBC_0x183.IBC_BrkTorq_VLC, system-signal=IBC_BrkTorq_VLC
        data-element=CPT_APPCOM_SWC.CPT_MCU_Composition.IBC_0x183.IBC_BrkTorq_VLC_Vaild, system-signal=IBC_BrkTorq_VLC_Vaild
        data-element=CPT_APPCOM_SWC.CPT_MCU_Composition.IBC_0x186.IBC_CRC_186, system-signal=IBC_CRC_186
        data-element=CPT_APPCOM_SWC.CPT_MCU_Composition.IBC_0x186.IBC_RollingCounter_186, system-signal=IBC_RollingCounter_186
        data-element=CPT_APPCOM_SWC.CPT_MCU_Composition.IBC_0x186.IBC_WheelPressureReliabilityFL, system-signal=IBC_WheelPressureReliabilityFL
        data-element=CPT_APPCOM_SWC.CPT_MCU_Composition.IBC_0x186.IBC_WheelPressureReliabilityFR, system-signal=IBC_WheelPressureReliabilityFR
        data-element=CPT_APPCOM_SWC.CPT_MCU_Composition.IBC_0x186.IBC_WheelPressureReliabilityRL, system-signal=IBC_WheelPressureReliabilityRL
        data-element=CPT_APPCOM_SWC.CPT_MCU_Composition.IBC_0x186.IBC_WheelPressureReliabilityRR, system-signal=IBC_WheelPressureReliabilityRR
        data-element=CPT_APPCOM_SWC.CPT_MCU_Composition.IBC_0x186.IBC_WheelCylinderPressure_FL, system-signal=IBC_WheelCylinderPressure_FL
        data-element=CPT_APPCOM_SWC.CPT_MCU_Composition.IBC_0x186.IBC_WheelCylinderPressure_FR, system-signal=IBC_WheelCylinderPressure_FR
        data-element=CPT_APPCOM_SWC.CPT_MCU_Composition.IBC_0x186.IBC_WheelCylinderPressure_RL, system-signal=IBC_WheelCylinderPressure_RL
        data-element=CPT_APPCOM_SWC.CPT_MCU_Composition.IBC_0x186.IBC_WheelCylinderPressure_RR, system-signal=IBC_WheelCylinderPressure_RR
        data-element=CPT_APPCOM_SWC.CPT_MCU_Composition.IBC_0x186.IBC_WheelSlipFLVD, system-signal=IBC_WheelSlipFLVD
        data-element=CPT_APPCOM_SWC.CPT_MCU_Composition.IBC_0x186.IBC_WheelSlipFRVD, system-signal=IBC_WheelSlipFRVD
        data-element=CPT_APPCOM_SWC.CPT_MCU_Composition.IBC_0x186.IBC_WheelSlipRLVD, system-signal=IBC_WheelSlipRLVD
        data-element=CPT_APPCOM_SWC.CPT_MCU_Composition.IBC_0x186.IBC_WheelSlipRRVD, system-signal=IBC_WheelSlipRRVD
        data-element=CPT_APPCOM_SWC.CPT_MCU_Composition.IBC_0x186.IBC_WheelSlipFL, system-signal=IBC_WheelSlipFL
        data-element=CPT_APPCOM_SWC.CPT_MCU_Composition.IBC_0x186.IBC_WheelSlipFR, system-signal=IBC_WheelSlipFR
        data-element=CPT_APPCOM_SWC.CPT_MCU_Composition.IBC_0x186.IBC_WheelSlipRL, system-signal=IBC_WheelSlipRL
        data-element=CPT_APPCOM_SWC.CPT_MCU_Composition.IBC_0x186.IBC_WheelSlipRR, system-signal=IBC_WheelSlipRR
        data-element=CPT_APPCOM_SWC.CPT_MCU_Composition.IBC_0x186.IBC_Slop_Pencent, system-signal=IBC_Slop_Pencent
        data-element=CPT_APPCOM_SWC.CPT_MCU_Composition.PTC_0x367.PTC_BscSts, system-signal=PTC_BscSts
        data-element=CPT_APPCOM_SWC.CPT_MCU_Composition.PTC_0x367.PTC_RollingCounter_367, system-signal=PTC_RollingCounter_367
        data-element=CPT_APPCOM_SWC.CPT_MCU_Composition.PTC_0x367.PTC_Fault, system-signal=PTC_Fault
        data-element=CPT_APPCOM_SWC.CPT_MCU_Composition.PTC_0x367.PTC_Power, system-signal=PTC_Power
        data-element=CPT_APPCOM_SWC.CPT_MCU_Composition.PTC_0x367.PTC_HV_interlock_faultSt, system-signal=PTC_HV_interlock_faultSt
        data-element=CPT_APPCOM_SWC.CPT_MCU_Composition.VCU_0x600.VCU_FaultData{0..31}, system-signal=VCU_FaultData{0..31}
        data-element=CPT_APPCOM_SWC.CPT_MCU_Composition.HPCGW_0x30B.GW_TCM_CRC_30B, system-signal=GW_TCM_CRC_30B
        data-element=CPT_APPCOM_SWC.CPT_MCU_Composition.HPCGW_0x30B.GW_TCM_RollingCounter_30B, system-signal=GW_TCM_RollingCounter_30B
        data-element=CPT_APPCOM_SWC.CPT_MCU_Composition.HPCGW_0x30B.GW_TCM_ParkingSwSts, system-signal=GW_TCM_ParkingSwSts
        data-element=CPT_APPCOM_SWC.CPT_MCU_Composition.HPCGW_0x30B.GW_TCM_STATUS_Park, system-signal=GW_TCM_STATUS_Park
        data-element=CPT_APPCOM_SWC.CPT_MCU_Composition.HPCGW_0x30B.GW_TCM_Counter_Park, system-signal=GW_TCM_Counter_Park
        data-element=CPT_APPCOM_SWC.CPT_MCU_Composition.HPCGW_0x30B.GW_TCM_CRC_Park, system-signal=GW_TCM_CRC_Park
        data-element=CPT_APPCOM_SWC.CPT_MCU_Composition.HPCGW_0x30B.GW_TCM_GearLevelSwitchSts, system-signal=GW_TCM_GearLevelSwitchSts
        data-element=CPT_APPCOM_SWC.CPT_MCU_Composition.HPCGW_0x30B.GW_TCM_STATUS_RND, system-signal=GW_TCM_STATUS_RND
        data-element=CPT_APPCOM_SWC.CPT_MCU_Composition.HPCGW_0x30B.GW_TCM_Counter_RND, system-signal=GW_TCM_Counter_RND
        data-element=CPT_APPCOM_SWC.CPT_MCU_Composition.HPCGW_0x30B.GW_TCM_CRC_RND, system-signal=GW_TCM_CRC_RND
        data-element=CPT_APPCOM_SWC.CPT_MCU_Composition.HPCGW_0x30B.GW_TCM_SelfCheckSt, system-signal=GW_TCM_SelfCheckSt
        data-element=CPT_APPCOM_SWC.CPT_MCU_Composition.VCU_0xB7.VCU_CRC_B7, system-signal=VCU_CRC_B7
        data-element=CPT_APPCOM_SWC.CPT_MCU_Composition.VCU_0xB7.VCU_KeepWorkModeFlag, system-signal=VCU_KeepWorkModeFlag
        data-element=CPT_APPCOM_SWC.CPT_MCU_Composition.VCU_0xB7.VCU_MAI_Active, system-signal=VCU_MAI_Active
        data-element=CPT_APPCOM_SWC.CPT_MCU_Composition.VCU_0xB7.VCU_MAI_Available, system-signal=VCU_MAI_Available
        data-element=CPT_APPCOM_SWC.CPT_MCU_Composition.VCU_0xB7.VCU_GetCrashStsReq, system-signal=VCU_GetCrashStsReq
        data-element=CPT_APPCOM_SWC.CPT_MCU_Composition.VCU_0xB7.VCU_ADASPosTorqueCap_VD, system-signal=VCU_ADASPosTorqueCap_VD
        data-element=CPT_APPCOM_SWC.CPT_MCU_Composition.VCU_0xB7.VCU_ADASPosTorqueCap, system-signal=VCU_ADASPosTorqueCap
        data-element=CPT_APPCOM_SWC.CPT_MCU_Composition.VCU_0xB7.VCU_RollingCounter_B7, system-signal=VCU_RollingCounter_B7
        data-element=CPT_APPCOM_SWC.CPT_MCU_Composition.VCU_0xB7.VCU_Vehicle_Warning_IDB7_CCAN, system-signal=VCU_Vehicle_Warning_IDB7_CCAN
        data-element=CPT_APPCOM_SWC.CPT_MCU_Composition.VCU_0xB7.VCU_VehicleSts_IDB7_CCAN, system-signal=VCU_VehicleSts_IDB7_CCAN
        data-element=CPT_APPCOM_SWC.CPT_MCU_Composition.VCU_0xB7.VCU_PowerReduceReq, system-signal=VCU_PowerReduceReq
        data-element=CPT_APPCOM_SWC.CPT_MCU_Composition.VCU_0xB7.VCU_ParkingReqToEPB_VD, system-signal=VCU_ParkingReqToEPB_VD
        data-element=CPT_APPCOM_SWC.CPT_MCU_Composition.VCU_0xB7.VCU_ParkingReqToEPB, system-signal=VCU_ParkingReqToEPB
        data-element=CPT_APPCOM_SWC.CPT_MCU_Composition.VCU_0xB7.VCU_ACCAvailable, system-signal=VCU_ACCAvailable
        data-element=CPT_APPCOM_SWC.CPT_MCU_Composition.VCU_0xB7.VCU_ACCActiveSts, system-signal=VCU_ACCActiveSts
        data-element=CPT_APPCOM_SWC.CPT_MCU_Composition.VCU_0xB7.VCU_Active_APS, system-signal=VCU_Active_APS
        data-element=CPT_APPCOM_SWC.CPT_MCU_Composition.VCU_0xB7.VCU_Available_APS, system-signal=VCU_Available_APS
        data-element=CPT_APPCOM_SWC.CPT_MCU_Composition.VCU_0xB7.VCU_ESCActive, system-signal=VCU_ESCActive
        data-element=CPT_APPCOM_SWC.CPT_MCU_Composition.VCU_0xB7.VCU_ESCTorqReqAvailability_Rear, system-signal=VCU_ESCTorqReqAvailability_Rear
        data-element=CPT_APPCOM_SWC.CPT_MCU_Composition.VCU_0xB7.VCU_AutoHold_ibit, system-signal=VCU_AutoHold_ibit
        data-element=CPT_APPCOM_SWC.CPT_MCU_Composition.VCU_0xB7.VCU_VehicleSpeedVD, system-signal=VCU_VehicleSpeedVD
        data-element=CPT_APPCOM_SWC.CPT_MCU_Composition.VCU_0xB7.VCU_CCSStatus, system-signal=VCU_CCSStatus
        data-element=CPT_APPCOM_SWC.CPT_MCU_Composition.VCU_0xB7.VCU_AutoDriveRequest, system-signal=VCU_AutoDriveRequest
        data-element=CPT_APPCOM_SWC.CPT_MCU_Composition.VCU_0xB7.VCU_CCSAllow, system-signal=VCU_CCSAllow
        data-element=CPT_APPCOM_SWC.CPT_MCU_Composition.VCU_0xB7.VCU_VlcHoldSts, system-signal=VCU_VlcHoldSts
        data-element=CPT_APPCOM_SWC.CPT_MCU_Composition.VCU_0xB7.VCU_HoldReqSts, system-signal=VCU_HoldReqSts
        data-element=CPT_APPCOM_SWC.CPT_MCU_Composition.VCU_0xB7.VCU_HoldReqStsValid, system-signal=VCU_HoldReqStsValid
        data-element=CPT_APPCOM_SWC.CPT_MCU_Composition.VCU_0xB7.VCU_DriverAssistProhibitSts_IDB7_CCAN, system-signal=VCU_DriverAssistProhibitSts_IDB7_CCAN
        data-element=CPT_APPCOM_SWC.CPT_MCU_Composition.VCU_0xB7.VCU_SpeedLimitedSts, system-signal=VCU_SpeedLimitedSts
        data-element=CPT_APPCOM_SWC.CPT_MCU_Composition.VCU_0xB7.VCU_SpeedLimitedValue, system-signal=VCU_SpeedLimitedValue
        data-element=CPT_APPCOM_SWC.CPT_MCU_Composition.VCU_0xB7.VCU_TheoAccePedalPercent, system-signal=VCU_TheoAccePedalPercent
        data-element=CPT_APPCOM_SWC.CPT_MCU_Composition.VCU_0xB7.VCU_RecuBrakeTorqueCap, system-signal=VCU_RecuBrakeTorqueCap
        data-element=CPT_APPCOM_SWC.CPT_MCU_Composition.VCU_0xB7.VCU_RecuBrakeTorqueAct, system-signal=VCU_RecuBrakeTorqueAct
        data-element=CPT_APPCOM_SWC.CPT_MCU_Composition.VCU_0xB7.VCU_TheoAccePedalValid, system-signal=VCU_TheoAccePedalValid
        data-element=CPT_APPCOM_SWC.CPT_MCU_Composition.VCU_0xB7.VCU_HydraTorqTgt, system-signal=VCU_HydraTorqTgt
        data-element=CPT_APPCOM_SWC.CPT_MCU_Composition.VCU_0xB7.VCU_RecuBrakeTorqueActDrag, system-signal=VCU_RecuBrakeTorqueActDrag
        data-element=CPT_APPCOM_SWC.CPT_MCU_Composition.VCU_0xB7.VCU_ESCTorqReqAvailability_Frnt, system-signal=VCU_ESCTorqReqAvailability_Frnt
        data-element=CPT_APPCOM_SWC.CPT_MCU_Composition.VCU_0xB7.VCU_RecuBrakeTorqueCap_Q, system-signal=VCU_RecuBrakeTorqueCap_Q
        data-element=CPT_APPCOM_SWC.CPT_MCU_Composition.VCU_0xB7.VCU_RecuBrakeTorqueAct_Q, system-signal=VCU_RecuBrakeTorqueAct_Q
        data-element=CPT_APPCOM_SWC.CPT_MCU_Composition.VCU_0xB7.VCU_HydraTorqTgt_Q, system-signal=VCU_HydraTorqTgt_Q
        data-element=CPT_APPCOM_SWC.CPT_MCU_Composition.VCU_0xB7.VCU_RecuBrakeTorqueActDrag_Q, system-signal=VCU_RecuBrakeTorqueActDrag_Q
        data-element=CPT_APPCOM_SWC.CPT_MCU_Composition.VCU_0xB7.VCU_RecuBrakeTorqueTarget_Drag, system-signal=VCU_RecuBrakeTorqueTarget_Drag
        data-element=CPT_APPCOM_SWC.CPT_MCU_Composition.VCU_0xB7.VCU_PreventVehSlipSts, system-signal=VCU_PreventVehSlipSts
        data-element=CPT_APPCOM_SWC.CPT_MCU_Composition.VCU_0xB7.VCU_RecuBrakeTorqueTarget_Drag_Q, system-signal=VCU_RecuBrakeTorqueTarget_Drag_Q
        data-element=CPT_APPCOM_SWC.CPT_MCU_Composition.VCU_0xB7.VCU_AllMotWhlTrqFB, system-signal=VCU_AllMotWhlTrqFB
        data-element=CPT_APPCOM_SWC.CPT_MCU_Composition.VCU_0xB7.VCU_AllMotWhlTrqFB_VD, system-signal=VCU_AllMotWhlTrqFB_VD
        data-element=CPT_APPCOM_SWC.CPT_MCU_Composition.VCU_0xB7.VCU_LSFC_Allow, system-signal=VCU_LSFC_Allow
        data-element=CPT_APPCOM_SWC.CPT_MCU_Composition.VCU_0xB7.VCU_LSFC_Active, system-signal=VCU_LSFC_Active
        data-element=CPT_APPCOM_SWC.CPT_MCU_Composition.VCU_0xB7.VCU_MGCUWorkMode_C, system-signal=VCU_MGCUWorkMode_C
        data-element=CPT_APPCOM_SWC.CPT_MCU_Composition.VCU_0xB7.VCU_AllRoadSts, system-signal=VCU_AllRoadSts
        data-element=CPT_APPCOM_SWC.CPT_MCU_Composition.VCU_0xB7.VCU_CmpUTurnAllow, system-signal=VCU_CmpUTurnAllow
        data-element=CPT_APPCOM_SWC.CPT_MCU_Composition.VCU_0xB7.VCU_CmpUTurnSts, system-signal=VCU_CmpUTurnSts
        data-element=CPT_APPCOM_SWC.CPT_MCU_Composition.VCU_0xB7.VCU_AllowCmpUTurnStartFlag, system-signal=VCU_AllowCmpUTurnStartFlag
        data-element=CPT_APPCOM_SWC.CPT_MCU_Composition.VCU_0xB7.VCU_CmpUTurnLockWhl, system-signal=VCU_CmpUTurnLockWhl
        data-element=CPT_APPCOM_SWC.CPT_MCU_Composition.VCU_0xB7.VCU_CmpUTurnActAngle, system-signal=VCU_CmpUTurnActAngle
        data-element=CPT_APPCOM_SWC.CPT_MCU_Composition.VCU_0xB7.VCU_CmpUTurnActSpinSpd, system-signal=VCU_CmpUTurnActSpinSpd
        data-element=CPT_APPCOM_SWC.CPT_MCU_Composition.VCU_0xB7.VCU_CmpUTurnFltHMI, system-signal=VCU_CmpUTurnFltHMI
        data-element=CPT_APPCOM_SWC.CPT_MCU_Composition.VCU_0xB7.VCU_EscapeModeSts, system-signal=VCU_EscapeModeSts
        data-element=CPT_APPCOM_SWC.CPT_MCU_Composition.VCU_0xB7.VCU_MCUSWorkFailMsg, system-signal=VCU_MCUSWorkFailMsg
        data-element=CPT_APPCOM_SWC.CPT_MCU_Composition.VCU_0xB7.VCU_EscapeWorkFailMsg, system-signal=VCU_EscapeWorkFailMsg
        data-element=CPT_APPCOM_SWC.CPT_MCU_Composition.VCU_0xB7.VCU_REClutchFltMsg, system-signal=VCU_REClutchFltMsg
        data-element=CPT_APPCOM_SWC.CPT_MCU_Composition.VCU_0xB7.VCU_BoostMode_Fail_C, system-signal=VCU_BoostMode_Fail_C
        data-element=CPT_APPCOM_SWC.CPT_MCU_Composition.VCU_0xB7.VCU_BoostModeSts_C, system-signal=VCU_BoostModeSts_C
        data-element=CPT_APPCOM_SWC.CPT_MCU_Composition.VCU_0xE6.DbgSignal{1..12}_FA, system-signal=DbgSignal{1..12}_FA
        data-element=CPT_APPCOM_SWC.CPT_MCU_Composition.VCU_0xE6.DbgSignal{1..12}_RA, system-signal=DbgSignal{1..12}_RA
        data-element=CPT_APPCOM_SWC.CPT_MCU_Composition.UDS_Phy_Tx_7E8_ECM.ECM_UDS_Res_Byte{0..7}, system-signal=ECM_UDS_Res_Byte{0..7}
        data-element=CPT_APPCOM_SWC.CPT_MCU_Composition.VCU_0x1E5.VCU_BCM_Authentication_MAC_A{0..15}, system-signal=VCU_BCM_Authentication_MAC_A{0..15}
        data-element=CPT_APPCOM_SWC.CPT_MCU_Composition.VCU_0x1E5.VCU_BCM_Authentication_Challenge_B{0..3}, system-signal=VCU_BCM_Authentication_Challenge_B{0..3}
        data-element=CPT_APPCOM_SWC.CPT_MCU_Composition.TMS_0x5FF.TMS_MCUMHeatPwrReq, system-signal=TMS_MCUMHeatPwrReq
        data-element=CPT_APPCOM_SWC.CPT_MCU_Composition.TMS_0x5FF.TMS_MCUMHeatModEnad, system-signal=TMS_MCUMHeatModEnad
        data-element=CPT_APPCOM_SWC.CPT_MCU_Composition.TMS_0x5FF.TMS_VCU_MotSelfHeatEnReq, system-signal=TMS_VCU_MotSelfHeatEnReq
        data-element=CPT_APPCOM_SWC.CPT_MCU_Composition.TMS_0x5FF.TMS_VCU_MotSelfHeatLvlReq, system-signal=TMS_VCU_MotSelfHeatLvlReq
        data-element=CPT_APPCOM_SWC.CPT_MCU_Composition.ECM_0x148.ECM_SWVersionC, system-signal=ECM_SWVersionC
        data-element=CPT_APPCOM_SWC.CPT_MCU_Composition.ECM_0x148.ECM_SWVersionB, system-signal=ECM_SWVersionB
        data-element=CPT_APPCOM_SWC.CPT_MCU_Composition.ECM_0x148.ECM_SWVersionA, system-signal=ECM_SWVersionA
        data-element=CPT_APPCOM_SWC.CPT_MCU_Composition.ECM_0x148.ECM_Total_fuel_consumed, system-signal=ECM_Total_fuel_consumed
        data-element=CPT_APPCOM_SWC.CPT_MCU_Composition.IVI_0x331.IVI_CRC_331, system-signal=IVI_CRC_331
        data-element=CPT_APPCOM_SWC.CPT_MCU_Composition.IVI_0x331.IVI_RollingCounter_331, system-signal=IVI_RollingCounter_331
        data-element=CPT_APPCOM_SWC.CPT_MCU_Composition.IVI_0x331.IVI_EPBRequst, system-signal=IVI_EPBRequst
        data-element=CPT_APPCOM_SWC.CPT_MCU_Composition.IVI_0x331.IVI_TerrainMatchMode, system-signal=IVI_TerrainMatchMode
        data-element=CPT_APPCOM_SWC.CPT_MCU_Composition.IVI_0x331.IVI_LPedalModeSW, system-signal=IVI_LPedalModeSW
        data-element=CPT_APPCOM_SWC.CPT_MCU_Composition.IVI_0x331.IVI_AVHSw_X, system-signal=IVI_AVHSw_X
