[part 2 of 2: package /MVCU_AutoGenPkg/MVCU/Pkg_AutoGen_Sys]
AUTOSAR XML (schema 4-2-2)
package /MVCU_AutoGenPkg/MVCU/Pkg_AutoGen_Sys  (continued)
  system MCU_System: category=SYSTEM_EXTRACT  (continued)
    system mapping SystemMapping_MCU_System  (continued)
      data-mappings:  (continued)
        data-element=CPT_APPCOM_SWC.CPT_MCU_Composition.IVI_0x331.IVI_ESCSw_X, system-signal=IVI_ESCSw_X
        data-element=CPT_APPCOM_SWC.CPT_MCU_Composition.IVI_0x331.IVI_HDCSw_X, system-signal=IVI_HDCSw_X
        data-element=CPT_APPCOM_SWC.CPT_MCU_Composition.IVI_0x331.IVI_CSTSw_X, system-signal=IVI_CSTSw_X
        data-element=CPT_APPCOM_SWC.CPT_MCU_Composition.IVI_0x331.IVI_AutoAllRoad, system-signal=IVI_AutoAllRoad
        data-element=CPT_APPCOM_SWC.CPT_MCU_Composition.IVI_0x331.IVI_CampingMode_SW, system-signal=IVI_CampingMode_SW
        data-element=CPT_APPCOM_SWC.CPT_MCU_Composition.IVI_0x331.IVI_BraPedMod, system-signal=IVI_BraPedMod
        data-element=CPT_APPCOM_SWC.CPT_MCU_Composition.IVI_0x331.IVI_SlowspeedSmartCtrl, system-signal=IVI_SlowspeedSmartCtrl
        data-element=CPT_APPCOM_SWC.CPT_MCU_Composition.IVI_0x331.IVI_TrailerModeCtrl, system-signal=IVI_TrailerModeCtrl
        data-element=CPT_APPCOM_SWC.CPT_MCU_Composition.IVI_0x331.IVI_EscapeMode_SW, system-signal=IVI_EscapeMode_SW
        data-element=CPT_APPCOM_SWC.CPT_MCU_Composition.IVI_0x331.IVI_PowerSavingModeReq, system-signal=IVI_PowerSavingModeReq
        data-element=CPT_APPCOM_SWC.CPT_MCU_Composition.IVI_0x331.IVI_SelfAdaptionDriveSW, system-signal=IVI_SelfAdaptionDriveSW
        data-element=CPT_APPCOM_SWC.CPT_MCU_Composition.IVI_0x331.IVI_CmpUTurnStartUI, system-signal=IVI_CmpUTurnStartUI
        data-element=CPT_APPCOM_SWC.CPT_MCU_Composition.IVI_0x331.IVI_CmpUTurnLockWhlUI, system-signal=IVI_CmpUTurnLockWhlUI
        data-element=CPT_APPCOM_SWC.CPT_MCU_Composition.IVI_0x331.IVI_CmpUTurnTarDirUI, system-signal=IVI_CmpUTurnTarDirUI
        data-element=CPT_APPCOM_SWC.CPT_MCU_Composition.IVI_0x331.IVI_CmpUTurnTarAngleUI, system-signal=IVI_CmpUTurnTarAngleUI
        data-element=CPT_APPCOM_SWC.CPT_MCU_Composition.IVI_0x331.IVI_CmpUTurnReq, system-signal=IVI_CmpUTurnReq
        data-element=CPT_APPCOM_SWC.CPT_MCU_Composition.IVI_0x3D8.IVI_InventerLimitOdometerkm, system-signal=IVI_InventerLimitOdometerkm
        data-element=CPT_APPCOM_SWC.CPT_MCU_Composition.IVI_0x3D8.IVI_FuelDetMode, system-signal=IVI_FuelDetMode
        data-element=CPT_APPCOM_SWC.CPT_MCU_Composition.IVI_0x3D8.IVI_EngineIdlingMode, system-signal=IVI_EngineIdlingMode
        data-element=CPT_APPCOM_SWC.CPT_MCU_Composition.IVI_0x3D8.IVI_CarWashMode, system-signal=IVI_CarWashMode
        data-element=CPT_APPCOM_SWC.CPT_MCU_Composition.IVI_0x3D8.IVI_CampingModeSW, system-signal=IVI_CampingModeSW
        data-element=CPT_APPCOM_SWC.CPT_MCU_Composition.IVI_0x3D8.IVI_SpeedLimitModeSW, system-signal=IVI_SpeedLimitModeSW
        data-element=CPT_APPCOM_SWC.CPT_MCU_Composition.IVI_0x3D8.IVI_FuelupReq, system-signal=IVI_FuelupReq
        data-element=CPT_APPCOM_SWC.CPT_MCU_Composition.IVI_0x3D8.IVI_FuelChgLevel, system-signal=IVI_FuelChgLevel
        data-element=CPT_APPCOM_SWC.CPT_MCU_Composition.IVI_0x3D8.IVI_FuelChgMode, system-signal=IVI_FuelChgMode
        data-element=CPT_APPCOM_SWC.CPT_MCU_Composition.IVI_0x3D8.IVI_InventerLimitOdometerkmVD, system-signal=IVI_InventerLimitOdometerkmVD
        data-element=CPT_APPCOM_SWC.CPT_MCU_Composition.IVI_0x3D8.IVI_EMSRepairModeReq, system-signal=IVI_EMSRepairModeReq
        data-element=CPT_APPCOM_SWC.CPT_MCU_Composition.IVI_0x3D8.IVI_ForceChgModeReq, system-signal=IVI_ForceChgModeReq
        data-element=CPT_APPCOM_SWC.CPT_MCU_Composition.IVI_0x3D8.IVI_ForceChgTargetSOCVD, system-signal=IVI_ForceChgTargetSOCVD
        data-element=CPT_APPCOM_SWC.CPT_MCU_Composition.IVI_0x3D8.IVI_SpeedLimitModeSpeed, system-signal=IVI_SpeedLimitModeSpeed
        data-element=CPT_APPCOM_SWC.CPT_MCU_Composition.IVI_0x3D8.IVI_ForceChgTargetSOC, system-signal=IVI_ForceChgTargetSOC
        data-element=CPT_APPCOM_SWC.CPT_MCU_Composition.HPCBCM_0x292.BCM_VCU_Authentication_Sts, system-signal=BCM_VCU_Authentication_Sts
        data-element=CPT_APPCOM_SWC.CPT_MCU_Composition.HPCBCM_0x292.BCM_PTCLossMissErr, system-signal=BCM_PTCLossMissErr
        data-element=CPT_APPCOM_SWC.CPT_MCU_Composition.HPCBCM_0x292.BCM_PTCRollCntErr, system-signal=BCM_PTCRollCntErr
        data-element=CPT_APPCOM_SWC.CPT_MCU_Composition.HPCBCM_0x292.BCM_PTCChksumErr, system-signal=BCM_PTCChksumErr
        data-element=CPT_APPCOM_SWC.CPT_MCU_Composition.HPCBCM_0x292.BCM_PDUHVIL_STs, system-signal=BCM_PDUHVIL_STs
        data-element=CPT_APPCOM_SWC.CPT_MCU_Composition.HPCBCM_0x292.BCM_Cab220VHVIL_STs, system-signal=BCM_Cab220VHVIL_STs
        data-element=CPT_APPCOM_SWC.CPT_MCU_Composition.HPCBCM_0x292.BCM_Cabin220VHVIL_STs, system-signal=BCM_Cabin220VHVIL_STs
        data-element=CPT_APPCOM_SWC.CPT_MCU_Composition.IBC_0x185.IBC_CRC_185, system-signal=IBC_CRC_185
        data-element=CPT_APPCOM_SWC.CPT_MCU_Composition.IBC_0x185.IBC_RollingCounter_185, system-signal=IBC_RollingCounter_185
        data-element=CPT_APPCOM_SWC.CPT_MCU_Composition.IBC_0x185.IBC_PlungerPressure, system-signal=IBC_PlungerPressure
        data-element=CPT_APPCOM_SWC.CPT_MCU_Composition.IBC_0x185.IBC_PlungerPressure_Q, system-signal=IBC_PlungerPressure_Q
        data-element=CPT_APPCOM_SWC.CPT_MCU_Composition.IBC_0x185.IBC_SimulatorPressure, system-signal=IBC_SimulatorPressure
        data-element=CPT_APPCOM_SWC.CPT_MCU_Composition.IBC_0x185.IBC_SimulatorPressure_Q, system-signal=IBC_SimulatorPressure_Q
        data-element=CPT_APPCOM_SWC.CPT_MCU_Composition.IBC_0x185.IBC_HMI_WarningOn, system-signal=IBC_HMI_WarningOn
        data-element=CPT_APPCOM_SWC.CPT_MCU_Composition.IBC_0x185.IBC_MIL_WarningOn, system-signal=IBC_MIL_WarningOn
        data-element=CPT_APPCOM_SWC.CPT_MCU_Composition.IBC_0x185.IBC_LongitAcceAct, system-signal=IBC_LongitAcceAct
        data-element=CPT_APPCOM_SWC.CPT_MCU_Composition.IBC_0x185.IBC_LongitAcceActValid, system-signal=IBC_LongitAcceActValid
        data-element=CPT_APPCOM_SWC.CPT_MCU_Composition.IBC_0x185.IBC_brakeFluidWarning, system-signal=IBC_brakeFluidWarning
        data-element=CPT_APPCOM_SWC.CPT_MCU_Composition.IBC_0x185.IBC_SCM_Active, system-signal=IBC_SCM_Active
        data-element=CPT_APPCOM_SWC.CPT_MCU_Composition.IBC_0x185.IBC_SCM_Failed, system-signal=IBC_SCM_Failed
        data-element=CPT_APPCOM_SWC.CPT_MCU_Composition.IBC_0x185.IBC_CDPAvailable, system-signal=IBC_CDPAvailable
        data-element=CPT_APPCOM_SWC.CPT_MCU_Composition.IBC_0x185.IBC_CDPIntervention, system-signal=IBC_CDPIntervention
        data-element=CPT_APPCOM_SWC.CPT_MCU_Composition.IBC_0x185.IBC_AEB_active, system-signal=IBC_AEB_active
        data-element=CPT_APPCOM_SWC.CPT_MCU_Composition.IBC_0x185.IBC_AEBdecAvailable, system-signal=IBC_AEBdecAvailable
        data-element=CPT_APPCOM_SWC.CPT_MCU_Composition.IBC_0x185.IBC_AVHStatus, system-signal=IBC_AVHStatus
        data-element=CPT_APPCOM_SWC.CPT_MCU_Composition.IBC_0x185.IBC_AVHAvailable, system-signal=IBC_AVHAvailable
        data-element=CPT_APPCOM_SWC.CPT_MCU_Composition.IBC_0x185.IBC_HHCActive, system-signal=IBC_HHCActive
        data-element=CPT_APPCOM_SWC.CPT_MCU_Composition.IBC_0x185.IBC_HHCFailed, system-signal=IBC_HHCFailed
        data-element=CPT_APPCOM_SWC.CPT_MCU_Composition.IBC_0x185.IBC_CDD_Available_APA, system-signal=IBC_CDD_Available_APA
        data-element=CPT_APPCOM_SWC.CPT_MCU_Composition.IBC_0x185.IBC_CDD_Active_APA, system-signal=IBC_CDD_Active_APA
        data-element=CPT_APPCOM_SWC.CPT_MCU_Composition.IBC_0x185.IBC_CDD_Available_ACC, system-signal=IBC_CDD_Available_ACC
        data-element=CPT_APPCOM_SWC.CPT_MCU_Composition.IBC_0x185.IBC_CDD_Active_ACC, system-signal=IBC_CDD_Active_ACC
        data-element=CPT_APPCOM_SWC.CPT_MCU_Composition.IBC_0x185.IBC_HDCStatus, system-signal=IBC_HDCStatus
        data-element=CPT_APPCOM_SWC.CPT_MCU_Composition.IBC_0x185.IBC_HDCAvailable, system-signal=IBC_HDCAvailable
        data-element=CPT_APPCOM_SWC.CPT_MCU_Composition.IBC_0x185.IBC_CSTStatus, system-signal=IBC_CSTStatus
        data-element=CPT_APPCOM_SWC.CPT_MCU_Composition.IBC_0x185.IBC_CSTAvailable, system-signal=IBC_CSTAvailable
        data-element=CPT_APPCOM_SWC.CPT_MCU_Composition.IBC_0x185.IBC_VLC_Available_ACC, system-signal=IBC_VLC_Available_ACC
        data-element=CPT_APPCOM_SWC.CPT_MCU_Composition.IBC_0x185.IBC_VLC_Active_ACC, system-signal=IBC_VLC_Active_ACC
        data-element=CPT_APPCOM_SWC.CPT_MCU_Composition.IBC_0x185.IBC_VLC_Available_APA, system-signal=IBC_VLC_Available_APA
        data-element=CPT_APPCOM_SWC.CPT_MCU_Composition.IBC_0x185.IBC_VLC_Active_APA, system-signal=IBC_VLC_Active_APA
        data-element=CPT_APPCOM_SWC.CPT_MCU_Composition.IBC_0x185.IBC_VehicleHoldStatus, system-signal=IBC_VehicleHoldStatus
        data-element=CPT_APPCOM_SWC.CPT_MCU_Composition.IBC_0x185.IBC_DrvrBrkTqAtWhlsReqd, system-signal=IBC_DrvrBrkTqAtWhlsReqd
        data-element=CPT_APPCOM_SWC.CPT_MCU_Composition.TMS_0x363.TMS_RollingCounter_363, system-signal=TMS_RollingCounter_363
        data-element=CPT_APPCOM_SWC.CPT_MCU_Composition.TMS_0x363.TMS_AC_Command, system-signal=TMS_AC_Command
        data-element=CPT_APPCOM_SWC.CPT_MCU_Composition.TMS_0x363.TMS_PTCHeatingReq, system-signal=TMS_PTCHeatingReq
        data-element=CPT_APPCOM_SWC.CPT_MCU_Composition.TMS_0x363.TMS_PTCPowerSet, system-signal=TMS_PTCPowerSet
        data-element=CPT_APPCOM_SWC.CPT_MCU_Composition.TMS_0x363.TMS_OutsideTempVD, system-signal=TMS_OutsideTempVD
        data-element=CPT_APPCOM_SWC.CPT_MCU_Composition.TMS_0x363.TMS_OutsideTemp_Corrected, system-signal=TMS_OutsideTemp_Corrected
        data-element=CPT_APPCOM_SWC.CPT_MCU_Composition.BMS_0x5B1.BMS_SOC_Real, system-signal=BMS_SOC_Real
        data-element=CPT_APPCOM_SWC.CPT_MCU_Composition.BMS_0x5B1.BMS_MODE_t, system-signal=BMS_MODE_t
        data-element=CPT_APPCOM_SWC.CPT_MCU_Composition.BMS_0x5B1.BMS_VoltLoDeratLevel_NA, system-signal=BMS_VoltLoDeratLevel_NA
        data-element=CPT_APPCOM_SWC.CPT_MCU_Composition.BMS_0x5B1.BMS_VoltHiDeratLevel_NA, system-signal=BMS_VoltHiDeratLevel_NA
        data-element=CPT_APPCOM_SWC.CPT_MCU_Composition.TMS_0x561.TMS_MCUOutTemp, system-signal=TMS_MCUOutTemp
        data-element=CPT_APPCOM_SWC.CPT_MCU_Composition.TMS_0x561.TMS_MCUMIntelTemp, system-signal=TMS_MCUMIntelTemp
        data-element=CPT_APPCOM_SWC.CPT_MCU_Composition.TMS_0x561.TMS_MCUSIntelTemp, system-signal=TMS_MCUSIntelTemp
        data-element=CPT_APPCOM_SWC.CPT_MCU_Composition.HPCBCM_0x1E4.BCM_VCU_Authentication_Challenge_A{0..3}, system-signal=BCM_VCU_Authentication_Challenge_A{0..3}
        data-element=CPT_APPCOM_SWC.CPT_MCU_Composition.MCU_0x5CA.EddyCur_Para_Cos_m, system-signal=EddyCur_Para_Cos_m
        data-element=CPT_APPCOM_SWC.CPT_MCU_Composition.MCU_0x5CA.MCUMR_EddyCur_Para_Cos_m, system-signal=MCUMR_EddyCur_Para_Cos_m
        data-element=CPT_APPCOM_SWC.CPT_MCU_Composition.ICU_0xDF.ICU_CRC_DF, system-signal=ICU_CRC_DF
        data-element=CPT_APPCOM_SWC.CPT_MCU_Composition.ICU_0xDF.ICU_RollingCounter_DF, system-signal=ICU_RollingCounter_DF
        data-element=CPT_APPCOM_SWC.CPT_MCU_Composition.ICU_0xDF.ICU_IMU_ACC_x, system-signal=ICU_IMU_ACC_x
        data-element=CPT_APPCOM_SWC.CPT_MCU_Composition.ICU_0xDF.ICU_IMU_ACC_y, system-signal=ICU_IMU_ACC_y
        data-element=CPT_APPCOM_SWC.CPT_MCU_Composition.ICU_0xDF.ICU_IMU_ACC_z, system-signal=ICU_IMU_ACC_z
        data-element=CPT_APPCOM_SWC.CPT_MCU_Composition.ICU_0xDF.ICU_IMU_ACC_Roll_Rate, system-signal=ICU_IMU_ACC_Roll_Rate
        data-element=CPT_APPCOM_SWC.CPT_MCU_Composition.ICU_0xDF.ICU_IMU_ACC_Pitch_Rate, system-signal=ICU_IMU_ACC_Pitch_Rate
        data-element=CPT_APPCOM_SWC.CPT_MCU_Composition.ICU_0xDF.ICU_IMU_ACC_Yaw_Rate, system-signal=ICU_IMU_ACC_Yaw_Rate
        data-element=CPT_APPCOM_SWC.CPT_MCU_Composition.ICU_0xDF.ICU_IMU_Calibrated, system-signal=ICU_IMU_Calibrated
        data-element=CPT_APPCOM_SWC.CPT_MCU_Composition.ICU_0xDF.ICU_IMU_Valid, system-signal=ICU_IMU_Valid
        data-element=CPT_APPCOM_SWC.CPT_MCU_Composition.MCU_0x5CA.EddyCur_Stage, system-signal=EddyCur_Stage
        data-element=CPT_APPCOM_SWC.CPT_MCU_Composition.MCU_0x5CA.EddyCur_IdenFinish_Flag, system-signal=EddyCur_IdenFinish_Flag
        data-element=CPT_APPCOM_SWC.CPT_MCU_Composition.MCU_0x5CA.EddyCur_Para_Sin_m, system-signal=EddyCur_Para_Sin_m
        data-element=CPT_APPCOM_SWC.CPT_MCU_Composition.MCU_0x5CA.EddyCur_Write_Flag, system-signal=EddyCur_Write_Flag
        data-element=CPT_APPCOM_SWC.CPT_MCU_Composition.MCU_0x5CA.EddyCur_FauPro_IDEL_OTime_Flag, system-signal=EddyCur_FauPro_IDEL_OTime_Flag
        data-element=CPT_APPCOM_SWC.CPT_MCU_Composition.MCU_0x5CA.EddyCur_FauPro_SpdInstab_Flag, system-signal=EddyCur_FauPro_SpdInstab_Flag
        data-element=CPT_APPCOM_SWC.CPT_MCU_Composition.MCU_0x5CA.EddyCur_FauPro_IDPara_OVal_Flag, system-signal=EddyCur_FauPro_IDPara_OVal_Flag
        data-element=CPT_APPCOM_SWC.CPT_MCU_Composition.MCU_0x5CA.EddyCur_Para_Cos_k, system-signal=EddyCur_Para_Cos_k
        data-element=CPT_APPCOM_SWC.CPT_MCU_Composition.MCU_0x5CA.EddyCur_Enable, system-signal=EddyCur_Enable
        data-element=CPT_APPCOM_SWC.CPT_MCU_Composition.MCU_0x5CA.EddyCur_Para_Sin_k, system-signal=EddyCur_Para_Sin_k
        data-element=CPT_APPCOM_SWC.CPT_MCU_Composition.MCU_0x5CA.EddyCur_IdenFail_Flag, system-signal=EddyCur_IdenFail_Flag
        data-element=CPT_APPCOM_SWC.CPT_MCU_Composition.MCU_0x5CA.EddyCur_Para_Cos_Pha, system-signal=EddyCur_Para_Cos_Pha
        data-element=CPT_APPCOM_SWC.CPT_MCU_Composition.MCU_0x5CA.EddyCur_Para_Sin_Pha, system-signal=EddyCur_Para_Sin_Pha
        data-element=CPT_APPCOM_SWC.CPT_MCU_Composition.MCU_0x5CA.EddyCur_ReadSuccess_Flag, system-signal=EddyCur_ReadSuccess_Flag
        data-element=CPT_APPCOM_SWC.CPT_MCU_Composition.MCU_0x5CA.OfsIden_ReadSuccess_Flag, system-signal=OfsIden_ReadSuccess_Flag
        data-element=CPT_APPCOM_SWC.CPT_MCU_Composition.MCU_0x5CA.OfsIden_SpdUp_Overtime, system-signal=OfsIden_SpdUp_Overtime
        data-element=CPT_APPCOM_SWC.CPT_MCU_Composition.MCU_0x5CA.OfsIden_SpdUp_OverSpd, system-signal=OfsIden_SpdUp_OverSpd
        data-element=CPT_APPCOM_SWC.CPT_MCU_Composition.MCU_0x5CA.OfsIden_IdenDiverge, system-signal=OfsIden_IdenDiverge
        data-element=CPT_APPCOM_SWC.CPT_MCU_Composition.MCU_0x5CA.OfsIden_IdenCntOver, system-signal=OfsIden_IdenCntOver
        data-element=CPT_APPCOM_SWC.CPT_MCU_Composition.MCU_0x5CA.OfsIden_MtrLock, system-signal=OfsIden_MtrLock
        data-element=CPT_APPCOM_SWC.CPT_MCU_Composition.MCU_0x5CA.OfsIden_OfsRslt, system-signal=OfsIden_OfsRslt
        data-element=CPT_APPCOM_SWC.CPT_MCU_Composition.MCU_0x5CA.OfsIden_Sts, system-signal=OfsIden_Sts
        data-element=CPT_APPCOM_SWC.CPT_MCU_Composition.MCU_0x5CA.OfsIden_Finish, system-signal=OfsIden_Finish
        data-element=CPT_APPCOM_SWC.CPT_MCU_Composition.MCU_0x5CA.OfsIden_OfsWrite_Finish, system-signal=OfsIden_OfsWrite_Finish
        data-element=CPT_APPCOM_SWC.CPT_MCU_Composition.MCU_0x5CA.OfsIden_DirWrite_Finish, system-signal=OfsIden_DirWrite_Finish
        data-element=CPT_APPCOM_SWC.CPT_MCU_Composition.MCU_0x5CA.OfsIden_DirIden_Rslt, system-signal=OfsIden_DirIden_Rslt
        data-element=CPT_APPCOM_SWC.CPT_MCU_Composition.MCU_0x5CA.OfsIden_ZeroAlign_OverTime, system-signal=OfsIden_ZeroAlign_OverTime
        data-element=CPT_APPCOM_SWC.CPT_MCU_Composition.MCU_0x5CA.OfsIden_ZeroAlign_Fail, system-signal=OfsIden_ZeroAlign_Fail
        data-element=CPT_APPCOM_SWC.CPT_MCU_Composition.MCU_0x5CA.OfsIden_IFStart_Overtime, system-signal=OfsIden_IFStart_Overtime
        data-element=CPT_APPCOM_SWC.CPT_MCU_Composition.MCU_0x5CA.OfsIden_IFStart_Fail, system-signal=OfsIden_IFStart_Fail
        data-element=CPT_APPCOM_SWC.CPT_MCU_Composition.MCU_0x5CA.PosDly_Cal_RslvDelayTime, system-signal=PosDly_Cal_RslvDelayTime
        data-element=CPT_APPCOM_SWC.CPT_MCU_Composition.MCU_0x5CA.PosDly_Theta_k_Std, system-signal=PosDly_Theta_k_Std
        data-element=CPT_APPCOM_SWC.CPT_MCU_Composition.MCU_0x5CA.PosDly_Supplier, system-signal=PosDly_Supplier
        data-element=CPT_APPCOM_SWC.CPT_MCU_Composition.MCU_0x5CA.PosDly_FauPro_Ident_OTm_Flag, system-signal=PosDly_FauPro_Ident_OTm_Flag
        data-element=CPT_APPCOM_SWC.CPT_MCU_Composition.MCU_0x5CA.PosDly_FauPro_SpdDn_OTm_Flag, system-signal=PosDly_FauPro_SpdDn_OTm_Flag
        data-element=CPT_APPCOM_SWC.CPT_MCU_Composition.MCU_0x5CA.PosDly_RslvOffsetComp, system-signal=PosDly_RslvOffsetComp
        data-element=CPT_APPCOM_SWC.CPT_MCU_Composition.MCU_0x5CA.PosDly_Enable, system-signal=PosDly_Enable
        data-element=CPT_APPCOM_SWC.CPT_MCU_Composition.MCU_0x5CA.PosDly_IdentFail_Flag, system-signal=PosDly_IdentFail_Flag
        data-element=CPT_APPCOM_SWC.CPT_MCU_Composition.MCU_0x5CA.PosDly_IdentFinish_Flag, system-signal=PosDly_IdentFinish_Flag
        data-element=CPT_APPCOM_SWC.CPT_MCU_Composition.MCU_0x5CA.PosDly_Write_Flag, system-signal=PosDly_Write_Flag
        data-element=CPT_APPCOM_SWC.CPT_MCU_Composition.MCU_0x5CA.PosDly_FauPro_Chk_DlyTime_OVal, system-signal=PosDly_FauPro_Chk_DlyTime_OVal
        data-element=CPT_APPCOM_SWC.CPT_MCU_Composition.MCU_0x5CA.PosDly_FauPro_Chk_RslvOfst_OVal, system-signal=PosDly_FauPro_Chk_RslvOfst_OVal
        data-element=CPT_APPCOM_SWC.CPT_MCU_Composition.MCU_0x5CA.PosDly_FauPro_Check_Divergence, system-signal=PosDly_FauPro_Check_Divergence
        data-element=CPT_APPCOM_SWC.CPT_MCU_Composition.MCU_0x5CA.PosDly_FauPro_SpdUp_OTm_Flag, system-signal=PosDly_FauPro_SpdUp_OTm_Flag
        data-element=CPT_APPCOM_SWC.CPT_MCU_Composition.MCU_0x5CA.PosDly_Stage, system-signal=PosDly_Stage
        data-element=CPT_APPCOM_SWC.CPT_MCU_Composition.MCU_0x5CA.IMParaIdent_ParEstMainStep, system-signal=IMParaIdent_ParEstMainStep
        data-element=CPT_APPCOM_SWC.CPT_MCU_Composition.MCU_0x5CA.IMParaIdent_Rs, system-signal=IMParaIdent_Rs
        data-element=CPT_APPCOM_SWC.CPT_MCU_Composition.MCU_0x5CA.IMParaIdent_Rr, system-signal=IMParaIdent_Rr
        data-element=CPT_APPCOM_SWC.CPT_MCU_Composition.MCU_0x5CA.IMParaIdent_Ll, system-signal=IMParaIdent_Ll
        data-element=CPT_APPCOM_SWC.CPT_MCU_Composition.MCU_0x5CA.IMParaIdent_Lm, system-signal=IMParaIdent_Lm
        data-element=CPT_APPCOM_SWC.CPT_MCU_Composition.MCU_0x5CA.IMParaIdent_TotalLo, system-signal=IMParaIdent_TotalLo
        data-element=CPT_APPCOM_SWC.CPT_MCU_Composition.MCU_0x5CA.IMParaIdent_IdentSubStep, system-signal=IMParaIdent_IdentSubStep
        data-element=CPT_APPCOM_SWC.CPT_MCU_Composition.MCU_0x5CA.MCUMR_EddyCur_Stage, system-signal=MCUMR_EddyCur_Stage
        data-element=CPT_APPCOM_SWC.CPT_MCU_Composition.MCU_0x5CA.MCUMR_EddyCur_IdenFinish_Flag, system-signal=MCUMR_EddyCur_IdenFinish_Flag
        data-element=CPT_APPCOM_SWC.CPT_MCU_Composition.MCU_0x5CA.MCUMR_EddyCur_Para_Sin_m, system-signal=MCUMR_EddyCur_Para_Sin_m
        data-element=CPT_APPCOM_SWC.CPT_MCU_Composition.MCU_0x5CA.MCUMR_EddyCur_Write_Flag, system-signal=MCUMR_EddyCur_Write_Flag
        data-element=CPT_APPCOM_SWC.CPT_MCU_Composition.MCU_0x5CA.MCUMR_EddyCur_FauPro_IDEL_OTime_Flag, system-signal=MCUMR_EddyCur_FauPro_IDEL_OTime_Flag
        data-element=CPT_APPCOM_SWC.CPT_MCU_Composition.MCU_0x5CA.MCUMR_EddyCur_FauPro_SpdInstab_Flag, system-signal=MCUMR_EddyCur_FauPro_SpdInstab_Flag
        data-element=CPT_APPCOM_SWC.CPT_MCU_Composition.MCU_0x5CA.MCUMR_EddyCur_FauPro_IDPara_OVal_Flag, system-signal=MCUMR_EddyCur_FauPro_IDPara_OVal_Flag
        data-element=CPT_APPCOM_SWC.CPT_MCU_Composition.MCU_0x5CA.MCUMR_EddyCur_Para_Cos_k, system-signal=MCUMR_EddyCur_Para_Cos_k
        data-element=CPT_APPCOM_SWC.CPT_MCU_Composition.MCU_0x5CA.MCUMR_EddyCur_Enable, system-signal=MCUMR_EddyCur_Enable
        data-element=CPT_APPCOM_SWC.CPT_MCU_Composition.MCU_0x5CA.MCUMR_EddyCur_Para_Sin_k, system-signal=MCUMR_EddyCur_Para_Sin_k
        data-element=CPT_APPCOM_SWC.CPT_MCU_Composition.MCU_0x5CA.MCUMR_EddyCur_IdenFail_Flag, system-signal=MCUMR_EddyCur_IdenFail_Flag
        data-element=CPT_APPCOM_SWC.CPT_MCU_Composition.MCU_0x5CA.MCUMR_EddyCur_Para_Cos_Pha, system-signal=MCUMR_EddyCur_Para_Cos_Pha
        data-element=CPT_APPCOM_SWC.CPT_MCU_Composition.MCU_0x5CA.MCUMR_EddyCur_Para_Sin_Pha, system-signal=MCUMR_EddyCur_Para_Sin_Pha
        data-element=CPT_APPCOM_SWC.CPT_MCU_Composition.MCU_0x5CA.MCUMR_EddyCur_ReadSuccess_Flag, system-signal=MCUMR_EddyCur_ReadSuccess_Flag
        data-element=CPT_APPCOM_SWC.CPT_MCU_Composition.MCU_0x5CA.MCUMR_OfsIden_ReadSuccess_Flag, system-signal=MCUMR_OfsIden_ReadSuccess_Flag
        data-element=CPT_APPCOM_SWC.CPT_MCU_Composition.MCU_0x5CA.MCUMR_OfsIden_SpdUp_Overtime, system-signal=MCUMR_OfsIden_SpdUp_Overtime
        data-element=CPT_APPCOM_SWC.CPT_MCU_Composition.MCU_0x5CA.MCUMR_OfsIden_SpdUp_OverSpd, system-signal=MCUMR_OfsIden_SpdUp_OverSpd
        data-element=CPT_APPCOM_SWC.CPT_MCU_Composition.MCU_0x5CA.MCUMR_OfsIden_IdenDiverge, system-signal=MCUMR_OfsIden_IdenDiverge
        data-element=CPT_APPCOM_SWC.CPT_MCU_Composition.MCU_0x5CA.MCUMR_OfsIden_IdenCntOver, system-signal=MCUMR_OfsIden_IdenCntOver
        data-element=CPT_APPCOM_SWC.CPT_MCU_Composition.MCU_0x5CA.MCUMR_OfsIden_MtrLock, system-signal=MCUMR_OfsIden_MtrLock
        data-element=CPT_APPCOM_SWC.CPT_MCU_Composition.MCU_0x5CA.MCUMR_OfsIden_OfsRslt, system-signal=MCUMR_OfsIden_OfsRslt
        data-element=CPT_APPCOM_SWC.CPT_MCU_Composition.MCU_0x5CA.MCUMR_OfsIden_Sts, system-signal=MCUMR_OfsIden_Sts
        data-element=CPT_APPCOM_SWC.CPT_MCU_Composition.MCU_0x5CA.MCUMR_OfsIden_Finish, system-signal=MCUMR_OfsIden_Finish
        data-element=CPT_APPCOM_SWC.CPT_MCU_Composition.MCU_0x5CA.MCUMR_OfsIden_OfsWrite_Finish, system-signal=MCUMR_OfsIden_OfsWrite_Finish
        data-element=CPT_APPCOM_SWC.CPT_MCU_Composition.MCU_0x5CA.MCUMR_OfsIden_DirWrite_Finish, system-signal=MCUMR_OfsIden_DirWrite_Finish
        data-element=CPT_APPCOM_SWC.CPT_MCU_Composition.MCU_0x5CA.MCUMR_OfsIden_DirIden_Rslt, system-signal=MCUMR_OfsIden_DirIden_Rslt
        data-element=CPT_APPCOM_SWC.CPT_MCU_Composition.MCU_0x5CA.MCUMR_OfsIden_ZeroAlign_OverTime, system-signal=MCUMR_OfsIden_ZeroAlign_OverTime
        data-element=CPT_APPCOM_SWC.CPT_MCU_Composition.MCU_0x5CA.MCUMR_OfsIden_ZeroAlign_Fail, system-signal=MCUMR_OfsIden_ZeroAlign_Fail
        data-element=CPT_APPCOM_SWC.CPT_MCU_Composition.MCU_0x5CA.MCUMR_OfsIden_IFStart_Overtime, system-signal=MCUMR_OfsIden_IFStart_Overtime
        data-element=CPT_APPCOM_SWC.CPT_MCU_Composition.MCU_0x5CA.MCUMR_OfsIden_IFStart_Fail, system-signal=MCUMR_OfsIden_IFStart_Fail
        data-element=CPT_APPCOM_SWC.CPT_MCU_Composition.MCUM_0x5D3.MCUM_StatorTemp_1, system-signal=MCUM_StatorTemp_1
        data-element=CPT_APPCOM_SWC.CPT_MCU_Composition.MCUM_0x5D3.MCUM_L2TqAct, system-signal=MCUM_L2TqAct
        data-element=CPT_APPCOM_SWC.CPT_MCU_Composition.MCUM_0x5D3.MCUM_EOPSw, system-signal=MCUM_EOPSw
        data-element=CPT_APPCOM_SWC.CPT_MCU_Composition.MCUM_0x5D3.MCUM_StatorTemp_2, system-signal=MCUM_StatorTemp_2
        data-element=CPT_APPCOM_SWC.CPT_MCU_Composition.MCUM_0x5D3.MCUM_IGBTTemp_U, system-signal=MCUM_IGBTTemp_U
        data-element=CPT_APPCOM_SWC.CPT_MCU_Composition.MCUM_0x5D3.MCUM_IGBTTemp_V, system-signal=MCUM_IGBTTemp_V
        data-element=CPT_APPCOM_SWC.CPT_MCU_Composition.MCUM_0x5D3.MCUM_IGBTTemp_W, system-signal=MCUM_IGBTTemp_W
        data-element=CPT_APPCOM_SWC.CPT_MCU_Composition.MCUM_0x5D3.MCUM_PCBTemp, system-signal=MCUM_PCBTemp
        data-element=CPT_APPCOM_SWC.CPT_MCU_Composition.MCUM_0x5D3.MCUM_Power_12V, system-signal=MCUM_Power_12V
        data-element=CPT_APPCOM_SWC.CPT_MCU_Composition.MCUM_0x5D3.MCUM_Power_15V, system-signal=MCUM_Power_15V
        data-element=CPT_APPCOM_SWC.CPT_MCU_Composition.MCUM_0x5D3.MCUM_Offset_IU, system-signal=MCUM_Offset_IU
        data-element=CPT_APPCOM_SWC.CPT_MCU_Composition.MCUM_0x5D3.MCUM_Offset_IV, system-signal=MCUM_Offset_IV
        data-element=CPT_APPCOM_SWC.CPT_MCU_Composition.MCUM_0x5D3.MCUM_Offset_IW, system-signal=MCUM_Offset_IW
        data-element=CPT_APPCOM_SWC.CPT_MCU_Composition.MCUM_0x5D3.MCUM_MainSt_State, system-signal=MCUM_MainSt_State
        data-element=CPT_APPCOM_SWC.CPT_MCU_Composition.MCUM_0x5D3.MCUM_Derate_Reason, system-signal=MCUM_Derate_Reason
        data-element=CPT_APPCOM_SWC.CPT_MCU_Composition.MCUM_0x5D3.MCUM_PWM_Freq_kHz, system-signal=MCUM_PWM_Freq_kHz
        data-element=CPT_APPCOM_SWC.CPT_MCU_Composition.MCUM_0x5D3.MCUM_PWMEn_State, system-signal=MCUM_PWMEn_State
        data-element=CPT_APPCOM_SWC.CPT_MCU_Composition.MCUM_0x5D3.MCUM_DrvPwrEn_Out_State, system-signal=MCUM_DrvPwrEn_Out_State
        data-element=CPT_APPCOM_SWC.CPT_MCU_Composition.MCUM_0x5D3.MCUM_SBC_SelfCheckFault, system-signal=MCUM_SBC_SelfCheckFault
        data-element=CPT_APPCOM_SWC.CPT_MCU_Composition.MCUM_0x5D3.MCUM_SBC_TempOverFault, system-signal=MCUM_SBC_TempOverFault
        data-element=CPT_APPCOM_SWC.CPT_MCU_Composition.MCUM_0x5D3.MCUM_SBC_SPIFault, system-signal=MCUM_SBC_SPIFault
        data-element=CPT_APPCOM_SWC.CPT_MCU_Composition.MCUM_0x5D3.MCUM_SBC_InsideVotageFault, system-signal=MCUM_SBC_InsideVotageFault
        data-element=CPT_APPCOM_SWC.CPT_MCU_Composition.MCUM_0x5D3.MCUM_SBC_OutPutVotageFault, system-signal=MCUM_SBC_OutPutVotageFault
        data-element=CPT_APPCOM_SWC.CPT_MCU_Composition.MCUM_0x5D3.MCUM_SBC_FeedDogFault, system-signal=MCUM_SBC_FeedDogFault
        data-element=CPT_APPCOM_SWC.CPT_MCU_Composition.MCUM_0x5D3.MCUM_NVM_RslvrZeroRFault, system-signal=MCUM_NVM_RslvrZeroRFault
        data-element=CPT_APPCOM_SWC.CPT_MCU_Composition.MCUM_0x5D3.MCUM_Rotor_Position, system-signal=MCUM_Rotor_Position
        data-element=CPT_APPCOM_SWC.CPT_MCU_Composition.MCUM_0x5D3.MCUM_PosTransduserFaultCode, system-signal=MCUM_PosTransduserFaultCode
        data-element=CPT_APPCOM_SWC.CPT_MCU_Composition.MCUM_0x5D3.MCUM_NVM_RslvrDirRFault, system-signal=MCUM_NVM_RslvrDirRFault
        data-element=CPT_APPCOM_SWC.CPT_MCU_Composition.MCUM_0x5D3.MCUM_NVM_RslvrDelayRFault, system-signal=MCUM_NVM_RslvrDelayRFault
        data-element=CPT_APPCOM_SWC.CPT_MCU_Composition.MCUM_0x5D3.MCUM_NVM_RslvrParamRFault, system-signal=MCUM_NVM_RslvrParamRFault
        data-element=CPT_APPCOM_SWC.CPT_MCU_Composition.MCUM_0x5D3.MCUM_NVM_HallGainRFault, system-signal=MCUM_NVM_HallGainRFault
        data-element=CPT_APPCOM_SWC.CPT_MCU_Composition.MCUM_0x5D3.MCUM_NVM_HallDelayRFault, system-signal=MCUM_NVM_HallDelayRFault
        data-element=CPT_APPCOM_SWC.CPT_MCU_Composition.MCUM_0x5D3.MCUM_NVM_IGBTTypeRFault, system-signal=MCUM_NVM_IGBTTypeRFault
        data-element=CPT_APPCOM_SWC.CPT_MCU_Composition.MCUM_0x5D3.MCUM_NVM_MotorTypeRFault, system-signal=MCUM_NVM_MotorTypeRFault
        data-element=CPT_APPCOM_SWC.CPT_MCU_Composition.MCUM_0x5D3.MCUM_NVM_VehicleTypeRFault, system-signal=MCUM_NVM_VehicleTypeRFault
        data-element=CPT_APPCOM_SWC.CPT_MCU_Composition.MCUM_0x5D3.MCUM_ASC_EntryCount, system-signal=MCUM_ASC_EntryCount
        data-element=CPT_APPCOM_SWC.CPT_MCU_Composition.MCUM_0x5D3.MCUM_Spd_Turn, system-signal=MCUM_Spd_Turn
        data-element=CPT_APPCOM_SWC.CPT_MCU_Composition.MCUM_0x5D3.MCUM_LUT_Spd_Max, system-signal=MCUM_LUT_Spd_Max
        data-element=CPT_APPCOM_SWC.CPT_MCU_Composition.MCUM_0x5D3.MCUM_EOP_Speed, system-signal=MCUM_EOP_Speed
        data-element=CPT_APPCOM_SWC.CPT_MCU_Composition.MCUM_0x5D3.MCUM_EOP_IqFb, system-signal=MCUM_EOP_IqFb
        data-element=CPT_APPCOM_SWC.CPT_MCU_Composition.MCUM_0x5D3.MCUM_EOP_IqRef, system-signal=MCUM_EOP_IqRef
        data-element=CPT_APPCOM_SWC.CPT_MCU_Composition.MCUM_0x5D3.MCUM_EOP_DCVolt, system-signal=MCUM_EOP_DCVolt
        data-element=CPT_APPCOM_SWC.CPT_MCU_Composition.MCUM_0x5D3.MCUM_EOP_DCCurr, system-signal=MCUM_EOP_DCCurr
        data-element=CPT_APPCOM_SWC.CPT_MCU_Composition.MCUM_0x5D3.MCUM_EOP_Temp, system-signal=MCUM_EOP_Temp
        data-element=CPT_APPCOM_SWC.CPT_MCU_Composition.MCUM_0x5D3.MCUM_EOP_State, system-signal=MCUM_EOP_State
        data-element=CPT_APPCOM_SWC.CPT_MCU_Composition.MCUM_0x5D3.MCUM_EOP_FaultCode, system-signal=MCUM_EOP_FaultCode
        data-element=CPT_APPCOM_SWC.CPT_MCU_Composition.MCUM_0x5D3.MCUM_HWFault_RstCnt, system-signal=MCUM_HWFault_RstCnt
        data-element=CPT_APPCOM_SWC.CPT_MCU_Composition.MCUM_0x5D3.MCUM_HWFoB_RstCnt, system-signal=MCUM_HWFoB_RstCnt
        data-element=CPT_APPCOM_SWC.CPT_MCU_Composition.MCUM_0x5D3.MCUM_HWFoT_RstCnt, system-signal=MCUM_HWFoT_RstCnt
        data-element=CPT_APPCOM_SWC.CPT_MCU_Composition.MCUM_0x5D3.MCUM_HWDrvUV_RstCnt, system-signal=MCUM_HWDrvUV_RstCnt
        data-element=CPT_APPCOM_SWC.CPT_MCU_Composition.MCUM_0x5D3.MCUM_HWRdc_RstCnt, system-signal=MCUM_HWRdc_RstCnt
        data-element=CPT_APPCOM_SWC.CPT_MCU_Composition.MCUM_0x5D3.MCUM_HWOC_RstCnt, system-signal=MCUM_HWOC_RstCnt
        data-element=CPT_APPCOM_SWC.CPT_MCU_Composition.MCUM_0x5D3.MCUM_HWOV_RstCnt, system-signal=MCUM_HWOV_RstCnt
        data-element=CPT_APPCOM_SWC.CPT_MCU_Composition.MCUM_0x5D3.MCUM_L2agRtrElecDiff, system-signal=MCUM_L2agRtrElecDiff
        data-element=CPT_APPCOM_SWC.CPT_MCU_Composition.MCUM_0x5D3.MCUM_500usOverTime_Cnt, system-signal=MCUM_500usOverTime_Cnt
        data-element=CPT_APPCOM_SWC.CPT_MCU_Composition.MCUM_0x5D3.MCUM_5msOverTime_Cnt, system-signal=MCUM_5msOverTime_Cnt
        data-element=CPT_APPCOM_SWC.CPT_MCU_Composition.MCUM_0x5D3.MCUM_12VHop_Cnt, system-signal=MCUM_12VHop_Cnt
        data-element=CPT_APPCOM_SWC.CPT_MCU_Composition.MCUM_0x5D3.MCUM_12V_Max, system-signal=MCUM_12V_Max
        data-element=CPT_APPCOM_SWC.CPT_MCU_Composition.MCUM_0x5D3.MCUM_12V_Min, system-signal=MCUM_12V_Min
        data-element=CPT_APPCOM_SWC.CPT_MCU_Composition.MCUM_0x5D3.MCUM_NVMFail_Cnt, system-signal=MCUM_NVMFail_Cnt
        data-element=CPT_APPCOM_SWC.CPT_MCU_Composition.MCUM_0x5D3.MCUM_EOL_CANCommReq, system-signal=MCUM_EOL_CANCommReq
        data-element=CPT_APPCOM_SWC.CPT_MCU_Composition.MCUM_0x5D3.MCUM_ResetReason, system-signal=MCUM_ResetReason
        data-element=CPT_APPCOM_SWC.CPT_MCU_Composition.MCUM_0x5D3.MCUM_CpldRest_TimeOut_flag, system-signal=MCUM_CpldRest_TimeOut_flag
        data-element=CPT_APPCOM_SWC.CPT_MCU_Composition.MCUM_0x5D3.MCUM_DrvPCBCurr, system-signal=MCUM_DrvPCBCurr
        data-element=CPT_APPCOM_SWC.CPT_MCU_Composition.MCUM_0x5D3.MCUM_EOL_StateMachine, system-signal=MCUM_EOL_StateMachine
        data-element=CPT_APPCOM_SWC.CPT_MCU_Composition.MCUM_0x5D3.MCUM_CpldRest_ASC_Flag, system-signal=MCUM_CpldRest_ASC_Flag
        data-element=CPT_APPCOM_SWC.CPT_MCU_Composition.MCUM_0x5D3.MCUM_LimSpdTorFlag, system-signal=MCUM_LimSpdTorFlag
        data-element=CPT_APPCOM_SWC.CPT_MCU_Composition.MCUM_0x5D3.MCUM_PWM_Err_Count, system-signal=MCUM_PWM_Err_Count
        data-element=CPT_APPCOM_SWC.CPT_MCU_Composition.MCUM_0x5D3.MCUM_RDC_Reset_Count, system-signal=MCUM_RDC_Reset_Count
        data-element=CPT_APPCOM_SWC.CPT_MCU_Composition.MCUM_0x5D3.MCUM_ASC_Stop_Flag, system-signal=MCUM_ASC_Stop_Flag
        data-element=CPT_APPCOM_SWC.CPT_MCU_Composition.MCUM_0x5D3.MCUM_ASC_Soft_Exiting_Flag, system-signal=MCUM_ASC_Soft_Exiting_Flag
        data-element=CPT_APPCOM_SWC.CPT_MCU_Composition.MCUM_0x5D3.MCUM_Vbus_ServeLowChkEn, system-signal=MCUM_Vbus_ServeLowChkEn
        data-element=CPT_APPCOM_SWC.CPT_MCU_Composition.MCUM_0x5D3.MCUM_EOP_BlockErr_IsLim_Flag, system-signal=MCUM_EOP_BlockErr_IsLim_Flag
        data-element=CPT_APPCOM_SWC.CPT_MCU_Composition.MCUM_0x5D3.MCUM_MotSelfHeat_EnSts, system-signal=MCUM_MotSelfHeat_EnSts
        data-element=CPT_APPCOM_SWC.CPT_MCU_Composition.MCUM_0x5D3.MCUM_MotBlockHeat_LvlFb, system-signal=MCUM_MotBlockHeat_LvlFb
        data-element=CPT_APPCOM_SWC.CPT_MCU_Composition.MCUM_0x5D3.MCUM_MotRotaryHeat_LvlFb, system-signal=MCUM_MotRotaryHeat_LvlFb
        data-element=CPT_APPCOM_SWC.CPT_MCU_Composition.MCUM_0x5D3.MCUM_MotSelfHeat_DropLvlFb, system-signal=MCUM_MotSelfHeat_DropLvlFb
        data-element=CPT_APPCOM_SWC.CPT_MCU_Composition.MCUM_0x5D3.MCUM_MotSelfHeat_DropLvlRsn, system-signal=MCUM_MotSelfHeat_DropLvlRsn
        data-element=CPT_APPCOM_SWC.CPT_MCU_Composition.MCUM_0x5D3.MCUM_MotBlockHeat_CurAngle, system-signal=MCUM_MotBlockHeat_CurAngle
        data-element=CPT_APPCOM_SWC.CPT_MCU_Composition.MCUM_0x5D3.MCUM_MotBlockHeat_CurMag, system-signal=MCUM_MotBlockHeat_CurMag
        data-element=CPT_APPCOM_SWC.CPT_MCU_Composition.MCUM_0x5D3.MCUM_FaultDataRec_State, system-signal=MCUM_FaultDataRec_State
        data-element=CPT_APPCOM_SWC.CPT_MCU_Composition.MCUM_0x5D3.MCUM_UserDefine_Byte{1..4}, system-signal=MCUM_UserDefine_Byte{1..4}
        data-element=CPT_APPCOM_SWC.CPT_MCU_Composition.MCUM_0x5D3.MCUM_UserDefine_Word{1..3}, system-signal=MCUM_UserDefine_Word{1..3}
        data-element=CPT_APPCOM_SWC.CPT_MCU_Composition.ECM_0x5EC.ECM_EngineWorktime, system-signal=ECM_EngineWorktime
        data-element=CPT_APPCOM_SWC.CPT_MCU_Composition.MCU_0x5CB.GTC_TestSts, system-signal=GTC_TestSts
        data-element=CPT_APPCOM_SWC.CPT_MCU_Composition.MCU_0x5CB.GTC_ThetaPos, system-signal=GTC_ThetaPos
        data-element=CPT_APPCOM_SWC.CPT_MCU_Composition.MCU_0x5CB.GTC_ThetaNeg, system-signal=GTC_ThetaNeg
        data-element=CPT_APPCOM_SWC.CPT_MCU_Composition.MCU_0x5CB.GTC_ThetaDelt, system-signal=GTC_ThetaDelt
        data-element=CPT_APPCOM_SWC.CPT_MCU_Composition.MCU_0x5CB.GTC_TestRslt, system-signal=GTC_TestRslt
        data-element=CPT_APPCOM_SWC.CPT_MCU_Composition.MCU_0x5CB.MCUMR_GTC_TestSts, system-signal=MCUMR_GTC_TestSts
        data-element=CPT_APPCOM_SWC.CPT_MCU_Composition.MCU_0x5CB.MCUMR_GTC_ThetaPos, system-signal=MCUMR_GTC_ThetaPos
        data-element=CPT_APPCOM_SWC.CPT_MCU_Composition.MCU_0x5CB.MCUMR_GTC_ThetaNeg, system-signal=MCUMR_GTC_ThetaNeg
        data-element=CPT_APPCOM_SWC.CPT_MCU_Composition.MCU_0x5CB.MCUMR_GTC_ThetaDelt, system-signal=MCUMR_GTC_ThetaDelt
        data-element=CPT_APPCOM_SWC.CPT_MCU_Composition.MCU_0x5CB.MCUMR_GTC_TestRslt, system-signal=MCUMR_GTC_TestRslt
        data-element=CPT_APPCOM_SWC.CPT_MCU_Composition.MCUM_0xCA.MCUM_CRC_CA, system-signal=MCUM_CRC_CA
        data-element=CPT_APPCOM_SWC.CPT_MCU_Composition.MCUM_0xCA.MCUM_RollingCounter_CA, system-signal=MCUM_RollingCounter_CA
        data-element=CPT_APPCOM_SWC.CPT_MCU_Composition.MCUM_0xCA.MCUM_WarningLevel, system-signal=MCUM_WarningLevel
        data-element=CPT_APPCOM_SWC.CPT_MCU_Composition.MCUM_0xCA.MCUM_SelfCheckSts, system-signal=MCUM_SelfCheckSts
        data-element=CPT_APPCOM_SWC.CPT_MCU_Composition.MCUM_0xCA.MCUM_DrvMotorWorkSts, system-signal=MCUM_DrvMotorWorkSts
        data-element=CPT_APPCOM_SWC.CPT_MCU_Composition.MCUM_0xCA.MCUM_PowerReduceSts, system-signal=MCUM_PowerReduceSts
        data-element=CPT_APPCOM_SWC.CPT_MCU_Composition.MCUM_0xCA.MCUM_SystemError, system-signal=MCUM_SystemError
        data-element=CPT_APPCOM_SWC.CPT_MCU_Composition.MCUM_0xCA.MCUM_DrvMotorRPM, system-signal=MCUM_DrvMotorRPM
        data-element=CPT_APPCOM_SWC.CPT_MCU_Composition.MCUM_0xCA.MCUM_ActualTorqueFB, system-signal=MCUM_ActualTorqueFB
        data-element=CPT_APPCOM_SWC.CPT_MCU_Composition.MCUM_0xCA.MCUM_HWRdcFault, system-signal=MCUM_HWRdcFault
        data-element=CPT_APPCOM_SWC.CPT_MCU_Composition.MCUM_0xCA.MCUM_LVSystemError, system-signal=MCUM_LVSystemError
        data-element=CPT_APPCOM_SWC.CPT_MCU_Composition.MCUM_0xCA.MCUM_HighVoltPowerOffReq, system-signal=MCUM_HighVoltPowerOffReq
        data-element=CPT_APPCOM_SWC.CPT_MCU_Composition.MCUM_0xCA.MCUM_HVILSts, system-signal=MCUM_HVILSts
        data-element=CPT_APPCOM_SWC.CPT_MCU_Composition.MCUM_0xCA.MCUM_DragSts, system-signal=MCUM_DragSts
        data-element=CPT_APPCOM_SWC.CPT_MCU_Composition.MCUM_0xCA.MCUM_CtrlMode, system-signal=MCUM_CtrlMode
        data-element=CPT_APPCOM_SWC.CPT_MCU_Composition.MCUM_0xCA.MCUM_MotorTempAlarm, system-signal=MCUM_MotorTempAlarm
        data-element=CPT_APPCOM_SWC.CPT_MCU_Composition.MCUM_0xCA.MCUM_HVSystemError, system-signal=MCUM_HVSystemError
        data-element=CPT_APPCOM_SWC.CPT_MCU_Composition.MCUM_0xCA.MCUM_MILlampReq, system-signal=MCUM_MILlampReq
        data-element=CPT_APPCOM_SWC.CPT_MCU_Composition.MCUM_0xCA.MCUM_SeriousWarning_Level, system-signal=MCUM_SeriousWarning_Level
        data-element=CPT_APPCOM_SWC.CPT_MCU_Composition.MCUM_0xCA.MCUM_DrvMotorRPMVD, system-signal=MCUM_DrvMotorRPMVD
        data-element=CPT_APPCOM_SWC.CPT_MCU_Composition.MCUM_0xCA.MCUM_ActualTorqueFBVD, system-signal=MCUM_ActualTorqueFBVD
        data-element=CPT_APPCOM_SWC.CPT_MCU_Composition.MCUM_0xCA.MCUM_CtrlModeVD, system-signal=MCUM_CtrlModeVD
        data-element=CPT_APPCOM_SWC.CPT_MCU_Composition.MCUM_0xCA.MCUM_MaxTorqueAllow, system-signal=MCUM_MaxTorqueAllow
        data-element=CPT_APPCOM_SWC.CPT_MCU_Composition.MCUM_0xCA.MCUM_MaxSpeedAllow, system-signal=MCUM_MaxSpeedAllow
        data-element=CPT_APPCOM_SWC.CPT_MCU_Composition.MCUM_0xCA.MCUM_WaterPumpLevlReq, system-signal=MCUM_WaterPumpLevlReq
        data-element=CPT_APPCOM_SWC.CPT_MCU_Composition.MCUM_0xCA.MCUM_ActiveReleaseSts, system-signal=MCUM_ActiveReleaseSts
        data-element=CPT_APPCOM_SWC.CPT_MCU_Composition.MCUM_0xCA.MCUM_DCChargRelaySts, system-signal=MCUM_DCChargRelaySts
        data-element=CPT_APPCOM_SWC.CPT_MCU_Composition.MCUM_0xCA.MCUM_Fault_DCChargRelay, system-signal=MCUM_Fault_DCChargRelay
        data-element=CPT_APPCOM_SWC.CPT_MCU_Composition.MCUM_0xCA.MCUM_MinTorqueAllow, system-signal=MCUM_MinTorqueAllow
        data-element=CPT_APPCOM_SWC.CPT_MCU_Composition.MCUM_0xCA.MCUM_MainWireVolt, system-signal=MCUM_MainWireVolt
        data-element=CPT_APPCOM_SWC.CPT_MCU_Composition.MCUM_0xCA.MCUM_MotorTemp, system-signal=MCUM_MotorTemp
        data-element=CPT_APPCOM_SWC.CPT_MCU_Composition.MCUM_0xCA.MCUM_IGBTTemp, system-signal=MCUM_IGBTTemp
        data-element=CPT_APPCOM_SWC.CPT_MCU_Composition.MCUM_0xCA.MCUM_InletTemp, system-signal=MCUM_InletTemp
        data-element=CPT_APPCOM_SWC.CPT_MCU_Composition.MCUM_0xCA.MCUM_MainWireCurr, system-signal=MCUM_MainWireCurr
        data-element=CPT_APPCOM_SWC.CPT_MCU_Composition.MCUM_0xCA.MCUM_TMS_MotSelfHeatEnSts, system-signal=MCUM_TMS_MotSelfHeatEnSts
        data-element=CPT_APPCOM_SWC.CPT_MCU_Composition.MCUM_0xCA.MCUM_TMS_MotSelfHeatLvlFb, system-signal=MCUM_TMS_MotSelfHeatLvlFb
        data-element=CPT_APPCOM_SWC.CPT_MCU_Composition.MCUM_0xCA.MCUM_HeatPwrAllwd, system-signal=MCUM_HeatPwrAllwd
        data-element=CPT_APPCOM_SWC.CPT_MCU_Composition.MCUM_0xCA.MCUM_HeatFdBck, system-signal=MCUM_HeatFdBck
        data-element=CPT_APPCOM_SWC.CPT_MCU_Composition.MCUM_0xCA.MCUM_RPowerReduceSts, system-signal=MCUM_RPowerReduceSts
        data-element=CPT_APPCOM_SWC.CPT_MCU_Composition.MCUM_0xCA.MCUM_HeatPwrAct, system-signal=MCUM_HeatPwrAct
        data-element=CPT_APPCOM_SWC.CPT_MCU_Composition.MCUM_0xCA.MCUM_HeatPwrMax, system-signal=MCUM_HeatPwrMax
        data-element=CPT_APPCOM_SWC.CPT_MCU_Composition.MCUM_0xCA.MCUM_HeatPwrAval, system-signal=MCUM_HeatPwrAval
        data-element=CPT_APPCOM_SWC.CPT_MCU_Composition.MCUM_0xCA.MCUM_RCtrlMode, system-signal=MCUM_RCtrlMode
        data-element=CPT_APPCOM_SWC.CPT_MCU_Composition.MCUM_0xCA.MCUM_RWarningLevel, system-signal=MCUM_RWarningLevel
        data-element=CPT_APPCOM_SWC.CPT_MCU_Composition.MCUM_0xCA.MCUM_RSelfCheckSts, system-signal=MCUM_RSelfCheckSts
        data-element=CPT_APPCOM_SWC.CPT_MCU_Composition.MCUM_0xCA.MCUM_RDrvMotorWorkSts, system-signal=MCUM_RDrvMotorWorkSts
        data-element=CPT_APPCOM_SWC.CPT_MCU_Composition.MCUM_0xCA.MCUM_RCtrlModeVD, system-signal=MCUM_RCtrlModeVD
        data-element=CPT_APPCOM_SWC.CPT_MCU_Composition.MCUM_0xCA.MCUM_RHWRdcFault, system-signal=MCUM_RHWRdcFault
        data-element=CPT_APPCOM_SWC.CPT_MCU_Composition.MCUM_0xCA.MCUM_RDrvMotorRPMVD, system-signal=MCUM_RDrvMotorRPMVD
        data-element=CPT_APPCOM_SWC.CPT_MCU_Composition.MCUM_0xCA.MCUM_RActualTorqueFBVD, system-signal=MCUM_RActualTorqueFBVD
        data-element=CPT_APPCOM_SWC.CPT_MCU_Composition.MCUM_0xCA.MCUM_RDrvMotorRPM, system-signal=MCUM_RDrvMotorRPM
        data-element=CPT_APPCOM_SWC.CPT_MCU_Composition.MCUM_0xCA.MCUM_RActualTorqueFB, system-signal=MCUM_RActualTorqueFB
        data-element=CPT_APPCOM_SWC.CPT_MCU_Composition.IBC_0x182.IBC_CRC_182, system-signal=IBC_CRC_182
        data-element=CPT_APPCOM_SWC.CPT_MCU_Composition.IBC_0x182.IBC_RollingCounter_182, system-signal=IBC_RollingCounter_182
        data-element=CPT_APPCOM_SWC.CPT_MCU_Composition.IBC_0x182.IBC_VehicleSpeed, system-signal=IBC_VehicleSpeed
        data-element=CPT_APPCOM_SWC.CPT_MCU_Composition.IBC_0x182.IBC_VehicleSpeedVD, system-signal=IBC_VehicleSpeedVD
        data-element=CPT_APPCOM_SWC.CPT_MCU_Composition.IBC_0x182.IBC_ABSActive, system-signal=IBC_ABSActive
        data-element=CPT_APPCOM_SWC.CPT_MCU_Composition.IBC_0x182.IBC_ABSFailed, system-signal=IBC_ABSFailed
        data-element=CPT_APPCOM_SWC.CPT_MCU_Composition.IBC_0x182.IBC_TCSActive, system-signal=IBC_TCSActive
        data-element=CPT_APPCOM_SWC.CPT_MCU_Composition.IBC_0x182.IBC_TCSFailed, system-signal=IBC_TCSFailed
        data-element=CPT_APPCOM_SWC.CPT_MCU_Composition.IBC_0x182.IBC_ESCFunctionStatus, system-signal=IBC_ESCFunctionStatus
        data-element=CPT_APPCOM_SWC.CPT_MCU_Composition.IBC_0x182.IBC_BrakeForce, system-signal=IBC_BrakeForce
        data-element=CPT_APPCOM_SWC.CPT_MCU_Composition.IBC_0x182.IBC_Vehiclestandstill, system-signal=IBC_Vehiclestandstill
        data-element=CPT_APPCOM_SWC.CPT_MCU_Composition.IBC_0x182.IBC_EBDFailed, system-signal=IBC_EBDFailed
        data-element=CPT_APPCOM_SWC.CPT_MCU_Composition.IBC_0x182.IBC_EBDActive, system-signal=IBC_EBDActive
        data-element=CPT_APPCOM_SWC.CPT_MCU_Composition.IBC_0x182.IBC_VDCActive, system-signal=IBC_VDCActive
        data-element=CPT_APPCOM_SWC.CPT_MCU_Composition.IBC_0x182.IBC_VDCFailed, system-signal=IBC_VDCFailed
        data-element=CPT_APPCOM_SWC.CPT_MCU_Composition.IBC_0x182.IBC_EDCActive, system-signal=IBC_EDCActive
        data-element=CPT_APPCOM_SWC.CPT_MCU_Composition.IBC_0x182.IBC_EDCFailed, system-signal=IBC_EDCFailed
        data-element=CPT_APPCOM_SWC.CPT_MCU_Composition.IBC_0x182.IBC_SystemInitializeStatus, system-signal=IBC_SystemInitializeStatus
        data-element=CPT_APPCOM_SWC.CPT_MCU_Composition.IBC_0x182.IBC_BTCSActive, system-signal=IBC_BTCSActive
        data-element=CPT_APPCOM_SWC.CPT_MCU_Composition.IBC_0x182.IBC_ETCSActive, system-signal=IBC_ETCSActive
        data-element=CPT_APPCOM_SWC.CPT_MCU_Composition.IBC_0x182.IBC_ARPActive, system-signal=IBC_ARPActive
        data-element=CPT_APPCOM_SWC.CPT_MCU_Composition.IBC_0x182.IBC_VCU_DrumMode, system-signal=IBC_VCU_DrumMode
        data-element=CPT_APPCOM_SWC.CPT_MCU_Composition.IBC_0x182.IBC_EscapeModeSts, system-signal=IBC_EscapeModeSts
        data-element=CPT_APPCOM_SWC.CPT_MCU_Composition.IBC_0x182.IBC_TSAActive, system-signal=IBC_TSAActive
        data-element=CPT_APPCOM_SWC.CPT_MCU_Composition.IBC_0x182.IBC_TSAStatus, system-signal=IBC_TSAStatus
        data-element=CPT_APPCOM_SWC.CPT_MCU_Composition.MCUM_0x605.MCUM_FaultData{0..14}, system-signal=MCUM_FaultData{0..14}
        data-element=CPT_APPCOM_SWC.CPT_MCU_Composition.MCUM_0x607.MCUM_R_FaultData{0..14}, system-signal=MCUM_R_FaultData{0..14}
        data-element=CPT_APPCOM_SWC.CPT_MCU_Composition.ICU_0x24D.ICU_CRC_24D, system-signal=ICU_CRC_24D
        data-element=CPT_APPCOM_SWC.CPT_MCU_Composition.ICU_0x24D.ICU_SpeedConversionCoefficient, system-signal=ICU_SpeedConversionCoefficient
        data-element=CPT_APPCOM_SWC.CPT_MCU_Composition.ICU_0x24D.ICU_RollingCounter_24D, system-signal=ICU_RollingCounter_24D
        data-element=CPT_APPCOM_SWC.CPT_MCU_Composition.ICU_0x24D.ICU_CCSFunctionStatus, system-signal=ICU_CCSFunctionStatus
        data-element=CPT_APPCOM_SWC.CPT_MCU_Composition.ICU_0x24D.ICU_CruiseVehicleSpeedCtl, system-signal=ICU_CruiseVehicleSpeedCtl
        data-element=CPT_APPCOM_SWC.CPT_MCU_Composition.ICU_0x24D.ICU_VehicleScreenSpeed, system-signal=ICU_VehicleScreenSpeed
        data-element=CPT_APPCOM_SWC.CPT_MCU_Composition.ICU_0x24D.ICU_VehicleSpeedUnit, system-signal=ICU_VehicleSpeedUnit
        data-element=CPT_APPCOM_SWC.CPT_MCU_Composition.ICU_0x24D.ICU_ACCFunctionStatus, system-signal=ICU_ACCFunctionStatus
        data-element=CPT_APPCOM_SWC.CPT_MCU_Composition.ICU_0x24D.ICU_LCCFunctionStatus, system-signal=ICU_LCCFunctionStatus
        data-element=CPT_APPCOM_SWC.CPT_MCU_Composition.ICU_0x24D.IVI_LPedalMode, system-signal=IVI_LPedalMode
        data-element=CPT_APPCOM_SWC.CPT_MCU_Composition.ICU_0x249.ICU_TotalOilmeterkm, system-signal=ICU_TotalOilmeterkm
        data-element=CPT_APPCOM_SWC.CPT_MCU_Composition.ICU_0x249.ICU_CLTCoilMileage, system-signal=ICU_CLTCoilMileage
        data-element=CPT_APPCOM_SWC.CPT_MCU_Composition.ICU_0x249.ICU_WLTC_oilMileage, system-signal=ICU_WLTC_oilMileage
        data-element=CPT_APPCOM_SWC.CPT_MCU_Composition.ICU_0x249.ICU_CLTC_ElectticityMileage, system-signal=ICU_CLTC_ElectticityMileage
        data-element=CPT_APPCOM_SWC.CPT_MCU_Composition.ICU_0x249.ICU_WLTC_ElectticityMileage, system-signal=ICU_WLTC_ElectticityMileage
        data-element=CPT_APPCOM_SWC.CPT_MCU_Composition.ICU_0x249.ICU_Switch_CLTCOrWLTC, system-signal=ICU_Switch_CLTCOrWLTC
        data-element=CPT_APPCOM_SWC.CPT_MCU_Composition.ICU_0x249.ICU_FuelPercent, system-signal=ICU_FuelPercent
        data-element=CPT_APPCOM_SWC.CPT_MCU_Composition.ACU_0x233.ACU_CRC_233, system-signal=ACU_CRC_233
        data-element=CPT_APPCOM_SWC.CPT_MCU_Composition.ACU_0x233.ACU_RollingCounter_233, system-signal=ACU_RollingCounter_233
        data-element=CPT_APPCOM_SWC.CPT_MCU_Composition.ACU_0x233.ACU_LateralAcce, system-signal=ACU_LateralAcce
        data-element=CPT_APPCOM_SWC.CPT_MCU_Composition.ACU_0x233.ACU_LongitAcce, system-signal=ACU_LongitAcce
        data-element=CPT_APPCOM_SWC.CPT_MCU_Composition.ACU_0x233.ACU_LateralAcceValid, system-signal=ACU_LateralAcceValid
        data-element=CPT_APPCOM_SWC.CPT_MCU_Composition.ACU_0x233.ACU_LongitAcceValid, system-signal=ACU_LongitAcceValid
        data-element=CPT_APPCOM_SWC.CPT_MCU_Composition.ACU_0x233.ACU_SensorCalSt, system-signal=ACU_SensorCalSt
        data-element=CPT_APPCOM_SWC.CPT_MCU_Composition.ACU_0x233.ACU_YawRate, system-signal=ACU_YawRate
        data-element=CPT_APPCOM_SWC.CPT_MCU_Composition.ACU_0x233.ACU_YawRateValid, system-signal=ACU_YawRateValid
        data-element=CPT_APPCOM_SWC.CPT_MCU_Composition.MCU_0x5C4.MotClb_UdFb, system-signal=MotClb_UdFb
        data-element=CPT_APPCOM_SWC.CPT_MCU_Composition.MCU_0x5C4.MotClb_UqFb, system-signal=MotClb_UqFb
        data-element=CPT_APPCOM_SWC.CPT_MCU_Composition.MCU_0x5C4.MotClb_IdSet, system-signal=MotClb_IdSet
        data-element=CPT_APPCOM_SWC.CPT_MCU_Composition.MCU_0x5C4.MotClb_IqSet, system-signal=MotClb_IqSet
        data-element=CPT_APPCOM_SWC.CPT_MCU_Composition.MCU_0x5C4.MotClb_IsCMD_Fb, system-signal=MotClb_IsCMD_Fb
        data-element=CPT_APPCOM_SWC.CPT_MCU_Composition.MCU_0x5C4.MotClb_ThetaCMD_Fb, system-signal=MotClb_ThetaCMD_Fb
        data-element=CPT_APPCOM_SWC.CPT_MCU_Composition.MCU_0x5C4.MotClb_Id_Fb, system-signal=MotClb_Id_Fb
        data-element=CPT_APPCOM_SWC.CPT_MCU_Composition.MCU_0x5C4.MotClb_Iq_Fb, system-signal=MotClb_Iq_Fb
        data-element=CPT_APPCOM_SWC.CPT_MCU_Composition.MCU_0x5C4.MotClb_Spd_rpm_Flt, system-signal=MotClb_Spd_rpm_Flt
        data-element=CPT_APPCOM_SWC.CPT_MCU_Composition.MCU_0x5C4.MotClb_ThtSetReal, system-signal=MotClb_ThtSetReal
        data-element=CPT_APPCOM_SWC.CPT_MCU_Composition.MCU_0x5C4.MotClb_Power_Inverter, system-signal=MotClb_Power_Inverter
        data-element=CPT_APPCOM_SWC.CPT_MCU_Composition.MCU_0x5C4.MotClb_Volt_DC, system-signal=MotClb_Volt_DC
        data-element=CPT_APPCOM_SWC.CPT_MCU_Composition.MCU_0x5C4.MotClb_UsOutFlt, system-signal=MotClb_UsOutFlt
        data-element=CPT_APPCOM_SWC.CPT_MCU_Composition.MCU_0x5C4.MotClb_CoolWater_Temp, system-signal=MotClb_CoolWater_Temp
        data-element=CPT_APPCOM_SWC.CPT_MCU_Composition.MCU_0x5C4.MotClb_Motor_Temp1_Flt, system-signal=MotClb_Motor_Temp1_Flt
        data-element=CPT_APPCOM_SWC.CPT_MCU_Composition.MCU_0x5C4.MotClb_IGBT_Temp1, system-signal=MotClb_IGBT_Temp1
        data-element=CPT_APPCOM_SWC.CPT_MCU_Composition.MCU_0x5C4.MotClb_ErrLevel, system-signal=MotClb_ErrLevel
        data-element=CPT_APPCOM_SWC.CPT_MCU_Composition.BMS_0x1A1.BMS_CRC_1A1, system-signal=BMS_CRC_1A1
        data-element=CPT_APPCOM_SWC.CPT_MCU_Composition.MCU_0x5C4.MCUMR_MotClb_UdFb, system-signal=MCUMR_MotClb_UdFb
        data-element=CPT_APPCOM_SWC.CPT_MCU_Composition.MCU_0x5C4.MCUMR_MotClb_UqFb, system-signal=MCUMR_MotClb_UqFb
        data-element=CPT_APPCOM_SWC.CPT_MCU_Composition.MCU_0x5C4.MCUMR_MotClb_IdSet, system-signal=MCUMR_MotClb_IdSet
        data-element=CPT_APPCOM_SWC.CPT_MCU_Composition.MCU_0x5C4.MCUMR_MotClb_IqSet, system-signal=MCUMR_MotClb_IqSet
        data-element=CPT_APPCOM_SWC.CPT_MCU_Composition.MCU_0x5C4.MCUMR_MotClb_IsCMD_Fb, system-signal=MCUMR_MotClb_IsCMD_Fb
        data-element=CPT_APPCOM_SWC.CPT_MCU_Composition.MCU_0x5C4.MCUMR_MotClb_ThetaCMD_Fb, system-signal=MCUMR_MotClb_ThetaCMD_Fb
        data-element=CPT_APPCOM_SWC.CPT_MCU_Composition.MCU_0x5C4.MCUMR_MotClb_Id_Fb, system-signal=MCUMR_MotClb_Id_Fb
        data-element=CPT_APPCOM_SWC.CPT_MCU_Composition.MCU_0x5C4.MCUMR_MotClb_Iq_Fb, system-signal=MCUMR_MotClb_Iq_Fb
        data-element=CPT_APPCOM_SWC.CPT_MCU_Composition.MCU_0x5C4.MCUMR_MotClb_Spd_rpm_Flt, system-signal=MCUMR_MotClb_Spd_rpm_Flt
        data-element=CPT_APPCOM_SWC.CPT_MCU_Composition.MCU_0x5C4.MCUMR_MotClb_ThtSetReal, system-signal=MCUMR_MotClb_ThtSetReal
        data-element=CPT_APPCOM_SWC.CPT_MCU_Composition.MCU_0x5C4.MCUMR_MotClb_Power_Inverter, system-signal=MCUMR_MotClb_Power_Inverter
        data-element=CPT_APPCOM_SWC.CPT_MCU_Composition.MCU_0x5C4.MCUMR_MotClb_Volt_DC, system-signal=MCUMR_MotClb_Volt_DC
        data-element=CPT_APPCOM_SWC.CPT_MCU_Composition.MCU_0x5C4.MCUMR_MotClb_UsOutFlt, system-signal=MCUMR_MotClb_UsOutFlt
        data-element=CPT_APPCOM_SWC.CPT_MCU_Composition.MCU_0x5C4.MCUMR_MotClb_CoolWater_Temp, system-signal=MCUMR_MotClb_CoolWater_Temp
        data-element=CPT_APPCOM_SWC.CPT_MCU_Composition.MCU_0x5C4.MCUMR_MotClb_Motor_Temp1_Flt, system-signal=MCUMR_MotClb_Motor_Temp1_Flt
        data-element=CPT_APPCOM_SWC.CPT_MCU_Composition.MCU_0x5C4.MCUMR_MotClb_IGBT_Temp1, system-signal=MCUMR_MotClb_IGBT_Temp1
        data-element=CPT_APPCOM_SWC.CPT_MCU_Composition.MCU_0x5C4.MCUMR_MotClb_ErrLevel, system-signal=MCUMR_MotClb_ErrLevel
        data-element=CPT_APPCOM_SWC.CPT_MCU_Composition.BMS_0x1A1.BMS_RollingCounter_1A1, system-signal=BMS_RollingCounter_1A1
        data-element=CPT_APPCOM_SWC.CPT_MCU_Composition.BMS_0x1A1.BMS_Warning_Level, system-signal=BMS_Warning_Level
        data-element=CPT_APPCOM_SWC.CPT_MCU_Composition.BMS_0x1A1.BMS_SelfCheck, system-signal=BMS_SelfCheck
        data-element=CPT_APPCOM_SWC.CPT_MCU_Composition.BMS_0x1A1.BMS_BattChargerSts, system-signal=BMS_BattChargerSts
        data-element=CPT_APPCOM_SWC.CPT_MCU_Composition.BMS_0x1A1.BMS_RHighVolSts, system-signal=BMS_RHighVolSts
        data-element=CPT_APPCOM_SWC.CPT_MCU_Composition.BMS_0x1A1.BMS_RPreChargeRelayFB, system-signal=BMS_RPreChargeRelayFB
        data-element=CPT_APPCOM_SWC.CPT_MCU_Composition.BMS_0x1A1.BMS_RPositiveRelayFB, system-signal=BMS_RPositiveRelayFB
        data-element=CPT_APPCOM_SWC.CPT_MCU_Composition.BMS_0x1A1.BMS_RNegativeRelayFB, system-signal=BMS_RNegativeRelayFB
        data-element=CPT_APPCOM_SWC.CPT_MCU_Composition.BMS_0x1A1.BMS_RPositiveRelay_F, system-signal=BMS_RPositiveRelay_F
        data-element=CPT_APPCOM_SWC.CPT_MCU_Composition.BMS_0x1A1.BMS_RNegativeRelay_F, system-signal=BMS_RNegativeRelay_F
        data-element=CPT_APPCOM_SWC.CPT_MCU_Composition.BMS_0x1A1.BMS_RPreChargeFinishSts, system-signal=BMS_RPreChargeFinishSts
        data-element=CPT_APPCOM_SWC.CPT_MCU_Composition.BMS_0x1A1.BMS_MCUMHVILSts, system-signal=BMS_MCUMHVILSts
        data-element=CPT_APPCOM_SWC.CPT_MCU_Composition.BMS_0x1A1.BMS_ACPTCHVILSts, system-signal=BMS_ACPTCHVILSts
        data-element=CPT_APPCOM_SWC.CPT_MCU_Composition.BMS_0x1A1.BMS_PTCHVILSts, system-signal=BMS_PTCHVILSts
        data-element=CPT_APPCOM_SWC.CPT_MCU_Composition.BMS_0x1A1.BMS_CCMHVILSts, system-signal=BMS_CCMHVILSts
        data-element=CPT_APPCOM_SWC.CPT_MCU_Composition.BMS_0x1A1.BMS_CDUHVILSts, system-signal=BMS_CDUHVILSts
        data-element=CPT_APPCOM_SWC.CPT_MCU_Composition.BMS_0x1A1.BMS_DCChgHVILSts, system-signal=BMS_DCChgHVILSts
        data-element=CPT_APPCOM_SWC.CPT_MCU_Composition.BMS_0x1A1.BMS_MCUSHVILSts, system-signal=BMS_MCUSHVILSts
        data-element=CPT_APPCOM_SWC.CPT_MCU_Composition.BMS_0x1A1.BMS_HVOffSts, system-signal=BMS_HVOffSts
        data-element=CPT_APPCOM_SWC.CPT_MCU_Composition.BMS_0x1A1.BMS_SeriousWarning_Level, system-signal=BMS_SeriousWarning_Level
        data-element=CPT_APPCOM_SWC.CPT_MCU_Composition.BMS_0x1A1.BMS_DCChgRelayCloseReq, system-signal=BMS_DCChgRelayCloseReq
        data-element=CPT_APPCOM_SWC.CPT_MCU_Composition.BMS_0x1A1.BMS_DCChgRelayFB, system-signal=BMS_DCChgRelayFB
        data-element=CPT_APPCOM_SWC.CPT_MCU_Composition.BMS_0x1A1.BMS_ChgStopReason, system-signal=BMS_ChgStopReason
        data-element=CPT_APPCOM_SWC.CPT_MCU_Composition.BMS_0x1A1.BMS_GCUHVILSts, system-signal=BMS_GCUHVILSts
        data-element=CPT_APPCOM_SWC.CPT_MCU_Composition.BMS_0x1A1.BMS_MILlampReq, system-signal=BMS_MILlampReq
        data-element=CPT_APPCOM_SWC.CPT_MCU_Composition.BMS_0x1A1.BMS_IsoRessistanceSts, system-signal=BMS_IsoRessistanceSts
        data-element=CPT_APPCOM_SWC.CPT_MCU_Composition.BMS_0x1A1.BMS_Integrity_Check, system-signal=BMS_Integrity_Check
        data-element=CPT_APPCOM_SWC.CPT_MCU_Composition.BMS_0x1A1.BMS_BattVolt, system-signal=BMS_BattVolt
        data-element=CPT_APPCOM_SWC.CPT_MCU_Composition.BMS_0x1A1.BMS_BattCurr, system-signal=BMS_BattCurr
        data-element=CPT_APPCOM_SWC.CPT_MCU_Composition.BMS_0x1A1.BMS_BatDyn_Dchgpwr, system-signal=BMS_BatDyn_Dchgpwr
        data-element=CPT_APPCOM_SWC.CPT_MCU_Composition.BMS_0x1A1.BMS_BatDyn_Chgpwr, system-signal=BMS_BatDyn_Chgpwr
        data-element=CPT_APPCOM_SWC.CPT_MCU_Composition.BMS_0x1A1.BMS_Precharge_CoolingSts, system-signal=BMS_Precharge_CoolingSts
        data-element=CPT_APPCOM_SWC.CPT_MCU_Composition.IBC_0xB1.IBC_CRC_B1, system-signal=IBC_CRC_B1
        data-element=CPT_APPCOM_SWC.CPT_MCU_Composition.IBC_0xB1.IBC_RollingCounter_B1, system-signal=IBC_RollingCounter_B1
        data-element=CPT_APPCOM_SWC.CPT_MCU_Composition.IBC_0xB1.IBC_EngTorqDec_Main, system-signal=IBC_EngTorqDec_Main
        data-element=CPT_APPCOM_SWC.CPT_MCU_Composition.IBC_0xB1.IBC_EngTorqDecActive_Main, system-signal=IBC_EngTorqDecActive_Main
        data-element=CPT_APPCOM_SWC.CPT_MCU_Composition.IBC_0xB1.IBC_EngTorqInc_Main, system-signal=IBC_EngTorqInc_Main
        data-element=CPT_APPCOM_SWC.CPT_MCU_Composition.IBC_0xB1.IBC_EngTorqIncActive_Main, system-signal=IBC_EngTorqIncActive_Main
        data-element=CPT_APPCOM_SWC.CPT_MCU_Composition.IBC_0xB1.IBC_EngTorqDec_Sub, system-signal=IBC_EngTorqDec_Sub
        data-element=CPT_APPCOM_SWC.CPT_MCU_Composition.IBC_0xB1.IBC_EngTorqDecActive_Sub, system-signal=IBC_EngTorqDecActive_Sub
        data-element=CPT_APPCOM_SWC.CPT_MCU_Composition.IBC_0xB1.IBC_EngTorqInc_Sub, system-signal=IBC_EngTorqInc_Sub
        data-element=CPT_APPCOM_SWC.CPT_MCU_Composition.IBC_0xB1.IBC_EngTorqIncActive_Sub, system-signal=IBC_EngTorqIncActive_Sub
        data-element=CPT_APPCOM_SWC.CPT_MCU_Composition.IBC_0xB1.IBC_EngTorqDec_MainR, system-signal=IBC_EngTorqDec_MainR
        data-element=CPT_APPCOM_SWC.CPT_MCU_Composition.IBC_0xB1.IBC_EngTorqDecActive_MainR, system-signal=IBC_EngTorqDecActive_MainR
        data-element=CPT_APPCOM_SWC.CPT_MCU_Composition.IBC_0xB1.IBC_EngTorqInc_MainR, system-signal=IBC_EngTorqInc_MainR
        data-element=CPT_APPCOM_SWC.CPT_MCU_Composition.IBC_0xB1.IBC_EngTorqIncActive_MainR, system-signal=IBC_EngTorqIncActive_MainR
        data-element=CPT_APPCOM_SWC.CPT_MCU_Composition.ADDC_0x83.ADDC_CRC_83, system-signal=ADDC_CRC_83
        data-element=CPT_APPCOM_SWC.CPT_MCU_Composition.ADDC_0x83.ADDC_ACC_AVHReq, system-signal=ADDC_ACC_AVHReq
        data-element=CPT_APPCOM_SWC.CPT_MCU_Composition.ADDC_0x83.ADDC_ACC_HoldSts, system-signal=ADDC_ACC_HoldSts
        data-element=CPT_APPCOM_SWC.CPT_MCU_Composition.ADDC_0x83.ADDC_ACCTargetTrq, system-signal=ADDC_ACCTargetTrq
        data-element=CPT_APPCOM_SWC.CPT_MCU_Composition.ADDC_0x83.ADDC_ACCTargetTrqVD, system-signal=ADDC_ACCTargetTrqVD
        data-element=CPT_APPCOM_SWC.CPT_MCU_Composition.ADDC_0x83.ADDC_ACCTargetTrqBrkVD, system-signal=ADDC_ACCTargetTrqBrkVD
        data-element=CPT_APPCOM_SWC.CPT_MCU_Composition.ADDC_0x83.ADDC_ACCTargetTrqBrk, system-signal=ADDC_ACCTargetTrqBrk
        data-element=CPT_APPCOM_SWC.CPT_MCU_Composition.ADDC_0x83.ADDC_MAIWarnTrqCtrlFlg, system-signal=ADDC_MAIWarnTrqCtrlFlg
        data-element=CPT_APPCOM_SWC.CPT_MCU_Composition.ADDC_0x83.ADDC_RollingCounter_83, system-signal=ADDC_RollingCounter_83
        data-element=CPT_APPCOM_SWC.CPT_MCU_Composition.ADDC_0x83.ADDC_ACC_FunType, system-signal=ADDC_ACC_FunType
        data-element=CPT_APPCOM_SWC.CPT_MCU_Composition.ADDC_0x83.ADDC_ACCMode, system-signal=ADDC_ACCMode
        data-element=CPT_APPCOM_SWC.CPT_MCU_Composition.ADDC_0x83.ADDC_Driveoff_Request, system-signal=ADDC_Driveoff_Request
        data-element=CPT_APPCOM_SWC.CPT_MCU_Composition.ADDC_0x83.ADDC_DecToStop, system-signal=ADDC_DecToStop
        data-element=CPT_APPCOM_SWC.CPT_MCU_Composition.ADDC_0x83.ADDC_ACCAvailable, system-signal=ADDC_ACCAvailable
        data-element=CPT_APPCOM_SWC.CPT_MCU_Composition.ADDC_0x83.ADDC_ACCTargetAcc, system-signal=ADDC_ACCTargetAcc
        data-element=CPT_APPCOM_SWC.CPT_MCU_Composition.ADDC_0x83.ADDC_ACCTargetAccVD, system-signal=ADDC_ACCTargetAccVD
        data-element=CPT_APPCOM_SWC.CPT_MCU_Composition.ADDC_0x83.ADDC_ACC_RecordingPulse, system-signal=ADDC_ACC_RecordingPulse
        data-element=CPT_APPCOM_SWC.CPT_MCU_Composition.ADDC_0x83.ADDC_VehicleSpeedCtlVD, system-signal=ADDC_VehicleSpeedCtlVD
        data-element=CPT_APPCOM_SWC.CPT_MCU_Composition.ADDC_0x83.ADDC_VehicleSpeedCtl, system-signal=ADDC_VehicleSpeedCtl
        data-element=CPT_APPCOM_SWC.CPT_MCU_Composition.ADDC_0x83.ADDC_ACC_EPBReq, system-signal=ADDC_ACC_EPBReq
        data-element=CPT_APPCOM_SWC.CPT_MCU_Composition.ADDC_0x83.ADDC_ACC_VehicleDirectCtl, system-signal=ADDC_ACC_VehicleDirectCtl
        data-element=CPT_APPCOM_SWC.CPT_MCU_Composition.ADDC_0x83.ADDC_ACC_VehicleDirectCtlVD, system-signal=ADDC_ACC_VehicleDirectCtlVD
        data-element=CPT_APPCOM_SWC.CPT_MCU_Composition.ADDC_0x83.ADDC_AEBTargetDec, system-signal=ADDC_AEBTargetDec
        data-element=CPT_APPCOM_SWC.CPT_MCU_Composition.ADDC_0x83.ADDC_AEBDecCtrl, system-signal=ADDC_AEBDecCtrl
        data-element=CPT_APPCOM_SWC.CPT_MCU_Composition.ADDC_0x83.ADDC_AEBMode, system-signal=ADDC_AEBMode
        data-element=CPT_APPCOM_SWC.CPT_MCU_Composition.ADDC_0x83.ADDC_AEBAvailable, system-signal=ADDC_AEBAvailable
        data-element=CPT_APPCOM_SWC.CPT_MCU_Composition.ADDC_0x83.ADDC_ACC_VLCCtlReq, system-signal=ADDC_ACC_VLCCtlReq
        data-element=CPT_APPCOM_SWC.CPT_MCU_Composition.ADDC_0x83.ADDC_ACC_OvrdSts, system-signal=ADDC_ACC_OvrdSts
        data-element=CPT_APPCOM_SWC.CPT_MCU_Composition.ADDC_0x83.ADDC_RCTB_DecReq, system-signal=ADDC_RCTB_DecReq
        data-element=CPT_APPCOM_SWC.CPT_MCU_Composition.ADDC_0x83.ADDC_RAEB_DecReq, system-signal=ADDC_RAEB_DecReq
        data-element=CPT_APPCOM_SWC.CPT_MCU_Composition.ADDC_0x83.ADDC_MEB_DecReq, system-signal=ADDC_MEB_DecReq
        data-element=CPT_APPCOM_SWC.CPT_MCU_Composition.VCU_0x13B.VCU_CRC_13B, system-signal=VCU_CRC_13B
        data-element=CPT_APPCOM_SWC.CPT_MCU_Composition.VCU_0x13B.VCU_RollingCounter_13B, system-signal=VCU_RollingCounter_13B
        data-element=CPT_APPCOM_SWC.CPT_MCU_Composition.VCU_0x13B.VCU_Vehicle_Warning, system-signal=VCU_Vehicle_Warning
        data-element=CPT_APPCOM_SWC.CPT_MCU_Composition.VCU_0x13B.VCU_VehicleSts, system-signal=VCU_VehicleSts
        data-element=CPT_APPCOM_SWC.CPT_MCU_Composition.VCU_0x13B.VCU_GearLevelPosSts, system-signal=VCU_GearLevelPosSts
        data-element=CPT_APPCOM_SWC.CPT_MCU_Composition.VCU_0x13B.VCU_GearLeverValid, system-signal=VCU_GearLeverValid
        data-element=CPT_APPCOM_SWC.CPT_MCU_Composition.VCU_0x13B.VCU_AccPedalValid, system-signal=VCU_AccPedalValid
        data-element=CPT_APPCOM_SWC.CPT_MCU_Composition.VCU_0x13B.VCU_ThrottlePosition, system-signal=VCU_ThrottlePosition
        data-element=CPT_APPCOM_SWC.CPT_MCU_Composition.VCU_0x13B.VCU_BMSMainRelayR_Cmd, system-signal=VCU_BMSMainRelayR_Cmd
        data-element=CPT_APPCOM_SWC.CPT_MCU_Composition.VCU_0x13B.VCU_BMSMainRelayF_Cmd, system-signal=VCU_BMSMainRelayF_Cmd
        data-element=CPT_APPCOM_SWC.CPT_MCU_Composition.VCU_0x13B.VCU_BMSEmergencyCmd, system-signal=VCU_BMSEmergencyCmd
        data-element=CPT_APPCOM_SWC.CPT_MCU_Composition.VCU_0x13B.VCU_MCUMActiveReleaseCmd, system-signal=VCU_MCUMActiveReleaseCmd
        data-element=CPT_APPCOM_SWC.CPT_MCU_Composition.VCU_0x13B.VCU_MCUSActiveReleaseCmd, system-signal=VCU_MCUSActiveReleaseCmd
        data-element=CPT_APPCOM_SWC.CPT_MCU_Composition.VCU_0x13B.VCU_AlwACChargeInventerSts, system-signal=VCU_AlwACChargeInventerSts
        data-element=CPT_APPCOM_SWC.CPT_MCU_Composition.VCU_0x13B.VCU_AlwDCChargeSts, system-signal=VCU_AlwDCChargeSts
        data-element=CPT_APPCOM_SWC.CPT_MCU_Composition.VCU_0x13B.VCU_ChargePauseReq, system-signal=VCU_ChargePauseReq
        data-element=CPT_APPCOM_SWC.CPT_MCU_Composition.VCU_0x13B.VCU_SuppressJitterMCUSRequest, system-signal=VCU_SuppressJitterMCUSRequest
        data-element=CPT_APPCOM_SWC.CPT_MCU_Composition.VCU_0x13B.VCU_DCDCEnableCmd, system-signal=VCU_DCDCEnableCmd
        data-element=CPT_APPCOM_SWC.CPT_MCU_Composition.VCU_0x13B.VCU_ACOffReq, system-signal=VCU_ACOffReq
        data-element=CPT_APPCOM_SWC.CPT_MCU_Composition.VCU_0x13B.VCU_VehicleDirect, system-signal=VCU_VehicleDirect
        data-element=CPT_APPCOM_SWC.CPT_MCU_Composition.VCU_0x13B.VCU_BrakeSysFault, system-signal=VCU_BrakeSysFault
        data-element=CPT_APPCOM_SWC.CPT_MCU_Composition.VCU_0x13B.VCU_SuppressJitterMCUMRequest, system-signal=VCU_SuppressJitterMCUMRequest
        data-element=CPT_APPCOM_SWC.CPT_MCU_Composition.VCU_0x13B.VCU_MDrvControlMode, system-signal=VCU_MDrvControlMode
        data-element=CPT_APPCOM_SWC.CPT_MCU_Composition.VCU_0x13B.VCU_BrakePedalValue, system-signal=VCU_BrakePedalValue
        data-element=CPT_APPCOM_SWC.CPT_MCU_Composition.VCU_0x13B.VCU_MCUMMaxDischargePower, system-signal=VCU_MCUMMaxDischargePower
        data-element=CPT_APPCOM_SWC.CPT_MCU_Composition.VCU_0x13B.VCU_MCUMMaxChargePower, system-signal=VCU_MCUMMaxChargePower
        data-element=CPT_APPCOM_SWC.CPT_MCU_Composition.VCU_0x13B.VCU_MDrvRequestTorque, system-signal=VCU_MDrvRequestTorque
        data-element=CPT_APPCOM_SWC.CPT_MCU_Composition.VCU_0x13B.VCU_MDrvRequesSpeed, system-signal=VCU_MDrvRequesSpeed
        data-element=CPT_APPCOM_SWC.CPT_MCU_Composition.VCU_0x13B.VCU_SDrvRequestTorque, system-signal=VCU_SDrvRequestTorque
        data-element=CPT_APPCOM_SWC.CPT_MCU_Composition.VCU_0x13B.VCU_SDrvRequesSpeed, system-signal=VCU_SDrvRequesSpeed
        data-element=CPT_APPCOM_SWC.CPT_MCU_Composition.VCU_0x13B.VCU_SVehicleSts, system-signal=VCU_SVehicleSts
        data-element=CPT_APPCOM_SWC.CPT_MCU_Composition.VCU_0x13B.VCU_VehicleHighVoltModeF, system-signal=VCU_VehicleHighVoltModeF
        data-element=CPT_APPCOM_SWC.CPT_MCU_Composition.VCU_0x13B.VCU_SDrvControlMode, system-signal=VCU_SDrvControlMode
        data-element=CPT_APPCOM_SWC.CPT_MCU_Composition.VCU_0x13B.VCU_ON2BRelayReq, system-signal=VCU_ON2BRelayReq
        data-element=CPT_APPCOM_SWC.CPT_MCU_Composition.VCU_0x13B.VCU_VehPreHVPwrOffCmd, system-signal=VCU_VehPreHVPwrOffCmd
        data-element=CPT_APPCOM_SWC.CPT_MCU_Composition.VCU_0x13B.VCU_FuelTankLockReq, system-signal=VCU_FuelTankLockReq
        data-element=CPT_APPCOM_SWC.CPT_MCU_Composition.VCU_0x13B.VCU_VehicleDirectS, system-signal=VCU_VehicleDirectS
        data-element=CPT_APPCOM_SWC.CPT_MCU_Composition.VCU_0x13B.VCU_VehicleDirectS_VD, system-signal=VCU_VehicleDirectS_VD
        data-element=CPT_APPCOM_SWC.CPT_MCU_Composition.VCU_0x13B.VCU_ACPwrLimited, system-signal=VCU_ACPwrLimited
        data-element=CPT_APPCOM_SWC.CPT_MCU_Composition.VCU_0x13B.VCU_MCUSMaxDischargePower, system-signal=VCU_MCUSMaxDischargePower
        data-element=CPT_APPCOM_SWC.CPT_MCU_Composition.VCU_0x13B.VCU_VehicleDirectVD, system-signal=VCU_VehicleDirectVD
        data-element=CPT_APPCOM_SWC.CPT_MCU_Composition.VCU_0x13B.VCU_MDrvControlModeVD, system-signal=VCU_MDrvControlModeVD
        data-element=CPT_APPCOM_SWC.CPT_MCU_Composition.VCU_0x13B.VCU_MDrvRequestTorqueVD, system-signal=VCU_MDrvRequestTorqueVD
        data-element=CPT_APPCOM_SWC.CPT_MCU_Composition.VCU_0x13B.VCU_MDrvRequesSpeedVD, system-signal=VCU_MDrvRequesSpeedVD
        data-element=CPT_APPCOM_SWC.CPT_MCU_Composition.VCU_0x13B.VCU_SDrvRequestTorqueVD, system-signal=VCU_SDrvRequestTorqueVD
        data-element=CPT_APPCOM_SWC.CPT_MCU_Composition.VCU_0x13B.VCU_SDrvRequesSpeedVD, system-signal=VCU_SDrvRequesSpeedVD
        data-element=CPT_APPCOM_SWC.CPT_MCU_Composition.VCU_0x13B.VCU_SDrvControlModeVD, system-signal=VCU_SDrvControlModeVD
        data-element=CPT_APPCOM_SWC.CPT_MCU_Composition.VCU_0x13B.VCU_MCUSMaxChargePower, system-signal=VCU_MCUSMaxChargePower
        data-element=CPT_APPCOM_SWC.CPT_MCU_Composition.VCU_0x13B.VCU_VehicleHighVoltMode, system-signal=VCU_VehicleHighVoltMode
        data-element=CPT_APPCOM_SWC.CPT_MCU_Composition.VCU_0x13B.VCU_PDUHVIL_Sts, system-signal=VCU_PDUHVIL_Sts
        data-element=CPT_APPCOM_SWC.CPT_MCU_Composition.VCU_0x13B.VCU_PDU220VRelay_Req, system-signal=VCU_PDU220VRelay_Req
        data-element=CPT_APPCOM_SWC.CPT_MCU_Composition.VCU_0x13B.VCU_Cab220VRelay_Req, system-signal=VCU_Cab220VRelay_Req
        data-element=CPT_APPCOM_SWC.CPT_MCU_Composition.VCU_0x13B.VCU_Cabin220VRelay_Req, system-signal=VCU_Cabin220VRelay_Req
        data-element=CPT_APPCOM_SWC.CPT_MCU_Composition.VCU_0x13B.VCU_Alw_Cab220VInverter_Sts, system-signal=VCU_Alw_Cab220VInverter_Sts
        data-element=CPT_APPCOM_SWC.CPT_MCU_Composition.VCU_0x13B.VCU_Alw_Cabin220VInverter_Sts, system-signal=VCU_Alw_Cabin220VInverter_Sts
        data-element=CPT_APPCOM_SWC.CPT_MCU_Composition.VCU_0x13B.VCU_MCUMDampgLmtFactor, system-signal=VCU_MCUMDampgLmtFactor
        data-element=CPT_APPCOM_SWC.CPT_MCU_Composition.VCU_0x13B.VCU_MCUSDampgLmtFactor, system-signal=VCU_MCUSDampgLmtFactor
        data-element=CPT_APPCOM_SWC.CPT_MCU_Composition.VCU_0x13B.VCU_BCM_Authentication_Sts, system-signal=VCU_BCM_Authentication_Sts
        data-element=CPT_APPCOM_SWC.CPT_MCU_Composition.VCU_0x13B.VCU_AuthenticationKey_WSts, system-signal=VCU_AuthenticationKey_WSts
        data-element=CPT_APPCOM_SWC.CPT_MCU_Composition.VCU_0x13B.VCU_BrakePedalSts_P, system-signal=VCU_BrakePedalSts_P
        data-element=CPT_APPCOM_SWC.CPT_MCU_Composition.VCU_0x13B.VCU_BrakePedalStsValid_P, system-signal=VCU_BrakePedalStsValid_P
        data-element=CPT_APPCOM_SWC.CPT_MCU_Composition.VCU_0x13B.VCU_BoostMode_Fail, system-signal=VCU_BoostMode_Fail
        data-element=CPT_APPCOM_SWC.CPT_MCU_Composition.VCU_0x13B.VCU_BoostModeSts, system-signal=VCU_BoostModeSts
        data-element=CPT_APPCOM_SWC.CPT_MCU_Composition.VCU_0x13B.VCU_MCUSMaxPosDampgTrq, system-signal=VCU_MCUSMaxPosDampgTrq
        data-element=CPT_APPCOM_SWC.CPT_MCU_Composition.VCU_0x13B.VCU_MCUSMaxNegDampgTrq, system-signal=VCU_MCUSMaxNegDampgTrq
        data-element=CPT_APPCOM_SWC.CPT_MCU_Composition.VCU_0x13B.VCU_MCUMMaxPosDampgTrq, system-signal=VCU_MCUMMaxPosDampgTrq
        data-element=CPT_APPCOM_SWC.CPT_MCU_Composition.VCU_0x13B.VCU_MCUMMaxNegDampgTrq, system-signal=VCU_MCUMMaxNegDampgTrq
        data-element=CPT_APPCOM_SWC.CPT_MCU_Composition.BMS_0x310.BMS_InverterPower, system-signal=BMS_InverterPower
        data-element=CPT_APPCOM_SWC.CPT_MCU_Composition.BMS_0x310.BMS_MaxChargeVolt, system-signal=BMS_MaxChargeVolt
        data-element=CPT_APPCOM_SWC.CPT_MCU_Composition.BMS_0x310.BMS_MaxChargeCurr, system-signal=BMS_MaxChargeCurr
        data-element=CPT_APPCOM_SWC.CPT_MCU_Composition.BMS_0x310.BMS_OBCWorkModeCtrl, system-signal=BMS_OBCWorkModeCtrl
        data-element=CPT_APPCOM_SWC.CPT_MCU_Composition.BMS_0x310.BMS_MaxPower, system-signal=BMS_MaxPower
        data-element=CPT_APPCOM_SWC.CPT_MCU_Composition.BMS_0x310.BMS_ChargerACInput, system-signal=BMS_ChargerACInput
        data-element=CPT_APPCOM_SWC.CPT_MCU_Composition.BMS_0x310.BMS_ChargerDCInput, system-signal=BMS_ChargerDCInput
        data-element=CPT_APPCOM_SWC.CPT_MCU_Composition.BMS_0x310.BMS_ChargeRequest, system-signal=BMS_ChargeRequest
        data-element=CPT_APPCOM_SWC.CPT_MCU_Composition.BMS_0x310.BMS_InverterRequest, system-signal=BMS_InverterRequest
        data-element=CPT_APPCOM_SWC.CPT_MCU_Composition.BMS_0x310.BMS_ChargeQuantity, system-signal=BMS_ChargeQuantity
        data-element=CPT_APPCOM_SWC.CPT_MCU_Composition.BMS_0x310.BMS_BattMaxTemp, system-signal=BMS_BattMaxTemp
        data-element=CPT_APPCOM_SWC.CPT_MCU_Composition.BMS_0x310.BMS_BattMinTemp, system-signal=BMS_BattMinTemp
        data-element=CPT_APPCOM_SWC.CPT_MCU_Composition.BMS_0x310.BMS_BattIntakeTemp, system-signal=BMS_BattIntakeTemp
        data-element=CPT_APPCOM_SWC.CPT_MCU_Composition.BMS_0x310.BMS_BattIOutletTemp, system-signal=BMS_BattIOutletTemp
        data-element=CPT_APPCOM_SWC.CPT_MCU_Composition.BMS_0x310.BMS_BattSOC_Display, system-signal=BMS_BattSOC_Display
        data-element=CPT_APPCOM_SWC.CPT_MCU_Composition.BMS_0x310.BMS_Req_Cab220VInverter_Sts, system-signal=BMS_Req_Cab220VInverter_Sts
        data-element=CPT_APPCOM_SWC.CPT_MCU_Composition.BMS_0x310.BMS_Req_Cabin220VInverter_Sts, system-signal=BMS_Req_Cabin220VInverter_Sts
        data-element=CPT_APPCOM_SWC.CPT_MCU_Composition.BMS_0x310.BMS_RemainEnergy, system-signal=BMS_RemainEnergy
        data-element=CPT_APPCOM_SWC.CPT_MCU_Composition.BMS_0x310.BMS_StateOfEngeryMax, system-signal=BMS_StateOfEngeryMax
        data-element=CPT_APPCOM_SWC.CPT_MCU_Composition.BMS_0x310.BMS_ThermalManageRequest, system-signal=BMS_ThermalManageRequest
        data-element=CPT_APPCOM_SWC.CPT_MCU_Composition.BMS_0x310.BMS_PreHeatingState, system-signal=BMS_PreHeatingState
        data-element=CPT_APPCOM_SWC.CPT_MCU_Composition.MCUM_0x6F8.MCUM_UDS_SW{1..10}, system-signal=MCUM_UDS_SW{1..10}
        data-element=CPT_APPCOM_SWC.CPT_MCU_Composition.MCUM_0x6F8.MCUM_UDS_HW{1..10}, system-signal=MCUM_UDS_HW{1..10}
        data-element=CPT_APPCOM_SWC.CPT_MCU_Composition.MCUM_0x6F8.MCUM_UDS_Boot{1..10}, system-signal=MCUM_UDS_Boot{1..10}
        data-element=CPT_APPCOM_SWC.CPT_MCU_Composition.MCUM_0x6F8.MCUM_UDS_ProductModel{1..16}, system-signal=MCUM_UDS_ProductModel{1..16}
        data-element=CPT_APPCOM_SWC.CPT_MCU_Composition.MCUM_0x6F8.MCUM_UDS_Supplier{1..6}, system-signal=MCUM_UDS_Supplier{1..6}
        data-element=CPT_APPCOM_SWC.CPT_MCU_Composition.GCU_0x2C1.GCU_SWVersionC, system-signal=GCU_SWVersionC
        data-element=CPT_APPCOM_SWC.CPT_MCU_Composition.GCU_0x2C1.GCU_SWVersionB, system-signal=GCU_SWVersionB
        data-element=CPT_APPCOM_SWC.CPT_MCU_Composition.GCU_0x2C1.GCU_SWVersionA, system-signal=GCU_SWVersionA
        data-element=CPT_APPCOM_SWC.CPT_MCU_Composition.VCU_0xB6.VCU_CRC_B6, system-signal=VCU_CRC_B6
        data-element=CPT_APPCOM_SWC.CPT_MCU_Composition.VCU_0xB6.VCU_TVTest2, system-signal=VCU_TVTest2
        data-element=CPT_APPCOM_SWC.CPT_MCU_Composition.VCU_0xB6.VCU_VPE_Test1, system-signal=VCU_VPE_Test1
        data-element=CPT_APPCOM_SWC.CPT_MCU_Composition.VCU_0xB6.VCU_VPE_Test2, system-signal=VCU_VPE_Test2
        data-element=CPT_APPCOM_SWC.CPT_MCU_Composition.VCU_0xB6.VCU_TVTest1, system-signal=VCU_TVTest1
        data-element=CPT_APPCOM_SWC.CPT_MCU_Composition.VCU_0xB6.VCU_RollingCounter_B6, system-signal=VCU_RollingCounter_B6
        data-element=CPT_APPCOM_SWC.CPT_MCU_Composition.VCU_0xB6.VCU_MDrvRequestTorque_IDB6_CCAN, system-signal=VCU_MDrvRequestTorque_IDB6_CCAN
        data-element=CPT_APPCOM_SWC.CPT_MCU_Composition.VCU_0xB6.VCU_MDriverRequireTorque, system-signal=VCU_MDriverRequireTorque
        data-element=CPT_APPCOM_SWC.CPT_MCU_Composition.VCU_0xB6.VCU_SDrvRequestTorque_IDB6_CCAN, system-signal=VCU_SDrvRequestTorque_IDB6_CCAN
        data-element=CPT_APPCOM_SWC.CPT_MCU_Composition.VCU_0xB6.VCU_SDriverRequireTorque, system-signal=VCU_SDriverRequireTorque
        data-element=CPT_APPCOM_SWC.CPT_MCU_Composition.VCU_0xB6.VCU_ThrottlePosition_IDB6_CCAN, system-signal=VCU_ThrottlePosition_IDB6_CCAN
        data-element=CPT_APPCOM_SWC.CPT_MCU_Composition.VCU_0xB6.VCU_AccPedalValid_IDB6_CCAN, system-signal=VCU_AccPedalValid_IDB6_CCAN
        data-element=CPT_APPCOM_SWC.CPT_MCU_Composition.VCU_0xB6.VCU_BrakeSysFault_IDB6_CCAN, system-signal=VCU_BrakeSysFault_IDB6_CCAN
        data-element=CPT_APPCOM_SWC.CPT_MCU_Composition.VCU_0xB6.VCU_BrakeLightReq, system-signal=VCU_BrakeLightReq
        data-element=CPT_APPCOM_SWC.CPT_MCU_Composition.VCU_0xB6.VCU_BrakePedalSts, system-signal=VCU_BrakePedalSts
        data-element=CPT_APPCOM_SWC.CPT_MCU_Composition.VCU_0xB6.VCU_BrakePedalStsValid, system-signal=VCU_BrakePedalStsValid
        data-element=CPT_APPCOM_SWC.CPT_MCU_Composition.VCU_0xB6.VCU_GearLevelPosSts_IDB6_CCAN, system-signal=VCU_GearLevelPosSts_IDB6_CCAN
        data-element=CPT_APPCOM_SWC.CPT_MCU_Composition.VCU_0xB6.VCU_GearLeverValid_IDB6_CCAN, system-signal=VCU_GearLeverValid_IDB6_CCAN
        data-element=CPT_APPCOM_SWC.CPT_MCU_Composition.VCU_0xB6.VCU_BrakeFirstSts, system-signal=VCU_BrakeFirstSts
        data-element=CPT_APPCOM_SWC.CPT_MCU_Composition.VCU_0xB6.VCU_DeliveryModeSts_IDB6_CCAN, system-signal=VCU_DeliveryModeSts_IDB6_CCAN
        data-element=CPT_APPCOM_SWC.CPT_MCU_Composition.VCU_0xB6.VCU_MRDrvRequestTorque_IDB6_CCAN, system-signal=VCU_MRDrvRequestTorque_IDB6_CCAN
        data-element=CPT_APPCOM_SWC.CPT_MCU_Composition.VCU_0xB6.VCU_MRDriverRequireTorque, system-signal=VCU_MRDriverRequireTorque
        data-element=CPT_APPCOM_SWC.CPT_MCU_Composition.HPCBCM_0x291.BCM_CRC_291, system-signal=BCM_CRC_291
        data-element=CPT_APPCOM_SWC.CPT_MCU_Composition.HPCBCM_0x291.BCM_ShutdownMode, system-signal=BCM_ShutdownMode
        data-element=CPT_APPCOM_SWC.CPT_MCU_Composition.HPCBCM_0x291.BCM_NM_PNC_ON_1ADr_Sts, system-signal=BCM_NM_PNC_ON_1ADr_Sts
        data-element=CPT_APPCOM_SWC.CPT_MCU_Composition.HPCBCM_0x291.BCM_RollingCounter_291, system-signal=BCM_RollingCounter_291
        data-element=CPT_APPCOM_SWC.CPT_MCU_Composition.HPCBCM_0x291.BCM_KeyPosition_ON2A, system-signal=BCM_KeyPosition_ON2A
        data-element=CPT_APPCOM_SWC.CPT_MCU_Composition.HPCBCM_0x291.BCM_CcmHvilSts_ID291, system-signal=BCM_CcmHvilSts_ID291
        data-element=CPT_APPCOM_SWC.CPT_MCU_Composition.HPCBCM_0x291.BCM_DriverDoorSts, system-signal=BCM_DriverDoorSts
        data-element=CPT_APPCOM_SWC.CPT_MCU_Composition.HPCBCM_0x291.BCM_FLDoorSts, system-signal=BCM_FLDoorSts
        data-element=CPT_APPCOM_SWC.CPT_MCU_Composition.HPCBCM_0x291.BCM_FRDoorSts, system-signal=BCM_FRDoorSts
        data-element=CPT_APPCOM_SWC.CPT_MCU_Composition.HPCBCM_0x291.BCM_RLDoorSts, system-signal=BCM_RLDoorSts
        data-element=CPT_APPCOM_SWC.CPT_MCU_Composition.HPCBCM_0x291.BCM_RRDoorSts, system-signal=BCM_RRDoorSts
        data-element=CPT_APPCOM_SWC.CPT_MCU_Composition.HPCBCM_0x291.BCM_BackDoorSts, system-signal=BCM_BackDoorSts
        data-element=CPT_APPCOM_SWC.CPT_MCU_Composition.HPCBCM_0x291.BCM_ON2BRelaySts, system-signal=BCM_ON2BRelaySts
        data-element=CPT_APPCOM_SWC.CPT_MCU_Composition.HPCBCM_0x291.BCM_ON2CRelaySts, system-signal=BCM_ON2CRelaySts
        data-element=CPT_APPCOM_SWC.CPT_MCU_Composition.HPCBCM_0x291.BCM_ON2InitiativeSts, system-signal=BCM_ON2InitiativeSts
        data-element=CPT_APPCOM_SWC.CPT_MCU_Composition.HPCBCM_0x291.BCM_VehicleRepairMode, system-signal=BCM_VehicleRepairMode
        data-element=CPT_APPCOM_SWC.CPT_MCU_Composition.HPCBCM_0x291.BCM_VehlockCtrl, system-signal=BCM_VehlockCtrl
        data-element=CPT_APPCOM_SWC.CPT_MCU_Composition.HPCBCM_0x291.BCM_VehLockSts, system-signal=BCM_VehLockSts
        data-element=CPT_APPCOM_SWC.CPT_MCU_Composition.HPCBCM_0x291.BCM_FuelTankLockReq, system-signal=BCM_FuelTankLockReq
        data-element=CPT_APPCOM_SWC.CPT_MCU_Composition.HPCBCM_0x291.BCM_ACChgLockCtrl, system-signal=BCM_ACChgLockCtrl
        data-element=CPT_APPCOM_SWC.CPT_MCU_Composition.HPCBCM_0x291.BCM_ChargeLockCtrl, system-signal=BCM_ChargeLockCtrl
        data-element=CPT_APPCOM_SWC.CPT_MCU_Composition.HPCBCM_0x291.BCM_DCChrgPwr_Sts_ID291, system-signal=BCM_DCChrgPwr_Sts_ID291
        data-element=CPT_APPCOM_SWC.CPT_MCU_Composition.HPCBCM_0x291.BCM_ACChrgPwr_Sts_ID291, system-signal=BCM_ACChrgPwr_Sts_ID291
        data-element=CPT_APPCOM_SWC.CPT_MCU_Composition.HPCBCM_0x291.BCM_DCChrgPwr_Volt_ID291, system-signal=BCM_DCChrgPwr_Volt_ID291
        data-element=CPT_APPCOM_SWC.CPT_MCU_Composition.HPCBCM_0x291.BCM_ACChrgPwr_Volt_ID291, system-signal=BCM_ACChrgPwr_Volt_ID291
        data-element=CPT_APPCOM_SWC.CPT_MCU_Composition.HPCBCM_0x291.BCM_KeyPosition_ON2B, system-signal=BCM_KeyPosition_ON2B
        data-element=CPT_APPCOM_SWC.CPT_MCU_Composition.HPCBCM_0x291.BCM_NM_PNC_ON_3Ch_Sts, system-signal=BCM_NM_PNC_ON_3Ch_Sts
        data-element=CPT_APPCOM_SWC.CPT_MCU_Composition.HPCBCM_0x291.BCM_HighVoltageReq, system-signal=BCM_HighVoltageReq
        data-element=CPT_APPCOM_SWC.CPT_MCU_Composition.ACU_0x2A3.ACU_CRC_2A3, system-signal=ACU_CRC_2A3
        data-element=CPT_APPCOM_SWC.CPT_MCU_Composition.ACU_0x2A3.ACU_Trigger, system-signal=ACU_Trigger
        data-element=CPT_APPCOM_SWC.CPT_MCU_Composition.ACU_0x2A3.ACU_RollingCounter_2A3, system-signal=ACU_RollingCounter_2A3
        data-element=CPT_APPCOM_SWC.CPT_MCU_Composition.ACU_0x2A3.ACU_TotalCrashOutputSts, system-signal=ACU_TotalCrashOutputSts
        data-element=CPT_APPCOM_SWC.CPT_MCU_Composition.ACU_0x2A3.ACU_SelfCheckSt, system-signal=ACU_SelfCheckSt
        data-element=CPT_APPCOM_SWC.CPT_MCU_Composition.ACU_0x2A3.ACU_FLSeatBeltRSt, system-signal=ACU_FLSeatBeltRSt
        data-element=CPT_APPCOM_SWC.CPT_MCU_Composition.ACU_0x2A3.ACU_FRSeatBeltRSt, system-signal=ACU_FRSeatBeltRSt
        data-element=CPT_APPCOM_SWC.CPT_MCU_Composition.IVI_0x34A.IVI_DeliveryModeReq, system-signal=IVI_DeliveryModeReq
        data-element=CPT_APPCOM_SWC.CPT_MCU_Composition.IVI_0x34A.IVI_ShowCarModeReq, system-signal=IVI_ShowCarModeReq
        data-element=CPT_APPCOM_SWC.CPT_MCU_Composition.VCU_0xBB.VCU_CheckSum_BB, system-signal=VCU_CheckSum_BB
        data-element=CPT_APPCOM_SWC.CPT_MCU_Composition.VCU_0xBB.VCU_WorkModeReq_PHEV, system-signal=VCU_WorkModeReq_PHEV
        data-element=CPT_APPCOM_SWC.CPT_MCU_Composition.VCU_0xBB.VCU_WorkMode_PHEV, system-signal=VCU_WorkMode_PHEV
        data-element=CPT_APPCOM_SWC.CPT_MCU_Composition.VCU_0xBB.VCU_HEVAllow_PHEV, system-signal=VCU_HEVAllow_PHEV
        data-element=CPT_APPCOM_SWC.CPT_MCU_Composition.VCU_0xBB.VCU_REAllow_PHEV, system-signal=VCU_REAllow_PHEV
        data-element=CPT_APPCOM_SWC.CPT_MCU_Composition.VCU_0xBB.VCU_EVDualAllow_PHEV, system-signal=VCU_EVDualAllow_PHEV
        data-element=CPT_APPCOM_SWC.CPT_MCU_Composition.VCU_0xBB.VCU_EVSingleAllow_PHEV, system-signal=VCU_EVSingleAllow_PHEV
        data-element=CPT_APPCOM_SWC.CPT_MCU_Composition.VCU_0xBB.VCU_Clutch_2_RequesSpeed, system-signal=VCU_Clutch_2_RequesSpeed
        data-element=CPT_APPCOM_SWC.CPT_MCU_Composition.VCU_0xBB.VCU_Clutch_1_RequesSpeed, system-signal=VCU_Clutch_1_RequesSpeed
        data-element=CPT_APPCOM_SWC.CPT_MCU_Composition.VCU_0xBB.VCU_Clutch2Position, system-signal=VCU_Clutch2Position
        data-element=CPT_APPCOM_SWC.CPT_MCU_Composition.VCU_0xBB.VCU_Clutch1Position, system-signal=VCU_Clutch1Position
        data-element=CPT_APPCOM_SWC.CPT_MCU_Composition.VCU_0xBB.VCU_RollingCounter_BB, system-signal=VCU_RollingCounter_BB
        data-element=CPT_APPCOM_SWC.CPT_MCU_Composition.VCU_0xBB.VCU_EngPreStartFlg, system-signal=VCU_EngPreStartFlg
        data-element=CPT_APPCOM_SWC.CPT_MCU_Composition.VCU_0xBB.VCU_FuelChgModeMsg, system-signal=VCU_FuelChgModeMsg
        data-element=CPT_APPCOM_SWC.CPT_MCU_Composition.VCU_0xBB.VCU_FuelChgModeSts, system-signal=VCU_FuelChgModeSts
        data-element=CPT_APPCOM_SWC.CPT_MCU_Composition.VCU_0xBB.VCU_RoughRoadDetectionFlag, system-signal=VCU_RoughRoadDetectionFlag
        data-element=CPT_APPCOM_SWC.CPT_MCU_Composition.VCU_0xBB.VCU_Clutch_2_RequesSpeedValid, system-signal=VCU_Clutch_2_RequesSpeedValid
        data-element=CPT_APPCOM_SWC.CPT_MCU_Composition.VCU_0xBB.VCU_Clutch_1_RequesSpeedValid, system-signal=VCU_Clutch_1_RequesSpeedValid
        data-element=CPT_APPCOM_SWC.CPT_MCU_Composition.VCU_0xBB.VCU_GCURequestTorque, system-signal=VCU_GCURequestTorque
        data-element=CPT_APPCOM_SWC.CPT_MCU_Composition.VCU_0xBB.VCU_PowerReducetSts, system-signal=VCU_PowerReducetSts
        data-element=CPT_APPCOM_SWC.CPT_MCU_Composition.VCU_0xBB.VCU_GCUAassistFB, system-signal=VCU_GCUAassistFB
        data-element=CPT_APPCOM_SWC.CPT_MCU_Composition.VCU_0xBB.VCU_GCUActiveReleaseCmd, system-signal=VCU_GCUActiveReleaseCmd
        data-element=CPT_APPCOM_SWC.CPT_MCU_Composition.VCU_0xBB.VCU_PowerOverSts, system-signal=VCU_PowerOverSts
        data-element=CPT_APPCOM_SWC.CPT_MCU_Composition.VCU_0xBB.VCU_GCURequesSpeed, system-signal=VCU_GCURequesSpeed
        data-element=CPT_APPCOM_SWC.CPT_MCU_Composition.VCU_0xBB.VCU_GCUControlMode, system-signal=VCU_GCUControlMode
        data-element=CPT_APPCOM_SWC.CPT_MCU_Composition.VCU_0xBB.VCU_MotChargePower, system-signal=VCU_MotChargePower
        data-element=CPT_APPCOM_SWC.CPT_MCU_Composition.VCU_0xBB.VCU_APS1Position, system-signal=VCU_APS1Position
        data-element=CPT_APPCOM_SWC.CPT_MCU_Composition.VCU_0xBB.VCU_EngineStartReq, system-signal=VCU_EngineStartReq
        data-element=CPT_APPCOM_SWC.CPT_MCU_Composition.VCU_0xBB.VCU_EngineFuelInhibitReq, system-signal=VCU_EngineFuelInhibitReq
        data-element=CPT_APPCOM_SWC.CPT_MCU_Composition.VCU_0xBB.VCU_EngineOffRequest, system-signal=VCU_EngineOffRequest
        data-element=CPT_APPCOM_SWC.CPT_MCU_Composition.VCU_0xBB.VCU_STorqueReqValid, system-signal=VCU_STorqueReqValid
        data-element=CPT_APPCOM_SWC.CPT_MCU_Composition.VCU_0xBB.VCU_STorqueReq, system-signal=VCU_STorqueReq
        data-element=CPT_APPCOM_SWC.CPT_MCU_Composition.VCU_0xBB.VCU_FTorqueSwFb, system-signal=VCU_FTorqueSwFb
        data-element=CPT_APPCOM_SWC.CPT_MCU_Composition.VCU_0xBB.VCU_FVVOpenReq, system-signal=VCU_FVVOpenReq
        data-element=CPT_APPCOM_SWC.CPT_MCU_Composition.VCU_0xBB.VCU_WarmUpCycleIndicator, system-signal=VCU_WarmUpCycleIndicator
        data-element=CPT_APPCOM_SWC.CPT_MCU_Composition.VCU_0xBB.VCU_EngineResetSts, system-signal=VCU_EngineResetSts
        data-element=CPT_APPCOM_SWC.CPT_MCU_Composition.VCU_0xBB.VCU_EngineSts, system-signal=VCU_EngineSts
        data-element=CPT_APPCOM_SWC.CPT_MCU_Composition.VCU_0xBB.VCU_FTorqueReq, system-signal=VCU_FTorqueReq
        data-element=CPT_APPCOM_SWC.CPT_MCU_Composition.VCU_0xBB.VCU_FTorqueReqValid, system-signal=VCU_FTorqueReqValid
        data-element=CPT_APPCOM_SWC.CPT_MCU_Composition.VCU_0xBB.VCU_EngineIdleReq, system-signal=VCU_EngineIdleReq
        data-element=CPT_APPCOM_SWC.CPT_MCU_Composition.VCU_0xBB.VCU_REsystemSts, system-signal=VCU_REsystemSts
        data-element=CPT_APPCOM_SWC.CPT_MCU_Composition.VCU_0xBB.VCU_REsystemFaultSts, system-signal=VCU_REsystemFaultSts
        data-element=CPT_APPCOM_SWC.CPT_MCU_Composition.VCU_0xBB.VCU_APS2Position, system-signal=VCU_APS2Position
        data-element=CPT_APPCOM_SWC.CPT_MCU_Composition.VCU_0xBB.VCU_EngineRunAllowFlg, system-signal=VCU_EngineRunAllowFlg
        data-element=CPT_APPCOM_SWC.CPT_MCU_Composition.VCU_0xBB.VCU_EngineIdleSpeed, system-signal=VCU_EngineIdleSpeed
        data-element=CPT_APPCOM_SWC.CPT_MCU_Composition.VCU_0xBB.VCU_EngineFuleCutoffReq, system-signal=VCU_EngineFuleCutoffReq
        data-element=CPT_APPCOM_SWC.CPT_MCU_Composition.VCU_0xBB.VCU_MCUSClutchPosition, system-signal=VCU_MCUSClutchPosition
        data-element=CPT_APPCOM_SWC.CPT_MCU_Composition.VCU_0xBB.VCU_MGCUWorkMode, system-signal=VCU_MGCUWorkMode
        data-element=CPT_APPCOM_SWC.CPT_MCU_Composition.VCU_0xBB.VCU_REChgTarget, system-signal=VCU_REChgTarget
        data-element=CPT_APPCOM_SWC.CPT_MCU_Composition.VCU_0xBB.VCU_MotStartStopPowerUP, system-signal=VCU_MotStartStopPowerUP
        data-element=CPT_APPCOM_SWC.CPT_MCU_Composition.VCU_0xBB.VCU_MotStartStopPowerLOW, system-signal=VCU_MotStartStopPowerLOW
        data-element=CPT_APPCOM_SWC.CPT_MCU_Composition.VCU_0xBB.VCU_GCURequesSpeed_MGCU, system-signal=VCU_GCURequesSpeed_MGCU
        data-element=CPT_APPCOM_SWC.CPT_MCU_Composition.VCU_0xBB.VCU_DynamicChgPwr, system-signal=VCU_DynamicChgPwr
        data-element=CPT_APPCOM_SWC.CPT_MCU_Composition.VCU_0xBB.VCU_ForceChgPwr, system-signal=VCU_ForceChgPwr
        data-element=CPT_APPCOM_SWC.CPT_MCU_Composition.VCU_0xBB.VCU_REStartType, system-signal=VCU_REStartType
        data-element=CPT_APPCOM_SWC.CPT_MCU_Composition.VCU_0x515.VCU_Pending_DTC, system-signal=VCU_Pending_DTC
        data-element=CPT_APPCOM_SWC.CPT_MCU_Composition.VCU_0x515.VCU_Comfirmed_DTC, system-signal=VCU_Comfirmed_DTC
        data-element=CPT_APPCOM_SWC.CPT_MCU_Composition.VCU_0x515.VCU_Permanent_DTC, system-signal=VCU_Permanent_DTC
        data-element=CPT_APPCOM_SWC.CPT_MCU_Composition.VCU_0x515.VCU_MilReq_DTC, system-signal=VCU_MilReq_DTC
        data-element=CPT_APPCOM_SWC.CPT_MCU_Composition.LMC_0xFA.LMC_WBDC_ActiveSt, system-signal=LMC_WBDC_ActiveSt
        data-element=CPT_APPCOM_SWC.CPT_MCU_Composition.IVI_0x3D8.IVI_AWDModeSW, system-signal=IVI_AWDModeSW
        data-element=CPT_APPCOM_SWC.CPT_MCU_Composition.LMC_0xFA.LMC_SysSt, system-signal=LMC_SysSt
        data-element=CPT_APPCOM_SWC.CPT_MCU_Composition.ECM_0x147.ECM_FuelConsumption, system-signal=ECM_FuelConsumption
        data-element=CPT_APPCOM_SWC.CPT_MCU_Composition.LMC_0xFA.LMC_EAF_ActiveSt, system-signal=LMC_EAF_ActiveSt
        data-element=CPT_APPCOM_SWC.CPT_MCU_Composition.LMC_0xFA.LMC_NSPC_ActiveSt, system-signal=LMC_NSPC_ActiveSt
        data-element=CPT_APPCOM_SWC.CPT_MCU_Composition.LMC_0xFA.LMC_LSFCActiveSt, system-signal=LMC_LSFCActiveSt
        data-element=CPT_APPCOM_SWC.CPT_MCU_Composition.LMC_0xFA.LMC_EngTorqDec_Main_R, system-signal=LMC_EngTorqDec_Main_R
        data-element=CPT_APPCOM_SWC.CPT_MCU_Composition.LMC_0xFA.LMC_EngTorqDecActive_Main_R, system-signal=LMC_EngTorqDecActive_Main_R
        data-element=CPT_APPCOM_SWC.CPT_MCU_Composition.LMC_0xFA.LMC_EngTorqInc_Main_R, system-signal=LMC_EngTorqInc_Main_R
        data-element=CPT_APPCOM_SWC.CPT_MCU_Composition.LMC_0xFA.LMC_EngTorqIncActive_Main_R, system-signal=LMC_EngTorqIncActive_Main_R
        data-element=CPT_APPCOM_SWC.CPT_MCU_Composition.LMC_0xFA.LMC_FTSC_ActiveSt, system-signal=LMC_FTSC_ActiveSt
        data-element=CPT_APPCOM_SWC.CPT_MCU_Composition.LMC_0xFA.LMC_SDRM_ActiveSt, system-signal=LMC_SDRM_ActiveSt
        data-element=CPT_APPCOM_SWC.CPT_MCU_Composition.LMC_0xFA.LMC_SelfCheckSt, system-signal=LMC_SelfCheckSt
        data-element=CPT_APPCOM_SWC.CPT_MCU_Composition.VCU_0x514.VCU_EngLongTimeStartReq, system-signal=VCU_EngLongTimeStartReq
        data-element=CPT_APPCOM_SWC.CPT_MCU_Composition.LMC_0xFA.LMC_HSPC_ActiveSt, system-signal=LMC_HSPC_ActiveSt
        data-element=CPT_APPCOM_SWC.CPT_MCU_Composition.MCUM_0x135.MCUM_CRC_135, system-signal=MCUM_CRC_135
        data-element=CPT_APPCOM_SWC.CPT_MCU_Composition.MCUM_0x135.MCUM_RollingCounter_135, system-signal=MCUM_RollingCounter_135
        data-element=CPT_APPCOM_SWC.CPT_MCU_Composition.MCUM_0x135.MCUM_LDC_SWInfo, system-signal=MCUM_LDC_SWInfo
        data-element=CPT_APPCOM_SWC.CPT_MCU_Composition.MCUM_0x135.MCUM_LDC_MTarOut_FA, system-signal=MCUM_LDC_MTarOut_FA
        data-element=CPT_APPCOM_SWC.CPT_MCU_Composition.MCUM_0x135.MCUM_LDC_MTarOut_RA, system-signal=MCUM_LDC_MTarOut_RA
        data-element=CPT_APPCOM_SWC.CPT_MCU_Composition.MCUM_0x135.MCUM_LDC_Available_FA, system-signal=MCUM_LDC_Available_FA
        data-element=CPT_APPCOM_SWC.CPT_MCU_Composition.MCUM_0x135.MCUM_LDC_OperationMode_FA, system-signal=MCUM_LDC_OperationMode_FA
        data-element=CPT_APPCOM_SWC.CPT_MCU_Composition.MCUM_0x135.MCUM_LDC_Available_RA, system-signal=MCUM_LDC_Available_RA
        data-element=CPT_APPCOM_SWC.CPT_MCU_Composition.MCUM_0x135.MCUM_LDC_OperationMode_RA, system-signal=MCUM_LDC_OperationMode_RA
        data-element=CPT_APPCOM_SWC.CPT_MCU_Composition.MCUM_0x135.MCUM_RTE_Exchange_Signal_Status, system-signal=MCUM_RTE_Exchange_Signal_Status
        data-element=CPT_APPCOM_SWC.CPT_MCU_Composition.MCUM_0x135.MCUM_MTarIn_FA, system-signal=MCUM_MTarIn_FA
        data-element=CPT_APPCOM_SWC.CPT_MCU_Composition.MCUM_0x135.MCUM_MTarIn_RA, system-signal=MCUM_MTarIn_RA
        data-element=CPT_APPCOM_SWC.CPT_MCU_Composition.MCUM_0x135.MCUM_InputQF_FA, system-signal=MCUM_InputQF_FA
        data-element=CPT_APPCOM_SWC.CPT_MCU_Composition.MCUM_0x135.MCUM_InputQF_RA, system-signal=MCUM_InputQF_RA
        data-element=CPT_APPCOM_SWC.CPT_MCU_Composition.IBC_0x136.IBC_CRC_136, system-signal=IBC_CRC_136
        data-element=CPT_APPCOM_SWC.CPT_MCU_Composition.IBC_0x136.IBC_RollingCounter_136, system-signal=IBC_RollingCounter_136
        data-element=CPT_APPCOM_SWC.CPT_MCU_Composition.IBC_0x136.IBC_ModeMinEDrvTar_FA, system-signal=IBC_ModeMinEDrvTar_FA
        data-element=CPT_APPCOM_SWC.CPT_MCU_Composition.IBC_0x136.IBC_ModeMinEDrvTar_RA, system-signal=IBC_ModeMinEDrvTar_RA
        data-element=CPT_APPCOM_SWC.CPT_MCU_Composition.IBC_0x136.IBC_ModeMaxEDrvTar_FA, system-signal=IBC_ModeMaxEDrvTar_FA
        data-element=CPT_APPCOM_SWC.CPT_MCU_Composition.IBC_0x136.IBC_ModeMaxEDrvTar_RA, system-signal=IBC_ModeMaxEDrvTar_RA
        data-element=CPT_APPCOM_SWC.CPT_MCU_Composition.IBC_0x136.IBC_torque_distribution_RA_Vaild, system-signal=IBC_torque_distribution_RA_Vaild
        data-element=CPT_APPCOM_SWC.CPT_MCU_Composition.IBC_0x136.IBC_torque_distribution_RA, system-signal=IBC_torque_distribution_RA
        data-element=CPT_APPCOM_SWC.CPT_MCU_Composition.IBC_0x136.IBC_mTar_FA, system-signal=IBC_mTar_FA
        data-element=CPT_APPCOM_SWC.CPT_MCU_Composition.IBC_0x136.IBC_mTar_RA, system-signal=IBC_mTar_RA
        data-element=CPT_APPCOM_SWC.CPT_MCU_Composition.IBC_0x136.IBC_iLDC_SWInfo, system-signal=IBC_iLDC_SWInfo
        data-element=CPT_APPCOM_SWC.CPT_MCU_Composition.IBC_0x136.IBC_Variant_Signal, system-signal=IBC_Variant_Signal
        data-element=CPT_APPCOM_SWC.CPT_MCU_Composition.IBC_0x136.IBC_nTarMax_FA, system-signal=IBC_nTarMax_FA
        data-element=CPT_APPCOM_SWC.CPT_MCU_Composition.IBC_0x136.IBC_nTarMax_RA, system-signal=IBC_nTarMax_RA
        data-element=CPT_APPCOM_SWC.CPT_MCU_Composition.IBC_0x136.IBC_nTarMin_FA, system-signal=IBC_nTarMin_FA
        data-element=CPT_APPCOM_SWC.CPT_MCU_Composition.IBC_0x136.IBC_nTarMin_RA, system-signal=IBC_nTarMin_RA
        data-element=CPT_APPCOM_SWC.CPT_MCU_Composition.MCUM_0x42C.MCUM_WakeUpReason, system-signal=MCUM_WakeUpReason
        data-element=CPT_APPCOM_SWC.CPT_MCU_Composition.MCUM_0x42C.MCUM_NMControlRMR_Sts, system-signal=MCUM_NMControlRMR_Sts
        data-element=CPT_APPCOM_SWC.CPT_MCU_Composition.MCUM_0x42C_PCANFD.MCUM_NMControlRMR_Sts_P, system-signal=MCUM_NMControlRMR_Sts_P
        data-element=CPT_APPCOM_SWC.CPT_MCU_Composition.MCUM_0x42C_PCANFD.MCUM_WakeUpReason_P, system-signal=MCUM_WakeUpReason_P
        data-element=CPT_APPCOM_SWC.CPT_MCU_Composition.VCU_0xDE.VCU_BrkPedOpen, system-signal=VCU_BrkPedOpen
        data-element=CPT_APPCOM_SWC.CPT_MCU_Composition.VCU_0xDE.VCU_BrkPedClose, system-signal=VCU_BrkPedClose
        data-element=CPT_APPCOM_SWC.CPT_MCU_Composition.VCU_0xDE.VCU_BrkPedOpen, system-signal=VCU_BrkPedOpen
        data-element=CPT_APPCOM_SWC.CPT_MCU_Composition.VCU_0xDE.VCU_BrkPedClose, system-signal=VCU_BrkPedClose
        data-element=CPT_APPCOM_SWC.CPT_MCU_Composition.VCU_0xDE.VCU_ColumnShiftP, system-signal=VCU_ColumnShiftP
        data-element=CPT_APPCOM_SWC.CPT_MCU_Composition.VCU_0xDE.VCU_VehiCrashSts, system-signal=VCU_VehiCrashSts
        data-element=CPT_APPCOM_SWC.CPT_MCU_Composition.VCU_0xDE.VCU_SleepSatisfiedSts, system-signal=VCU_SleepSatisfiedSts
        data-element=CPT_APPCOM_SWC.CPT_MCU_Composition.VCU_0xDE.VCU_VehiHvCmd, system-signal=VCU_VehiHvCmd
        data-element=CPT_APPCOM_SWC.CPT_MCU_Composition.VCU_0xDE.VCU_GearQuitAps, system-signal=VCU_GearQuitAps
        data-element=CPT_APPCOM_SWC.CPT_MCU_Composition.VCU_0xDE.VCU_REOverChgPwrFlag, system-signal=VCU_REOverChgPwrFlag
        data-element=CPT_APPCOM_SWC.CPT_MCU_Composition.VCU_0xDE.VCU_VehiAccnFilt, system-signal=VCU_VehiAccnFilt
        data-element=CPT_APPCOM_SWC.CPT_MCU_Composition.VCU_0xDE.VCU_HvOffSts, system-signal=VCU_HvOffSts
        data-element=CPT_APPCOM_SWC.CPT_MCU_Composition.VCU_0xDE.VCU_ElecPwrBalanceReq, system-signal=VCU_ElecPwrBalanceReq
        data-element=CPT_APPCOM_SWC.CPT_MCU_Composition.VCU_0xDE.VCU_CDU_RecvTr, system-signal=VCU_CDU_RecvTr
        data-element=CPT_APPCOM_SWC.CPT_MCU_Composition.VCU_0xDE.VCU_BMS_RecvTr, system-signal=VCU_BMS_RecvTr
        data-element=CPT_APPCOM_SWC.CPT_MCU_Composition.VCU_0xDE.VCU_IVI_RecvTr, system-signal=VCU_IVI_RecvTr
        data-element=CPT_APPCOM_SWC.CPT_MCU_Composition.VCU_0xDE.VCU_WheelMaxDrvTrq, system-signal=VCU_WheelMaxDrvTrq
        data-element=CPT_APPCOM_SWC.CPT_MCU_Composition.VCU_0xDE.VCU_WheelMaxRecTrq, system-signal=VCU_WheelMaxRecTrq
        data-element=CPT_APPCOM_SWC.CPT_MCU_Composition.VCU_0xDE.VCU_GCU_RecvTr, system-signal=VCU_GCU_RecvTr
        data-element=CPT_APPCOM_SWC.CPT_MCU_Composition.VCU_0xDE.VCU_TCM_RecvTr, system-signal=VCU_TCM_RecvTr
        data-element=CPT_APPCOM_SWC.CPT_MCU_Composition.VCU_0xDE.VCU_PTC_RecvTr, system-signal=VCU_PTC_RecvTr
        data-element=CPT_APPCOM_SWC.CPT_MCU_Composition.VCU_0xDE.VCU_LossFctorFlgFL, system-signal=VCU_LossFctorFlgFL
        data-element=CPT_APPCOM_SWC.CPT_MCU_Composition.VCU_0xDE.VCU_LowBattVolt, system-signal=VCU_LowBattVolt
        data-element=CPT_APPCOM_SWC.CPT_MCU_Composition.VCU_0xDE.VCU_HighPerforDisable, system-signal=VCU_HighPerforDisable
        data-element=CPT_APPCOM_SWC.CPT_MCU_Composition.VCU_0xDE.VCU_AccPedHSigVolt, system-signal=VCU_AccPedHSigVolt
        data-element=CPT_APPCOM_SWC.CPT_MCU_Composition.VCU_0xDE.VCU_LossFctorFlgFR, system-signal=VCU_LossFctorFlgFR
        data-element=CPT_APPCOM_SWC.CPT_MCU_Composition.VCU_0xDE.VCU_AccPedLSigVolt, system-signal=VCU_AccPedLSigVolt
        data-element=CPT_APPCOM_SWC.CPT_MCU_Composition.VCU_0xDE.VCU_LossFctorFlgRL, system-signal=VCU_LossFctorFlgRL
        data-element=CPT_APPCOM_SWC.CPT_MCU_Composition.VCU_0xDE.VCU_AccPedHPwrVolt, system-signal=VCU_AccPedHPwrVolt
        data-element=CPT_APPCOM_SWC.CPT_MCU_Composition.VCU_0xDE.VCU_LossFctorFlgRR, system-signal=VCU_LossFctorFlgRR
        data-element=CPT_APPCOM_SWC.CPT_MCU_Composition.VCU_0xDE.VCU_AccPedLPwrVolt, system-signal=VCU_AccPedLPwrVolt
        data-element=CPT_APPCOM_SWC.CPT_MCU_Composition.VCU_0xDE.VCU_PreReqChgPwr, system-signal=VCU_PreReqChgPwr
        data-element=CPT_APPCOM_SWC.CPT_MCU_Composition.VCU_0xDE.VCU_VehPwrChageLimit, system-signal=VCU_VehPwrChageLimit
        data-element=CPT_APPCOM_SWC.CPT_MCU_Composition.VCU_0xDE.VCU_FastPwrRequest, system-signal=VCU_FastPwrRequest
        data-element=CPT_APPCOM_SWC.CPT_MCU_Composition.VCU_0xDE.VCU_On2KL15_Volt, system-signal=VCU_On2KL15_Volt
        data-element=CPT_APPCOM_SWC.CPT_MCU_Composition.VCU_0xDE.VCU_ClutchWrkModDebug, system-signal=VCU_ClutchWrkModDebug
        data-element=CPT_APPCOM_SWC.CPT_MCU_Composition.VCU_0xDE.VCU_HighPerforSwtFlg, system-signal=VCU_HighPerforSwtFlg
        data-element=CPT_APPCOM_SWC.CPT_MCU_Composition.VCU_0xDE.VCU_VehiPowrConsumption, system-signal=VCU_VehiPowrConsumption
        data-element=CPT_APPCOM_SWC.CPT_MCU_Composition.VCU_0xDE.VCU_MDrvFilterTrqRange, system-signal=VCU_MDrvFilterTrqRange
        data-element=CPT_APPCOM_SWC.CPT_MCU_Composition.VCU_0xDE.VCU_WheelPwrOvrLimitflgRE, system-signal=VCU_WheelPwrOvrLimitflgRE
        data-element=CPT_APPCOM_SWC.CPT_MCU_Composition.VCU_0xDE.VCU_MRDrvControlMode, system-signal=VCU_MRDrvControlMode
        data-element=CPT_APPCOM_SWC.CPT_MCU_Composition.VCU_0xDE.VCU_MRDrvControlModeVD, system-signal=VCU_MRDrvControlModeVD
        data-element=CPT_APPCOM_SWC.CPT_MCU_Composition.VCU_0xDE.VCU_VehicleDirectMR, system-signal=VCU_VehicleDirectMR
        data-element=CPT_APPCOM_SWC.CPT_MCU_Composition.VCU_0xDE.VCU_VehicleDirectMRVD, system-signal=VCU_VehicleDirectMRVD
        data-element=CPT_APPCOM_SWC.CPT_MCU_Composition.VCU_0xDE.VCU_MRDrvRequestTorque, system-signal=VCU_MRDrvRequestTorque
        data-element=CPT_APPCOM_SWC.CPT_MCU_Composition.VCU_0xDE.VCU_MRDrvRequesSpeed, system-signal=VCU_MRDrvRequesSpeed
        data-element=CPT_APPCOM_SWC.CPT_MCU_Composition.VCU_0xDE.VCU_MCUMRMaxDischargePower, system-signal=VCU_MCUMRMaxDischargePower
        data-element=CPT_APPCOM_SWC.CPT_MCU_Composition.VCU_0xDE.VCU_MCUMRMaxPosDampgTrq, system-signal=VCU_MCUMRMaxPosDampgTrq
        data-element=CPT_APPCOM_SWC.CPT_MCU_Composition.VCU_0xDE.VCU_MRDrvRequestTorqueVD, system-signal=VCU_MRDrvRequestTorqueVD
        data-element=CPT_APPCOM_SWC.CPT_MCU_Composition.VCU_0xDE.VCU_MCUMRMaxChargePower, system-signal=VCU_MCUMRMaxChargePower
        data-element=CPT_APPCOM_SWC.CPT_MCU_Composition.VCU_0xDE.VCU_MCUMRMaxNegDampgTrq, system-signal=VCU_MCUMRMaxNegDampgTrq
        data-element=CPT_APPCOM_SWC.CPT_MCU_Composition.VCU_0xDE.VCU_MRDrvRequesSpeedVD, system-signal=VCU_MRDrvRequesSpeedVD
        data-element=CPT_APPCOM_SWC.CPT_MCU_Composition.VCU_0xDE.VCU_MCUMRDampgLmtFactor, system-signal=VCU_MCUMRDampgLmtFactor
        data-element=CPT_APPCOM_SWC.CPT_MCU_Composition.VCU_0xDE.VCU_SuppressJitterMCUMRRequest, system-signal=VCU_SuppressJitterMCUMRRequest
        data-element=CPT_APPCOM_SWC.CPT_MCU_Composition.VCU_0x3.EOL_VCU_BrkPedOpen, system-signal=EOL_VCU_BrkPedOpen
        data-element=CPT_APPCOM_SWC.CPT_MCU_Composition.VCU_0x3.EOL_VCU_BrkPedClose, system-signal=EOL_VCU_BrkPedClose
        data-element=CPT_APPCOM_SWC.CPT_MCU_Composition.VCU_0x3.EOL_VCU_ColumnShiftP, system-signal=EOL_VCU_ColumnShiftP
        data-element=CPT_APPCOM_SWC.CPT_MCU_Composition.VCU_0x3.EOL_VCU_VehiCrashSts, system-signal=EOL_VCU_VehiCrashSts
        data-element=CPT_APPCOM_SWC.CPT_MCU_Composition.VCU_0x3.EOL_VCU_SleepSatisfiedSts, system-signal=EOL_VCU_SleepSatisfiedSts
        data-element=CPT_APPCOM_SWC.CPT_MCU_Composition.VCU_0x3.EOL_VCU_VehiHvCmd, system-signal=EOL_VCU_VehiHvCmd
        data-element=CPT_APPCOM_SWC.CPT_MCU_Composition.VCU_0x3.EOL_VCU_GearQuitAps, system-signal=EOL_VCU_GearQuitAps
        data-element=CPT_APPCOM_SWC.CPT_MCU_Composition.VCU_0x3.EOL_VCU_REOverChgPwrFlag, system-signal=EOL_VCU_REOverChgPwrFlag
        data-element=CPT_APPCOM_SWC.CPT_MCU_Composition.VCU_0x3.EOL_VCU_VehiAccnFilt, system-signal=EOL_VCU_VehiAccnFilt
        data-element=CPT_APPCOM_SWC.CPT_MCU_Composition.VCU_0x3.EOL_VCU_HvOffSts, system-signal=EOL_VCU_HvOffSts
        data-element=CPT_APPCOM_SWC.CPT_MCU_Composition.VCU_0x3.EOL_VCU_ElecPwrBalanceReq, system-signal=EOL_VCU_ElecPwrBalanceReq
        data-element=CPT_APPCOM_SWC.CPT_MCU_Composition.VCU_0x3.EOL_VCU_CDU_RecvTr, system-signal=EOL_VCU_CDU_RecvTr
        data-element=CPT_APPCOM_SWC.CPT_MCU_Composition.VCU_0x3.EOL_VCU_BMS_RecvTr, system-signal=EOL_VCU_BMS_RecvTr
        data-element=CPT_APPCOM_SWC.CPT_MCU_Composition.VCU_0x3.EOL_VCU_IVI_RecvTr, system-signal=EOL_VCU_IVI_RecvTr
        data-element=CPT_APPCOM_SWC.CPT_MCU_Composition.VCU_0x3.EOL_VCU_WheelMaxDrvTrq, system-signal=EOL_VCU_WheelMaxDrvTrq
        data-element=CPT_APPCOM_SWC.CPT_MCU_Composition.VCU_0x3.EOL_VCU_WheelMaxRecTrq, system-signal=EOL_VCU_WheelMaxRecTrq
        data-element=CPT_APPCOM_SWC.CPT_MCU_Composition.VCU_0x3.EOL_VCU_GCU_RecvTr, system-signal=EOL_VCU_GCU_RecvTr
        data-element=CPT_APPCOM_SWC.CPT_MCU_Composition.VCU_0x3.EOL_VCU_TCM_RecvTr, system-signal=EOL_VCU_TCM_RecvTr
        data-element=CPT_APPCOM_SWC.CPT_MCU_Composition.VCU_0x3.EOL_VCU_PTC_RecvTr, system-signal=EOL_VCU_PTC_RecvTr
        data-element=CPT_APPCOM_SWC.CPT_MCU_Composition.VCU_0x3.EOL_VCU_LossFctorFlgFL, system-signal=EOL_VCU_LossFctorFlgFL
        data-element=CPT_APPCOM_SWC.CPT_MCU_Composition.VCU_0x3.EOL_VCU_LowBattVolt, system-signal=EOL_VCU_LowBattVolt
        data-element=CPT_APPCOM_SWC.CPT_MCU_Composition.VCU_0x3.EOL_VCU_HighPerforDisable, system-signal=EOL_VCU_HighPerforDisable
        data-element=CPT_APPCOM_SWC.CPT_MCU_Composition.VCU_0x3.EOL_VCU_AccPedHSigVolt, system-signal=EOL_VCU_AccPedHSigVolt
        data-element=CPT_APPCOM_SWC.CPT_MCU_Composition.VCU_0x3.EOL_VCU_LossFctorFlgFR, system-signal=EOL_VCU_LossFctorFlgFR
        data-element=CPT_APPCOM_SWC.CPT_MCU_Composition.VCU_0x3.EOL_VCU_AccPedLSigVolt, system-signal=EOL_VCU_AccPedLSigVolt
        data-element=CPT_APPCOM_SWC.CPT_MCU_Composition.VCU_0x3.EOL_VCU_LossFctorFlgRL, system-signal=EOL_VCU_LossFctorFlgRL
        data-element=CPT_APPCOM_SWC.CPT_MCU_Composition.VCU_0x3.EOL_VCU_AccPedHPwrVolt, system-signal=EOL_VCU_AccPedHPwrVolt
        data-element=CPT_APPCOM_SWC.CPT_MCU_Composition.VCU_0x3.EOL_VCU_LossFctorFlgRR, system-signal=EOL_VCU_LossFctorFlgRR
        data-element=CPT_APPCOM_SWC.CPT_MCU_Composition.VCU_0x3.EOL_VCU_AccPedLPwrVolt, system-signal=EOL_VCU_AccPedLPwrVolt
        data-element=CPT_APPCOM_SWC.CPT_MCU_Composition.VCU_0x3.EOL_VCU_PreReqChgPwr, system-signal=EOL_VCU_PreReqChgPwr
        data-element=CPT_APPCOM_SWC.CPT_MCU_Composition.VCU_0x3.EOL_VCU_VehPwrChageLimit, system-signal=EOL_VCU_VehPwrChageLimit
        data-element=CPT_APPCOM_SWC.CPT_MCU_Composition.VCU_0x3.EOL_VCU_FastPwrRequest, system-signal=EOL_VCU_FastPwrRequest
        data-element=CPT_APPCOM_SWC.CPT_MCU_Composition.VCU_0x3.EOL_VCU_On2KL15_Volt, system-signal=EOL_VCU_On2KL15_Volt
        data-element=CPT_APPCOM_SWC.CPT_MCU_Composition.VCU_0x3.EOL_VCU_ClutchWrkModDebug, system-signal=EOL_VCU_ClutchWrkModDebug
        data-element=CPT_APPCOM_SWC.CPT_MCU_Composition.VCU_0x3.EOL_VCU_HighPerforSwtFlg, system-signal=EOL_VCU_HighPerforSwtFlg
        data-element=CPT_APPCOM_SWC.CPT_MCU_Composition.VCU_0x3.EOL_VCU_VehiPowrConsumption, system-signal=EOL_VCU_VehiPowrConsumption
        data-element=CPT_APPCOM_SWC.CPT_MCU_Composition.VCU_0x3.EOL_VCU_MDrvFilterTrqRange, system-signal=EOL_VCU_MDrvFilterTrqRange
        data-element=CPT_APPCOM_SWC.CPT_MCU_Composition.VCU_0x3.EOL_VCU_WheelPwrOvrLimitflgRE, system-signal=EOL_VCU_WheelPwrOvrLimitflgRE
        data-element=CPT_APPCOM_SWC.CPT_MCU_Composition.VCU_0x3.EOL_VCU_MRDrvControlMode, system-signal=EOL_VCU_MRDrvControlMode
        data-element=CPT_APPCOM_SWC.CPT_MCU_Composition.VCU_0x3.EOL_VCU_MRDrvControlModeVD, system-signal=EOL_VCU_MRDrvControlModeVD
        data-element=CPT_APPCOM_SWC.CPT_MCU_Composition.VCU_0x3.EOL_VCU_VehicleDirectMR, system-signal=EOL_VCU_VehicleDirectMR
        data-element=CPT_APPCOM_SWC.CPT_MCU_Composition.VCU_0x3.EOL_VCU_VehicleDirectMRVD, system-signal=EOL_VCU_VehicleDirectMRVD
        data-element=CPT_APPCOM_SWC.CPT_MCU_Composition.VCU_0x3.EOL_VCU_MRDrvRequestTorque, system-signal=EOL_VCU_MRDrvRequestTorque
        data-element=CPT_APPCOM_SWC.CPT_MCU_Composition.VCU_0x3.EOL_VCU_MRDrvRequesSpeed, system-signal=EOL_VCU_MRDrvRequesSpeed
        data-element=CPT_APPCOM_SWC.CPT_MCU_Composition.VCU_0x3.EOL_VCU_MCUMRMaxDischargePower, system-signal=EOL_VCU_MCUMRMaxDischargePower
        data-element=CPT_APPCOM_SWC.CPT_MCU_Composition.VCU_0x3.EOL_VCU_MCUMRMaxPosDampgTrq, system-signal=EOL_VCU_MCUMRMaxPosDampgTrq
        data-element=CPT_APPCOM_SWC.CPT_MCU_Composition.VCU_0x3.EOL_VCU_MRDrvRequestTorqueVD, system-signal=EOL_VCU_MRDrvRequestTorqueVD
        data-element=CPT_APPCOM_SWC.CPT_MCU_Composition.VCU_0x3.EOL_VCU_MCUMRMaxChargePower, system-signal=EOL_VCU_MCUMRMaxChargePower
        data-element=CPT_APPCOM_SWC.CPT_MCU_Composition.VCU_0x3.EOL_VCU_MCUMRMaxNegDampgTrq, system-signal=EOL_VCU_MCUMRMaxNegDampgTrq
        data-element=CPT_APPCOM_SWC.CPT_MCU_Composition.VCU_0x3.EOL_VCU_MRDrvRequesSpeedVD, system-signal=EOL_VCU_MRDrvRequesSpeedVD
        data-element=CPT_APPCOM_SWC.CPT_MCU_Composition.VCU_0x3.EOL_VCU_MCUMRDampgLmtFactor, system-signal=EOL_VCU_MCUMRDampgLmtFactor
        data-element=CPT_APPCOM_SWC.CPT_MCU_Composition.VCU_0x3.EOL_VCU_SuppressJitterMCUMRRequest, system-signal=EOL_VCU_SuppressJitterMCUMRRequest
        data-element=CPT_APPCOM_SWC.CPT_MCU_Composition.EMS_0xBE.ECM_ClearingSparkcarbonedRequest, system-signal=ECM_ClearingSparkcarbonedRequest
        data-element=CPT_APPCOM_SWC.CPT_MCU_Composition.MCUS_0xDB.MCUS_SystemError, system-signal=MCUS_SystemError
        data-element=CPT_APPCOM_SWC.CPT_MCU_Composition.MCUS_0xDB.MCUS_LVSystemError, system-signal=MCUS_LVSystemError
        data-element=CPT_APPCOM_SWC.CPT_MCU_Composition.MCUS_0xDB.MCUS_MotorTempAlarm, system-signal=MCUS_MotorTempAlarm
        data-element=CPT_APPCOM_SWC.CPT_MCU_Composition.MCUS_0xDB.MCUS_HVSystemError, system-signal=MCUS_HVSystemError
        data-element=CPT_APPCOM_SWC.CPT_MCU_Composition.MCUS_0xDB.MCUS_SeriousWarning_Level, system-signal=MCUS_SeriousWarning_Level
        data-element=CPT_APPCOM_SWC.CPT_MCU_Composition.MCUS_0xDB.MCUS_CtrlModeVD, system-signal=MCUS_CtrlModeVD
        data-element=CPT_APPCOM_SWC.CPT_MCU_Composition.MCUS_0xDB.MCUS_WaterPumpLevlReq, system-signal=MCUS_WaterPumpLevlReq
        data-element=CPT_APPCOM_SWC.CPT_MCU_Composition.MCUS_0xDB.MCUS_MotorTemp, system-signal=MCUS_MotorTemp
        data-element=CPT_APPCOM_SWC.CPT_MCU_Composition.MCUS_0xDB.MCUS_IGBTTemp, system-signal=MCUS_IGBTTemp
        data-element=CPT_APPCOM_SWC.CPT_MCU_Composition.MCUS_0xDB.MCUS_InletTemp, system-signal=MCUS_InletTemp
        data-element=CPT_APPCOM_SWC.CPT_MCU_Composition.TMS_0x362.TMS_RAPTC_ModOprtgStsFrt, system-signal=TMS_RAPTC_ModOprtgStsFrt
        data-element=CPT_APPCOM_SWC.CPT_MCU_Composition.TMS_0x362.TMS_RAPTC_ModOpEnblCmd, system-signal=TMS_RAPTC_ModOpEnblCmd
        data-element=CPT_APPCOM_SWC.CPT_MCU_Composition.TMS_0x362.TMS_RAPTC_MsrdPwrFrt, system-signal=TMS_RAPTC_MsrdPwrFrt
        data-element=CPT_APPCOM_SWC.CPT_MCU_Composition.ACU_0x15.ACU_IMU_CRC_15, system-signal=ACU_IMU_CRC_15
        data-element=CPT_APPCOM_SWC.CPT_MCU_Composition.ACU_0x15.ACU_IMU_RollingCounter_15, system-signal=ACU_IMU_RollingCounter_15
        data-element=CPT_APPCOM_SWC.CPT_MCU_Composition.ACU_0x15.ACU_IMU_ACC_x, system-signal=ACU_IMU_ACC_x
        data-element=CPT_APPCOM_SWC.CPT_MCU_Composition.ACU_0x15.ACU_IMU_ACC_y, system-signal=ACU_IMU_ACC_y
        data-element=CPT_APPCOM_SWC.CPT_MCU_Composition.ACU_0x15.ACU_IMU_ACC_z, system-signal=ACU_IMU_ACC_z
        data-element=CPT_APPCOM_SWC.CPT_MCU_Composition.ACU_0x15.ACU_IMU_Roll_Rate, system-signal=ACU_IMU_Roll_Rate
        data-element=CPT_APPCOM_SWC.CPT_MCU_Composition.ACU_0x15.ACU_IMU_Pitch_Rate, system-signal=ACU_IMU_Pitch_Rate
        data-element=CPT_APPCOM_SWC.CPT_MCU_Composition.ACU_0x15.ACU_IMU_Yaw_Rate, system-signal=ACU_IMU_Yaw_Rate
        data-element=CPT_APPCOM_SWC.CPT_MCU_Composition.ACU_0x15.ACU_IMU_Calibrated, system-signal=ACU_IMU_Calibrated
        data-element=CPT_APPCOM_SWC.CPT_MCU_Composition.ACU_0x15.ACU_IMU_Valid, system-signal=ACU_IMU_Valid
        data-element=CPT_APPCOM_SWC.CPT_MCU_Composition.ACU_0x15.ACU_IMU_Fault_Status, system-signal=ACU_IMU_Fault_Status
        data-element=CPT_APPCOM_SWC.CPT_MCU_Composition.ACU_0x15.ACU_IMU_MessageStatus, system-signal=ACU_IMU_MessageStatus
        data-element=CPT_APPCOM_SWC.CPT_MCU_Composition.ACU_0x15.ACU_IMU_FunctionSafetyStatus, system-signal=ACU_IMU_FunctionSafetyStatus
        data-element=CPT_APPCOM_SWC.CPT_MCU_Composition.ACU_0x15.ACU_IMU_Temperature, system-signal=ACU_IMU_Temperature
        data-element=CPT_APPCOM_SWC.CPT_MCU_Composition.HPCBCM_0xDA.BCM_CRC_DA, system-signal=BCM_CRC_DA
        data-element=CPT_APPCOM_SWC.CPT_MCU_Composition.HPCBCM_0xDA.BCM_RollingCounter_DA, system-signal=BCM_RollingCounter_DA
        data-element=CPT_APPCOM_SWC.CPT_MCU_Composition.HPCBCM_0xDA.BCM_IMU_ACC_x, system-signal=BCM_IMU_ACC_x
        data-element=CPT_APPCOM_SWC.CPT_MCU_Composition.HPCBCM_0xDA.BCM_IMU_ACC_y, system-signal=BCM_IMU_ACC_y
        data-element=CPT_APPCOM_SWC.CPT_MCU_Composition.HPCBCM_0xDA.BCM_IMU_ACC_z, system-signal=BCM_IMU_ACC_z
        data-element=CPT_APPCOM_SWC.CPT_MCU_Composition.HPCBCM_0xDA.BCM_IMU_ACC_Roll_Rate, system-signal=BCM_IMU_ACC_Roll_Rate
        data-element=CPT_APPCOM_SWC.CPT_MCU_Composition.HPCBCM_0xDA.BCM_IMU_ACC_Pitch_Rate, system-signal=BCM_IMU_ACC_Pitch_Rate
        data-element=CPT_APPCOM_SWC.CPT_MCU_Composition.HPCBCM_0xDA.BCM_IMU_ACC_Yaw_Rate, system-signal=BCM_IMU_ACC_Yaw_Rate
        data-element=CPT_APPCOM_SWC.CPT_MCU_Composition.HPCBCM_0xDA.BCM_IMU_Valid, system-signal=BCM_IMU_Valid
        data-element=CPT_APPCOM_SWC.CPT_MCU_Composition.LMC_0x133.LMC_CRC_133, system-signal=LMC_CRC_133
        data-element=CPT_APPCOM_SWC.CPT_MCU_Composition.LMC_0x133.LMC_DrvReqTorque, system-signal=LMC_DrvReqTorque
        data-element=CPT_APPCOM_SWC.CPT_MCU_Composition.LMC_0x133.LMC_RollingCounter_133, system-signal=LMC_RollingCounter_133
        data-element=CPT_APPCOM_SWC.CPT_MCU_Composition.LMCSSU_0x25A.LMC_CRC_25A, system-signal=LMC_CRC_25A
        data-element=CPT_APPCOM_SWC.CPT_MCU_Composition.LMCSSU_0x25A.LMC_ECAS_DriveModeFb, system-signal=LMC_ECAS_DriveModeFb
        data-element=CPT_APPCOM_SWC.CPT_MCU_Composition.LMCSSU_0x25A.LMC_CDC_DriveModeFb, system-signal=LMC_CDC_DriveModeFb
        data-element=CPT_APPCOM_SWC.CPT_MCU_Composition.LMCSSU_0x25A.LMC_RollingCounter_25A, system-signal=LMC_RollingCounter_25A
        data-element=CPT_APPCOM_SWC.CPT_MCU_Composition.ICU_0x5BE.ICU_RollingCounter_5BE, system-signal=ICU_RollingCounter_5BE
        data-element=CPT_APPCOM_SWC.CPT_MCU_Composition.ICU_0x5BE.ICU_Imu_Cal_Staus, system-signal=ICU_Imu_Cal_Staus
        data-element=CPT_APPCOM_SWC.CPT_MCU_Composition.ICU_0x5BE.ICU_Imu_Cal_Gyro, system-signal=ICU_Imu_Cal_Gyro
        data-element=CPT_APPCOM_SWC.CPT_MCU_Composition.ICU_0x5BE.ICU_Imu_Cal_Pitch, system-signal=ICU_Imu_Cal_Pitch
        data-element=CPT_APPCOM_SWC.CPT_MCU_Composition.ICU_0x5BE.ICU_Imu_Cal_Roll, system-signal=ICU_Imu_Cal_Roll
        data-element=CPT_APPCOM_SWC.CPT_MCU_Composition.HPCBCM_0x4A.BCM_CRC_4A, system-signal=BCM_CRC_4A
        data-element=CPT_APPCOM_SWC.CPT_MCU_Composition.HPCBCM_0x4A.BCM_IBCLimphomeSts, system-signal=BCM_IBCLimphomeSts
        data-element=CPT_APPCOM_SWC.CPT_MCU_Composition.HPCBCM_0x4A.BCM_EOLAutomaticActiveSts_C, system-signal=BCM_EOLAutomaticActiveSts_C
        data-element=CPT_APPCOM_SWC.CPT_MCU_Composition.HPCBCM_0x4A.BCM_TorqueLimte, system-signal=BCM_TorqueLimte
        data-element=CPT_APPCOM_SWC.CPT_MCU_Composition.HPCBCM_0x4A.BCM_RollingCounter_4A, system-signal=BCM_RollingCounter_4A
      sw-mappings:
        swc to ecu mapping SwcToEcuMapping_MVCU: ecu-instance=MVCU
          component:
            CPT_MCU_Composition.CPT_APPCOM_SWC
            CPT_MCU_Composition.CPT_APPDIAG_SWC
            CPT_MCU_Composition.CPT_APPFLT_SWC
            CPT_MCU_Composition.CPT_Base_SWC
            CPT_MCU_Composition.CPT_BswM
            CPT_MCU_Composition.CPT_ComM
            CPT_MCU_Composition.CPT_Core0_QM
            CPT_MCU_Composition.CPT_Core1_ASIL_A
            CPT_MCU_Composition.CPT_Core1_ASIL_B
            CPT_MCU_Composition.CPT_Core1_ASIL_C
            CPT_MCU_Composition.CPT_Core1_QM
            CPT_MCU_Composition.CPT_Core2_QM
            CPT_MCU_Composition.CPT_DATASTORE_SAFETY_SWC
            CPT_MCU_Composition.CPT_DATASTORE_SWC
            CPT_MCU_Composition.CPT_Dcm
            CPT_MCU_Composition.CPT_Dem
            CPT_MCU_Composition.CPT_Det
            CPT_MCU_Composition.CPT_EcuM
            CPT_MCU_Composition.CPT_IOHwAb
            CPT_MCU_Composition.CPT_NvM
            CPT_MCU_Composition.CPT_IOC_Core2
            CPT_MCU_Composition.CPT_IOC_Core0
            CPT_MCU_Composition.CPT_IOHwAb_SWC_Core2
            CPT_MCU_Composition.CPT_IOC_Core1
            CPT_MCU_Composition.CPT_Core1_ASIL_D
    root-software-compositions:
      root sw composition prototype CPT_MCU_Composition: software-composition=MCU_Composition
