[part 3 of 4: package /ETAS_Project/EcucModuleConfigurationValuess]
AUTOSAR XML (schema 4-2-2)
package /ETAS_Project/EcucModuleConfigurationValuess  (continued)
  module config Com: implementation-config-variant=VARIANT-PRE-COMPILE  (continued)
    ComConfig_0 (ComConfig)  (continued)
      18 x ComSignal, all with ComSignalInitValue=0, ComSignalEndianness=LITTLE_ENDIAN, ComUpdateBitPosition=-1, ComTransferProperty=PENDING:
        MotClb_FaultCode1: ComSignalType=UINT8, ComBitSize=8, ComBitPosition=0, ComSystemTemplateSystemSignalRef=MotClb_FaultCode1
        MotClb_FaultCode2: ComSignalType=UINT8, ComBitSize=8, ComBitPosition=8, ComSystemTemplateSystemSignalRef=MotClb_FaultCode2
        MotClb_FaultCode3: ComSignalType=UINT8, ComBitSize=8, ComBitPosition=16, ComSystemTemplateSystemSignalRef=MotClb_FaultCode3
        MotClb_FaultCode4: ComSignalType=UINT8, ComBitSize=8, ComBitPosition=24, ComSystemTemplateSystemSignalRef=MotClb_FaultCode4
        MotClb_FaultCode5: ComSignalType=UINT8, ComBitSize=8, ComBitPosition=32, ComSystemTemplateSystemSignalRef=MotClb_FaultCode5
        MotClb_FaultCode6: ComSignalType=UINT8, ComBitSize=8, ComBitPosition=40, ComSystemTemplateSystemSignalRef=MotClb_FaultCode6
        MotClb_FaultCode7: ComSignalType=UINT8, ComBitSize=8, ComBitPosition=48, ComSystemTemplateSystemSignalRef=MotClb_FaultCode7
        MotClb_FaultCode8: ComSignalType=UINT8, ComBitSize=8, ComBitPosition=56, ComSystemTemplateSystemSignalRef=MotClb_FaultCode8
        MotClb_OfsApply: ComSignalType=UINT16, ComBitSize=16, ComBitPosition=64, ComSystemTemplateSystemSignalRef=MotClb_OfsApply
        MCUMR_MotClb_FaultCode1: ComSignalType=UINT8, ComBitSize=8, ComBitPosition=96, ComSystemTemplateSystemSignalRef=MCUMR_MotClb_FaultCode1
        MCUMR_MotClb_FaultCode2: ComSignalType=UINT8, ComBitSize=8, ComBitPosition=104, ComSystemTemplateSystemSignalRef=MCUMR_MotClb_FaultCode2
        MCUMR_MotClb_FaultCode3: ComSignalType=UINT8, ComBitSize=8, ComBitPosition=112, ComSystemTemplateSystemSignalRef=MCUMR_MotClb_FaultCode3
        MCUMR_MotClb_FaultCode4: ComSignalType=UINT8, ComBitSize=8, ComBitPosition=120, ComSystemTemplateSystemSignalRef=MCUMR_MotClb_FaultCode4
        MCUMR_MotClb_FaultCode5: ComSignalType=UINT8, ComBitSize=8, ComBitPosition=128, ComSystemTemplateSystemSignalRef=MCUMR_MotClb_FaultCode5
        MCUMR_MotClb_FaultCode6: ComSignalType=UINT8, ComBitSize=8, ComBitPosition=136, ComSystemTemplateSystemSignalRef=MCUMR_MotClb_FaultCode6
        MCUMR_MotClb_FaultCode7: ComSignalType=UINT8, ComBitSize=8, ComBitPosition=144, ComSystemTemplateSystemSignalRef=MCUMR_MotClb_FaultCode7
        MCUMR_MotClb_FaultCode8: ComSignalType=UINT8, ComBitSize=8, ComBitPosition=152, ComSystemTemplateSystemSignalRef=MCUMR_MotClb_FaultCode8
        MCUMR_MotClb_OfsApply: ComSignalType=UINT16, ComBitSize=16, ComBitPosition=160, ComSystemTemplateSystemSignalRef=MCUMR_MotClb_OfsApply
      MCU_0x5C4_P_CANFD (ComIPdu):
        ComIPduSignalProcessing = IMMEDIATE
        ComIPduType = NORMAL
        ComIPduDirection = SEND
        ComFirstTimeout = 0.01
        ComTimeout = 0.01
        ComPduIdRef = PduCollection/MCU_0x5C4_P_CANFD_Com2PduR
        ComIPduSignalRef = MotClb_UdFb
        ComIPduSignalRef = MotClb_UqFb
        ComIPduSignalRef = MotClb_IdSet
        ComIPduSignalRef = MotClb_IqSet
        ComIPduSignalRef = MotClb_IsCMD_Fb
        ComIPduSignalRef = MotClb_ThetaCMD_Fb
        ComIPduSignalRef = MotClb_Id_Fb
        ComIPduSignalRef = MotClb_Iq_Fb
        ComIPduSignalRef = MotClb_Spd_rpm_Flt
        ComIPduSignalRef = MotClb_ThtSetReal
        ComIPduSignalRef = MotClb_Power_Inverter
        ComIPduSignalRef = MotClb_Volt_DC
        ComIPduSignalRef = MotClb_UsOutFlt
        ComIPduSignalRef = MotClb_CoolWater_Temp
        ComIPduSignalRef = MotClb_Motor_Temp1_Flt
        ComIPduSignalRef = MotClb_IGBT_Temp1
        ComIPduSignalRef = MotClb_ErrLevel
        ComIPduSignalRef = MCUMR_MotClb_UdFb
        ComIPduSignalRef = MCUMR_MotClb_UqFb
        ComIPduSignalRef = MCUMR_MotClb_IdSet
        ComIPduSignalRef = MCUMR_MotClb_IqSet
        ComIPduSignalRef = MCUMR_MotClb_IsCMD_Fb
        ComIPduSignalRef = MCUMR_MotClb_ThetaCMD_Fb
        ComIPduSignalRef = MCUMR_MotClb_Id_Fb
        ComIPduSignalRef = MCUMR_MotClb_Iq_Fb
        ComIPduSignalRef = MCUMR_MotClb_Spd_rpm_Flt
        ComIPduSignalRef = MCUMR_MotClb_ThtSetReal
        ComIPduSignalRef = MCUMR_MotClb_Power_Inverter
        ComIPduSignalRef = MCUMR_MotClb_Volt_DC
        ComIPduSignalRef = MCUMR_MotClb_UsOutFlt
        ComIPduSignalRef = MCUMR_MotClb_CoolWater_Temp
        ComIPduSignalRef = MCUMR_MotClb_Motor_Temp1_Flt
        ComIPduSignalRef = MCUMR_MotClb_IGBT_Temp1
        ComIPduSignalRef = MCUMR_MotClb_ErrLevel
        ComIPduGroupRef = ComIPduGroup_DevMCU
        ComTxIPdu: ComMinimumDelayTime=0.0, ComTxIPduUnusedAreasDefault=0
          ComTxModeTrue
            ComTxMode: ComTxModeTimePeriod=0.01, ComTxModeMode=DIRECT, ComTxModeNumberOfRepetitions=0, ComTxModeRepetitionPeriod=0, ComTxModeTimeOffset=0.0
          ComTxModeFalse
            ComTxMode: ComTxModeTimePeriod=0.01, ComTxModeMode=PERIODIC, ComTxModeNumberOfRepetitions=0, ComTxModeRepetitionPeriod=0, ComTxModeTimeOffset=0.0
      34 x ComSignal, all with ComSignalInitValue=0, ComSignalEndianness=LITTLE_ENDIAN, ComUpdateBitPosition=-1, ComTransferProperty=PENDING:
        MotClb_UdFb: ComSignalType=UINT16, ComBitSize=16, ComBitPosition=0, ComSystemTemplateSystemSignalRef=MotClb_UdFb
        MotClb_UqFb: ComSignalType=UINT16, ComBitSize=16, ComBitPosition=16, ComSystemTemplateSystemSignalRef=MotClb_UqFb
        MotClb_IdSet: ComSignalType=UINT16, ComBitSize=16, ComBitPosition=32, ComSystemTemplateSystemSignalRef=MotClb_IdSet
        MotClb_IqSet: ComSignalType=UINT16, ComBitSize=16, ComBitPosition=48, ComSystemTemplateSystemSignalRef=MotClb_IqSet
        MotClb_IsCMD_Fb: ComSignalType=UINT16, ComBitSize=16, ComBitPosition=64, ComSystemTemplateSystemSignalRef=MotClb_IsCMD_Fb
        MotClb_ThetaCMD_Fb: ComSignalType=UINT16, ComBitSize=16, ComBitPosition=80, ComSystemTemplateSystemSignalRef=MotClb_ThetaCMD_Fb
        MotClb_Id_Fb: ComSignalType=UINT16, ComBitSize=16, ComBitPosition=96, ComSystemTemplateSystemSignalRef=MotClb_Id_Fb
        MotClb_Iq_Fb: ComSignalType=UINT16, ComBitSize=16, ComBitPosition=112, ComSystemTemplateSystemSignalRef=MotClb_Iq_Fb
        MotClb_Spd_rpm_Flt: ComSignalType=UINT16, ComBitSize=16, ComBitPosition=128, ComSystemTemplateSystemSignalRef=MotClb_Spd_rpm_Flt
        MotClb_ThtSetReal: ComSignalType=UINT16, ComBitSize=16, ComBitPosition=144, ComSystemTemplateSystemSignalRef=MotClb_ThtSetReal
        MotClb_Power_Inverter: ComSignalType=UINT16, ComBitSize=16, ComBitPosition=160, ComSystemTemplateSystemSignalRef=MotClb_Power_Inverter
        MotClb_Volt_DC: ComSignalType=UINT16, ComBitSize=16, ComBitPosition=176, ComSystemTemplateSystemSignalRef=MotClb_Volt_DC
        MotClb_UsOutFlt: ComSignalType=UINT16, ComBitSize=16, ComBitPosition=192, ComSystemTemplateSystemSignalRef=MotClb_UsOutFlt
        MotClb_CoolWater_Temp: ComSignalType=UINT16, ComBitSize=16, ComBitPosition=208, ComSystemTemplateSystemSignalRef=MotClb_CoolWater_Temp
        MotClb_Motor_Temp1_Flt: ComSignalType=UINT8, ComBitSize=8, ComBitPosition=224, ComSystemTemplateSystemSignalRef=MotClb_Motor_Temp1_Flt
        MotClb_IGBT_Temp1: ComSignalType=UINT8, ComBitSize=8, ComBitPosition=232, ComSystemTemplateSystemSignalRef=MotClb_IGBT_Temp1
        MotClb_ErrLevel: ComSignalType=UINT8, ComBitSize=8, ComBitPosition=240, ComSystemTemplateSystemSignalRef=MotClb_ErrLevel
        MCUMR_MotClb_UdFb: ComSignalType=UINT16, ComBitSize=16, ComBitPosition=256, ComSystemTemplateSystemSignalRef=MCUMR_MotClb_UdFb
        MCUMR_MotClb_UqFb: ComSignalType=UINT16, ComBitSize=16, ComBitPosition=272, ComSystemTemplateSystemSignalRef=MCUMR_MotClb_UqFb
        MCUMR_MotClb_IdSet: ComSignalType=UINT16, ComBitSize=16, ComBitPosition=288, ComSystemTemplateSystemSignalRef=MCUMR_MotClb_IdSet
        MCUMR_MotClb_IqSet: ComSignalType=UINT16, ComBitSize=16, ComBitPosition=304, ComSystemTemplateSystemSignalRef=MCUMR_MotClb_IqSet
        MCUMR_MotClb_IsCMD_Fb: ComSignalType=UINT16, ComBitSize=16, ComBitPosition=320, ComSystemTemplateSystemSignalRef=MCUMR_MotClb_IsCMD_Fb
        MCUMR_MotClb_ThetaCMD_Fb: ComSignalType=UINT16, ComBitSize=16, ComBitPosition=336, ComSystemTemplateSystemSignalRef=MCUMR_MotClb_ThetaCMD_Fb
        MCUMR_MotClb_Id_Fb: ComSignalType=UINT16, ComBitSize=16, ComBitPosition=352, ComSystemTemplateSystemSignalRef=MCUMR_MotClb_Id_Fb
        MCUMR_MotClb_Iq_Fb: ComSignalType=UINT16, ComBitSize=16, ComBitPosition=368, ComSystemTemplateSystemSignalRef=MCUMR_MotClb_Iq_Fb
        MCUMR_MotClb_Spd_rpm_Flt: ComSignalType=UINT16, ComBitSize=16, ComBitPosition=384, ComSystemTemplateSystemSignalRef=MCUMR_MotClb_Spd_rpm_Flt
        MCUMR_MotClb_ThtSetReal: ComSignalType=UINT16, ComBitSize=16, ComBitPosition=400, ComSystemTemplateSystemSignalRef=MCUMR_MotClb_ThtSetReal
        MCUMR_MotClb_Power_Inverter: ComSignalType=UINT16, ComBitSize=16, ComBitPosition=416, ComSystemTemplateSystemSignalRef=MCUMR_MotClb_Power_Inverter
        MCUMR_MotClb_Volt_DC: ComSignalType=UINT16, ComBitSize=16, ComBitPosition=432, ComSystemTemplateSystemSignalRef=MCUMR_MotClb_Volt_DC
        MCUMR_MotClb_UsOutFlt: ComSignalType=UINT16, ComBitSize=16, ComBitPosition=448, ComSystemTemplateSystemSignalRef=MCUMR_MotClb_UsOutFlt
        MCUMR_MotClb_CoolWater_Temp: ComSignalType=UINT16, ComBitSize=16, ComBitPosition=464, ComSystemTemplateSystemSignalRef=MCUMR_MotClb_CoolWater_Temp
        MCUMR_MotClb_Motor_Temp1_Flt: ComSignalType=UINT8, ComBitSize=8, ComBitPosition=480, ComSystemTemplateSystemSignalRef=MCUMR_MotClb_Motor_Temp1_Flt
        MCUMR_MotClb_IGBT_Temp1: ComSignalType=UINT8, ComBitSize=8, ComBitPosition=488, ComSystemTemplateSystemSignalRef=MCUMR_MotClb_IGBT_Temp1
        MCUMR_MotClb_ErrLevel: ComSignalType=UINT8, ComBitSize=8, ComBitPosition=496, ComSystemTemplateSystemSignalRef=MCUMR_MotClb_ErrLevel
      VCU_0x13B_P_CANFD (ComIPdu):
        ComIPduSignalProcessing = IMMEDIATE
        ComIPduType = NORMAL
        ComIPduDirection = SEND
        ComIPduCallout = ComCallOut_VCU_0x13B_P_CANFD
        ComIpduNotificationCallback = ComTxSucceedCbk_HPCVCU_13B_P_CANFD
        ComIPduGroupRef = ComIPduGroup_Tx
        ComPduIdRef = PduCollection/VCU_0x13B_P_CANFD_Com2PduR
        ComIPduSignalRef = VCU_CRC_13B
        ComIPduSignalRef = VCU_RollingCounter_13B
        ComIPduSignalRef = VCU_Vehicle_Warning
        ComIPduSignalRef = VCU_VehicleSts
        ComIPduSignalRef = VCU_GearLevelPosSts
        ComIPduSignalRef = VCU_GearLeverValid
        ComIPduSignalRef = VCU_AccPedalValid
        ComIPduSignalRef = VCU_ThrottlePosition
        ComIPduSignalRef = VCU_BMSMainRelayR_Cmd
        ComIPduSignalRef = VCU_BMSMainRelayF_Cmd
        ComIPduSignalRef = VCU_BMSEmergencyCmd
        ComIPduSignalRef = VCU_MCUMActiveReleaseCmd
        ComIPduSignalRef = VCU_MCUSActiveReleaseCmd
        ComIPduSignalRef = VCU_AlwACChargeInventerSts
        ComIPduSignalRef = VCU_AlwDCChargeSts
        ComIPduSignalRef = VCU_ChargePauseReq
        ComIPduSignalRef = VCU_SuppressJitterMCUSRequest
        ComIPduSignalRef = VCU_DCDCEnableCmd
        ComIPduSignalRef = VCU_ACOffReq
        ComIPduSignalRef = VCU_VehicleDirect
        ComIPduSignalRef = VCU_BrakeSysFault
        ComIPduSignalRef = VCU_SuppressJitterMCUMRequest
        ComIPduSignalRef = VCU_MDrvControlMode
        ComIPduSignalRef = VCU_BrakePedalValue
        ComIPduSignalRef = VCU_MCUMMaxDischargePower
        ComIPduSignalRef = VCU_MCUMMaxChargePower
        ComIPduSignalRef = VCU_MDrvRequestTorque
        ComIPduSignalRef = VCU_MDrvRequesSpeed
        ComIPduSignalRef = VCU_SDrvRequestTorque
        ComIPduSignalRef = VCU_SDrvRequesSpeed
        ComIPduSignalRef = VCU_SVehicleSts
        ComIPduSignalRef = VCU_VehicleHighVoltModeF
        ComIPduSignalRef = VCU_SDrvControlMode
        ComIPduSignalRef = VCU_ON2BRelayReq
        ComIPduSignalRef = VCU_VehPreHVPwrOffCmd
        ComIPduSignalRef = VCU_FuelTankLockReq
        ComIPduSignalRef = VCU_VehicleDirectS
        ComIPduSignalRef = VCU_VehicleDirectS_VD
        ComIPduSignalRef = VCU_ACPwrLimited
        ComIPduSignalRef = VCU_MCUSMaxDischargePower
        ComIPduSignalRef = VCU_VehicleDirectVD
        ComIPduSignalRef = VCU_MDrvControlModeVD
        ComIPduSignalRef = VCU_MDrvRequestTorqueVD
        ComIPduSignalRef = VCU_MDrvRequesSpeedVD
        ComIPduSignalRef = VCU_SDrvRequestTorqueVD
        ComIPduSignalRef = VCU_SDrvRequesSpeedVD
        ComIPduSignalRef = VCU_SDrvControlModeVD
        ComIPduSignalRef = VCU_MCUSMaxChargePower
        ComIPduSignalRef = VCU_VehicleHighVoltMode
        ComIPduSignalRef = VCU_PDUHVIL_Sts
        ComIPduSignalRef = VCU_PDU220VRelay_Req
        ComIPduSignalRef = VCU_Cab220VRelay_Req
        ComIPduSignalRef = VCU_Cabin220VRelay_Req
        ComIPduSignalRef = VCU_Alw_Cab220VInverter_Sts
        ComIPduSignalRef = VCU_Alw_Cabin220VInverter_Sts
        ComIPduSignalRef = VCU_MCUMDampgLmtFactor
        ComIPduSignalRef = VCU_MCUSDampgLmtFactor
        ComIPduSignalRef = VCU_BCM_Authentication_Sts
        ComIPduSignalRef = VCU_AuthenticationKey_WSts
        ComIPduSignalRef = VCU_BrakePedalSts_P
        ComIPduSignalRef = VCU_BrakePedalStsValid_P
        ComIPduSignalRef = VCU_BoostMode_Fail
        ComIPduSignalRef = VCU_BoostModeSts
        ComIPduSignalRef = VCU_MCUSMaxPosDampgTrq
        ComIPduSignalRef = VCU_MCUSMaxNegDampgTrq
        ComIPduSignalRef = VCU_MCUMMaxPosDampgTrq
        ComIPduSignalRef = VCU_MCUMMaxNegDampgTrq
        ComTxIPdu: ComMinimumDelayTime=0.0, ComTxIPduUnusedAreasDefault=0
          ComTxModeTrue
            ComTxMode: ComTxModeTimePeriod=0.01, ComTxModeMode=PERIODIC, ComTxModeNumberOfRepetitions=0, ComTxModeRepetitionPeriod=0, ComTxModeTimeOffset=0.0
          ComTxModeFalse
            ComTxMode: ComTxModeTimePeriod=0.01, ComTxModeMode=PERIODIC, ComTxModeNumberOfRepetitions=0, ComTxModeRepetitionPeriod=0, ComTxModeTimeOffset=0.0
      67 x ComSignal, all with ComSignalInitValue=0, ComSignalEndianness=LITTLE_ENDIAN, ComUpdateBitPosition=-1, ComTransferProperty=PENDING:
        VCU_CRC_13B: ComSignalType=UINT8, ComBitSize=8, ComBitPosition=0, ComSystemTemplateSystemSignalRef=VCU_CRC_13B
        VCU_RollingCounter_13B: ComSignalType=UINT8, ComBitSize=4, ComBitPosition=8, ComSystemTemplateSystemSignalRef=VCU_RollingCounter_13B
        VCU_Vehicle_Warning: ComSignalType=UINT8, ComBitSize=2, ComBitPosition=16, ComSystemTemplateSystemSignalRef=VCU_Vehicle_Warning
        VCU_VehicleSts: ComSignalType=BOOLEAN, ComBitSize=1, ComBitPosition=18, ComSystemTemplateSystemSignalRef=VCU_VehicleSts
        VCU_GearLevelPosSts: ComSignalType=UINT8, ComBitSize=2, ComBitPosition=19, ComSystemTemplateSystemSignalRef=VCU_GearLevelPosSts
        VCU_GearLeverValid: ComSignalType=BOOLEAN, ComBitSize=1, ComBitPosition=21, ComSystemTemplateSystemSignalRef=VCU_GearLeverValid
        VCU_AccPedalValid: ComSignalType=BOOLEAN, ComBitSize=1, ComBitPosition=23, ComSystemTemplateSystemSignalRef=VCU_AccPedalValid
        VCU_ThrottlePosition: ComSignalType=UINT8, ComBitSize=8, ComBitPosition=24, ComSystemTemplateSystemSignalRef=VCU_ThrottlePosition
        VCU_BMSMainRelayR_Cmd: ComSignalType=BOOLEAN, ComBitSize=1, ComBitPosition=32, ComSystemTemplateSystemSignalRef=VCU_BMSMainRelayR_Cmd
        VCU_BMSMainRelayF_Cmd: ComSignalType=BOOLEAN, ComBitSize=1, ComBitPosition=33, ComSystemTemplateSystemSignalRef=VCU_BMSMainRelayF_Cmd
        VCU_BMSEmergencyCmd: ComSignalType=BOOLEAN, ComBitSize=1, ComBitPosition=34, ComSystemTemplateSystemSignalRef=VCU_BMSEmergencyCmd
        VCU_MCUMActiveReleaseCmd: ComSignalType=BOOLEAN, ComBitSize=1, ComBitPosition=35, ComSystemTemplateSystemSignalRef=VCU_MCUMActiveReleaseCmd
        VCU_MCUSActiveReleaseCmd: ComSignalType=BOOLEAN, ComBitSize=1, ComBitPosition=36, ComSystemTemplateSystemSignalRef=VCU_MCUSActiveReleaseCmd
        VCU_AlwACChargeInventerSts: ComSignalType=BOOLEAN, ComBitSize=1, ComBitPosition=37, ComSystemTemplateSystemSignalRef=VCU_AlwACChargeInventerSts
        VCU_AlwDCChargeSts: ComSignalType=BOOLEAN, ComBitSize=1, ComBitPosition=38, ComSystemTemplateSystemSignalRef=VCU_AlwDCChargeSts
        VCU_ChargePauseReq: ComSignalType=BOOLEAN, ComBitSize=1, ComBitPosition=39, ComSystemTemplateSystemSignalRef=VCU_ChargePauseReq
        VCU_SuppressJitterMCUSRequest: ComSignalType=BOOLEAN, ComBitSize=1, ComBitPosition=40, ComSystemTemplateSystemSignalRef=VCU_SuppressJitterMCUSRequest
        VCU_DCDCEnableCmd: ComSignalType=BOOLEAN, ComBitSize=1, ComBitPosition=41, ComSystemTemplateSystemSignalRef=VCU_DCDCEnableCmd
        VCU_ACOffReq: ComSignalType=UINT8, ComBitSize=2, ComBitPosition=42, ComSystemTemplateSystemSignalRef=VCU_ACOffReq
        VCU_VehicleDirect: ComSignalType=BOOLEAN, ComBitSize=1, ComBitPosition=44, ComSystemTemplateSystemSignalRef=VCU_VehicleDirect
        VCU_BrakeSysFault: ComSignalType=BOOLEAN, ComBitSize=1, ComBitPosition=45, ComSystemTemplateSystemSignalRef=VCU_BrakeSysFault
        VCU_SuppressJitterMCUMRequest: ComSignalType=BOOLEAN, ComBitSize=1, ComBitPosition=46, ComSystemTemplateSystemSignalRef=VCU_SuppressJitterMCUMRequest
        VCU_MDrvControlMode: ComSignalType=BOOLEAN, ComBitSize=1, ComBitPosition=47, ComSystemTemplateSystemSignalRef=VCU_MDrvControlMode
        VCU_BrakePedalValue: ComSignalType=UINT8, ComBitSize=8, ComBitPosition=48, ComSystemTemplateSystemSignalRef=VCU_BrakePedalValue
        VCU_MCUMMaxDischargePower: ComSignalType=UINT16, ComBitSize=9, ComBitPosition=56, ComSystemTemplateSystemSignalRef=VCU_MCUMMaxDischargePower
        VCU_MCUMMaxChargePower: ComSignalType=UINT16, ComBitSize=9, ComBitPosition=71, ComSystemTemplateSystemSignalRef=VCU_MCUMMaxChargePower
        VCU_MDrvRequestTorque: ComSignalType=UINT16, ComBitSize=16, ComBitPosition=80, ComSystemTemplateSystemSignalRef=VCU_MDrvRequestTorque
        VCU_MDrvRequesSpeed: ComSignalType=UINT16, ComBitSize=16, ComBitPosition=96, ComSystemTemplateSystemSignalRef=VCU_MDrvRequesSpeed
        VCU_SDrvRequestTorque: ComSignalType=UINT16, ComBitSize=16, ComBitPosition=112, ComSystemTemplateSystemSignalRef=VCU_SDrvRequestTorque
        VCU_SDrvRequesSpeed: ComSignalType=UINT16, ComBitSize=16, ComBitPosition=128, ComSystemTemplateSystemSignalRef=VCU_SDrvRequesSpeed
        VCU_SVehicleSts: ComSignalType=BOOLEAN, ComBitSize=1, ComBitPosition=144, ComSystemTemplateSystemSignalRef=VCU_SVehicleSts
        VCU_VehicleHighVoltModeF: ComSignalType=UINT8, ComBitSize=3, ComBitPosition=145, ComSystemTemplateSystemSignalRef=VCU_VehicleHighVoltModeF
        VCU_SDrvControlMode: ComSignalType=BOOLEAN, ComBitSize=1, ComBitPosition=148, ComSystemTemplateSystemSignalRef=VCU_SDrvControlMode
        VCU_ON2BRelayReq: ComSignalType=UINT8, ComBitSize=2, ComBitPosition=149, ComSystemTemplateSystemSignalRef=VCU_ON2BRelayReq
        VCU_VehPreHVPwrOffCmd: ComSignalType=BOOLEAN, ComBitSize=1, ComBitPosition=151, ComSystemTemplateSystemSignalRef=VCU_VehPreHVPwrOffCmd
        VCU_FuelTankLockReq: ComSignalType=UINT8, ComBitSize=2, ComBitPosition=152, ComSystemTemplateSystemSignalRef=VCU_FuelTankLockReq
        VCU_VehicleDirectS: ComSignalType=BOOLEAN, ComBitSize=1, ComBitPosition=154, ComSystemTemplateSystemSignalRef=VCU_VehicleDirectS
        VCU_VehicleDirectS_VD: ComSignalType=BOOLEAN, ComBitSize=1, ComBitPosition=155, ComSystemTemplateSystemSignalRef=VCU_VehicleDirectS_VD
        VCU_ACPwrLimited: ComSignalType=UINT8, ComBitSize=8, ComBitPosition=160, ComSystemTemplateSystemSignalRef=VCU_ACPwrLimited
        VCU_MCUSMaxDischargePower: ComSignalType=UINT16, ComBitSize=9, ComBitPosition=168, ComSystemTemplateSystemSignalRef=VCU_MCUSMaxDischargePower
        VCU_VehicleDirectVD: ComSignalType=BOOLEAN, ComBitSize=1, ComBitPosition=177, ComSystemTemplateSystemSignalRef=VCU_VehicleDirectVD
        VCU_MDrvControlModeVD: ComSignalType=BOOLEAN, ComBitSize=1, ComBitPosition=178, ComSystemTemplateSystemSignalRef=VCU_MDrvControlModeVD
        VCU_MDrvRequestTorqueVD: ComSignalType=BOOLEAN, ComBitSize=1, ComBitPosition=179, ComSystemTemplateSystemSignalRef=VCU_MDrvRequestTorqueVD
        VCU_MDrvRequesSpeedVD: ComSignalType=BOOLEAN, ComBitSize=1, ComBitPosition=180, ComSystemTemplateSystemSignalRef=VCU_MDrvRequesSpeedVD
        VCU_SDrvRequestTorqueVD: ComSignalType=BOOLEAN, ComBitSize=1, ComBitPosition=181, ComSystemTemplateSystemSignalRef=VCU_SDrvRequestTorqueVD
        VCU_SDrvRequesSpeedVD: ComSignalType=BOOLEAN, ComBitSize=1, ComBitPosition=182, ComSystemTemplateSystemSignalRef=VCU_SDrvRequesSpeedVD
        VCU_SDrvControlModeVD: ComSignalType=BOOLEAN, ComBitSize=1, ComBitPosition=183, ComSystemTemplateSystemSignalRef=VCU_SDrvControlModeVD
        VCU_MCUSMaxChargePower: ComSignalType=UINT16, ComBitSize=9, ComBitPosition=184, ComSystemTemplateSystemSignalRef=VCU_MCUSMaxChargePower
        VCU_VehicleHighVoltMode: ComSignalType=UINT8, ComBitSize=3, ComBitPosition=193, ComSystemTemplateSystemSignalRef=VCU_VehicleHighVoltMode
        VCU_PDUHVIL_Sts: ComSignalType=BOOLEAN, ComBitSize=1, ComBitPosition=196, ComSystemTemplateSystemSignalRef=VCU_PDUHVIL_Sts
        VCU_PDU220VRelay_Req: ComSignalType=BOOLEAN, ComBitSize=1, ComBitPosition=197, ComSystemTemplateSystemSignalRef=VCU_PDU220VRelay_Req
        VCU_Cab220VRelay_Req: ComSignalType=BOOLEAN, ComBitSize=1, ComBitPosition=198, ComSystemTemplateSystemSignalRef=VCU_Cab220VRelay_Req
        VCU_Cabin220VRelay_Req: ComSignalType=BOOLEAN, ComBitSize=1, ComBitPosition=199, ComSystemTemplateSystemSignalRef=VCU_Cabin220VRelay_Req
        VCU_Alw_Cab220VInverter_Sts: ComSignalType=BOOLEAN, ComBitSize=1, ComBitPosition=200, ComSystemTemplateSystemSignalRef=VCU_Alw_Cab220VInverter_Sts
        VCU_Alw_Cabin220VInverter_Sts: ComSignalType=BOOLEAN, ComBitSize=1, ComBitPosition=201, ComSystemTemplateSystemSignalRef=VCU_Alw_Cabin220VInverter_Sts
        VCU_MCUMDampgLmtFactor: ComSignalType=UINT8, ComBitSize=7, ComBitPosition=202, ComSystemTemplateSystemSignalRef=VCU_MCUMDampgLmtFactor
        VCU_MCUSDampgLmtFactor: ComSignalType=UINT8, ComBitSize=7, ComBitPosition=209, ComSystemTemplateSystemSignalRef=VCU_MCUSDampgLmtFactor
        VCU_BCM_Authentication_Sts: ComSignalType=UINT8, ComBitSize=2, ComBitPosition=216, ComSystemTemplateSystemSignalRef=VCU_BCM_Authentication_Sts
        VCU_AuthenticationKey_WSts: ComSignalType=BOOLEAN, ComBitSize=1, ComBitPosition=218, ComSystemTemplateSystemSignalRef=VCU_AuthenticationKey_WSts
        VCU_BrakePedalSts_P: ComSignalType=BOOLEAN, ComBitSize=1, ComBitPosition=219, ComSystemTemplateSystemSignalRef=VCU_BrakePedalSts_P
        VCU_BrakePedalStsValid_P: ComSignalType=BOOLEAN, ComBitSize=1, ComBitPosition=220, ComSystemTemplateSystemSignalRef=VCU_BrakePedalStsValid_P
        VCU_BoostMode_Fail: ComSignalType=UINT8, ComBitSize=3, ComBitPosition=221, ComSystemTemplateSystemSignalRef=VCU_BoostMode_Fail
        VCU_BoostModeSts: ComSignalType=UINT8, ComBitSize=2, ComBitPosition=224, ComSystemTemplateSystemSignalRef=VCU_BoostModeSts
        VCU_MCUSMaxPosDampgTrq: ComSignalType=UINT8, ComBitSize=6, ComBitPosition=232, ComSystemTemplateSystemSignalRef=VCU_MCUSMaxPosDampgTrq
        VCU_MCUSMaxNegDampgTrq: ComSignalType=UINT8, ComBitSize=6, ComBitPosition=238, ComSystemTemplateSystemSignalRef=VCU_MCUSMaxNegDampgTrq
        VCU_MCUMMaxPosDampgTrq: ComSignalType=UINT8, ComBitSize=6, ComBitPosition=244, ComSystemTemplateSystemSignalRef=VCU_MCUMMaxPosDampgTrq
        VCU_MCUMMaxNegDampgTrq: ComSignalType=UINT8, ComBitSize=6, ComBitPosition=250, ComSystemTemplateSystemSignalRef=VCU_MCUMMaxNegDampgTrq
      UDS_Phy_Tx_7E8_ECM_P_CANFD (ComIPdu):
        ComIPduSignalProcessing = IMMEDIATE
        ComIPduType = NORMAL
        ComIPduDirection = SEND
        ComFirstTimeout = 0.0
        ComTimeout = 0.0
        ComIPduCallout = ComCallOut_ECM_0x7E8_P_CANFD
        ComIPduGroupRef = ComIPduGroup_Tx
        ComPduIdRef = PduCollection/UDS_Phy_Tx_7E8_ECM_P_CANFD_Com2PduR
        ComIPduSignalRef = ECM_UDS_Res_Byte{0..7}
        ComTxIPdu: ComMinimumDelayTime=0.0, ComTxIPduUnusedAreasDefault=0
          ComTxModeTrue
            ComTxMode: ComTxModeTimePeriod=0, ComTxModeMode=DIRECT, ComTxModeNumberOfRepetitions=0, ComTxModeRepetitionPeriod=0, ComTxModeTimeOffset=0
          ComTxModeFalse
            ComTxMode: ComTxModeTimePeriod=0, ComTxModeMode=DIRECT, ComTxModeNumberOfRepetitions=0, ComTxModeRepetitionPeriod=0, ComTxModeTimeOffset=0
      8 x ComSignal, all with ComSignalInitValue=0, ComSignalType=UINT8, ComSignalEndianness=LITTLE_ENDIAN, ComBitSize=8, ComUpdateBitPosition=-1, ComTransferProperty=TRIGGERED:
        ECM_UDS_Res_Byte0: ComBitPosition=0, ComSystemTemplateSystemSignalRef=ECM_UDS_Res_Byte0
        ECM_UDS_Res_Byte1: ComBitPosition=8, ComSystemTemplateSystemSignalRef=ECM_UDS_Res_Byte1
        ECM_UDS_Res_Byte2: ComBitPosition=16, ComSystemTemplateSystemSignalRef=ECM_UDS_Res_Byte2
        ECM_UDS_Res_Byte3: ComBitPosition=24, ComSystemTemplateSystemSignalRef=ECM_UDS_Res_Byte3
        ECM_UDS_Res_Byte4: ComBitPosition=32, ComSystemTemplateSystemSignalRef=ECM_UDS_Res_Byte4
        ECM_UDS_Res_Byte5: ComBitPosition=40, ComSystemTemplateSystemSignalRef=ECM_UDS_Res_Byte5
        ECM_UDS_Res_Byte6: ComBitPosition=48, ComSystemTemplateSystemSignalRef=ECM_UDS_Res_Byte6
        ECM_UDS_Res_Byte7: ComBitPosition=56, ComSystemTemplateSystemSignalRef=ECM_UDS_Res_Byte7
      VCU_0x358_P_CANFD (ComIPdu):
        ComIPduSignalProcessing = IMMEDIATE
        ComIPduType = NORMAL
        ComIPduDirection = SEND
        ComFirstTimeout = 0.1
        ComTimeout = 0.1
        ComIPduGroupRef = ComIPduGroup_Tx
        ComPduIdRef = PduCollection/VCU_0x358_P_CANFD_Com2PduR
        ComIPduSignalRef = VCU_MotSelfHeatPwrFb
        ComIPduSignalRef = VCU_MotSelfHeatLvlFb
        ComIPduSignalRef = VCU_MCUMWaterPumpLevlReq
        ComIPduSignalRef = VCU_MCUSWaterPumpLevlReq
        ComIPduSignalRef = VCU_HeatPwrAval
        ComIPduSignalRef = VCU_MotSelfHeatAllwd
        ComIPduSignalRef = VCU_MMotSelfHeatEnReq
        ComIPduSignalRef = VCU_MMotSelfHeatLvlReq
        ComIPduSignalRef = VCU_SMotSelfHeatEnReq
        ComIPduSignalRef = VCU_SMotSelfHeatLvlReq
        ComTxIPdu: ComMinimumDelayTime=0.0, ComTxIPduUnusedAreasDefault=0
          ComTxModeTrue
            ComTxMode: ComTxModeTimePeriod=0.1, ComTxModeMode=PERIODIC, ComTxModeNumberOfRepetitions=0, ComTxModeRepetitionPeriod=0, ComTxModeTimeOffset=0.0
          ComTxModeFalse
            ComTxMode: ComTxModeTimePeriod=0.1, ComTxModeMode=PERIODIC, ComTxModeNumberOfRepetitions=0, ComTxModeRepetitionPeriod=0, ComTxModeTimeOffset=0.0
      10 x ComSignal, all with ComSignalInitValue=0, ComSignalEndianness=LITTLE_ENDIAN, ComUpdateBitPosition=-1, ComTransferProperty=PENDING:
        VCU_MotSelfHeatPwrFb: ComSignalType=UINT8, ComBitSize=5, ComBitPosition=16, ComSystemTemplateSystemSignalRef=VCU_MotSelfHeatPwrFb
        VCU_MotSelfHeatLvlFb: ComSignalType=UINT8, ComBitSize=4, ComBitPosition=40, ComSystemTemplateSystemSignalRef=VCU_MotSelfHeatLvlFb
        VCU_MCUMWaterPumpLevlReq: ComSignalType=UINT8, ComBitSize=4, ComBitPosition=44, ComSystemTemplateSystemSignalRef=VCU_MCUMWaterPumpLevlReq
        VCU_MCUSWaterPumpLevlReq: ComSignalType=UINT8, ComBitSize=4, ComBitPosition=48, ComSystemTemplateSystemSignalRef=VCU_MCUSWaterPumpLevlReq
        VCU_HeatPwrAval: ComSignalType=UINT8, ComBitSize=5, ComBitPosition=24, ComSystemTemplateSystemSignalRef=VCU_HeatPwrAval
        VCU_MotSelfHeatAllwd: ComSignalType=BOOLEAN, ComBitSize=1, ComBitPosition=29, ComSystemTemplateSystemSignalRef=VCU_MotSelfHeatAllwd
        VCU_MMotSelfHeatEnReq: ComSignalType=BOOLEAN, ComBitSize=1, ComBitPosition=32, ComSystemTemplateSystemSignalRef=VCU_MMotSelfHeatEnReq
        VCU_MMotSelfHeatLvlReq: ComSignalType=UINT8, ComBitSize=3, ComBitPosition=33, ComSystemTemplateSystemSignalRef=VCU_MMotSelfHeatLvlReq
        VCU_SMotSelfHeatEnReq: ComSignalType=BOOLEAN, ComBitSize=1, ComBitPosition=36, ComSystemTemplateSystemSignalRef=VCU_SMotSelfHeatEnReq
        VCU_SMotSelfHeatLvlReq: ComSignalType=UINT8, ComBitSize=3, ComBitPosition=37, ComSystemTemplateSystemSignalRef=VCU_SMotSelfHeatLvlReq
      VCU_0x359_P_CANFD (ComIPdu):
        ComIPduSignalProcessing = IMMEDIATE
        ComIPduType = NORMAL
        ComIPduDirection = SEND
        ComFirstTimeout = 0.2
        ComTimeout = 0.2
        ComIPduGroupRef = ComIPduGroup_Tx
        ComPduIdRef = PduCollection/VCU_0x359_P_CANFD_Com2PduR
        ComIPduSignalRef = VCU_EolCfg_ESC
        ComIPduSignalRef = VCU_AbStartupFlag
        ComIPduSignalRef = VCU_AbResetFlag
        ComIPduSignalRef = VCU_AbResetlnitFinish
        ComIPduSignalRef = VCU_EolCfg_EPB
        ComIPduSignalRef = VCU_EolCfg_AEB
        ComIPduSignalRef = VCU_EolCfg_InverterFunc
        ComIPduSignalRef = VCU_EolCfg_APS
        ComIPduSignalRef = VCU_EolCfg_VehiModels
        ComIPduSignalRef = VCU_EolCfg_SpdLmtVal
        ComIPduSignalRef = VCU_EolCfg_WheelType
        ComIPduSignalRef = VCU_EolCfg_Curise
        ComIPduSignalRef = VCU_EolCfg_VehiType
        ComIPduSignalRef = VCU_EolCfg_MotPwr
        ComIPduSignalRef = VCU_EolCfg_MotDrvStructure
        ComIPduSignalRef = VCU_WLTCModeFlag
        ComIPduSignalRef = VCU_EolCfg_RudderDir
        ComIPduSignalRef = VCU_EolCfg_DCChgRelayPos
        ComIPduSignalRef = VCU_EolCfg_FPTCIL
        ComIPduSignalRef = VCU_PWakeupSt
        ComIPduSignalRef = VCU_SpdLimitReason
        ComIPduSignalRef = BSW_VertifySts
        ComIPduSignalRef = VCU_InterAllowEngStart
        ComIPduSignalRef = VCU_EmergencyStopReq
        ComIPduSignalRef = VCU_EngineAllowStop
        ComIPduSignalRef = VCU_AdditionalPwrVal
        ComIPduSignalRef = VCU_VehichRealPwDown
        ComIPduSignalRef = VCU_IMMOStsResult
        ComIPduSignalRef = VCU_IMMOStateMachine
        ComIPduSignalRef = VCU_ShowCarModeNvmResult
        ComIPduSignalRef = VCU_DeliveryModeNvmData
        ComIPduSignalRef = VCU_AccPedFaultLvNvmResult
        ComIPduSignalRef = VCU_VehicleConfigNvmResult
        ComIPduSignalRef = VCU_EngRunTimeNvmResult
        ComIPduSignalRef = VCU_IMMOKeyWriteCnt
        ComIPduSignalRef = VCU_REStartReq
        ComIPduSignalRef = VCU_REStopReq
        ComIPduSignalRef = VCU_Vehicle_NVHPwrLimitVal
        ComIPduSignalRef = VCU_EngineOff_Flag
        ComIPduSignalRef = VCU_EngineStopAllow
        ComIPduSignalRef = VCU_REHighPerformVehiPwr
        ComIPduSignalRef = VCU_REPwrDampingFactor
        ComIPduSignalRef = VCU_REDrvTarPwrFit
        ComIPduSignalRef = VCU_REVehiWheelTrqReq
        ComTxIPdu: ComMinimumDelayTime=0.0, ComTxIPduUnusedAreasDefault=0
          ComTxModeTrue
            ComTxMode: ComTxModeTimePeriod=0.2, ComTxModeMode=PERIODIC, ComTxModeNumberOfRepetitions=0, ComTxModeRepetitionPeriod=0, ComTxModeTimeOffset=0.0
          ComTxModeFalse
            ComTxMode: ComTxModeTimePeriod=0.2, ComTxModeMode=PERIODIC, ComTxModeNumberOfRepetitions=0, ComTxModeRepetitionPeriod=0, ComTxModeTimeOffset=0.0
      35 x ComSignal, all with ComSignalInitValue=0, ComSignalEndianness=LITTLE_ENDIAN, ComUpdateBitPosition=-1, ComTransferProperty=PENDING:
        VCU_EolCfg_ESC: ComSignalType=BOOLEAN, ComBitSize=1, ComBitPosition=0, ComSystemTemplateSystemSignalRef=VCU_EolCfg_ESC
        VCU_AbStartupFlag: ComSignalType=BOOLEAN, ComBitSize=1, ComBitPosition=47, ComSystemTemplateSystemSignalRef=VCU_AbStartupFlag
        VCU_AbResetFlag: ComSignalType=BOOLEAN, ComBitSize=1, ComBitPosition=46, ComSystemTemplateSystemSignalRef=VCU_AbResetFlag
        VCU_AbResetlnitFinish: ComSignalType=BOOLEAN, ComBitSize=1, ComBitPosition=45, ComSystemTemplateSystemSignalRef=VCU_AbResetlnitFinish
        VCU_EolCfg_EPB: ComSignalType=BOOLEAN, ComBitSize=1, ComBitPosition=1, ComSystemTemplateSystemSignalRef=VCU_EolCfg_EPB
        VCU_EolCfg_AEB: ComSignalType=BOOLEAN, ComBitSize=1, ComBitPosition=2, ComSystemTemplateSystemSignalRef=VCU_EolCfg_AEB
        VCU_EolCfg_InverterFunc: ComSignalType=BOOLEAN, ComBitSize=1, ComBitPosition=3, ComSystemTemplateSystemSignalRef=VCU_EolCfg_InverterFunc
        VCU_EolCfg_APS: ComSignalType=BOOLEAN, ComBitSize=1, ComBitPosition=4, ComSystemTemplateSystemSignalRef=VCU_EolCfg_APS
        VCU_EolCfg_VehiModels: ComSignalType=UINT8, ComBitSize=3, ComBitPosition=5, ComSystemTemplateSystemSignalRef=VCU_EolCfg_VehiModels
        VCU_EolCfg_SpdLmtVal: ComSignalType=UINT8, ComBitSize=4, ComBitPosition=8, ComSystemTemplateSystemSignalRef=VCU_EolCfg_SpdLmtVal
        VCU_EolCfg_WheelType: ComSignalType=UINT8, ComBitSize=4, ComBitPosition=12, ComSystemTemplateSystemSignalRef=VCU_EolCfg_WheelType
        VCU_EolCfg_Curise: ComSignalType=UINT8, ComBitSize=2, ComBitPosition=16, ComSystemTemplateSystemSignalRef=VCU_EolCfg_Curise
        VCU_EolCfg_VehiType: ComSignalType=BOOLEAN, ComBitSize=1, ComBitPosition=20, ComSystemTemplateSystemSignalRef=VCU_EolCfg_VehiType
        VCU_EolCfg_MotPwr: ComSignalType=UINT8, ComBitSize=3, ComBitPosition=21, ComSystemTemplateSystemSignalRef=VCU_EolCfg_MotPwr
        VCU_EolCfg_MotDrvStructure: ComSignalType=UINT8, ComBitSize=2, ComBitPosition=32, ComSystemTemplateSystemSignalRef=VCU_EolCfg_MotDrvStructure
        VCU_WLTCModeFlag: ComSignalType=BOOLEAN, ComBitSize=1, ComBitPosition=34, ComSystemTemplateSystemSignalRef=VCU_WLTCModeFlag
        VCU_EolCfg_RudderDir: ComSignalType=BOOLEAN, ComBitSize=1, ComBitPosition=35, ComSystemTemplateSystemSignalRef=VCU_EolCfg_RudderDir
        VCU_EolCfg_DCChgRelayPos: ComSignalType=UINT8, ComBitSize=2, ComBitPosition=36, ComSystemTemplateSystemSignalRef=VCU_EolCfg_DCChgRelayPos
        VCU_EolCfg_FPTCIL: ComSignalType=BOOLEAN, ComBitSize=1, ComBitPosition=38, ComSystemTemplateSystemSignalRef=VCU_EolCfg_FPTCIL
        VCU_PWakeupSt: ComSignalType=BOOLEAN, ComBitSize=1, ComBitPosition=39, ComSystemTemplateSystemSignalRef=VCU_PWakeupSt
        VCU_SpdLimitReason: ComSignalType=UINT8, ComBitSize=3, ComBitPosition=40, ComSystemTemplateSystemSignalRef=VCU_SpdLimitReason
        BSW_VertifySts: ComSignalType=UINT8, ComBitSize=2, ComBitPosition=43, ComSystemTemplateSystemSignalRef=BSW_VertifySts
        VCU_InterAllowEngStart: ComSignalType=BOOLEAN, ComBitSize=1, ComBitPosition=57, ComSystemTemplateSystemSignalRef=VCU_InterAllowEngStart
        VCU_EmergencyStopReq: ComSignalType=BOOLEAN, ComBitSize=1, ComBitPosition=60, ComSystemTemplateSystemSignalRef=VCU_EmergencyStopReq
        VCU_EngineAllowStop: ComSignalType=BOOLEAN, ComBitSize=1, ComBitPosition=61, ComSystemTemplateSystemSignalRef=VCU_EngineAllowStop
        VCU_AdditionalPwrVal: ComSignalType=UINT8, ComBitSize=8, ComBitPosition=96, ComSystemTemplateSystemSignalRef=VCU_AdditionalPwrVal
        VCU_VehichRealPwDown: ComSignalType=UINT8, ComBitSize=8, ComBitPosition=104, ComSystemTemplateSystemSignalRef=VCU_VehichRealPwDown
        VCU_IMMOStsResult: ComSignalType=UINT8, ComBitSize=4, ComBitPosition=112, ComSystemTemplateSystemSignalRef=VCU_IMMOStsResult
        VCU_IMMOStateMachine: ComSignalType=UINT8, ComBitSize=3, ComBitPosition=116, ComSystemTemplateSystemSignalRef=VCU_IMMOStateMachine
        VCU_ShowCarModeNvmResult: ComSignalType=UINT8, ComBitSize=1, ComBitPosition=119, ComSystemTemplateSystemSignalRef=VCU_ShowCarModeNvmResult
        VCU_DeliveryModeNvmData: ComSignalType=UINT8, ComBitSize=1, ComBitPosition=120, ComSystemTemplateSystemSignalRef=VCU_DeliveryModeNvmData
        VCU_AccPedFaultLvNvmResult: ComSignalType=UINT8, ComBitSize=1, ComBitPosition=121, ComSystemTemplateSystemSignalRef=VCU_AccPedFaultLvNvmResult
        VCU_VehicleConfigNvmResult: ComSignalType=UINT8, ComBitSize=1, ComBitPosition=122, ComSystemTemplateSystemSignalRef=VCU_VehicleConfigNvmResult
        VCU_EngRunTimeNvmResult: ComSignalType=UINT8, ComBitSize=1, ComBitPosition=123, ComSystemTemplateSystemSignalRef=VCU_EngRunTimeNvmResult
        VCU_IMMOKeyWriteCnt: ComSignalType=UINT8, ComBitSize=2, ComBitPosition=124, ComSystemTemplateSystemSignalRef=VCU_IMMOKeyWriteCnt
      MCUM_0x5D3_P_CANFD (ComIPdu):
        ComIPduSignalProcessing = IMMEDIATE
        ComIPduType = NORMAL
        ComIPduDirection = SEND
        ComFirstTimeout = 0.2
        ComTimeout = 0.2
        ComIPduGroupRef = ComIPduGroup_Tx
        ComPduIdRef = PduCollection/MCUM_0x5D3_P_CANFD_Com2PduR
        ComIPduSignalRef = MCUM_StatorTemp_1
        ComIPduSignalRef = MCUM_L2TqAct
        ComIPduSignalRef = MCUM_EOPSw
        ComIPduSignalRef = MCUM_StatorTemp_2
        ComIPduSignalRef = MCUM_IGBTTemp_U
        ComIPduSignalRef = MCUM_IGBTTemp_V
        ComIPduSignalRef = MCUM_IGBTTemp_W
        ComIPduSignalRef = MCUM_PCBTemp
        ComIPduSignalRef = MCUM_Power_12V
        ComIPduSignalRef = MCUM_Power_15V
        ComIPduSignalRef = MCUM_Offset_IU
        ComIPduSignalRef = MCUM_Offset_IV
        ComIPduSignalRef = MCUM_Offset_IW
        ComIPduSignalRef = MCUM_MainSt_State
        ComIPduSignalRef = MCUM_Derate_Reason
        ComIPduSignalRef = MCUM_PWM_Freq_kHz
        ComIPduSignalRef = MCUM_PWMEn_State
        ComIPduSignalRef = MCUM_DrvPwrEn_Out_State
        ComIPduSignalRef = MCUM_SBC_SelfCheckFault
        ComIPduSignalRef = MCUM_SBC_TempOverFault
        ComIPduSignalRef = MCUM_SBC_SPIFault
        ComIPduSignalRef = MCUM_SBC_InsideVotageFault
        ComIPduSignalRef = MCUM_SBC_OutPutVotageFault
        ComIPduSignalRef = MCUM_SBC_FeedDogFault
        ComIPduSignalRef = MCUM_NVM_RslvrZeroRFault
        ComIPduSignalRef = MCUM_Rotor_Position
        ComIPduSignalRef = MCUM_PosTransduserFaultCode
        ComIPduSignalRef = MCUM_NVM_RslvrDirRFault
        ComIPduSignalRef = MCUM_NVM_RslvrDelayRFault
        ComIPduSignalRef = MCUM_NVM_RslvrParamRFault
        ComIPduSignalRef = MCUM_NVM_HallGainRFault
        ComIPduSignalRef = MCUM_NVM_HallDelayRFault
        ComIPduSignalRef = MCUM_NVM_IGBTTypeRFault
        ComIPduSignalRef = MCUM_NVM_MotorTypeRFault
        ComIPduSignalRef = MCUM_NVM_VehicleTypeRFault
        ComIPduSignalRef = MCUM_ASC_EntryCount
        ComIPduSignalRef = MCUM_Spd_Turn
        ComIPduSignalRef = MCUM_LUT_Spd_Max
        ComIPduSignalRef = MCUM_EOP_Speed
        ComIPduSignalRef = MCUM_EOP_IqFb
        ComIPduSignalRef = MCUM_EOP_IqRef
        ComIPduSignalRef = MCUM_EOP_DCVolt
        ComIPduSignalRef = MCUM_EOP_DCCurr
        ComIPduSignalRef = MCUM_EOP_Temp
        ComIPduSignalRef = MCUM_EOP_State
        ComIPduSignalRef = MCUM_EOP_FaultCode
        ComIPduSignalRef = MCUM_HWFault_RstCnt
        ComIPduSignalRef = MCUM_HWFoB_RstCnt
        ComIPduSignalRef = MCUM_HWFoT_RstCnt
        ComIPduSignalRef = MCUM_HWDrvUV_RstCnt
        ComIPduSignalRef = MCUM_HWRdc_RstCnt
        ComIPduSignalRef = MCUM_HWOC_RstCnt
        ComIPduSignalRef = MCUM_HWOV_RstCnt
        ComIPduSignalRef = MCUM_L2agRtrElecDiff
        ComIPduSignalRef = MCUM_500usOverTime_Cnt
        ComIPduSignalRef = MCUM_5msOverTime_Cnt
        ComIPduSignalRef = MCUM_12VHop_Cnt
        ComIPduSignalRef = MCUM_12V_Max
        ComIPduSignalRef = MCUM_12V_Min
        ComIPduSignalRef = MCUM_NVMFail_Cnt
        ComIPduSignalRef = MCUM_EOL_CANCommReq
        ComIPduSignalRef = MCUM_ResetReason
        ComIPduSignalRef = MCUM_CpldRest_TimeOut_flag
        ComIPduSignalRef = MCUM_DrvPCBCurr
        ComIPduSignalRef = MCUM_EOL_StateMachine
        ComIPduSignalRef = MCUM_CpldRest_ASC_Flag
        ComIPduSignalRef = MCUM_LimSpdTorFlag
        ComIPduSignalRef = MCUM_PWM_Err_Count
        ComIPduSignalRef = MCUM_RDC_Reset_Count
        ComIPduSignalRef = MCUM_ASC_Stop_Flag
        ComIPduSignalRef = MCUM_ASC_Soft_Exiting_Flag
        ComIPduSignalRef = MCUM_Vbus_ServeLowChkEn
        ComIPduSignalRef = MCUM_EOP_BlockErr_IsLim_Flag
        ComIPduSignalRef = MCUM_MotSelfHeat_EnSts
        ComIPduSignalRef = MCUM_MotBlockHeat_LvlFb
        ComIPduSignalRef = MCUM_MotRotaryHeat_LvlFb
        ComIPduSignalRef = MCUM_MotSelfHeat_DropLvlFb
        ComIPduSignalRef = MCUM_MotSelfHeat_DropLvlRsn
        ComIPduSignalRef = MCUM_MotBlockHeat_CurAngle
        ComIPduSignalRef = MCUM_MotBlockHeat_CurMag
        ComIPduSignalRef = MCUM_FaultDataRec_State
        ComIPduSignalRef = MCUM_UserDefine_Byte{1..4}
        ComIPduSignalRef = MCUM_UserDefine_Word{1..3}
        ComTxIPdu: ComMinimumDelayTime=0.0, ComTxIPduUnusedAreasDefault=0
          ComTxModeTrue
            ComTxMode: ComTxModeTimePeriod=0.2, ComTxModeMode=PERIODIC, ComTxModeNumberOfRepetitions=0, ComTxModeRepetitionPeriod=0, ComTxModeTimeOffset=0.0
          ComTxModeFalse
            ComTxMode: ComTxModeTimePeriod=0.1, ComTxModeMode=PERIODIC, ComTxModeNumberOfRepetitions=0, ComTxModeRepetitionPeriod=0, ComTxModeTimeOffset=0.0
      88 x ComSignal, all with ComSignalInitValue=0, ComSignalEndianness=LITTLE_ENDIAN, ComUpdateBitPosition=-1, ComTransferProperty=PENDING:
        MCUM_StatorTemp_1: ComSignalType=UINT8, ComBitSize=8, ComBitPosition=0, ComSystemTemplateSystemSignalRef=MCUM_StatorTemp_1
        MCUM_L2TqAct: ComSignalType=UINT16, ComBitSize=10, ComBitPosition=388, ComSystemTemplateSystemSignalRef=MCUM_L2TqAct
        MCUM_EOPSw: ComSignalType=UINT32, ComBitSize=17, ComBitPosition=337, ComSystemTemplateSystemSignalRef=MCUM_EOPSw
        MCUM_StatorTemp_2: ComSignalType=UINT8, ComBitSize=8, ComBitPosition=8, ComSystemTemplateSystemSignalRef=MCUM_StatorTemp_2
        MCUM_IGBTTemp_U: ComSignalType=UINT8, ComBitSize=8, ComBitPosition=16, ComSystemTemplateSystemSignalRef=MCUM_IGBTTemp_U
        MCUM_IGBTTemp_V: ComSignalType=UINT8, ComBitSize=8, ComBitPosition=24, ComSystemTemplateSystemSignalRef=MCUM_IGBTTemp_V
        MCUM_IGBTTemp_W: ComSignalType=UINT8, ComBitSize=8, ComBitPosition=32, ComSystemTemplateSystemSignalRef=MCUM_IGBTTemp_W
        MCUM_PCBTemp: ComSignalType=UINT8, ComBitSize=8, ComBitPosition=40, ComSystemTemplateSystemSignalRef=MCUM_PCBTemp
        MCUM_Power_12V: ComSignalType=UINT8, ComBitSize=8, ComBitPosition=48, ComSystemTemplateSystemSignalRef=MCUM_Power_12V
        MCUM_Power_15V: ComSignalType=UINT8, ComBitSize=8, ComBitPosition=56, ComSystemTemplateSystemSignalRef=MCUM_Power_15V
        MCUM_Offset_IU: ComSignalType=UINT16, ComBitSize=13, ComBitPosition=64, ComSystemTemplateSystemSignalRef=MCUM_Offset_IU
        MCUM_Offset_IV: ComSignalType=UINT16, ComBitSize=13, ComBitPosition=77, ComSystemTemplateSystemSignalRef=MCUM_Offset_IV
        MCUM_Offset_IW: ComSignalType=UINT16, ComBitSize=13, ComBitPosition=90, ComSystemTemplateSystemSignalRef=MCUM_Offset_IW
        MCUM_MainSt_State: ComSignalType=UINT8, ComBitSize=4, ComBitPosition=103, ComSystemTemplateSystemSignalRef=MCUM_MainSt_State
        MCUM_Derate_Reason: ComSignalType=UINT8, ComBitSize=4, ComBitPosition=107, ComSystemTemplateSystemSignalRef=MCUM_Derate_Reason
        MCUM_PWM_Freq_kHz: ComSignalType=UINT8, ComBitSize=8, ComBitPosition=111, ComSystemTemplateSystemSignalRef=MCUM_PWM_Freq_kHz
        MCUM_PWMEn_State: ComSignalType=BOOLEAN, ComBitSize=1, ComBitPosition=119, ComSystemTemplateSystemSignalRef=MCUM_PWMEn_State
        MCUM_DrvPwrEn_Out_State: ComSignalType=BOOLEAN, ComBitSize=1, ComBitPosition=120, ComSystemTemplateSystemSignalRef=MCUM_DrvPwrEn_Out_State
        MCUM_SBC_SelfCheckFault: ComSignalType=BOOLEAN, ComBitSize=1, ComBitPosition=121, ComSystemTemplateSystemSignalRef=MCUM_SBC_SelfCheckFault
        MCUM_SBC_TempOverFault: ComSignalType=BOOLEAN, ComBitSize=1, ComBitPosition=122, ComSystemTemplateSystemSignalRef=MCUM_SBC_TempOverFault
        MCUM_SBC_SPIFault: ComSignalType=BOOLEAN, ComBitSize=1, ComBitPosition=123, ComSystemTemplateSystemSignalRef=MCUM_SBC_SPIFault
        MCUM_SBC_InsideVotageFault: ComSignalType=BOOLEAN, ComBitSize=1, ComBitPosition=124, ComSystemTemplateSystemSignalRef=MCUM_SBC_InsideVotageFault
        MCUM_SBC_OutPutVotageFault: ComSignalType=BOOLEAN, ComBitSize=1, ComBitPosition=125, ComSystemTemplateSystemSignalRef=MCUM_SBC_OutPutVotageFault
        MCUM_SBC_FeedDogFault: ComSignalType=BOOLEAN, ComBitSize=1, ComBitPosition=126, ComSystemTemplateSystemSignalRef=MCUM_SBC_FeedDogFault
        MCUM_NVM_RslvrZeroRFault: ComSignalType=BOOLEAN, ComBitSize=1, ComBitPosition=127, ComSystemTemplateSystemSignalRef=MCUM_NVM_RslvrZeroRFault
        MCUM_Rotor_Position: ComSignalType=UINT16, ComBitSize=13, ComBitPosition=128, ComSystemTemplateSystemSignalRef=MCUM_Rotor_Position
        MCUM_PosTransduserFaultCode: ComSignalType=UINT8, ComBitSize=8, ComBitPosition=141, ComSystemTemplateSystemSignalRef=MCUM_PosTransduserFaultCode
        MCUM_NVM_RslvrDirRFault: ComSignalType=BOOLEAN, ComBitSize=1, ComBitPosition=149, ComSystemTemplateSystemSignalRef=MCUM_NVM_RslvrDirRFault
        MCUM_NVM_RslvrDelayRFault: ComSignalType=BOOLEAN, ComBitSize=1, ComBitPosition=150, ComSystemTemplateSystemSignalRef=MCUM_NVM_RslvrDelayRFault
        MCUM_NVM_RslvrParamRFault: ComSignalType=BOOLEAN, ComBitSize=1, ComBitPosition=151, ComSystemTemplateSystemSignalRef=MCUM_NVM_RslvrParamRFault
        MCUM_NVM_HallGainRFault: ComSignalType=BOOLEAN, ComBitSize=1, ComBitPosition=152, ComSystemTemplateSystemSignalRef=MCUM_NVM_HallGainRFault
        MCUM_NVM_HallDelayRFault: ComSignalType=BOOLEAN, ComBitSize=1, ComBitPosition=153, ComSystemTemplateSystemSignalRef=MCUM_NVM_HallDelayRFault
        MCUM_NVM_IGBTTypeRFault: ComSignalType=BOOLEAN, ComBitSize=1, ComBitPosition=154, ComSystemTemplateSystemSignalRef=MCUM_NVM_IGBTTypeRFault
        MCUM_NVM_MotorTypeRFault: ComSignalType=BOOLEAN, ComBitSize=1, ComBitPosition=155, ComSystemTemplateSystemSignalRef=MCUM_NVM_MotorTypeRFault
        MCUM_NVM_VehicleTypeRFault: ComSignalType=BOOLEAN, ComBitSize=1, ComBitPosition=156, ComSystemTemplateSystemSignalRef=MCUM_NVM_VehicleTypeRFault
        MCUM_ASC_EntryCount: ComSignalType=UINT8, ComBitSize=5, ComBitPosition=157, ComSystemTemplateSystemSignalRef=MCUM_ASC_EntryCount
        MCUM_Spd_Turn: ComSignalType=UINT16, ComBitSize=15, ComBitPosition=162, ComSystemTemplateSystemSignalRef=MCUM_Spd_Turn
        MCUM_LUT_Spd_Max: ComSignalType=UINT16, ComBitSize=15, ComBitPosition=177, ComSystemTemplateSystemSignalRef=MCUM_LUT_Spd_Max
        MCUM_EOP_Speed: ComSignalType=UINT16, ComBitSize=13, ComBitPosition=192, ComSystemTemplateSystemSignalRef=MCUM_EOP_Speed
        MCUM_EOP_IqFb: ComSignalType=UINT16, ComBitSize=9, ComBitPosition=205, ComSystemTemplateSystemSignalRef=MCUM_EOP_IqFb
        MCUM_EOP_IqRef: ComSignalType=UINT16, ComBitSize=9, ComBitPosition=214, ComSystemTemplateSystemSignalRef=MCUM_EOP_IqRef
        MCUM_EOP_DCVolt: ComSignalType=UINT16, ComBitSize=9, ComBitPosition=223, ComSystemTemplateSystemSignalRef=MCUM_EOP_DCVolt
        MCUM_EOP_DCCurr: ComSignalType=UINT16, ComBitSize=9, ComBitPosition=232, ComSystemTemplateSystemSignalRef=MCUM_EOP_DCCurr
        MCUM_EOP_Temp: ComSignalType=UINT8, ComBitSize=8, ComBitPosition=241, ComSystemTemplateSystemSignalRef=MCUM_EOP_Temp
        MCUM_EOP_State: ComSignalType=UINT8, ComBitSize=4, ComBitPosition=249, ComSystemTemplateSystemSignalRef=MCUM_EOP_State
        MCUM_EOP_FaultCode: ComSignalType=UINT8, ComBitSize=3, ComBitPosition=253, ComSystemTemplateSystemSignalRef=MCUM_EOP_FaultCode
        MCUM_HWFault_RstCnt: ComSignalType=UINT8, ComBitSize=4, ComBitPosition=256, ComSystemTemplateSystemSignalRef=MCUM_HWFault_RstCnt
        MCUM_HWFoB_RstCnt: ComSignalType=UINT8, ComBitSize=4, ComBitPosition=260, ComSystemTemplateSystemSignalRef=MCUM_HWFoB_RstCnt
        MCUM_HWFoT_RstCnt: ComSignalType=UINT8, ComBitSize=4, ComBitPosition=264, ComSystemTemplateSystemSignalRef=MCUM_HWFoT_RstCnt
        MCUM_HWDrvUV_RstCnt: ComSignalType=UINT8, ComBitSize=4, ComBitPosition=268, ComSystemTemplateSystemSignalRef=MCUM_HWDrvUV_RstCnt
        MCUM_HWRdc_RstCnt: ComSignalType=UINT8, ComBitSize=4, ComBitPosition=272, ComSystemTemplateSystemSignalRef=MCUM_HWRdc_RstCnt
        MCUM_HWOC_RstCnt: ComSignalType=UINT8, ComBitSize=4, ComBitPosition=276, ComSystemTemplateSystemSignalRef=MCUM_HWOC_RstCnt
        MCUM_HWOV_RstCnt: ComSignalType=UINT8, ComBitSize=4, ComBitPosition=280, ComSystemTemplateSystemSignalRef=MCUM_HWOV_RstCnt
        MCUM_L2agRtrElecDiff: ComSignalType=UINT8, ComBitSize=4, ComBitPosition=284, ComSystemTemplateSystemSignalRef=MCUM_L2agRtrElecDiff
        MCUM_500usOverTime_Cnt: ComSignalType=UINT8, ComBitSize=4, ComBitPosition=288, ComSystemTemplateSystemSignalRef=MCUM_500usOverTime_Cnt
        MCUM_5msOverTime_Cnt: ComSignalType=UINT8, ComBitSize=4, ComBitPosition=292, ComSystemTemplateSystemSignalRef=MCUM_5msOverTime_Cnt
        MCUM_12VHop_Cnt: ComSignalType=UINT8, ComBitSize=4, ComBitPosition=296, ComSystemTemplateSystemSignalRef=MCUM_12VHop_Cnt
        MCUM_12V_Max: ComSignalType=UINT8, ComBitSize=8, ComBitPosition=300, ComSystemTemplateSystemSignalRef=MCUM_12V_Max
        MCUM_12V_Min: ComSignalType=UINT8, ComBitSize=8, ComBitPosition=308, ComSystemTemplateSystemSignalRef=MCUM_12V_Min
        MCUM_NVMFail_Cnt: ComSignalType=UINT8, ComBitSize=4, ComBitPosition=316, ComSystemTemplateSystemSignalRef=MCUM_NVMFail_Cnt
        MCUM_EOL_CANCommReq: ComSignalType=BOOLEAN, ComBitSize=1, ComBitPosition=320, ComSystemTemplateSystemSignalRef=MCUM_EOL_CANCommReq
        MCUM_ResetReason: ComSignalType=UINT8, ComBitSize=8, ComBitPosition=321, ComSystemTemplateSystemSignalRef=MCUM_ResetReason
        MCUM_CpldRest_TimeOut_flag: ComSignalType=UINT8, ComBitSize=2, ComBitPosition=354, ComSystemTemplateSystemSignalRef=MCUM_CpldRest_TimeOut_flag
        MCUM_DrvPCBCurr: ComSignalType=UINT8, ComBitSize=5, ComBitPosition=356, ComSystemTemplateSystemSignalRef=MCUM_DrvPCBCurr
        MCUM_EOL_StateMachine: ComSignalType=UINT8, ComBitSize=8, ComBitPosition=361, ComSystemTemplateSystemSignalRef=MCUM_EOL_StateMachine
        MCUM_CpldRest_ASC_Flag: ComSignalType=BOOLEAN, ComBitSize=1, ComBitPosition=369, ComSystemTemplateSystemSignalRef=MCUM_CpldRest_ASC_Flag
        MCUM_LimSpdTorFlag: ComSignalType=BOOLEAN, ComBitSize=1, ComBitPosition=370, ComSystemTemplateSystemSignalRef=MCUM_LimSpdTorFlag
        MCUM_PWM_Err_Count: ComSignalType=UINT8, ComBitSize=5, ComBitPosition=371, ComSystemTemplateSystemSignalRef=MCUM_PWM_Err_Count
        MCUM_RDC_Reset_Count: ComSignalType=UINT8, ComBitSize=8, ComBitPosition=376, ComSystemTemplateSystemSignalRef=MCUM_RDC_Reset_Count
        MCUM_ASC_Stop_Flag: ComSignalType=BOOLEAN, ComBitSize=1, ComBitPosition=384, ComSystemTemplateSystemSignalRef=MCUM_ASC_Stop_Flag
        MCUM_ASC_Soft_Exiting_Flag: ComSignalType=BOOLEAN, ComBitSize=1, ComBitPosition=385, ComSystemTemplateSystemSignalRef=MCUM_ASC_Soft_Exiting_Flag
        MCUM_Vbus_ServeLowChkEn: ComSignalType=BOOLEAN, ComBitSize=1, ComBitPosition=386, ComSystemTemplateSystemSignalRef=MCUM_Vbus_ServeLowChkEn
        MCUM_EOP_BlockErr_IsLim_Flag: ComSignalType=BOOLEAN, ComBitSize=1, ComBitPosition=387, ComSystemTemplateSystemSignalRef=MCUM_EOP_BlockErr_IsLim_Flag
        MCUM_MotSelfHeat_EnSts: ComSignalType=UINT8, ComBitSize=2, ComBitPosition=399, ComSystemTemplateSystemSignalRef=MCUM_MotSelfHeat_EnSts
        MCUM_MotBlockHeat_LvlFb: ComSignalType=UINT8, ComBitSize=3, ComBitPosition=401, ComSystemTemplateSystemSignalRef=MCUM_MotBlockHeat_LvlFb
        MCUM_MotRotaryHeat_LvlFb: ComSignalType=UINT8, ComBitSize=3, ComBitPosition=404, ComSystemTemplateSystemSignalRef=MCUM_MotRotaryHeat_LvlFb
        MCUM_MotSelfHeat_DropLvlFb: ComSignalType=BOOLEAN, ComBitSize=1, ComBitPosition=407, ComSystemTemplateSystemSignalRef=MCUM_MotSelfHeat_DropLvlFb
        MCUM_MotSelfHeat_DropLvlRsn: ComSignalType=UINT8, ComBitSize=2, ComBitPosition=408, ComSystemTemplateSystemSignalRef=MCUM_MotSelfHeat_DropLvlRsn
        MCUM_MotBlockHeat_CurAngle: ComSignalType=UINT16, ComBitSize=9, ComBitPosition=410, ComSystemTemplateSystemSignalRef=MCUM_MotBlockHeat_CurAngle
        MCUM_MotBlockHeat_CurMag: ComSignalType=UINT16, ComBitSize=9, ComBitPosition=419, ComSystemTemplateSystemSignalRef=MCUM_MotBlockHeat_CurMag
        MCUM_FaultDataRec_State: ComSignalType=UINT8, ComBitSize=4, ComBitPosition=428, ComSystemTemplateSystemSignalRef=MCUM_FaultDataRec_State
        MCUM_UserDefine_Byte1: ComSignalType=UINT8, ComBitSize=8, ComBitPosition=432, ComSystemTemplateSystemSignalRef=MCUM_UserDefine_Byte1
        MCUM_UserDefine_Byte2: ComSignalType=UINT8, ComBitSize=8, ComBitPosition=440, ComSystemTemplateSystemSignalRef=MCUM_UserDefine_Byte2
        MCUM_UserDefine_Byte3: ComSignalType=UINT8, ComBitSize=8, ComBitPosition=448, ComSystemTemplateSystemSignalRef=MCUM_UserDefine_Byte3
        MCUM_UserDefine_Byte4: ComSignalType=UINT8, ComBitSize=8, ComBitPosition=456, ComSystemTemplateSystemSignalRef=MCUM_UserDefine_Byte4
        MCUM_UserDefine_Word1: ComSignalType=UINT16, ComBitSize=16, ComBitPosition=464, ComSystemTemplateSystemSignalRef=MCUM_UserDefine_Word1
        MCUM_UserDefine_Word2: ComSignalType=UINT16, ComBitSize=16, ComBitPosition=480, ComSystemTemplateSystemSignalRef=MCUM_UserDefine_Word2
        MCUM_UserDefine_Word3: ComSignalType=UINT16, ComBitSize=16, ComBitPosition=496, ComSystemTemplateSystemSignalRef=MCUM_UserDefine_Word3
      VCU_0xBB_P_CANFD (ComIPdu):
        ComIPduSignalProcessing = IMMEDIATE
        ComIPduType = NORMAL
        ComIPduDirection = SEND
        ComFirstTimeout = 0.01
        ComTimeout = 0.01
        ComIPduCallout = ComCallOut_VCU_0xBB_P_CANFD
        ComIPduGroupRef = ComIPduGroup_Tx
        ComPduIdRef = PduCollection/VCU_0xBB_P_CANFD_Com2PduR
        ComIPduSignalRef = VCU_CheckSum_BB
        ComIPduSignalRef = VCU_WorkModeReq_PHEV
        ComIPduSignalRef = VCU_WorkMode_PHEV
        ComIPduSignalRef = VCU_HEVAllow_PHEV
        ComIPduSignalRef = VCU_REAllow_PHEV
        ComIPduSignalRef = VCU_EVDualAllow_PHEV
        ComIPduSignalRef = VCU_EVSingleAllow_PHEV
        ComIPduSignalRef = VCU_Clutch_2_RequesSpeed
        ComIPduSignalRef = VCU_Clutch_1_RequesSpeed
        ComIPduSignalRef = VCU_Clutch2Position
        ComIPduSignalRef = VCU_Clutch1Position
        ComIPduSignalRef = VCU_RollingCounter_BB
        ComIPduSignalRef = VCU_RoughRoadDetectionFlag
        ComIPduSignalRef = VCU_Clutch_2_RequesSpeedValid
        ComIPduSignalRef = VCU_Clutch_1_RequesSpeedValid
        ComIPduSignalRef = VCU_GCURequestTorque
        ComIPduSignalRef = VCU_PowerReducetSts
        ComIPduSignalRef = VCU_GCUAassistFB
        ComIPduSignalRef = VCU_GCUActiveReleaseCmd
        ComIPduSignalRef = VCU_PowerOverSts
        ComIPduSignalRef = VCU_GCURequesSpeed
        ComIPduSignalRef = VCU_GCUControlMode
        ComIPduSignalRef = VCU_MotChargePower
        ComIPduSignalRef = VCU_APS1Position
        ComIPduSignalRef = VCU_EngineStartReq
        ComIPduSignalRef = VCU_EngineFuelInhibitReq
        ComIPduSignalRef = VCU_EngineOffRequest
        ComIPduSignalRef = VCU_STorqueReqValid
        ComIPduSignalRef = VCU_STorqueReq
        ComIPduSignalRef = VCU_FTorqueSwFb
        ComIPduSignalRef = VCU_FVVOpenReq
        ComIPduSignalRef = VCU_WarmUpCycleIndicator
        ComIPduSignalRef = VCU_EngineResetSts
        ComIPduSignalRef = VCU_EngineSts
        ComIPduSignalRef = VCU_FTorqueReq
        ComIPduSignalRef = VCU_FTorqueReqValid
        ComIPduSignalRef = VCU_EngineIdleReq
        ComIPduSignalRef = VCU_REsystemSts
        ComIPduSignalRef = VCU_REsystemFaultSts
        ComIPduSignalRef = VCU_APS2Position
        ComIPduSignalRef = VCU_EngineRunAllowFlg
        ComIPduSignalRef = VCU_EngineIdleSpeed
        ComIPduSignalRef = VCU_EngineFuleCutoffReq
        ComIPduSignalRef = VCU_MCUSClutchPosition
        ComIPduSignalRef = VCU_MGCUWorkMode
        ComIPduSignalRef = VCU_REChgTarget
        ComIPduSignalRef = VCU_MotStartStopPowerUP
        ComIPduSignalRef = VCU_MotStartStopPowerLOW
        ComIPduSignalRef = VCU_GCURequesSpeed_MGCU
        ComIPduSignalRef = VCU_DynamicChgPwr
        ComIPduSignalRef = VCU_ForceChgPwr
        ComIPduSignalRef = VCU_REStartType
        ComTxIPdu: ComMinimumDelayTime=0.0, ComTxIPduUnusedAreasDefault=0
          ComTxModeTrue
            ComTxMode: ComTxModeTimePeriod=0.01, ComTxModeMode=PERIODIC, ComTxModeNumberOfRepetitions=0, ComTxModeRepetitionPeriod=0, ComTxModeTimeOffset=0.0
          ComTxModeFalse
            ComTxMode: ComTxModeTimePeriod=0.01, ComTxModeMode=PERIODIC, ComTxModeNumberOfRepetitions=0, ComTxModeRepetitionPeriod=0, ComTxModeTimeOffset=0.0
      52 x ComSignal, all with ComSignalInitValue=0, ComSignalEndianness=LITTLE_ENDIAN, ComUpdateBitPosition=-1, ComTransferProperty=PENDING:
        VCU_CheckSum_BB: ComSignalType=UINT8, ComBitSize=8, ComBitPosition=0, ComSystemTemplateSystemSignalRef=VCU_CheckSum_BB
        VCU_WorkModeReq_PHEV: ComSignalType=UINT8, ComBitSize=3, ComBitPosition=219, ComSystemTemplateSystemSignalRef=VCU_WorkModeReq_PHEV
        VCU_WorkMode_PHEV: ComSignalType=UINT8, ComBitSize=3, ComBitPosition=216, ComSystemTemplateSystemSignalRef=VCU_WorkMode_PHEV
        VCU_HEVAllow_PHEV: ComSignalType=BOOLEAN, ComBitSize=1, ComBitPosition=215, ComSystemTemplateSystemSignalRef=VCU_HEVAllow_PHEV
        VCU_REAllow_PHEV: ComSignalType=BOOLEAN, ComBitSize=1, ComBitPosition=214, ComSystemTemplateSystemSignalRef=VCU_REAllow_PHEV
        VCU_EVDualAllow_PHEV: ComSignalType=BOOLEAN, ComBitSize=1, ComBitPosition=213, ComSystemTemplateSystemSignalRef=VCU_EVDualAllow_PHEV
        VCU_EVSingleAllow_PHEV: ComSignalType=BOOLEAN, ComBitSize=1, ComBitPosition=212, ComSystemTemplateSystemSignalRef=VCU_EVSingleAllow_PHEV
        VCU_Clutch_2_RequesSpeed: ComSignalType=UINT16, ComBitSize=16, ComBitPosition=196, ComSystemTemplateSystemSignalRef=VCU_Clutch_2_RequesSpeed
        VCU_Clutch_1_RequesSpeed: ComSignalType=UINT16, ComBitSize=16, ComBitPosition=180, ComSystemTemplateSystemSignalRef=VCU_Clutch_1_RequesSpeed
        VCU_Clutch2Position: ComSignalType=UINT8, ComBitSize=2, ComBitPosition=178, ComSystemTemplateSystemSignalRef=VCU_Clutch2Position
        VCU_Clutch1Position: ComSignalType=UINT8, ComBitSize=2, ComBitPosition=176, ComSystemTemplateSystemSignalRef=VCU_Clutch1Position
        VCU_RollingCounter_BB: ComSignalType=UINT8, ComBitSize=4, ComBitPosition=8, ComSystemTemplateSystemSignalRef=VCU_RollingCounter_BB
        VCU_RoughRoadDetectionFlag: ComSignalType=BOOLEAN, ComBitSize=1, ComBitPosition=47, ComSystemTemplateSystemSignalRef=VCU_RoughRoadDetectionFlag
        VCU_Clutch_2_RequesSpeedValid: ComSignalType=BOOLEAN, ComBitSize=1, ComBitPosition=223, ComSystemTemplateSystemSignalRef=VCU_Clutch_2_RequesSpeedValid
        VCU_Clutch_1_RequesSpeedValid: ComSignalType=BOOLEAN, ComBitSize=1, ComBitPosition=222, ComSystemTemplateSystemSignalRef=VCU_Clutch_1_RequesSpeedValid
        VCU_GCURequestTorque: ComSignalType=UINT16, ComBitSize=12, ComBitPosition=16, ComSystemTemplateSystemSignalRef=VCU_GCURequestTorque
        VCU_PowerReducetSts: ComSignalType=BOOLEAN, ComBitSize=1, ComBitPosition=28, ComSystemTemplateSystemSignalRef=VCU_PowerReducetSts
        VCU_GCUAassistFB: ComSignalType=BOOLEAN, ComBitSize=1, ComBitPosition=29, ComSystemTemplateSystemSignalRef=VCU_GCUAassistFB
        VCU_GCUActiveReleaseCmd: ComSignalType=BOOLEAN, ComBitSize=1, ComBitPosition=30, ComSystemTemplateSystemSignalRef=VCU_GCUActiveReleaseCmd
        VCU_PowerOverSts: ComSignalType=BOOLEAN, ComBitSize=1, ComBitPosition=31, ComSystemTemplateSystemSignalRef=VCU_PowerOverSts
        VCU_GCURequesSpeed: ComSignalType=UINT16, ComBitSize=14, ComBitPosition=32, ComSystemTemplateSystemSignalRef=VCU_GCURequesSpeed
        VCU_GCUControlMode: ComSignalType=BOOLEAN, ComBitSize=1, ComBitPosition=46, ComSystemTemplateSystemSignalRef=VCU_GCUControlMode
        VCU_MotChargePower: ComSignalType=UINT8, ComBitSize=8, ComBitPosition=48, ComSystemTemplateSystemSignalRef=VCU_MotChargePower
        VCU_APS1Position: ComSignalType=UINT8, ComBitSize=8, ComBitPosition=56, ComSystemTemplateSystemSignalRef=VCU_APS1Position
        VCU_EngineStartReq: ComSignalType=BOOLEAN, ComBitSize=1, ComBitPosition=64, ComSystemTemplateSystemSignalRef=VCU_EngineStartReq
        VCU_EngineFuelInhibitReq: ComSignalType=BOOLEAN, ComBitSize=1, ComBitPosition=65, ComSystemTemplateSystemSignalRef=VCU_EngineFuelInhibitReq
        VCU_EngineOffRequest: ComSignalType=BOOLEAN, ComBitSize=1, ComBitPosition=66, ComSystemTemplateSystemSignalRef=VCU_EngineOffRequest
        VCU_STorqueReqValid: ComSignalType=BOOLEAN, ComBitSize=1, ComBitPosition=67, ComSystemTemplateSystemSignalRef=VCU_STorqueReqValid
        VCU_STorqueReq: ComSignalType=UINT16, ComBitSize=12, ComBitPosition=68, ComSystemTemplateSystemSignalRef=VCU_STorqueReq
        VCU_FTorqueSwFb: ComSignalType=BOOLEAN, ComBitSize=1, ComBitPosition=80, ComSystemTemplateSystemSignalRef=VCU_FTorqueSwFb
        VCU_FVVOpenReq: ComSignalType=BOOLEAN, ComBitSize=1, ComBitPosition=81, ComSystemTemplateSystemSignalRef=VCU_FVVOpenReq
        VCU_WarmUpCycleIndicator: ComSignalType=BOOLEAN, ComBitSize=1, ComBitPosition=82, ComSystemTemplateSystemSignalRef=VCU_WarmUpCycleIndicator
        VCU_EngineResetSts: ComSignalType=BOOLEAN, ComBitSize=1, ComBitPosition=83, ComSystemTemplateSystemSignalRef=VCU_EngineResetSts
        VCU_EngineSts: ComSignalType=UINT8, ComBitSize=4, ComBitPosition=84, ComSystemTemplateSystemSignalRef=VCU_EngineSts
        VCU_FTorqueReq: ComSignalType=UINT16, ComBitSize=12, ComBitPosition=88, ComSystemTemplateSystemSignalRef=VCU_FTorqueReq
        VCU_FTorqueReqValid: ComSignalType=BOOLEAN, ComBitSize=1, ComBitPosition=100, ComSystemTemplateSystemSignalRef=VCU_FTorqueReqValid
        VCU_EngineIdleReq: ComSignalType=BOOLEAN, ComBitSize=1, ComBitPosition=101, ComSystemTemplateSystemSignalRef=VCU_EngineIdleReq
        VCU_REsystemSts: ComSignalType=BOOLEAN, ComBitSize=1, ComBitPosition=102, ComSystemTemplateSystemSignalRef=VCU_REsystemSts
        VCU_REsystemFaultSts: ComSignalType=BOOLEAN, ComBitSize=1, ComBitPosition=103, ComSystemTemplateSystemSignalRef=VCU_REsystemFaultSts
        VCU_APS2Position: ComSignalType=UINT8, ComBitSize=8, ComBitPosition=104, ComSystemTemplateSystemSignalRef=VCU_APS2Position
        VCU_EngineRunAllowFlg: ComSignalType=BOOLEAN, ComBitSize=1, ComBitPosition=112, ComSystemTemplateSystemSignalRef=VCU_EngineRunAllowFlg
        VCU_EngineIdleSpeed: ComSignalType=UINT8, ComBitSize=2, ComBitPosition=113, ComSystemTemplateSystemSignalRef=VCU_EngineIdleSpeed
        VCU_EngineFuleCutoffReq: ComSignalType=BOOLEAN, ComBitSize=1, ComBitPosition=115, ComSystemTemplateSystemSignalRef=VCU_EngineFuleCutoffReq
        VCU_MCUSClutchPosition: ComSignalType=UINT8, ComBitSize=2, ComBitPosition=116, ComSystemTemplateSystemSignalRef=VCU_MCUSClutchPosition
        VCU_MGCUWorkMode: ComSignalType=UINT8, ComBitSize=2, ComBitPosition=118, ComSystemTemplateSystemSignalRef=VCU_MGCUWorkMode
        VCU_REChgTarget: ComSignalType=UINT8, ComBitSize=8, ComBitPosition=120, ComSystemTemplateSystemSignalRef=VCU_REChgTarget
        VCU_MotStartStopPowerUP: ComSignalType=UINT8, ComBitSize=8, ComBitPosition=128, ComSystemTemplateSystemSignalRef=VCU_MotStartStopPowerUP
        VCU_MotStartStopPowerLOW: ComSignalType=UINT8, ComBitSize=8, ComBitPosition=136, ComSystemTemplateSystemSignalRef=VCU_MotStartStopPowerLOW
        VCU_GCURequesSpeed_MGCU: ComSignalType=UINT16, ComBitSize=16, ComBitPosition=144, ComSystemTemplateSystemSignalRef=VCU_GCURequesSpeed_MGCU
        VCU_DynamicChgPwr: ComSignalType=UINT8, ComBitSize=5, ComBitPosition=160, ComSystemTemplateSystemSignalRef=VCU_DynamicChgPwr
        VCU_ForceChgPwr: ComSignalType=UINT8, ComBitSize=5, ComBitPosition=165, ComSystemTemplateSystemSignalRef=VCU_ForceChgPwr
        VCU_REStartType: ComSignalType=UINT8, ComBitSize=6, ComBitPosition=170, ComSystemTemplateSystemSignalRef=VCU_REStartType
      VCU_0xBC_P_CANFD (ComIPdu):
        ComIPduSignalProcessing = IMMEDIATE
        ComIPduType = NORMAL
        ComIPduDirection = SEND
        ComFirstTimeout = 0.01
        ComTimeout = 0.01
        ComIPduGroupRef = ComIPduGroup_Tx
        ComPduIdRef = PduCollection/VCU_0xBC_P_CANFD_Com2PduR
        ComIPduSignalRef = VCU_VehicleSpdDirect
        ComIPduSignalRef = VCU_ADM_ActualMode
        ComIPduSignalRef = VCU_ADM_MainMode
        ComIPduSignalRef = VCU_DeliveryModeSts
        ComIPduSignalRef = VCU_VehSpdLimtRemind
        ComIPduSignalRef = VCU_SinglePedalSts
        ComIPduSignalRef = VCU_GearLvrChangeSts
        ComIPduSignalRef = VCU_HighVoltSysSts
        ComIPduSignalRef = VCU_ChrgDischrgFunSts
        ComIPduSignalRef = VCU_CalibrationVersion
        ComIPduSignalRef = VCU_CalibrationNumber
        ComIPduSignalRef = VCU_VehicleNegTrqRspdSts
        ComIPduSignalRef = VCU_SlopeEst
        ComIPduSignalRef = VCU_SlopeEst_Valid
        ComIPduSignalRef = VCU_WheelTrqType
        ComIPduSignalRef = VCU_DriverAssistProhibitSts
        ComIPduSignalRef = VCU_VacumRlySts
        ComIPduSignalRef = VCU_DriveSHVILSts
        ComIPduSignalRef = VCU_DriveMHVILSts
        ComIPduSignalRef = VCU_DCChgHVILSts
        ComIPduSignalRef = VCU_ACChgHVILSts
        ComIPduSignalRef = VCU_CCMHVILSts
        ComIPduSignalRef = VCU_SystemError
        ComIPduSignalRef = VCU_AccPedalFaultLV
        ComIPduSignalRef = VCU_HVILSysSts
        ComIPduSignalRef = VCU_VacuumDegree
        ComIPduSignalRef = VCU_LPedalModeSts
        ComIPduSignalRef = VCU_LVSystemError
        ComIPduSignalRef = VCU_HVSystemError
        ComIPduSignalRef = VCU_OpeartingMode
        ComIPduSignalRef = VCU_EnergyMode
        ComIPduSignalRef = VCU_GearLevelPosFault
        ComIPduSignalRef = VCU_BrakeSwitchSts
        ComIPduSignalRef = VCU_SpdLimModeSts
        ComIPduSignalRef = VCU_TrqDstrbutnPrio
        ComIPduSignalRef = VCU_TrqDstrbutnTransferSts
        ComIPduSignalRef = VCU_MCUMDiffProtectSts
        ComIPduSignalRef = VCU_MCUSDiffProtectSts
        ComTxIPdu: ComMinimumDelayTime=0.0, ComTxIPduUnusedAreasDefault=0
          ComTxModeTrue
            ComTxMode: ComTxModeTimePeriod=0.01, ComTxModeMode=PERIODIC, ComTxModeNumberOfRepetitions=0, ComTxModeRepetitionPeriod=0, ComTxModeTimeOffset=0.0
          ComTxModeFalse
            ComTxMode: ComTxModeTimePeriod=0.01, ComTxModeMode=PERIODIC, ComTxModeNumberOfRepetitions=0, ComTxModeRepetitionPeriod=0, ComTxModeTimeOffset=0.0
      38 x ComSignal, all with ComSignalInitValue=0, ComSignalEndianness=LITTLE_ENDIAN, ComUpdateBitPosition=-1, ComTransferProperty=PENDING:
        VCU_VehicleSpdDirect: ComSignalType=UINT16, ComBitSize=9, ComBitPosition=16, ComSystemTemplateSystemSignalRef=VCU_VehicleSpdDirect
        VCU_ADM_ActualMode: ComSignalType=UINT8, ComBitSize=2, ComBitPosition=112, ComSystemTemplateSystemSignalRef=VCU_ADM_ActualMode
        VCU_ADM_MainMode: ComSignalType=UINT8, ComBitSize=2, ComBitPosition=110, ComSystemTemplateSystemSignalRef=VCU_ADM_MainMode
        VCU_DeliveryModeSts: ComSignalType=BOOLEAN, ComBitSize=1, ComBitPosition=25, ComSystemTemplateSystemSignalRef=VCU_DeliveryModeSts
        VCU_VehSpdLimtRemind: ComSignalType=BOOLEAN, ComBitSize=1, ComBitPosition=26, ComSystemTemplateSystemSignalRef=VCU_VehSpdLimtRemind
        VCU_SinglePedalSts: ComSignalType=BOOLEAN, ComBitSize=1, ComBitPosition=27, ComSystemTemplateSystemSignalRef=VCU_SinglePedalSts
        VCU_GearLvrChangeSts: ComSignalType=UINT8, ComBitSize=4, ComBitPosition=28, ComSystemTemplateSystemSignalRef=VCU_GearLvrChangeSts
        VCU_HighVoltSysSts: ComSignalType=UINT8, ComBitSize=4, ComBitPosition=32, ComSystemTemplateSystemSignalRef=VCU_HighVoltSysSts
        VCU_ChrgDischrgFunSts: ComSignalType=UINT8, ComBitSize=4, ComBitPosition=36, ComSystemTemplateSystemSignalRef=VCU_ChrgDischrgFunSts
        VCU_CalibrationVersion: ComSignalType=UINT8, ComBitSize=4, ComBitPosition=40, ComSystemTemplateSystemSignalRef=VCU_CalibrationVersion
        VCU_CalibrationNumber: ComSignalType=UINT8, ComBitSize=3, ComBitPosition=44, ComSystemTemplateSystemSignalRef=VCU_CalibrationNumber
        VCU_VehicleNegTrqRspdSts: ComSignalType=BOOLEAN, ComBitSize=1, ComBitPosition=47, ComSystemTemplateSystemSignalRef=VCU_VehicleNegTrqRspdSts
        VCU_SlopeEst: ComSignalType=UINT16, ComBitSize=10, ComBitPosition=48, ComSystemTemplateSystemSignalRef=VCU_SlopeEst
        VCU_SlopeEst_Valid: ComSignalType=BOOLEAN, ComBitSize=1, ComBitPosition=58, ComSystemTemplateSystemSignalRef=VCU_SlopeEst_Valid
        VCU_WheelTrqType: ComSignalType=UINT8, ComBitSize=4, ComBitPosition=60, ComSystemTemplateSystemSignalRef=VCU_WheelTrqType
        VCU_DriverAssistProhibitSts: ComSignalType=BOOLEAN, ComBitSize=1, ComBitPosition=64, ComSystemTemplateSystemSignalRef=VCU_DriverAssistProhibitSts
        VCU_VacumRlySts: ComSignalType=BOOLEAN, ComBitSize=1, ComBitPosition=65, ComSystemTemplateSystemSignalRef=VCU_VacumRlySts
        VCU_DriveSHVILSts: ComSignalType=BOOLEAN, ComBitSize=1, ComBitPosition=66, ComSystemTemplateSystemSignalRef=VCU_DriveSHVILSts
        VCU_DriveMHVILSts: ComSignalType=BOOLEAN, ComBitSize=1, ComBitPosition=67, ComSystemTemplateSystemSignalRef=VCU_DriveMHVILSts
        VCU_DCChgHVILSts: ComSignalType=BOOLEAN, ComBitSize=1, ComBitPosition=68, ComSystemTemplateSystemSignalRef=VCU_DCChgHVILSts
        VCU_ACChgHVILSts: ComSignalType=BOOLEAN, ComBitSize=1, ComBitPosition=69, ComSystemTemplateSystemSignalRef=VCU_ACChgHVILSts
        VCU_CCMHVILSts: ComSignalType=BOOLEAN, ComBitSize=1, ComBitPosition=70, ComSystemTemplateSystemSignalRef=VCU_CCMHVILSts
        VCU_SystemError: ComSignalType=BOOLEAN, ComBitSize=1, ComBitPosition=71, ComSystemTemplateSystemSignalRef=VCU_SystemError
        VCU_AccPedalFaultLV: ComSignalType=UINT8, ComBitSize=3, ComBitPosition=72, ComSystemTemplateSystemSignalRef=VCU_AccPedalFaultLV
        VCU_HVILSysSts: ComSignalType=UINT8, ComBitSize=4, ComBitPosition=76, ComSystemTemplateSystemSignalRef=VCU_HVILSysSts
        VCU_VacuumDegree: ComSignalType=UINT8, ComBitSize=8, ComBitPosition=80, ComSystemTemplateSystemSignalRef=VCU_VacuumDegree
        VCU_LPedalModeSts: ComSignalType=UINT8, ComBitSize=2, ComBitPosition=88, ComSystemTemplateSystemSignalRef=VCU_LPedalModeSts
        VCU_LVSystemError: ComSignalType=BOOLEAN, ComBitSize=1, ComBitPosition=90, ComSystemTemplateSystemSignalRef=VCU_LVSystemError
        VCU_HVSystemError: ComSignalType=BOOLEAN, ComBitSize=1, ComBitPosition=91, ComSystemTemplateSystemSignalRef=VCU_HVSystemError
        VCU_OpeartingMode: ComSignalType=UINT8, ComBitSize=2, ComBitPosition=92, ComSystemTemplateSystemSignalRef=VCU_OpeartingMode
        VCU_EnergyMode: ComSignalType=UINT8, ComBitSize=3, ComBitPosition=94, ComSystemTemplateSystemSignalRef=VCU_EnergyMode
        VCU_GearLevelPosFault: ComSignalType=BOOLEAN, ComBitSize=1, ComBitPosition=97, ComSystemTemplateSystemSignalRef=VCU_GearLevelPosFault
        VCU_BrakeSwitchSts: ComSignalType=UINT8, ComBitSize=2, ComBitPosition=98, ComSystemTemplateSystemSignalRef=VCU_BrakeSwitchSts
        VCU_SpdLimModeSts: ComSignalType=UINT8, ComBitSize=2, ComBitPosition=100, ComSystemTemplateSystemSignalRef=VCU_SpdLimModeSts
        VCU_TrqDstrbutnPrio: ComSignalType=UINT8, ComBitSize=3, ComBitPosition=102, ComSystemTemplateSystemSignalRef=VCU_TrqDstrbutnPrio
        VCU_TrqDstrbutnTransferSts: ComSignalType=UINT8, ComBitSize=3, ComBitPosition=105, ComSystemTemplateSystemSignalRef=VCU_TrqDstrbutnTransferSts
        VCU_MCUMDiffProtectSts: ComSignalType=BOOLEAN, ComBitSize=1, ComBitPosition=108, ComSystemTemplateSystemSignalRef=VCU_MCUMDiffProtectSts
        VCU_MCUSDiffProtectSts: ComSignalType=BOOLEAN, ComBitSize=1, ComBitPosition=109, ComSystemTemplateSystemSignalRef=VCU_MCUSDiffProtectSts
      VCU_0x1E5_P_CANFD (ComIPdu):
        ComIPduSignalProcessing = IMMEDIATE
        ComIPduType = NORMAL
        ComIPduDirection = SEND
        ComFirstTimeout = 0.0
        ComTimeout = 0.0
        ComIPduGroupRef = ComIPduGroup_Tx
        ComPduIdRef = PduCollection/VCU_0x1E5_P_CANFD_Com2PduR
        ComIPduSignalRef = VCU_BCM_Authentication_MAC_A{0..15}
        ComIPduSignalRef = VCU_BCM_Authentication_Challenge_B{0..3}
        ComTxIPdu: ComMinimumDelayTime=0.0, ComTxIPduUnusedAreasDefault=0
          ComTxModeTrue
            ComTxMode: ComTxModeTimePeriod=0, ComTxModeMode=DIRECT, ComTxModeNumberOfRepetitions=0, ComTxModeRepetitionPeriod=0, ComTxModeTimeOffset=0
          ComTxModeFalse
            ComTxMode: ComTxModeTimePeriod=0, ComTxModeMode=DIRECT, ComTxModeNumberOfRepetitions=0, ComTxModeRepetitionPeriod=0, ComTxModeTimeOffset=0
      20 x ComSignal, all with ComSignalInitValue=0, ComSignalType=UINT8, ComSignalEndianness=LITTLE_ENDIAN, ComBitSize=8, ComUpdateBitPosition=-1, ComTransferProperty=PENDING:
        VCU_BCM_Authentication_MAC_A0: ComBitPosition=0, ComSystemTemplateSystemSignalRef=VCU_BCM_Authentication_MAC_A0
        VCU_BCM_Authentication_MAC_A1: ComBitPosition=8, ComSystemTemplateSystemSignalRef=VCU_BCM_Authentication_MAC_A1
        VCU_BCM_Authentication_MAC_A2: ComBitPosition=16, ComSystemTemplateSystemSignalRef=VCU_BCM_Authentication_MAC_A2
        VCU_BCM_Authentication_MAC_A3: ComBitPosition=24, ComSystemTemplateSystemSignalRef=VCU_BCM_Authentication_MAC_A3
        VCU_BCM_Authentication_MAC_A4: ComBitPosition=32, ComSystemTemplateSystemSignalRef=VCU_BCM_Authentication_MAC_A4
        VCU_BCM_Authentication_MAC_A5: ComBitPosition=40, ComSystemTemplateSystemSignalRef=VCU_BCM_Authentication_MAC_A5
        VCU_BCM_Authentication_MAC_A6: ComBitPosition=48, ComSystemTemplateSystemSignalRef=VCU_BCM_Authentication_MAC_A6
        VCU_BCM_Authentication_MAC_A7: ComBitPosition=56, ComSystemTemplateSystemSignalRef=VCU_BCM_Authentication_MAC_A7
        VCU_BCM_Authentication_MAC_A8: ComBitPosition=64, ComSystemTemplateSystemSignalRef=VCU_BCM_Authentication_MAC_A8
        VCU_BCM_Authentication_MAC_A9: ComBitPosition=72, ComSystemTemplateSystemSignalRef=VCU_BCM_Authentication_MAC_A9
        VCU_BCM_Authentication_MAC_A10: ComBitPosition=80, ComSystemTemplateSystemSignalRef=VCU_BCM_Authentication_MAC_A10
        VCU_BCM_Authentication_MAC_A11: ComBitPosition=88, ComSystemTemplateSystemSignalRef=VCU_BCM_Authentication_MAC_A11
        VCU_BCM_Authentication_MAC_A12: ComBitPosition=96, ComSystemTemplateSystemSignalRef=VCU_BCM_Authentication_MAC_A12
        VCU_BCM_Authentication_MAC_A13: ComBitPosition=104, ComSystemTemplateSystemSignalRef=VCU_BCM_Authentication_MAC_A13
        VCU_BCM_Authentication_MAC_A14: ComBitPosition=112, ComSystemTemplateSystemSignalRef=VCU_BCM_Authentication_MAC_A14
        VCU_BCM_Authentication_MAC_A15: ComBitPosition=120, ComSystemTemplateSystemSignalRef=VCU_BCM_Authentication_MAC_A15
        VCU_BCM_Authentication_Challenge_B0: ComBitPosition=128, ComSystemTemplateSystemSignalRef=VCU_BCM_Authentication_Challenge_B0
        VCU_BCM_Authentication_Challenge_B1: ComBitPosition=136, ComSystemTemplateSystemSignalRef=VCU_BCM_Authentication_Challenge_B1
        VCU_BCM_Authentication_Challenge_B2: ComBitPosition=144, ComSystemTemplateSystemSignalRef=VCU_BCM_Authentication_Challenge_B2
        VCU_BCM_Authentication_Challenge_B3: ComBitPosition=152, ComSystemTemplateSystemSignalRef=VCU_BCM_Authentication_Challenge_B3
      VCU_0xDE_P_CANFD (ComIPdu):
        ComIPduSignalProcessing = IMMEDIATE
        ComIPduType = NORMAL
        ComIPduDirection = SEND
        ComFirstTimeout = 0.01
        ComTimeout = 0.01
        ComIPduGroupRef = ComIPduGroup_Tx
        ComPduIdRef = PduCollection/VCU_0xDE_P_CANFD_Com2PduR
        ComIPduSignalRef = VCU_BrkPedOpen
        ComIPduSignalRef = VCU_BrkPedClose
        ComIPduSignalRef = VCU_ColumnShiftP
        ComIPduSignalRef = VCU_VehiCrashSts
        ComIPduSignalRef = VCU_SleepSatisfiedSts
        ComIPduSignalRef = VCU_VehiHvCmd
        ComIPduSignalRef = VCU_GearQuitAps
        ComIPduSignalRef = VCU_REOverChgPwrFlag
        ComIPduSignalRef = VCU_VehiAccnFilt
        ComIPduSignalRef = VCU_HvOffSts
        ComIPduSignalRef = VCU_ElecPwrBalanceReq
        ComIPduSignalRef = VCU_CDU_RecvTr
        ComIPduSignalRef = VCU_BMS_RecvTr
        ComIPduSignalRef = VCU_IVI_RecvTr
        ComIPduSignalRef = VCU_WheelMaxDrvTrq
        ComIPduSignalRef = VCU_WheelMaxRecTrq
        ComIPduSignalRef = VCU_GCU_RecvTr
        ComIPduSignalRef = VCU_TCM_RecvTr
        ComIPduSignalRef = VCU_PTC_RecvTr
        ComIPduSignalRef = VCU_LossFctorFlgFL
        ComIPduSignalRef = VCU_LowBattVolt
        ComIPduSignalRef = VCU_HighPerforDisable
        ComIPduSignalRef = VCU_AccPedHSigVolt
        ComIPduSignalRef = VCU_LossFctorFlgFR
        ComIPduSignalRef = VCU_AccPedLSigVolt
        ComIPduSignalRef = VCU_LossFctorFlgRL
        ComIPduSignalRef = VCU_AccPedHPwrVolt
        ComIPduSignalRef = VCU_LossFctorFlgRR
        ComIPduSignalRef = VCU_AccPedLPwrVolt
        ComIPduSignalRef = VCU_PreReqChgPwr
        ComIPduSignalRef = VCU_VehPwrChageLimit
        ComIPduSignalRef = VCU_FastPwrRequest
        ComIPduSignalRef = VCU_On2KL15_Volt
        ComIPduSignalRef = VCU_ClutchWrkModDebug
        ComIPduSignalRef = VCU_HighPerforSwtFlg
        ComIPduSignalRef = VCU_VehiPowrConsumption
        ComIPduSignalRef = VCU_MDrvFilterTrqRange
        ComIPduSignalRef = VCU_WheelPwrOvrLimitflgRE
        ComIPduSignalRef = VCU_MRDrvControlMode
        ComIPduSignalRef = VCU_MRDrvControlModeVD
        ComIPduSignalRef = VCU_VehicleDirectMR
        ComIPduSignalRef = VCU_VehicleDirectMRVD
        ComIPduSignalRef = VCU_MRDrvRequestTorque
        ComIPduSignalRef = VCU_MRDrvRequesSpeed
        ComIPduSignalRef = VCU_MCUMRMaxDischargePower
        ComIPduSignalRef = VCU_MCUMRMaxPosDampgTrq
        ComIPduSignalRef = VCU_MRDrvRequestTorqueVD
        ComIPduSignalRef = VCU_MCUMRMaxChargePower
        ComIPduSignalRef = VCU_MCUMRMaxNegDampgTrq
        ComIPduSignalRef = VCU_MRDrvRequesSpeedVD
        ComIPduSignalRef = VCU_MCUMRDampgLmtFactor
        ComIPduSignalRef = VCU_SuppressJitterMCUMRRequest
        ComTxIPdu: ComMinimumDelayTime=0.0, ComTxIPduUnusedAreasDefault=0
          ComTxModeTrue
            ComTxMode: ComTxModeTimePeriod=0.01, ComTxModeMode=PERIODIC, ComTxModeNumberOfRepetitions=0, ComTxModeRepetitionPeriod=0, ComTxModeTimeOffset=0.0
          ComTxModeFalse
            ComTxMode: ComTxModeTimePeriod=0.01, ComTxModeMode=PERIODIC, ComTxModeNumberOfRepetitions=0, ComTxModeRepetitionPeriod=0, ComTxModeTimeOffset=0.0
      MCUM_0x5D0_P_CANFD (ComIPdu):
        ComIPduSignalProcessing = IMMEDIATE
        ComIPduType = NORMAL
        ComIPduDirection = SEND
        ComFirstTimeout = 0.02
        ComTimeout = 0.02
        ComIPduGroupRef = ComIPduGroup_Tx
        ComPduIdRef = PduCollection/MCUM_0x5D0_P_CANFD_Com2PduR
        ComIPduSignalRef = MCUM_Id_Ref
        ComIPduSignalRef = MCUM_Iq_Ref
        ComIPduSignalRef = MCUM_Id_Fb
        ComIPduSignalRef = MCUM_Iq_Fb
        ComIPduSignalRef = MCUM_Torque_Ref
        ComIPduSignalRef = MCUM_R_Id_Ref
        ComIPduSignalRef = MCUM_R_Iq_Ref
        ComIPduSignalRef = MCUM_R_Id_Fb
        ComIPduSignalRef = MCUM_R_Iq_Fb
        ComIPduSignalRef = MCUM_R_Torque_Ref
        ComTxIPdu: ComMinimumDelayTime=0.0, ComTxIPduUnusedAreasDefault=0
          ComTxModeTrue
            ComTxMode: ComTxModeTimePeriod=0.02, ComTxModeMode=PERIODIC, ComTxModeNumberOfRepetitions=0, ComTxModeRepetitionPeriod=0, ComTxModeTimeOffset=0.0
          ComTxModeFalse
            ComTxMode: ComTxModeTimePeriod=0.02, ComTxModeMode=PERIODIC, ComTxModeNumberOfRepetitions=0, ComTxModeRepetitionPeriod=0, ComTxModeTimeOffset=0.0
      10 x ComSignal, all with ComSignalInitValue=0, ComSignalType=UINT16, ComSignalEndianness=LITTLE_ENDIAN, ComUpdateBitPosition=-1, ComTransferProperty=PENDING:
        MCUM_Id_Ref: ComBitSize=11, ComBitPosition=0, ComSystemTemplateSystemSignalRef=MCUM_Id_Ref
        MCUM_Iq_Ref: ComBitSize=11, ComBitPosition=11, ComSystemTemplateSystemSignalRef=MCUM_Iq_Ref
        MCUM_Id_Fb: ComBitSize=11, ComBitPosition=22, ComSystemTemplateSystemSignalRef=MCUM_Id_Fb
        MCUM_Iq_Fb: ComBitSize=11, ComBitPosition=33, ComSystemTemplateSystemSignalRef=MCUM_Iq_Fb
        MCUM_Torque_Ref: ComBitSize=10, ComBitPosition=44, ComSystemTemplateSystemSignalRef=MCUM_Torque_Ref
        MCUM_R_Id_Ref: ComBitSize=11, ComBitPosition=64, ComSystemTemplateSystemSignalRef=MCUM_R_Id_Ref
        MCUM_R_Iq_Ref: ComBitSize=11, ComBitPosition=75, ComSystemTemplateSystemSignalRef=MCUM_R_Iq_Ref
        MCUM_R_Id_Fb: ComBitSize=11, ComBitPosition=86, ComSystemTemplateSystemSignalRef=MCUM_R_Id_Fb
        MCUM_R_Iq_Fb: ComBitSize=11, ComBitPosition=97, ComSystemTemplateSystemSignalRef=MCUM_R_Iq_Fb
        MCUM_R_Torque_Ref: ComBitSize=10, ComBitPosition=108, ComSystemTemplateSystemSignalRef=MCUM_R_Torque_Ref
      MCUM_0x5D1_P_CANFD (ComIPdu):
        ComIPduSignalProcessing = IMMEDIATE
        ComIPduType = NORMAL
        ComIPduDirection = SEND
        ComIPduGroupRef = ComIPduGroup_Tx
        ComPduIdRef = PduCollection/MCUM_0x5D1_P_CANFD_Com2PduR
        ComIPduSignalRef = MCUM_Vd_Ref
        ComIPduSignalRef = MCUM_Vq_Ref
        ComIPduSignalRef = MCUM_Id_LookUp
        ComIPduSignalRef = MCUM_Iq_LookUp
        ComIPduSignalRef = MCUM_Spd_Delta
        ComIPduSignalRef = MCUM_Us_Out
        ComIPduSignalRef = MCUM_Torque_PwrEst
        ComIPduSignalRef = MCUM_UserDefine_50ms
        ComIPduSignalRef = MCUM_Torque_ExtChar
        ComIPduSignalRef = MCUM_Damp_CompTorque
        ComIPduSignalRef = MCUM_Damp_CompCoeff
        ComIPduSignalRef = MCUM_Damp_State
        ComIPduSignalRef = MCUM_PWM_State
        ComIPduSignalRef = MCUM_JuncTemp_Max
        ComIPduSignalRef = MCUM_JuncLoss_Max
        ComIPduSignalRef = MCUM_CurrAmp_Comp
        ComIPduSignalRef = MCUM_CurrTheta_Comp
        ComIPduSignalRef = MCUM_RawSinCorr
        ComIPduSignalRef = MCUM_RawCosCorr
        ComIPduSignalRef = MCUM_LUT_Spd
        ComIPduSignalRef = MCUM_R_HighVoltPowerOffReq
        ComIPduSignalRef = MCUM_R_MaxTorqueAllow
        ComIPduSignalRef = MCUM_R_MaxSpeedAllow
        ComIPduSignalRef = MCUM_R_MinTorqueAllow
        ComIPduSignalRef = MCUM_R_MotorTemp
        ComIPduSignalRef = MCUM_R_IGBTTemp
        ComIPduSignalRef = MCUM_R_InletTemp
        ComIPduSignalRef = MCUM_R_HeatPwrAllwd
        ComIPduSignalRef = MCUM_R_HeatFdBck
        ComIPduSignalRef = MCUM_R_HeatPwrAct
        ComIPduSignalRef = MCUM_R_HeatPwrMax
        ComIPduSignalRef = MCUM_R_HeatPwrAval
        ComIPduSignalRef = MCUM_R_Vd_Ref
        ComIPduSignalRef = MCUM_R_Vq_Ref
        ComIPduSignalRef = MCUM_R_Id_LookUp
        ComIPduSignalRef = MCUM_R_Iq_LookUp
        ComIPduSignalRef = MCUM_R_Spd_Delta
        ComIPduSignalRef = MCUM_R_Us_Out
        ComIPduSignalRef = MCUM_R_Torque_PwrEst
        ComIPduSignalRef = MCUM_R_UserDefine_50ms
        ComIPduSignalRef = MCUM_R_Torque_ExtChar
        ComIPduSignalRef = MCUM_R_Damp_CompTorque
        ComIPduSignalRef = MCUM_R_Damp_CompCoeff
        ComIPduSignalRef = MCUM_R_Damp_State
        ComIPduSignalRef = MCUM_R_PWM_State
        ComIPduSignalRef = MCUM_R_JuncTemp_Max
        ComIPduSignalRef = MCUM_R_JuncLoss_Max
        ComIPduSignalRef = MCUM_R_CurrAmp_Comp
        ComIPduSignalRef = MCUM_R_CurrTheta_Comp
        ComIPduSignalRef = MCUM_R_RawSinCorr
        ComIPduSignalRef = MCUM_R_RawCosCorr
        ComIPduSignalRef = MCUM_R_LUT_Spd
        ComTxIPdu: ComMinimumDelayTime=0.05, ComTxIPduUnusedAreasDefault=0
          ComTxModeTrue
            ComTxMode: ComTxModeTimePeriod=0.05, ComTxModeMode=PERIODIC, ComTxModeNumberOfRepetitions=0, ComTxModeRepetitionPeriod=0, ComTxModeTimeOffset=0.0
          ComTxModeFalse
            ComTxMode: ComTxModeTimePeriod=0.05, ComTxModeMode=PERIODIC, ComTxModeNumberOfRepetitions=0, ComTxModeRepetitionPeriod=0, ComTxModeTimeOffset=0.0
      52 x ComSignal, all with ComSignalEndianness=LITTLE_ENDIAN, ComUpdateBitPosition=-1, ComTransferProperty=PENDING:
        MCUM_Vd_Ref: ComSignalInitValue=500.0, ComSignalType=UINT16, ComBitSize=10, ComBitPosition=0, ComSystemTemplateSystemSignalRef=MCUM_Vd_Ref
        MCUM_Vq_Ref: ComSignalInitValue=500.0, ComSignalType=UINT16, ComBitSize=10, ComBitPosition=10, ComSystemTemplateSystemSignalRef=MCUM_Vq_Ref
        MCUM_Id_LookUp: ComSignalInitValue=1000.0, ComSignalType=UINT16, ComBitSize=11, ComBitPosition=20, ComSystemTemplateSystemSignalRef=MCUM_Id_LookUp
        MCUM_Iq_LookUp: ComSignalInitValue=1000.0, ComSignalType=UINT16, ComBitSize=11, ComBitPosition=31, ComSystemTemplateSystemSignalRef=MCUM_Iq_LookUp
        MCUM_Spd_Delta: ComSignalInitValue=2000.0, ComSignalType=UINT16, ComBitSize=12, ComBitPosition=42, ComSystemTemplateSystemSignalRef=MCUM_Spd_Delta
        MCUM_Us_Out: ComSignalInitValue=0.0, ComSignalType=UINT16, ComBitSize=11, ComBitPosition=54, ComSystemTemplateSystemSignalRef=MCUM_Us_Out
        MCUM_Torque_PwrEst: ComSignalInitValue=0.0, ComSignalType=UINT8, ComBitSize=7, ComBitPosition=65, ComSystemTemplateSystemSignalRef=MCUM_Torque_PwrEst
        MCUM_UserDefine_50ms: ComSignalInitValue=500.0, ComSignalType=UINT16, ComBitSize=10, ComBitPosition=72, ComSystemTemplateSystemSignalRef=MCUM_UserDefine_50ms
        MCUM_Torque_ExtChar: ComSignalInitValue=0.0, ComSignalType=UINT16, ComBitSize=9, ComBitPosition=82, ComSystemTemplateSystemSignalRef=MCUM_Torque_ExtChar
        MCUM_Damp_CompTorque: ComSignalInitValue=500.0, ComSignalType=UINT16, ComBitSize=10, ComBitPosition=91, ComSystemTemplateSystemSignalRef=MCUM_Damp_CompTorque
        MCUM_Damp_CompCoeff: ComSignalInitValue=0.0, ComSignalType=UINT8, ComBitSize=7, ComBitPosition=101, ComSystemTemplateSystemSignalRef=MCUM_Damp_CompCoeff
        MCUM_Damp_State: ComSignalInitValue=0.0, ComSignalType=BOOLEAN, ComBitSize=1, ComBitPosition=108, ComSystemTemplateSystemSignalRef=MCUM_Damp_State
        MCUM_PWM_State: ComSignalInitValue=0.0, ComSignalType=UINT8, ComBitSize=2, ComBitPosition=109, ComSystemTemplateSystemSignalRef=MCUM_PWM_State
        MCUM_JuncTemp_Max: ComSignalInitValue=0.0, ComSignalType=UINT16, ComBitSize=12, ComBitPosition=111, ComSystemTemplateSystemSignalRef=MCUM_JuncTemp_Max
        MCUM_JuncLoss_Max: ComSignalInitValue=0.0, ComSignalType=UINT16, ComBitSize=13, ComBitPosition=123, ComSystemTemplateSystemSignalRef=MCUM_JuncLoss_Max
        MCUM_CurrAmp_Comp: ComSignalInitValue=100.0, ComSignalType=UINT8, ComBitSize=8, ComBitPosition=136, ComSystemTemplateSystemSignalRef=MCUM_CurrAmp_Comp
        MCUM_CurrTheta_Comp: ComSignalInitValue=250.0, ComSignalType=UINT16, ComBitSize=9, ComBitPosition=144, ComSystemTemplateSystemSignalRef=MCUM_CurrTheta_Comp
        MCUM_RawSinCorr: ComSignalInitValue=2000.0, ComSignalType=UINT16, ComBitSize=12, ComBitPosition=153, ComSystemTemplateSystemSignalRef=MCUM_RawSinCorr
        MCUM_RawCosCorr: ComSignalInitValue=2000.0, ComSignalType=UINT16, ComBitSize=12, ComBitPosition=165, ComSystemTemplateSystemSignalRef=MCUM_RawCosCorr
        MCUM_LUT_Spd: ComSignalInitValue=0.0, ComSignalType=UINT16, ComBitSize=15, ComBitPosition=177, ComSystemTemplateSystemSignalRef=MCUM_LUT_Spd
        MCUM_R_HighVoltPowerOffReq: ComSignalInitValue=0.0, ComSignalType=BOOLEAN, ComBitSize=1, ComBitPosition=192, ComSystemTemplateSystemSignalRef=MCUM_R_HighVoltPowerOffReq
        MCUM_R_MaxTorqueAllow: ComSignalInitValue=55000.0, ComSignalType=UINT16, ComBitSize=16, ComBitPosition=193, ComSystemTemplateSystemSignalRef=MCUM_R_MaxTorqueAllow
        MCUM_R_MaxSpeedAllow: ComSignalInitValue=34000.0, ComSignalType=UINT16, ComBitSize=16, ComBitPosition=209, ComSystemTemplateSystemSignalRef=MCUM_R_MaxSpeedAllow
        MCUM_R_MinTorqueAllow: ComSignalInitValue=55000.0, ComSignalType=UINT16, ComBitSize=16, ComBitPosition=225, ComSystemTemplateSystemSignalRef=MCUM_R_MinTorqueAllow
        MCUM_R_MotorTemp: ComSignalInitValue=100.0, ComSignalType=UINT8, ComBitSize=8, ComBitPosition=241, ComSystemTemplateSystemSignalRef=MCUM_R_MotorTemp
        MCUM_R_IGBTTemp: ComSignalInitValue=100.0, ComSignalType=UINT8, ComBitSize=8, ComBitPosition=249, ComSystemTemplateSystemSignalRef=MCUM_R_IGBTTemp
        MCUM_R_InletTemp: ComSignalInitValue=100.0, ComSignalType=UINT8, ComBitSize=8, ComBitPosition=257, ComSystemTemplateSystemSignalRef=MCUM_R_InletTemp
        MCUM_R_HeatPwrAllwd: ComSignalInitValue=0.0, ComSignalType=BOOLEAN, ComBitSize=1, ComBitPosition=265, ComSystemTemplateSystemSignalRef=MCUM_R_HeatPwrAllwd
        MCUM_R_HeatFdBck: ComSignalInitValue=0.0, ComSignalType=UINT8, ComBitSize=2, ComBitPosition=266, ComSystemTemplateSystemSignalRef=MCUM_R_HeatFdBck
        MCUM_R_HeatPwrAct: ComSignalInitValue=0.0, ComSignalType=UINT8, ComBitSize=8, ComBitPosition=268, ComSystemTemplateSystemSignalRef=MCUM_R_HeatPwrAct
        MCUM_R_HeatPwrMax: ComSignalInitValue=0.0, ComSignalType=UINT8, ComBitSize=8, ComBitPosition=276, ComSystemTemplateSystemSignalRef=MCUM_R_HeatPwrMax
        MCUM_R_HeatPwrAval: ComSignalInitValue=0.0, ComSignalType=UINT8, ComBitSize=5, ComBitPosition=284, ComSystemTemplateSystemSignalRef=MCUM_R_HeatPwrAval
        MCUM_R_Vd_Ref: ComSignalInitValue=500.0, ComSignalType=UINT16, ComBitSize=10, ComBitPosition=289, ComSystemTemplateSystemSignalRef=MCUM_R_Vd_Ref
        MCUM_R_Vq_Ref: ComSignalInitValue=500.0, ComSignalType=UINT16, ComBitSize=10, ComBitPosition=299, ComSystemTemplateSystemSignalRef=MCUM_R_Vq_Ref
        MCUM_R_Id_LookUp: ComSignalInitValue=1000.0, ComSignalType=UINT16, ComBitSize=11, ComBitPosition=309, ComSystemTemplateSystemSignalRef=MCUM_R_Id_LookUp
        MCUM_R_Iq_LookUp: ComSignalInitValue=1000.0, ComSignalType=UINT16, ComBitSize=11, ComBitPosition=320, ComSystemTemplateSystemSignalRef=MCUM_R_Iq_LookUp
        MCUM_R_Spd_Delta: ComSignalInitValue=2000.0, ComSignalType=UINT16, ComBitSize=12, ComBitPosition=331, ComSystemTemplateSystemSignalRef=MCUM_R_Spd_Delta
        MCUM_R_Us_Out: ComSignalInitValue=0.0, ComSignalType=UINT16, ComBitSize=11, ComBitPosition=343, ComSystemTemplateSystemSignalRef=MCUM_R_Us_Out
        MCUM_R_Torque_PwrEst: ComSignalInitValue=500.0, ComSignalType=UINT16, ComBitSize=10, ComBitPosition=354, ComSystemTemplateSystemSignalRef=MCUM_R_Torque_PwrEst
        MCUM_R_UserDefine_50ms: ComSignalInitValue=500.0, ComSignalType=UINT16, ComBitSize=10, ComBitPosition=364, ComSystemTemplateSystemSignalRef=MCUM_R_UserDefine_50ms
        MCUM_R_Torque_ExtChar: ComSignalInitValue=0.0, ComSignalType=UINT16, ComBitSize=9, ComBitPosition=374, ComSystemTemplateSystemSignalRef=MCUM_R_Torque_ExtChar
        MCUM_R_Damp_CompTorque: ComSignalInitValue=500.0, ComSignalType=UINT16, ComBitSize=10, ComBitPosition=383, ComSystemTemplateSystemSignalRef=MCUM_R_Damp_CompTorque
        MCUM_R_Damp_CompCoeff: ComSignalInitValue=0.0, ComSignalType=UINT8, ComBitSize=7, ComBitPosition=393, ComSystemTemplateSystemSignalRef=MCUM_R_Damp_CompCoeff
        MCUM_R_Damp_State: ComSignalInitValue=0.0, ComSignalType=BOOLEAN, ComBitSize=1, ComBitPosition=400, ComSystemTemplateSystemSignalRef=MCUM_R_Damp_State
        MCUM_R_PWM_State: ComSignalInitValue=0.0, ComSignalType=UINT8, ComBitSize=2, ComBitPosition=401, ComSystemTemplateSystemSignalRef=MCUM_R_PWM_State
        MCUM_R_JuncTemp_Max: ComSignalInitValue=0.0, ComSignalType=UINT16, ComBitSize=12, ComBitPosition=403, ComSystemTemplateSystemSignalRef=MCUM_R_JuncTemp_Max
        MCUM_R_JuncLoss_Max: ComSignalInitValue=0.0, ComSignalType=UINT16, ComBitSize=13, ComBitPosition=415, ComSystemTemplateSystemSignalRef=MCUM_R_JuncLoss_Max
        MCUM_R_CurrAmp_Comp: ComSignalInitValue=100.0, ComSignalType=UINT8, ComBitSize=8, ComBitPosition=428, ComSystemTemplateSystemSignalRef=MCUM_R_CurrAmp_Comp
        MCUM_R_CurrTheta_Comp: ComSignalInitValue=250.0, ComSignalType=UINT16, ComBitSize=9, ComBitPosition=436, ComSystemTemplateSystemSignalRef=MCUM_R_CurrTheta_Comp
        MCUM_R_RawSinCorr: ComSignalInitValue=2000.0, ComSignalType=UINT16, ComBitSize=12, ComBitPosition=445, ComSystemTemplateSystemSignalRef=MCUM_R_RawSinCorr
        MCUM_R_RawCosCorr: ComSignalInitValue=2000.0, ComSignalType=UINT16, ComBitSize=12, ComBitPosition=457, ComSystemTemplateSystemSignalRef=MCUM_R_RawCosCorr
        MCUM_R_LUT_Spd: ComSignalInitValue=0.0, ComSignalType=UINT16, ComBitSize=15, ComBitPosition=469, ComSystemTemplateSystemSignalRef=MCUM_R_LUT_Spd
      MCUM_0x5D2_P_CANFD (ComIPdu):
        ComIPduSignalProcessing = IMMEDIATE
        ComIPduType = NORMAL
        ComIPduDirection = SEND
        ComFirstTimeout = 0.2
        ComTimeout = 0.2
        ComIPduGroupRef = ComIPduGroup_Tx
        ComPduIdRef = PduCollection/MCUM_0x5D2_P_CANFD_Com2PduR
        ComIPduSignalRef = MCUM_R_StatorTemp_1
        ComIPduSignalRef = MCUM_R_L2TqAct
        ComIPduSignalRef = MCUM_R_EOPSw
        ComIPduSignalRef = MCUM_R_StatorTemp_2
        ComIPduSignalRef = MCUM_R_IGBTTemp_U
        ComIPduSignalRef = MCUM_R_IGBTTemp_V
        ComIPduSignalRef = MCUM_R_IGBTTemp_W
        ComIPduSignalRef = MCUM_R_Power_15V
        ComIPduSignalRef = MCUM_R_Offset_IU
        ComIPduSignalRef = MCUM_R_Offset_IV
        ComIPduSignalRef = MCUM_R_Offset_IW
        ComIPduSignalRef = MCUM_R_MainSt_State
        ComIPduSignalRef = MCUM_R_Derate_Reason
        ComIPduSignalRef = MCUM_R_PWM_Freq_kHz
        ComIPduSignalRef = MCUM_R_PWMEn_State
        ComIPduSignalRef = MCUM_R_DrvPwrEn_Out_State
        ComIPduSignalRef = MCUM_R_NVM_RslvrZeroRFault
        ComIPduSignalRef = MCUM_R_Rotor_Position
        ComIPduSignalRef = MCUM_R_PosTransduserFaultCode
        ComIPduSignalRef = MCUM_R_NVM_RslvrDirRFault
        ComIPduSignalRef = MCUM_R_NVM_RslvrDelayRFault
        ComIPduSignalRef = MCUM_R_NVM_RslvrParamRFault
        ComIPduSignalRef = MCUM_R_NVM_HallGainRFault
        ComIPduSignalRef = MCUM_R_NVM_HallDelayRFault
        ComIPduSignalRef = MCUM_R_NVM_IGBTTypeRFault
        ComIPduSignalRef = MCUM_R_ASC_EntryCount
        ComIPduSignalRef = MCUM_R_Spd_Turn
        ComIPduSignalRef = MCUM_R_LUT_Spd_Max
        ComIPduSignalRef = MCUM_R_EOP_Speed
        ComIPduSignalRef = MCUM_R_EOP_IqFb
        ComIPduSignalRef = MCUM_R_EOP_IqRef
        ComIPduSignalRef = MCUM_R_EOP_DCVolt
        ComIPduSignalRef = MCUM_R_EOP_DCCurr
        ComIPduSignalRef = MCUM_R_EOP_Temp
        ComIPduSignalRef = MCUM_R_EOP_State
        ComIPduSignalRef = MCUM_R_EOP_FaultCode
        ComIPduSignalRef = MCUM_R_HWFault_RstCnt
        ComIPduSignalRef = MCUM_R_HWFoB_RstCnt
        ComIPduSignalRef = MCUM_R_HWFoT_RstCnt
        ComIPduSignalRef = MCUM_R_HWDrvUV_RstCnt
        ComIPduSignalRef = MCUM_R_HWRdc_RstCnt
        ComIPduSignalRef = MCUM_R_HWOC_RstCnt
        ComIPduSignalRef = MCUM_R_HWOV_RstCnt
        ComIPduSignalRef = MCUM_R_L2agRtrElecDiff
        ComIPduSignalRef = MCUM_R_500usOverTime_Cnt
        ComIPduSignalRef = MCUM_R_5msOverTime_Cnt
        ComIPduSignalRef = MCUM_R_CpldRest_TimeOut_flag
        ComIPduSignalRef = MCUM_R_DrvPCBCurr
        ComIPduSignalRef = MCUM_R_EOL_StateMachine
        ComIPduSignalRef = MCUM_R_CpldRest_ASC_Flag
        ComIPduSignalRef = MCUM_R_LimSpdTorFlag
        ComIPduSignalRef = MCUM_R_PWM_Err_Count
        ComIPduSignalRef = MCUM_R_RDC_Reset_Count
        ComIPduSignalRef = MCUM_R_ASC_Stop_Flag
        ComIPduSignalRef = MCUM_R_ASC_Soft_Exiting_Flag
        ComIPduSignalRef = MCUM_R_Vbus_ServeLowChkEn
        ComIPduSignalRef = MCUM_R_EOP_BlockErr_IsLim_Flag
        ComIPduSignalRef = MCUM_R_IdqErrCount
        ComIPduSignalRef = MCUM_R_MotSelfHeat_EnSts
        ComIPduSignalRef = MCUM_R_MotBlockHeat_LvlFb
        ComIPduSignalRef = MCUM_R_MotRotaryHeat_LvlFb
        ComIPduSignalRef = MCUM_R_MotSelfHeat_DropLvlFb
        ComIPduSignalRef = MCUM_R_MotSelfHeat_DropLvlRsn
        ComIPduSignalRef = MCUM_R_MotBlockHeat_CurAngle
        ComIPduSignalRef = MCUM_R_MotBlockHeat_CurMag
        ComIPduSignalRef = MCUM_R_UserDefine_Byte{1..4}
        ComIPduSignalRef = MCUM_R_UserDefine_Word{1..3}
        ComTxIPdu: ComMinimumDelayTime=0.0, ComTxIPduUnusedAreasDefault=0
          ComTxModeTrue
            ComTxMode: ComTxModeTimePeriod=0.2, ComTxModeMode=PERIODIC, ComTxModeNumberOfRepetitions=0, ComTxModeRepetitionPeriod=0, ComTxModeTimeOffset=0.0
          ComTxModeFalse
            ComTxMode: ComTxModeTimePeriod=0.2, ComTxModeMode=PERIODIC, ComTxModeNumberOfRepetitions=0, ComTxModeRepetitionPeriod=0, ComTxModeTimeOffset=0.0
      72 x ComSignal, all with ComSignalEndianness=LITTLE_ENDIAN, ComUpdateBitPosition=-1, ComTransferProperty=PENDING:
        MCUM_R_StatorTemp_1: ComSignalInitValue=50.0, ComSignalType=UINT8, ComBitSize=8, ComBitPosition=0, ComSystemTemplateSystemSignalRef=MCUM_R_StatorTemp_1
        MCUM_R_L2TqAct: ComSignalInitValue=50.0, ComSignalType=UINT16, ComBitSize=10, ComBitPosition=306, ComSystemTemplateSystemSignalRef=MCUM_R_L2TqAct
        MCUM_R_EOPSw: ComSignalInitValue=50.0, ComSignalType=UINT32, ComBitSize=17, ComBitPosition=426, ComSystemTemplateSystemSignalRef=MCUM_R_EOPSw
        MCUM_R_StatorTemp_2: ComSignalInitValue=50.0, ComSignalType=UINT8, ComBitSize=8, ComBitPosition=8, ComSystemTemplateSystemSignalRef=MCUM_R_StatorTemp_2
        MCUM_R_IGBTTemp_U: ComSignalInitValue=50.0, ComSignalType=UINT8, ComBitSize=8, ComBitPosition=16, ComSystemTemplateSystemSignalRef=MCUM_R_IGBTTemp_U
        MCUM_R_IGBTTemp_V: ComSignalInitValue=50.0, ComSignalType=UINT8, ComBitSize=8, ComBitPosition=24, ComSystemTemplateSystemSignalRef=MCUM_R_IGBTTemp_V
        MCUM_R_IGBTTemp_W: ComSignalInitValue=50.0, ComSignalType=UINT8, ComBitSize=8, ComBitPosition=32, ComSystemTemplateSystemSignalRef=MCUM_R_IGBTTemp_W
        MCUM_R_Power_15V: ComSignalInitValue=0.0, ComSignalType=UINT8, ComBitSize=8, ComBitPosition=40, ComSystemTemplateSystemSignalRef=MCUM_R_Power_15V
        MCUM_R_Offset_IU: ComSignalInitValue=0.0, ComSignalType=UINT16, ComBitSize=13, ComBitPosition=48, ComSystemTemplateSystemSignalRef=MCUM_R_Offset_IU
        MCUM_R_Offset_IV: ComSignalInitValue=0.0, ComSignalType=UINT16, ComBitSize=13, ComBitPosition=61, ComSystemTemplateSystemSignalRef=MCUM_R_Offset_IV
        MCUM_R_Offset_IW: ComSignalInitValue=0.0, ComSignalType=UINT16, ComBitSize=13, ComBitPosition=74, ComSystemTemplateSystemSignalRef=MCUM_R_Offset_IW
        MCUM_R_MainSt_State: ComSignalInitValue=0.0, ComSignalType=UINT8, ComBitSize=4, ComBitPosition=87, ComSystemTemplateSystemSignalRef=MCUM_R_MainSt_State
        MCUM_R_Derate_Reason: ComSignalInitValue=0.0, ComSignalType=UINT8, ComBitSize=4, ComBitPosition=91, ComSystemTemplateSystemSignalRef=MCUM_R_Derate_Reason
        MCUM_R_PWM_Freq_kHz: ComSignalInitValue=0.0, ComSignalType=UINT8, ComBitSize=8, ComBitPosition=95, ComSystemTemplateSystemSignalRef=MCUM_R_PWM_Freq_kHz
        MCUM_R_PWMEn_State: ComSignalInitValue=0.0, ComSignalType=BOOLEAN, ComBitSize=1, ComBitPosition=103, ComSystemTemplateSystemSignalRef=MCUM_R_PWMEn_State
        MCUM_R_DrvPwrEn_Out_State: ComSignalInitValue=0.0, ComSignalType=BOOLEAN, ComBitSize=1, ComBitPosition=104, ComSystemTemplateSystemSignalRef=MCUM_R_DrvPwrEn_Out_State
        MCUM_R_NVM_RslvrZeroRFault: ComSignalInitValue=0.0, ComSignalType=BOOLEAN, ComBitSize=1, ComBitPosition=105, ComSystemTemplateSystemSignalRef=MCUM_R_NVM_RslvrZeroRFault
        MCUM_R_Rotor_Position: ComSignalInitValue=0.0, ComSignalType=UINT16, ComBitSize=13, ComBitPosition=106, ComSystemTemplateSystemSignalRef=MCUM_R_Rotor_Position
        MCUM_R_PosTransduserFaultCode: ComSignalInitValue=0.0, ComSignalType=UINT8, ComBitSize=8, ComBitPosition=119, ComSystemTemplateSystemSignalRef=MCUM_R_PosTransduserFaultCode
        MCUM_R_NVM_RslvrDirRFault: ComSignalInitValue=0.0, ComSignalType=BOOLEAN, ComBitSize=1, ComBitPosition=127, ComSystemTemplateSystemSignalRef=MCUM_R_NVM_RslvrDirRFault
        MCUM_R_NVM_RslvrDelayRFault: ComSignalInitValue=0.0, ComSignalType=BOOLEAN, ComBitSize=1, ComBitPosition=128, ComSystemTemplateSystemSignalRef=MCUM_R_NVM_RslvrDelayRFault
        MCUM_R_NVM_RslvrParamRFault: ComSignalInitValue=0.0, ComSignalType=BOOLEAN, ComBitSize=1, ComBitPosition=129, ComSystemTemplateSystemSignalRef=MCUM_R_NVM_RslvrParamRFault
        MCUM_R_NVM_HallGainRFault: ComSignalInitValue=0.0, ComSignalType=BOOLEAN, ComBitSize=1, ComBitPosition=130, ComSystemTemplateSystemSignalRef=MCUM_R_NVM_HallGainRFault
        MCUM_R_NVM_HallDelayRFault: ComSignalInitValue=0.0, ComSignalType=BOOLEAN, ComBitSize=1, ComBitPosition=131, ComSystemTemplateSystemSignalRef=MCUM_R_NVM_HallDelayRFault
        MCUM_R_NVM_IGBTTypeRFault: ComSignalInitValue=0.0, ComSignalType=BOOLEAN, ComBitSize=1, ComBitPosition=132, ComSystemTemplateSystemSignalRef=MCUM_R_NVM_IGBTTypeRFault
        MCUM_R_ASC_EntryCount: ComSignalInitValue=0.0, ComSignalType=UINT8, ComBitSize=5, ComBitPosition=133, ComSystemTemplateSystemSignalRef=MCUM_R_ASC_EntryCount
        MCUM_R_Spd_Turn: ComSignalInitValue=0.0, ComSignalType=UINT16, ComBitSize=15, ComBitPosition=138, ComSystemTemplateSystemSignalRef=MCUM_R_Spd_Turn
        MCUM_R_LUT_Spd_Max: ComSignalInitValue=0.0, ComSignalType=UINT16, ComBitSize=15, ComBitPosition=153, ComSystemTemplateSystemSignalRef=MCUM_R_LUT_Spd_Max
        MCUM_R_EOP_Speed: ComSignalInitValue=4095.5631399317404, ComSignalType=UINT16, ComBitSize=13, ComBitPosition=168, ComSystemTemplateSystemSignalRef=MCUM_R_EOP_Speed
        MCUM_R_EOP_IqFb: ComSignalInitValue=0.0, ComSignalType=UINT16, ComBitSize=9, ComBitPosition=181, ComSystemTemplateSystemSignalRef=MCUM_R_EOP_IqFb
        MCUM_R_EOP_IqRef: ComSignalInitValue=0.0, ComSignalType=UINT16, ComBitSize=9, ComBitPosition=190, ComSystemTemplateSystemSignalRef=MCUM_R_EOP_IqRef
        MCUM_R_EOP_DCVolt: ComSignalInitValue=0.0, ComSignalType=UINT16, ComBitSize=9, ComBitPosition=199, ComSystemTemplateSystemSignalRef=MCUM_R_EOP_DCVolt
        MCUM_R_EOP_DCCurr: ComSignalInitValue=0.0, ComSignalType=UINT16, ComBitSize=9, ComBitPosition=208, ComSystemTemplateSystemSignalRef=MCUM_R_EOP_DCCurr
        MCUM_R_EOP_Temp: ComSignalInitValue=50.0, ComSignalType=UINT8, ComBitSize=8, ComBitPosition=217, ComSystemTemplateSystemSignalRef=MCUM_R_EOP_Temp
        MCUM_R_EOP_State: ComSignalInitValue=0.0, ComSignalType=UINT8, ComBitSize=4, ComBitPosition=225, ComSystemTemplateSystemSignalRef=MCUM_R_EOP_State
        MCUM_R_EOP_FaultCode: ComSignalInitValue=0.0, ComSignalType=UINT8, ComBitSize=3, ComBitPosition=229, ComSystemTemplateSystemSignalRef=MCUM_R_EOP_FaultCode
        MCUM_R_HWFault_RstCnt: ComSignalInitValue=0.0, ComSignalType=UINT8, ComBitSize=4, ComBitPosition=232, ComSystemTemplateSystemSignalRef=MCUM_R_HWFault_RstCnt
        MCUM_R_HWFoB_RstCnt: ComSignalInitValue=0.0, ComSignalType=UINT8, ComBitSize=4, ComBitPosition=236, ComSystemTemplateSystemSignalRef=MCUM_R_HWFoB_RstCnt
        MCUM_R_HWFoT_RstCnt: ComSignalInitValue=0.0, ComSignalType=UINT8, ComBitSize=4, ComBitPosition=240, ComSystemTemplateSystemSignalRef=MCUM_R_HWFoT_RstCnt
        MCUM_R_HWDrvUV_RstCnt: ComSignalInitValue=0.0, ComSignalType=UINT8, ComBitSize=4, ComBitPosition=244, ComSystemTemplateSystemSignalRef=MCUM_R_HWDrvUV_RstCnt
        MCUM_R_HWRdc_RstCnt: ComSignalInitValue=0.0, ComSignalType=UINT8, ComBitSize=4, ComBitPosition=248, ComSystemTemplateSystemSignalRef=MCUM_R_HWRdc_RstCnt
        MCUM_R_HWOC_RstCnt: ComSignalInitValue=0.0, ComSignalType=UINT8, ComBitSize=4, ComBitPosition=252, ComSystemTemplateSystemSignalRef=MCUM_R_HWOC_RstCnt
        MCUM_R_HWOV_RstCnt: ComSignalInitValue=0.0, ComSignalType=UINT8, ComBitSize=4, ComBitPosition=256, ComSystemTemplateSystemSignalRef=MCUM_R_HWOV_RstCnt
        MCUM_R_L2agRtrElecDiff: ComSignalInitValue=0.0, ComSignalType=UINT8, ComBitSize=4, ComBitPosition=260, ComSystemTemplateSystemSignalRef=MCUM_R_L2agRtrElecDiff
        MCUM_R_500usOverTime_Cnt: ComSignalInitValue=0.0, ComSignalType=UINT8, ComBitSize=4, ComBitPosition=264, ComSystemTemplateSystemSignalRef=MCUM_R_500usOverTime_Cnt
        MCUM_R_5msOverTime_Cnt: ComSignalInitValue=0.0, ComSignalType=UINT8, ComBitSize=4, ComBitPosition=268, ComSystemTemplateSystemSignalRef=MCUM_R_5msOverTime_Cnt
        MCUM_R_CpldRest_TimeOut_flag: ComSignalInitValue=0.0, ComSignalType=UINT8, ComBitSize=2, ComBitPosition=272, ComSystemTemplateSystemSignalRef=MCUM_R_CpldRest_TimeOut_flag
        MCUM_R_DrvPCBCurr: ComSignalInitValue=0.0, ComSignalType=UINT8, ComBitSize=5, ComBitPosition=274, ComSystemTemplateSystemSignalRef=MCUM_R_DrvPCBCurr
        MCUM_R_EOL_StateMachine: ComSignalInitValue=0.0, ComSignalType=UINT8, ComBitSize=8, ComBitPosition=279, ComSystemTemplateSystemSignalRef=MCUM_R_EOL_StateMachine
        MCUM_R_CpldRest_ASC_Flag: ComSignalInitValue=0.0, ComSignalType=BOOLEAN, ComBitSize=1, ComBitPosition=287, ComSystemTemplateSystemSignalRef=MCUM_R_CpldRest_ASC_Flag
        MCUM_R_LimSpdTorFlag: ComSignalInitValue=0.0, ComSignalType=BOOLEAN, ComBitSize=1, ComBitPosition=288, ComSystemTemplateSystemSignalRef=MCUM_R_LimSpdTorFlag
        MCUM_R_PWM_Err_Count: ComSignalInitValue=0.0, ComSignalType=UINT8, ComBitSize=5, ComBitPosition=289, ComSystemTemplateSystemSignalRef=MCUM_R_PWM_Err_Count
        MCUM_R_RDC_Reset_Count: ComSignalInitValue=0.0, ComSignalType=UINT8, ComBitSize=8, ComBitPosition=294, ComSystemTemplateSystemSignalRef=MCUM_R_RDC_Reset_Count
        MCUM_R_ASC_Stop_Flag: ComSignalInitValue=0.0, ComSignalType=BOOLEAN, ComBitSize=1, ComBitPosition=302, ComSystemTemplateSystemSignalRef=MCUM_R_ASC_Stop_Flag
        MCUM_R_ASC_Soft_Exiting_Flag: ComSignalInitValue=0.0, ComSignalType=BOOLEAN, ComBitSize=1, ComBitPosition=303, ComSystemTemplateSystemSignalRef=MCUM_R_ASC_Soft_Exiting_Flag
        MCUM_R_Vbus_ServeLowChkEn: ComSignalInitValue=0.0, ComSignalType=BOOLEAN, ComBitSize=1, ComBitPosition=304, ComSystemTemplateSystemSignalRef=MCUM_R_Vbus_ServeLowChkEn
        MCUM_R_EOP_BlockErr_IsLim_Flag: ComSignalInitValue=0.0, ComSignalType=BOOLEAN, ComBitSize=1, ComBitPosition=305, ComSystemTemplateSystemSignalRef=MCUM_R_EOP_BlockErr_IsLim_Flag
        MCUM_R_IdqErrCount: ComSignalInitValue=0.0, ComSignalType=UINT16, ComBitSize=11, ComBitPosition=306, ComSystemTemplateSystemSignalRef=MCUM_R_IdqErrCount
        MCUM_R_MotSelfHeat_EnSts: ComSignalInitValue=0.0, ComSignalType=UINT8, ComBitSize=2, ComBitPosition=317, ComSystemTemplateSystemSignalRef=MCUM_R_MotSelfHeat_EnSts
        MCUM_R_MotBlockHeat_LvlFb: ComSignalInitValue=0.0, ComSignalType=UINT8, ComBitSize=3, ComBitPosition=319, ComSystemTemplateSystemSignalRef=MCUM_R_MotBlockHeat_LvlFb
        MCUM_R_MotRotaryHeat_LvlFb: ComSignalInitValue=0.0, ComSignalType=UINT8, ComBitSize=3, ComBitPosition=322, ComSystemTemplateSystemSignalRef=MCUM_R_MotRotaryHeat_LvlFb
        MCUM_R_MotSelfHeat_DropLvlFb: ComSignalInitValue=0.0, ComSignalType=BOOLEAN, ComBitSize=1, ComBitPosition=325, ComSystemTemplateSystemSignalRef=MCUM_R_MotSelfHeat_DropLvlFb
        MCUM_R_MotSelfHeat_DropLvlRsn: ComSignalInitValue=0.0, ComSignalType=UINT8, ComBitSize=2, ComBitPosition=326, ComSystemTemplateSystemSignalRef=MCUM_R_MotSelfHeat_DropLvlRsn
        MCUM_R_MotBlockHeat_CurAngle: ComSignalInitValue=0.0, ComSignalType=UINT16, ComBitSize=9, ComBitPosition=328, ComSystemTemplateSystemSignalRef=MCUM_R_MotBlockHeat_CurAngle
        MCUM_R_MotBlockHeat_CurMag: ComSignalInitValue=0.0, ComSignalType=UINT16, ComBitSize=9, ComBitPosition=337, ComSystemTemplateSystemSignalRef=MCUM_R_MotBlockHeat_CurMag
        MCUM_R_UserDefine_Byte1: ComSignalInitValue=0.0, ComSignalType=UINT8, ComBitSize=8, ComBitPosition=346, ComSystemTemplateSystemSignalRef=MCUM_R_UserDefine_Byte1
        MCUM_R_UserDefine_Byte2: ComSignalInitValue=0.0, ComSignalType=UINT8, ComBitSize=8, ComBitPosition=354, ComSystemTemplateSystemSignalRef=MCUM_R_UserDefine_Byte2
        MCUM_R_UserDefine_Byte3: ComSignalInitValue=0.0, ComSignalType=UINT8, ComBitSize=8, ComBitPosition=362, ComSystemTemplateSystemSignalRef=MCUM_R_UserDefine_Byte3
        MCUM_R_UserDefine_Byte4: ComSignalInitValue=0.0, ComSignalType=UINT8, ComBitSize=8, ComBitPosition=370, ComSystemTemplateSystemSignalRef=MCUM_R_UserDefine_Byte4
        MCUM_R_UserDefine_Word1: ComSignalInitValue=0.0, ComSignalType=UINT16, ComBitSize=16, ComBitPosition=378, ComSystemTemplateSystemSignalRef=MCUM_R_UserDefine_Word1
        MCUM_R_UserDefine_Word2: ComSignalInitValue=0.0, ComSignalType=UINT16, ComBitSize=16, ComBitPosition=394, ComSystemTemplateSystemSignalRef=MCUM_R_UserDefine_Word2
        MCUM_R_UserDefine_Word3: ComSignalInitValue=0.0, ComSignalType=UINT16, ComBitSize=16, ComBitPosition=410, ComSystemTemplateSystemSignalRef=MCUM_R_UserDefine_Word3
      VCU_0x515_P_CANFD (ComIPdu):
        ComIPduSignalProcessing = IMMEDIATE
        ComIPduType = NORMAL
        ComIPduDirection = SEND
        ComFirstTimeout = 0.2
        ComTimeout = 0.2
        ComIPduGroupRef = ComIPduGroup_Tx
        ComPduIdRef = PduCollection/VCU_0x515_P_CANFD_Com2PduR
        ComIPduSignalRef = VCU_Pending_DTC
        ComIPduSignalRef = VCU_Comfirmed_DTC
        ComIPduSignalRef = VCU_Permanent_DTC
        ComIPduSignalRef = VCU_MilReq_DTC
        ComTxIPdu: ComMinimumDelayTime=0.0, ComTxIPduUnusedAreasDefault=0
          ComTxModeTrue
            ComTxMode: ComTxModeTimePeriod=0.2, ComTxModeMode=PERIODIC, ComTxModeNumberOfRepetitions=0, ComTxModeRepetitionPeriod=0, ComTxModeTimeOffset=0.0
          ComTxModeFalse
            ComTxMode: ComTxModeTimePeriod=0.2, ComTxModeMode=PERIODIC, ComTxModeNumberOfRepetitions=0, ComTxModeRepetitionPeriod=0, ComTxModeTimeOffset=0.0
      4 x ComSignal, all with ComSignalInitValue=0, ComSignalType=UINT8, ComSignalEndianness=LITTLE_ENDIAN, ComBitSize=8, ComUpdateBitPosition=-1, ComTransferProperty=PENDING:
        VCU_Pending_DTC: ComBitPosition=0, ComSystemTemplateSystemSignalRef=VCU_Pending_DTC
        VCU_Comfirmed_DTC: ComBitPosition=8, ComSystemTemplateSystemSignalRef=VCU_Comfirmed_DTC
        VCU_Permanent_DTC: ComBitPosition=16, ComSystemTemplateSystemSignalRef=VCU_Permanent_DTC
        VCU_MilReq_DTC: ComBitPosition=24, ComSystemTemplateSystemSignalRef=VCU_MilReq_DTC
      MCUM_0xCA_P_CANFD (ComIPdu):
        ComIPduSignalProcessing = IMMEDIATE
        ComIPduType = NORMAL
        ComIPduDirection = SEND
        ComIPduCallout = ComCallOut_MCUM_0xCA_P_CANFD
        ComIPduGroupRef = ComIPduGroup_Tx
        ComPduIdRef = PduCollection/MCUM_0xCA_P_CANFD_Com2PduR
        ComIPduSignalRef = MCUM_CRC_CA
        ComIPduSignalRef = MCUM_RollingCounter_CA
        ComIPduSignalRef = MCUM_WarningLevel
        ComIPduSignalRef = MCUM_SelfCheckSts
        ComIPduSignalRef = MCUM_DrvMotorWorkSts
        ComIPduSignalRef = MCUM_PowerReduceSts
        ComIPduSignalRef = MCUM_SystemError
        ComIPduSignalRef = MCUM_DrvMotorRPM
        ComIPduSignalRef = MCUM_ActualTorqueFB
        ComIPduSignalRef = MCUM_HWRdcFault
        ComIPduSignalRef = MCUM_LVSystemError
        ComIPduSignalRef = MCUM_HighVoltPowerOffReq
        ComIPduSignalRef = MCUM_HVILSts
        ComIPduSignalRef = MCUM_DragSts
        ComIPduSignalRef = MCUM_CtrlMode
        ComIPduSignalRef = MCUM_MotorTempAlarm
        ComIPduSignalRef = MCUM_HVSystemError
        ComIPduSignalRef = MCUM_MILlampReq
        ComIPduSignalRef = MCUM_SeriousWarning_Level
        ComIPduSignalRef = MCUM_DrvMotorRPMVD
        ComIPduSignalRef = MCUM_ActualTorqueFBVD
        ComIPduSignalRef = MCUM_CtrlModeVD
        ComIPduSignalRef = MCUM_MaxTorqueAllow
        ComIPduSignalRef = MCUM_MaxSpeedAllow
        ComIPduSignalRef = MCUM_WaterPumpLevlReq
        ComIPduSignalRef = MCUM_ActiveReleaseSts
        ComIPduSignalRef = MCUM_DCChargRelaySts
        ComIPduSignalRef = MCUM_Fault_DCChargRelay
        ComIPduSignalRef = MCUM_MinTorqueAllow
        ComIPduSignalRef = MCUM_MainWireVolt
        ComIPduSignalRef = MCUM_MotorTemp
        ComIPduSignalRef = MCUM_IGBTTemp
        ComIPduSignalRef = MCUM_InletTemp
        ComIPduSignalRef = MCUM_MainWireCurr
        ComIPduSignalRef = MCUM_TMS_MotSelfHeatEnSts
        ComIPduSignalRef = MCUM_TMS_MotSelfHeatLvlFb
        ComIPduSignalRef = MCUM_HeatPwrAllwd
        ComIPduSignalRef = MCUM_HeatFdBck
        ComIPduSignalRef = MCUM_RPowerReduceSts
        ComIPduSignalRef = MCUM_HeatPwrAct
        ComIPduSignalRef = MCUM_HeatPwrMax
        ComIPduSignalRef = MCUM_HeatPwrAval
        ComIPduSignalRef = MCUM_RCtrlMode
        ComIPduSignalRef = MCUM_RWarningLevel
        ComIPduSignalRef = MCUM_RSelfCheckSts
        ComIPduSignalRef = MCUM_RDrvMotorWorkSts
        ComIPduSignalRef = MCUM_RCtrlModeVD
        ComIPduSignalRef = MCUM_RHWRdcFault
        ComIPduSignalRef = MCUM_RDrvMotorRPMVD
        ComIPduSignalRef = MCUM_RActualTorqueFBVD
        ComIPduSignalRef = MCUM_RDrvMotorRPM
        ComIPduSignalRef = MCUM_RActualTorqueFB
        ComTxIPdu: ComMinimumDelayTime=0.0, ComTxIPduUnusedAreasDefault=0
          ComTxModeTrue
            ComTxMode: ComTxModeTimePeriod=0.01, ComTxModeMode=PERIODIC, ComTxModeNumberOfRepetitions=0, ComTxModeRepetitionPeriod=0, ComTxModeTimeOffset=0.0
          ComTxModeFalse
            ComTxMode: ComTxModeTimePeriod=0.01, ComTxModeMode=PERIODIC, ComTxModeNumberOfRepetitions=0, ComTxModeRepetitionPeriod=0, ComTxModeTimeOffset=0.0
      52 x ComSignal, all with ComSignalInitValue=0, ComSignalEndianness=LITTLE_ENDIAN, ComUpdateBitPosition=-1, ComTransferProperty=PENDING:
        MCUM_CRC_CA: ComSignalType=UINT8, ComBitSize=8, ComBitPosition=0, ComSystemTemplateSystemSignalRef=MCUM_CRC_CA
        MCUM_RollingCounter_CA: ComSignalType=UINT8, ComBitSize=4, ComBitPosition=8, ComSystemTemplateSystemSignalRef=MCUM_RollingCounter_CA
        MCUM_WarningLevel: ComSignalType=UINT8, ComBitSize=2, ComBitPosition=16, ComSystemTemplateSystemSignalRef=MCUM_WarningLevel
        MCUM_SelfCheckSts: ComSignalType=UINT8, ComBitSize=2, ComBitPosition=18, ComSystemTemplateSystemSignalRef=MCUM_SelfCheckSts
        MCUM_DrvMotorWorkSts: ComSignalType=UINT8, ComBitSize=2, ComBitPosition=20, ComSystemTemplateSystemSignalRef=MCUM_DrvMotorWorkSts
        MCUM_PowerReduceSts: ComSignalType=BOOLEAN, ComBitSize=1, ComBitPosition=22, ComSystemTemplateSystemSignalRef=MCUM_PowerReduceSts
        MCUM_SystemError: ComSignalType=BOOLEAN, ComBitSize=1, ComBitPosition=23, ComSystemTemplateSystemSignalRef=MCUM_SystemError
        MCUM_DrvMotorRPM: ComSignalType=UINT16, ComBitSize=16, ComBitPosition=24, ComSystemTemplateSystemSignalRef=MCUM_DrvMotorRPM
        MCUM_ActualTorqueFB: ComSignalType=UINT16, ComBitSize=16, ComBitPosition=40, ComSystemTemplateSystemSignalRef=MCUM_ActualTorqueFB
        MCUM_HWRdcFault: ComSignalType=BOOLEAN, ComBitSize=1, ComBitPosition=56, ComSystemTemplateSystemSignalRef=MCUM_HWRdcFault
        MCUM_LVSystemError: ComSignalType=BOOLEAN, ComBitSize=1, ComBitPosition=57, ComSystemTemplateSystemSignalRef=MCUM_LVSystemError
        MCUM_HighVoltPowerOffReq: ComSignalType=BOOLEAN, ComBitSize=1, ComBitPosition=58, ComSystemTemplateSystemSignalRef=MCUM_HighVoltPowerOffReq
        MCUM_HVILSts: ComSignalType=BOOLEAN, ComBitSize=1, ComBitPosition=59, ComSystemTemplateSystemSignalRef=MCUM_HVILSts
        MCUM_DragSts: ComSignalType=UINT8, ComBitSize=2, ComBitPosition=60, ComSystemTemplateSystemSignalRef=MCUM_DragSts
        MCUM_CtrlMode: ComSignalType=BOOLEAN, ComBitSize=1, ComBitPosition=62, ComSystemTemplateSystemSignalRef=MCUM_CtrlMode
        MCUM_MotorTempAlarm: ComSignalType=BOOLEAN, ComBitSize=1, ComBitPosition=63, ComSystemTemplateSystemSignalRef=MCUM_MotorTempAlarm
        MCUM_HVSystemError: ComSignalType=BOOLEAN, ComBitSize=1, ComBitPosition=64, ComSystemTemplateSystemSignalRef=MCUM_HVSystemError
        MCUM_MILlampReq: ComSignalType=BOOLEAN, ComBitSize=1, ComBitPosition=65, ComSystemTemplateSystemSignalRef=MCUM_MILlampReq
        MCUM_SeriousWarning_Level: ComSignalType=UINT8, ComBitSize=2, ComBitPosition=66, ComSystemTemplateSystemSignalRef=MCUM_SeriousWarning_Level
        MCUM_DrvMotorRPMVD: ComSignalType=BOOLEAN, ComBitSize=1, ComBitPosition=68, ComSystemTemplateSystemSignalRef=MCUM_DrvMotorRPMVD
        MCUM_ActualTorqueFBVD: ComSignalType=BOOLEAN, ComBitSize=1, ComBitPosition=69, ComSystemTemplateSystemSignalRef=MCUM_ActualTorqueFBVD
        MCUM_CtrlModeVD: ComSignalType=BOOLEAN, ComBitSize=1, ComBitPosition=70, ComSystemTemplateSystemSignalRef=MCUM_CtrlModeVD
        MCUM_MaxTorqueAllow: ComSignalType=UINT16, ComBitSize=16, ComBitPosition=72, ComSystemTemplateSystemSignalRef=MCUM_MaxTorqueAllow
        MCUM_MaxSpeedAllow: ComSignalType=UINT16, ComBitSize=16, ComBitPosition=88, ComSystemTemplateSystemSignalRef=MCUM_MaxSpeedAllow
        MCUM_WaterPumpLevlReq: ComSignalType=UINT8, ComBitSize=4, ComBitPosition=104, ComSystemTemplateSystemSignalRef=MCUM_WaterPumpLevlReq
        MCUM_ActiveReleaseSts: ComSignalType=UINT8, ComBitSize=2, ComBitPosition=108, ComSystemTemplateSystemSignalRef=MCUM_ActiveReleaseSts
        MCUM_DCChargRelaySts: ComSignalType=BOOLEAN, ComBitSize=1, ComBitPosition=110, ComSystemTemplateSystemSignalRef=MCUM_DCChargRelaySts
        MCUM_Fault_DCChargRelay: ComSignalType=BOOLEAN, ComBitSize=1, ComBitPosition=111, ComSystemTemplateSystemSignalRef=MCUM_Fault_DCChargRelay
        MCUM_MinTorqueAllow: ComSignalType=UINT16, ComBitSize=16, ComBitPosition=112, ComSystemTemplateSystemSignalRef=MCUM_MinTorqueAllow
        MCUM_MainWireVolt: ComSignalType=UINT16, ComBitSize=16, ComBitPosition=128, ComSystemTemplateSystemSignalRef=MCUM_MainWireVolt
        MCUM_MotorTemp: ComSignalType=UINT8, ComBitSize=8, ComBitPosition=144, ComSystemTemplateSystemSignalRef=MCUM_MotorTemp
        MCUM_IGBTTemp: ComSignalType=UINT8, ComBitSize=8, ComBitPosition=152, ComSystemTemplateSystemSignalRef=MCUM_IGBTTemp
        MCUM_InletTemp: ComSignalType=UINT8, ComBitSize=8, ComBitPosition=160, ComSystemTemplateSystemSignalRef=MCUM_InletTemp
        MCUM_MainWireCurr: ComSignalType=UINT16, ComBitSize=16, ComBitPosition=168, ComSystemTemplateSystemSignalRef=MCUM_MainWireCurr
        MCUM_TMS_MotSelfHeatEnSts: ComSignalType=BOOLEAN, ComBitSize=1, ComBitPosition=184, ComSystemTemplateSystemSignalRef=MCUM_TMS_MotSelfHeatEnSts
        MCUM_TMS_MotSelfHeatLvlFb: ComSignalType=UINT8, ComBitSize=3, ComBitPosition=185, ComSystemTemplateSystemSignalRef=MCUM_TMS_MotSelfHeatLvlFb
        MCUM_HeatPwrAllwd: ComSignalType=BOOLEAN, ComBitSize=1, ComBitPosition=188, ComSystemTemplateSystemSignalRef=MCUM_HeatPwrAllwd
        MCUM_HeatFdBck: ComSignalType=UINT8, ComBitSize=2, ComBitPosition=189, ComSystemTemplateSystemSignalRef=MCUM_HeatFdBck
        MCUM_RPowerReduceSts: ComSignalType=UINT8, ComBitSize=1, ComBitPosition=191, ComSystemTemplateSystemSignalRef=MCUM_RPowerReduceSts
        MCUM_HeatPwrAct: ComSignalType=UINT8, ComBitSize=8, ComBitPosition=192, ComSystemTemplateSystemSignalRef=MCUM_HeatPwrAct
        MCUM_HeatPwrMax: ComSignalType=UINT8, ComBitSize=8, ComBitPosition=200, ComSystemTemplateSystemSignalRef=MCUM_HeatPwrMax
        MCUM_HeatPwrAval: ComSignalType=UINT8, ComBitSize=5, ComBitPosition=208, ComSystemTemplateSystemSignalRef=MCUM_HeatPwrAval
        MCUM_RCtrlMode: ComSignalType=UINT8, ComBitSize=1, ComBitPosition=213, ComSystemTemplateSystemSignalRef=MCUM_RCtrlMode
        MCUM_RWarningLevel: ComSignalType=UINT8, ComBitSize=2, ComBitPosition=214, ComSystemTemplateSystemSignalRef=MCUM_RWarningLevel
        MCUM_RSelfCheckSts: ComSignalType=UINT8, ComBitSize=2, ComBitPosition=216, ComSystemTemplateSystemSignalRef=MCUM_RSelfCheckSts
        MCUM_RDrvMotorWorkSts: ComSignalType=UINT8, ComBitSize=2, ComBitPosition=218, ComSystemTemplateSystemSignalRef=MCUM_RDrvMotorWorkSts
        MCUM_RCtrlModeVD: ComSignalType=UINT8, ComBitSize=1, ComBitPosition=220, ComSystemTemplateSystemSignalRef=MCUM_RCtrlModeVD
        MCUM_RHWRdcFault: ComSignalType=UINT8, ComBitSize=1, ComBitPosition=221, ComSystemTemplateSystemSignalRef=MCUM_RHWRdcFault
        MCUM_RDrvMotorRPMVD: ComSignalType=UINT8, ComBitSize=1, ComBitPosition=222, ComSystemTemplateSystemSignalRef=MCUM_RDrvMotorRPMVD
        MCUM_RActualTorqueFBVD: ComSignalType=UINT8, ComBitSize=1, ComBitPosition=223, ComSystemTemplateSystemSignalRef=MCUM_RActualTorqueFBVD
        MCUM_RDrvMotorRPM: ComSignalType=UINT16, ComBitSize=16, ComBitPosition=224, ComSystemTemplateSystemSignalRef=MCUM_RDrvMotorRPM
        MCUM_RActualTorqueFB: ComSignalType=UINT16, ComBitSize=16, ComBitPosition=240, ComSystemTemplateSystemSignalRef=MCUM_RActualTorqueFB
      MCUM_0x6F8_P_CANFD (ComIPdu):
        ComIPduSignalProcessing = IMMEDIATE
        ComIPduType = NORMAL
        ComIPduDirection = SEND
        ComFirstTimeout = 1.0
        ComTimeout = 1.0
        ComIPduGroupRef = ComIPduGroup_Tx
        ComPduIdRef = PduCollection/MCUM_0x6F8_P_CANFD_Com2PduR
        ComIPduSignalRef = MCUM_UDS_SW{1..10}
        ComIPduSignalRef = MCUM_UDS_HW{1..10}
        ComIPduSignalRef = MCUM_UDS_Boot{1..10}
        ComIPduSignalRef = MCUM_UDS_ProductModel{1..16}
        ComIPduSignalRef = MCUM_UDS_Supplier{1..6}
        ComTxIPdu: ComMinimumDelayTime=0.0, ComTxIPduUnusedAreasDefault=0
          ComTxModeTrue
            ComTxMode: ComTxModeTimePeriod=1.0, ComTxModeMode=PERIODIC, ComTxModeNumberOfRepetitions=0, ComTxModeRepetitionPeriod=0, ComTxModeTimeOffset=0.0
          ComTxModeFalse
            ComTxMode: ComTxModeTimePeriod=1.0, ComTxModeMode=PERIODIC, ComTxModeNumberOfRepetitions=0, ComTxModeRepetitionPeriod=0, ComTxModeTimeOffset=0.0
      52 x ComSignal, all with ComSignalInitValue=0, ComSignalType=UINT8, ComSignalEndianness=LITTLE_ENDIAN, ComBitSize=8, ComUpdateBitPosition=-1, ComTransferProperty=PENDING:
        MCUM_UDS_SW1: ComBitPosition=0, ComSystemTemplateSystemSignalRef=MCUM_UDS_SW1
        MCUM_UDS_SW2: ComBitPosition=8, ComSystemTemplateSystemSignalRef=MCUM_UDS_SW2
        MCUM_UDS_SW3: ComBitPosition=16, ComSystemTemplateSystemSignalRef=MCUM_UDS_SW3
        MCUM_UDS_SW4: ComBitPosition=24, ComSystemTemplateSystemSignalRef=MCUM_UDS_SW4
        MCUM_UDS_SW5: ComBitPosition=32, ComSystemTemplateSystemSignalRef=MCUM_UDS_SW5
        MCUM_UDS_SW6: ComBitPosition=40, ComSystemTemplateSystemSignalRef=MCUM_UDS_SW6
        MCUM_UDS_SW7: ComBitPosition=48, ComSystemTemplateSystemSignalRef=MCUM_UDS_SW7
        MCUM_UDS_SW8: ComBitPosition=56, ComSystemTemplateSystemSignalRef=MCUM_UDS_SW8
        MCUM_UDS_SW9: ComBitPosition=64, ComSystemTemplateSystemSignalRef=MCUM_UDS_SW9
        MCUM_UDS_SW10: ComBitPosition=72, ComSystemTemplateSystemSignalRef=MCUM_UDS_SW10
        MCUM_UDS_HW1: ComBitPosition=80, ComSystemTemplateSystemSignalRef=MCUM_UDS_HW1
        MCUM_UDS_HW2: ComBitPosition=88, ComSystemTemplateSystemSignalRef=MCUM_UDS_HW2
        MCUM_UDS_HW3: ComBitPosition=96, ComSystemTemplateSystemSignalRef=MCUM_UDS_HW3
        MCUM_UDS_HW4: ComBitPosition=104, ComSystemTemplateSystemSignalRef=MCUM_UDS_HW4
        MCUM_UDS_HW5: ComBitPosition=112, ComSystemTemplateSystemSignalRef=MCUM_UDS_HW5
        MCUM_UDS_HW6: ComBitPosition=120, ComSystemTemplateSystemSignalRef=MCUM_UDS_HW6
        MCUM_UDS_HW7: ComBitPosition=128, ComSystemTemplateSystemSignalRef=MCUM_UDS_HW7
        MCUM_UDS_HW8: ComBitPosition=136, ComSystemTemplateSystemSignalRef=MCUM_UDS_HW8
        MCUM_UDS_HW9: ComBitPosition=144, ComSystemTemplateSystemSignalRef=MCUM_UDS_HW9
        MCUM_UDS_HW10: ComBitPosition=152, ComSystemTemplateSystemSignalRef=MCUM_UDS_HW10
        MCUM_UDS_Boot1: ComBitPosition=160, ComSystemTemplateSystemSignalRef=MCUM_UDS_Boot1
        MCUM_UDS_Boot2: ComBitPosition=168, ComSystemTemplateSystemSignalRef=MCUM_UDS_Boot2
        MCUM_UDS_Boot3: ComBitPosition=176, ComSystemTemplateSystemSignalRef=MCUM_UDS_Boot3
        MCUM_UDS_Boot4: ComBitPosition=184, ComSystemTemplateSystemSignalRef=MCUM_UDS_Boot4
        MCUM_UDS_Boot5: ComBitPosition=192, ComSystemTemplateSystemSignalRef=MCUM_UDS_Boot5
        MCUM_UDS_Boot6: ComBitPosition=200, ComSystemTemplateSystemSignalRef=MCUM_UDS_Boot6
        MCUM_UDS_Boot7: ComBitPosition=208, ComSystemTemplateSystemSignalRef=MCUM_UDS_Boot7
        MCUM_UDS_Boot8: ComBitPosition=216, ComSystemTemplateSystemSignalRef=MCUM_UDS_Boot8
        MCUM_UDS_Boot9: ComBitPosition=224, ComSystemTemplateSystemSignalRef=MCUM_UDS_Boot9
        MCUM_UDS_Boot10: ComBitPosition=232, ComSystemTemplateSystemSignalRef=MCUM_UDS_Boot10
        MCUM_UDS_ProductModel1: ComBitPosition=240, ComSystemTemplateSystemSignalRef=MCUM_UDS_ProductModel1
        MCUM_UDS_ProductModel2: ComBitPosition=248, ComSystemTemplateSystemSignalRef=MCUM_UDS_ProductModel2
        MCUM_UDS_ProductModel3: ComBitPosition=256, ComSystemTemplateSystemSignalRef=MCUM_UDS_ProductModel3
        MCUM_UDS_ProductModel4: ComBitPosition=264, ComSystemTemplateSystemSignalRef=MCUM_UDS_ProductModel4
        MCUM_UDS_ProductModel5: ComBitPosition=272, ComSystemTemplateSystemSignalRef=MCUM_UDS_ProductModel5
        MCUM_UDS_ProductModel6: ComBitPosition=280, ComSystemTemplateSystemSignalRef=MCUM_UDS_ProductModel6
        MCUM_UDS_ProductModel7: ComBitPosition=288, ComSystemTemplateSystemSignalRef=MCUM_UDS_ProductModel7
        MCUM_UDS_ProductModel8: ComBitPosition=296, ComSystemTemplateSystemSignalRef=MCUM_UDS_ProductModel8
        MCUM_UDS_ProductModel9: ComBitPosition=304, ComSystemTemplateSystemSignalRef=MCUM_UDS_ProductModel9
        MCUM_UDS_ProductModel10: ComBitPosition=312, ComSystemTemplateSystemSignalRef=MCUM_UDS_ProductModel10
        MCUM_UDS_ProductModel11: ComBitPosition=320, ComSystemTemplateSystemSignalRef=MCUM_UDS_ProductModel11
        MCUM_UDS_ProductModel12: ComBitPosition=328, ComSystemTemplateSystemSignalRef=MCUM_UDS_ProductModel12
        MCUM_UDS_ProductModel13: ComBitPosition=336, ComSystemTemplateSystemSignalRef=MCUM_UDS_ProductModel13
        MCUM_UDS_ProductModel14: ComBitPosition=344, ComSystemTemplateSystemSignalRef=MCUM_UDS_ProductModel14
        MCUM_UDS_ProductModel15: ComBitPosition=352, ComSystemTemplateSystemSignalRef=MCUM_UDS_ProductModel15
        MCUM_UDS_ProductModel16: ComBitPosition=360, ComSystemTemplateSystemSignalRef=MCUM_UDS_ProductModel16
        MCUM_UDS_Supplier1: ComBitPosition=368, ComSystemTemplateSystemSignalRef=MCUM_UDS_Supplier1
        MCUM_UDS_Supplier2: ComBitPosition=376, ComSystemTemplateSystemSignalRef=MCUM_UDS_Supplier2
        MCUM_UDS_Supplier3: ComBitPosition=384, ComSystemTemplateSystemSignalRef=MCUM_UDS_Supplier3
        MCUM_UDS_Supplier4: ComBitPosition=392, ComSystemTemplateSystemSignalRef=MCUM_UDS_Supplier4
        MCUM_UDS_Supplier5: ComBitPosition=400, ComSystemTemplateSystemSignalRef=MCUM_UDS_Supplier5
        MCUM_UDS_Supplier6: ComBitPosition=408, ComSystemTemplateSystemSignalRef=MCUM_UDS_Supplier6
      VCU_0x514_P_CANFD (ComIPdu):
        ComIPduSignalProcessing = IMMEDIATE
        ComIPduType = NORMAL
        ComIPduDirection = SEND
        ComFirstTimeout = 0.1
        ComTimeout = 0.1
        ComIPduGroupRef = ComIPduGroup_Tx
        ComPduIdRef = PduCollection/VCU_0x514_P_CANFD_Com2PduR
        ComIPduSignalRef = VCU_FuelConsumption
        ComIPduSignalRef = VCU_SVSLamp
        ComIPduSignalRef = VCU_MilLamp
        ComIPduSignalRef = VCU_SinglePedalSts_ID514
        ComIPduSignalRef = VCU_GearLevelPosFault_ID514
        ComIPduSignalRef = VCU_EngineStartFailure_ID514
        ComIPduSignalRef = VCU_ParkBeforeFuelup
        ComIPduSignalRef = VCU_REsystemFaultSts_ID514
        ComIPduSignalRef = VCU_EngineRunAllowFlg_ID514
        ComIPduSignalRef = VCU_InverterTip
        ComIPduSignalRef = VCU_EMSRepairModeSts
        ComIPduSignalRef = VCU_FuelTankFlapSts
        ComIPduSignalRef = VCU_REsystemSts_ID514
        ComIPduSignalRef = VCU_PowerModeAllow
        ComIPduSignalRef = VCU_PowerModeSwitchMsg
        ComIPduSignalRef = VCU_HighVoltFailed_M
        ComIPduSignalRef = VCU_HighVoltFailed_S
        ComIPduSignalRef = VCU_BrakeBeforeGear
        ComIPduSignalRef = VCU_ParkBeforeGear
        ComIPduSignalRef = VCU_GearBeforDriving
        ComIPduSignalRef = VCU_UnlockBeforeDriving
        ComIPduSignalRef = VCU_PreventSliding
        ComIPduSignalRef = VCU_MMErrorSts
        ComIPduSignalRef = VCU_ShowCarModeSts
        ComIPduSignalRef = VCU_PGearFlashSts
        ComIPduSignalRef = VCU_ACConnectSts
        ComIPduSignalRef = VCU_DcChgPwrSts
        ComIPduSignalRef = VCU_DriverAssistProhibitSts_ID514
        ComIPduSignalRef = VCU_MilLampRequest_ID514
        ComIPduSignalRef = VCU_CcmHvilInSigFreq_FB
        ComIPduSignalRef = VCU_CcmHvilInSigDuty_FB
        ComIPduSignalRef = VCU_FuelDectionModeSts
        ComIPduSignalRef = VCU_EnergyCtrlMode
        ComIPduSignalRef = VCU_VehSpdLimtRemind_ID514
        ComIPduSignalRef = VCU_TurtleLamp
        ComIPduSignalRef = VCU_EngLongTimeStartReq
        ComTxIPdu: ComMinimumDelayTime=0.0, ComTxIPduUnusedAreasDefault=0
          ComTxModeTrue
            ComTxMode: ComTxModeTimePeriod=0.1, ComTxModeMode=PERIODIC, ComTxModeNumberOfRepetitions=0, ComTxModeRepetitionPeriod=0, ComTxModeTimeOffset=0.0
          ComTxModeFalse
            ComTxMode: ComTxModeTimePeriod=0.1, ComTxModeMode=PERIODIC, ComTxModeNumberOfRepetitions=0, ComTxModeRepetitionPeriod=0, ComTxModeTimeOffset=0.0
      36 x ComSignal, all with ComSignalInitValue=0, ComSignalEndianness=LITTLE_ENDIAN, ComUpdateBitPosition=-1, ComTransferProperty=PENDING:
        VCU_FuelConsumption: ComSignalType=UINT8, ComBitSize=8, ComBitPosition=0, ComSystemTemplateSystemSignalRef=VCU_FuelConsumption
        VCU_SVSLamp: ComSignalType=BOOLEAN, ComBitSize=1, ComBitPosition=8, ComSystemTemplateSystemSignalRef=VCU_SVSLamp
        VCU_MilLamp: ComSignalType=BOOLEAN, ComBitSize=1, ComBitPosition=9, ComSystemTemplateSystemSignalRef=VCU_MilLamp
        VCU_SinglePedalSts_ID514: ComSignalType=BOOLEAN, ComBitSize=1, ComBitPosition=10, ComSystemTemplateSystemSignalRef=VCU_SinglePedalSts_ID514
        VCU_GearLevelPosFault_ID514: ComSignalType=BOOLEAN, ComBitSize=1, ComBitPosition=11, ComSystemTemplateSystemSignalRef=VCU_GearLevelPosFault_ID514
        VCU_EngineStartFailure_ID514: ComSignalType=BOOLEAN, ComBitSize=1, ComBitPosition=12, ComSystemTemplateSystemSignalRef=VCU_EngineStartFailure_ID514
        VCU_ParkBeforeFuelup: ComSignalType=BOOLEAN, ComBitSize=1, ComBitPosition=13, ComSystemTemplateSystemSignalRef=VCU_ParkBeforeFuelup
        VCU_REsystemFaultSts_ID514: ComSignalType=BOOLEAN, ComBitSize=1, ComBitPosition=14, ComSystemTemplateSystemSignalRef=VCU_REsystemFaultSts_ID514
        VCU_EngineRunAllowFlg_ID514: ComSignalType=BOOLEAN, ComBitSize=1, ComBitPosition=15, ComSystemTemplateSystemSignalRef=VCU_EngineRunAllowFlg_ID514
        VCU_InverterTip: ComSignalType=UINT8, ComBitSize=3, ComBitPosition=16, ComSystemTemplateSystemSignalRef=VCU_InverterTip
        VCU_EMSRepairModeSts: ComSignalType=UINT8, ComBitSize=2, ComBitPosition=19, ComSystemTemplateSystemSignalRef=VCU_EMSRepairModeSts
        VCU_FuelTankFlapSts: ComSignalType=BOOLEAN, ComBitSize=1, ComBitPosition=21, ComSystemTemplateSystemSignalRef=VCU_FuelTankFlapSts
        VCU_REsystemSts_ID514: ComSignalType=BOOLEAN, ComBitSize=1, ComBitPosition=22, ComSystemTemplateSystemSignalRef=VCU_REsystemSts_ID514
        VCU_PowerModeAllow: ComSignalType=UINT8, ComBitSize=2, ComBitPosition=23, ComSystemTemplateSystemSignalRef=VCU_PowerModeAllow
        VCU_PowerModeSwitchMsg: ComSignalType=BOOLEAN, ComBitSize=1, ComBitPosition=25, ComSystemTemplateSystemSignalRef=VCU_PowerModeSwitchMsg
        VCU_HighVoltFailed_M: ComSignalType=BOOLEAN, ComBitSize=1, ComBitPosition=26, ComSystemTemplateSystemSignalRef=VCU_HighVoltFailed_M
        VCU_HighVoltFailed_S: ComSignalType=BOOLEAN, ComBitSize=1, ComBitPosition=27, ComSystemTemplateSystemSignalRef=VCU_HighVoltFailed_S
        VCU_BrakeBeforeGear: ComSignalType=BOOLEAN, ComBitSize=1, ComBitPosition=28, ComSystemTemplateSystemSignalRef=VCU_BrakeBeforeGear
        VCU_ParkBeforeGear: ComSignalType=BOOLEAN, ComBitSize=1, ComBitPosition=29, ComSystemTemplateSystemSignalRef=VCU_ParkBeforeGear
        VCU_GearBeforDriving: ComSignalType=BOOLEAN, ComBitSize=1, ComBitPosition=30, ComSystemTemplateSystemSignalRef=VCU_GearBeforDriving
        VCU_UnlockBeforeDriving: ComSignalType=BOOLEAN, ComBitSize=1, ComBitPosition=31, ComSystemTemplateSystemSignalRef=VCU_UnlockBeforeDriving
        VCU_PreventSliding: ComSignalType=BOOLEAN, ComBitSize=1, ComBitPosition=32, ComSystemTemplateSystemSignalRef=VCU_PreventSliding
        VCU_MMErrorSts: ComSignalType=BOOLEAN, ComBitSize=1, ComBitPosition=33, ComSystemTemplateSystemSignalRef=VCU_MMErrorSts
        VCU_ShowCarModeSts: ComSignalType=BOOLEAN, ComBitSize=1, ComBitPosition=34, ComSystemTemplateSystemSignalRef=VCU_ShowCarModeSts
        VCU_PGearFlashSts: ComSignalType=BOOLEAN, ComBitSize=1, ComBitPosition=35, ComSystemTemplateSystemSignalRef=VCU_PGearFlashSts
        VCU_ACConnectSts: ComSignalType=BOOLEAN, ComBitSize=1, ComBitPosition=36, ComSystemTemplateSystemSignalRef=VCU_ACConnectSts
        VCU_DcChgPwrSts: ComSignalType=BOOLEAN, ComBitSize=1, ComBitPosition=37, ComSystemTemplateSystemSignalRef=VCU_DcChgPwrSts
        VCU_DriverAssistProhibitSts_ID514: ComSignalType=BOOLEAN, ComBitSize=1, ComBitPosition=38, ComSystemTemplateSystemSignalRef=VCU_DriverAssistProhibitSts_ID514
        VCU_MilLampRequest_ID514: ComSignalType=BOOLEAN, ComBitSize=1, ComBitPosition=39, ComSystemTemplateSystemSignalRef=VCU_MilLampRequest_ID514
        VCU_CcmHvilInSigFreq_FB: ComSignalType=UINT8, ComBitSize=8, ComBitPosition=40, ComSystemTemplateSystemSignalRef=VCU_CcmHvilInSigFreq_FB
        VCU_CcmHvilInSigDuty_FB: ComSignalType=UINT8, ComBitSize=8, ComBitPosition=48, ComSystemTemplateSystemSignalRef=VCU_CcmHvilInSigDuty_FB
        VCU_FuelDectionModeSts: ComSignalType=UINT8, ComBitSize=2, ComBitPosition=56, ComSystemTemplateSystemSignalRef=VCU_FuelDectionModeSts
        VCU_EnergyCtrlMode: ComSignalType=BOOLEAN, ComBitSize=1, ComBitPosition=58, ComSystemTemplateSystemSignalRef=VCU_EnergyCtrlMode
        VCU_VehSpdLimtRemind_ID514: ComSignalType=BOOLEAN, ComBitSize=1, ComBitPosition=59, ComSystemTemplateSystemSignalRef=VCU_VehSpdLimtRemind_ID514
        VCU_TurtleLamp: ComSignalType=BOOLEAN, ComBitSize=1, ComBitPosition=60, ComSystemTemplateSystemSignalRef=VCU_TurtleLamp
        VCU_EngLongTimeStartReq: ComSignalType=BOOLEAN, ComBitSize=1, ComBitPosition=61, ComSystemTemplateSystemSignalRef=VCU_EngLongTimeStartReq
      MCUM_0x605_P_CANFD (ComIPdu):
        ComIPduSignalProcessing = IMMEDIATE
        ComIPduType = NORMAL
        ComIPduDirection = SEND
        ComFirstTimeout = 0.2
        ComTimeout = 0.2
        ComIPduGroupRef = ComIPduGroup_Tx
        ComPduIdRef = PduCollection/MCUM_0x605_P_CANFD_Com2PduR
        ComIPduSignalRef = MCUM_FaultData{0..14}
        ComTxIPdu: ComMinimumDelayTime=0.0, ComTxIPduUnusedAreasDefault=0
          ComTxModeTrue
            ComTxMode: ComTxModeTimePeriod=0.2, ComTxModeMode=PERIODIC, ComTxModeNumberOfRepetitions=0, ComTxModeRepetitionPeriod=0, ComTxModeTimeOffset=0.0
          ComTxModeFalse
            ComTxMode: ComTxModeTimePeriod=0.2, ComTxModeMode=PERIODIC, ComTxModeNumberOfRepetitions=0, ComTxModeRepetitionPeriod=0, ComTxModeTimeOffset=0.0
      15 x ComSignal, all with ComSignalInitValue=0, ComSignalEndianness=LITTLE_ENDIAN, ComUpdateBitPosition=-1, ComTransferProperty=PENDING:
        MCUM_FaultData0: ComSignalType=UINT8, ComBitSize=8, ComBitPosition=0, ComSystemTemplateSystemSignalRef=MCUM_FaultData0
        MCUM_FaultData1: ComSignalType=UINT8, ComBitSize=8, ComBitPosition=8, ComSystemTemplateSystemSignalRef=MCUM_FaultData1
        MCUM_FaultData2: ComSignalType=UINT8, ComBitSize=8, ComBitPosition=16, ComSystemTemplateSystemSignalRef=MCUM_FaultData2
        MCUM_FaultData3: ComSignalType=UINT8, ComBitSize=8, ComBitPosition=24, ComSystemTemplateSystemSignalRef=MCUM_FaultData3
        MCUM_FaultData4: ComSignalType=UINT8, ComBitSize=8, ComBitPosition=32, ComSystemTemplateSystemSignalRef=MCUM_FaultData4
        MCUM_FaultData5: ComSignalType=UINT8, ComBitSize=8, ComBitPosition=40, ComSystemTemplateSystemSignalRef=MCUM_FaultData5
        MCUM_FaultData6: ComSignalType=UINT8, ComBitSize=8, ComBitPosition=48, ComSystemTemplateSystemSignalRef=MCUM_FaultData6
        MCUM_FaultData7: ComSignalType=UINT8, ComBitSize=8, ComBitPosition=56, ComSystemTemplateSystemSignalRef=MCUM_FaultData7
        MCUM_FaultData8: ComSignalType=UINT64, ComBitSize=64, ComBitPosition=64, ComSystemTemplateSystemSignalRef=MCUM_FaultData8
        MCUM_FaultData9: ComSignalType=UINT64, ComBitSize=64, ComBitPosition=128, ComSystemTemplateSystemSignalRef=MCUM_FaultData9
        MCUM_FaultData10: ComSignalType=UINT64, ComBitSize=64, ComBitPosition=192, ComSystemTemplateSystemSignalRef=MCUM_FaultData10
        MCUM_FaultData11: ComSignalType=UINT64, ComBitSize=64, ComBitPosition=256, ComSystemTemplateSystemSignalRef=MCUM_FaultData11
        MCUM_FaultData12: ComSignalType=UINT64, ComBitSize=64, ComBitPosition=320, ComSystemTemplateSystemSignalRef=MCUM_FaultData12
        MCUM_FaultData13: ComSignalType=UINT64, ComBitSize=64, ComBitPosition=384, ComSystemTemplateSystemSignalRef=MCUM_FaultData13
        MCUM_FaultData14: ComSignalType=UINT64, ComBitSize=64, ComBitPosition=448, ComSystemTemplateSystemSignalRef=MCUM_FaultData14
      MCUM_0x607_P_CANFD (ComIPdu):
        ComIPduSignalProcessing = IMMEDIATE
        ComIPduType = NORMAL
        ComIPduDirection = SEND
        ComFirstTimeout = 0.2
        ComTimeout = 0.2
        ComIPduGroupRef = ComIPduGroup_Tx
        ComPduIdRef = PduCollection/MCUM_0x607_P_CANFD_Com2PduR
        ComIPduSignalRef = MCUM_R_FaultData{0..14}
        ComTxIPdu: ComMinimumDelayTime=0.0, ComTxIPduUnusedAreasDefault=0
          ComTxModeTrue
            ComTxMode: ComTxModeTimePeriod=0.2, ComTxModeMode=PERIODIC, ComTxModeNumberOfRepetitions=0, ComTxModeRepetitionPeriod=0, ComTxModeTimeOffset=0.0
          ComTxModeFalse
            ComTxMode: ComTxModeTimePeriod=0.2, ComTxModeMode=PERIODIC, ComTxModeNumberOfRepetitions=0, ComTxModeRepetitionPeriod=0, ComTxModeTimeOffset=0.0
      15 x ComSignal, all with ComSignalInitValue=0, ComSignalEndianness=LITTLE_ENDIAN, ComUpdateBitPosition=-1, ComTransferProperty=PENDING:
        MCUM_R_FaultData0: ComSignalType=UINT8, ComBitSize=8, ComBitPosition=0, ComSystemTemplateSystemSignalRef=MCUM_R_FaultData0
        MCUM_R_FaultData1: ComSignalType=UINT8, ComBitSize=8, ComBitPosition=8, ComSystemTemplateSystemSignalRef=MCUM_R_FaultData1
        MCUM_R_FaultData2: ComSignalType=UINT8, ComBitSize=8, ComBitPosition=16, ComSystemTemplateSystemSignalRef=MCUM_R_FaultData2
        MCUM_R_FaultData3: ComSignalType=UINT8, ComBitSize=8, ComBitPosition=24, ComSystemTemplateSystemSignalRef=MCUM_R_FaultData3
        MCUM_R_FaultData4: ComSignalType=UINT8, ComBitSize=8, ComBitPosition=32, ComSystemTemplateSystemSignalRef=MCUM_R_FaultData4
        MCUM_R_FaultData5: ComSignalType=UINT8, ComBitSize=8, ComBitPosition=40, ComSystemTemplateSystemSignalRef=MCUM_R_FaultData5
        MCUM_R_FaultData6: ComSignalType=UINT8, ComBitSize=8, ComBitPosition=48, ComSystemTemplateSystemSignalRef=MCUM_R_FaultData6
        MCUM_R_FaultData7: ComSignalType=UINT8, ComBitSize=8, ComBitPosition=56, ComSystemTemplateSystemSignalRef=MCUM_R_FaultData7
        MCUM_R_FaultData8: ComSignalType=UINT64, ComBitSize=64, ComBitPosition=64, ComSystemTemplateSystemSignalRef=MCUM_R_FaultData8
        MCUM_R_FaultData9: ComSignalType=UINT64, ComBitSize=64, ComBitPosition=128, ComSystemTemplateSystemSignalRef=MCUM_R_FaultData9
        MCUM_R_FaultData10: ComSignalType=UINT64, ComBitSize=64, ComBitPosition=192, ComSystemTemplateSystemSignalRef=MCUM_R_FaultData10
        MCUM_R_FaultData11: ComSignalType=UINT64, ComBitSize=64, ComBitPosition=256, ComSystemTemplateSystemSignalRef=MCUM_R_FaultData11
        MCUM_R_FaultData12: ComSignalType=UINT64, ComBitSize=64, ComBitPosition=320, ComSystemTemplateSystemSignalRef=MCUM_R_FaultData12
        MCUM_R_FaultData13: ComSignalType=UINT64, ComBitSize=64, ComBitPosition=384, ComSystemTemplateSystemSignalRef=MCUM_R_FaultData13
        MCUM_R_FaultData14: ComSignalType=UINT64, ComBitSize=64, ComBitPosition=448, ComSystemTemplateSystemSignalRef=MCUM_R_FaultData14
      IBC_0x186_C_CANFD (ComIPdu):
        ComIPduSignalProcessing = IMMEDIATE
        ComIPduType = NORMAL
        ComIPduDirection = RECEIVE
        ComIPduCallout = ComCallOut_IBC_0x186_C_CANFD
        ComIPduErrorNotification = ComCbk_RxTimeOut_IBC_0x186_C_CANFD
        ComFirstTimeout = 2.1
        ComTimeout = 0.1
        ComIPduGroupRef = ComIPduGroup_Rx
        ComPduIdRef = PduCollection/IBC_0x186_C_CANFD_PduR2Com
        ComIPduSignalRef = IBC_CRC_186
        ComIPduSignalRef = IBC_RollingCounter_186
        ComIPduSignalRef = IBC_WheelCylinderPressure_FL
        ComIPduSignalRef = IBC_WheelCylinderPressure_FR
        ComIPduSignalRef = IBC_WheelCylinderPressure_RL
        ComIPduSignalRef = IBC_WheelCylinderPressure_RR
        ComIPduSignalRef = IBC_WheelSlipFLVD
        ComIPduSignalRef = IBC_WheelSlipFRVD
        ComIPduSignalRef = IBC_WheelSlipRLVD
        ComIPduSignalRef = IBC_WheelSlipRRVD
        ComIPduSignalRef = IBC_WheelSlipFL
        ComIPduSignalRef = IBC_WheelSlipFR
        ComIPduSignalRef = IBC_WheelSlipRL
        ComIPduSignalRef = IBC_WheelSlipRR
        ComIPduSignalRef = IBC_Slop_Pencent
        ComIPduSignalRef = IBC_WheelPressureReliabilityFL
        ComIPduSignalRef = IBC_WheelPressureReliabilityFR
        ComIPduSignalRef = IBC_WheelPressureReliabilityRL
        ComIPduSignalRef = IBC_WheelPressureReliabilityRR
      15 x ComSignal, all with ComSignalInitValue=0, ComSignalEndianness=LITTLE_ENDIAN, ComUpdateBitPosition=-1, ComTransferProperty=TRIGGERED:
        IBC_CRC_186: ComSignalType=UINT8, ComBitSize=8, ComBitPosition=0, ComNotification=Rte_COMCbk_IBC_CRC_186, ComSystemTemplateSystemSignalRef=IBC_CRC_186
        IBC_RollingCounter_186: ComSignalType=UINT8, ComBitSize=4, ComBitPosition=8, ComNotification=Rte_COMCbk_IBC_RollingCounter_186, ComSystemTemplateSystemSignalRef=IBC_RollingCounter_186
        IBC_WheelCylinderPressure_FL: ComSignalType=UINT16, ComBitSize=11, ComBitPosition=192, ComNotification=Rte_COMCbk_IBC_WheelCylinderPressure_FL, ComSystemTemplateSystemSignalRef=IBC_WheelCylinderPressure_FL
        IBC_WheelCylinderPressure_FR: ComSignalType=UINT16, ComBitSize=11, ComBitPosition=208, ComNotification=Rte_COMCbk_IBC_WheelCylinderPressure_FR, ComSystemTemplateSystemSignalRef=IBC_WheelCylinderPressure_FR
        IBC_WheelCylinderPressure_RL: ComSignalType=UINT16, ComBitSize=11, ComBitPosition=224, ComNotification=Rte_COMCbk_IBC_WheelCylinderPressure_RL, ComSystemTemplateSystemSignalRef=IBC_WheelCylinderPressure_RL
        IBC_WheelCylinderPressure_RR: ComSignalType=UINT16, ComBitSize=11, ComBitPosition=240, ComNotification=Rte_COMCbk_IBC_WheelCylinderPressure_RR, ComSystemTemplateSystemSignalRef=IBC_WheelCylinderPressure_RR
        IBC_WheelSlipFLVD: ComSignalType=BOOLEAN, ComBitSize=1, ComBitPosition=76, ComNotification=Rte_COMCbk_IBC_WheelSlipFLVD, ComSystemTemplateSystemSignalRef=IBC_WheelSlipFLVD
        IBC_WheelSlipFRVD: ComSignalType=BOOLEAN, ComBitSize=1, ComBitPosition=77, ComNotification=Rte_COMCbk_IBC_WheelSlipFRVD, ComSystemTemplateSystemSignalRef=IBC_WheelSlipFRVD
        IBC_WheelSlipRLVD: ComSignalType=BOOLEAN, ComBitSize=1, ComBitPosition=78, ComNotification=Rte_COMCbk_IBC_WheelSlipRLVD, ComSystemTemplateSystemSignalRef=IBC_WheelSlipRLVD
        IBC_WheelSlipRRVD: ComSignalType=BOOLEAN, ComBitSize=1, ComBitPosition=79, ComNotification=Rte_COMCbk_IBC_WheelSlipRRVD, ComSystemTemplateSystemSignalRef=IBC_WheelSlipRRVD
        IBC_WheelSlipFL: ComSignalType=UINT8, ComBitSize=8, ComBitPosition=80, ComNotification=Rte_COMCbk_IBC_WheelSlipFL, ComSystemTemplateSystemSignalRef=IBC_WheelSlipFL
        IBC_WheelSlipFR: ComSignalType=UINT8, ComBitSize=8, ComBitPosition=88, ComNotification=Rte_COMCbk_IBC_WheelSlipFR, ComSystemTemplateSystemSignalRef=IBC_WheelSlipFR
        IBC_WheelSlipRL: ComSignalType=UINT8, ComBitSize=8, ComBitPosition=96, ComNotification=Rte_COMCbk_IBC_WheelSlipRL, ComSystemTemplateSystemSignalRef=IBC_WheelSlipRL
        IBC_WheelSlipRR: ComSignalType=UINT8, ComBitSize=8, ComBitPosition=104, ComNotification=Rte_COMCbk_IBC_WheelSlipRR, ComSystemTemplateSystemSignalRef=IBC_WheelSlipRR
        IBC_Slop_Pencent: ComSignalType=UINT8, ComBitSize=8, ComBitPosition=136, ComNotification=Rte_COMCbk_IBC_Slop_Pencent, ComSystemTemplateSystemSignalRef=IBC_Slop_Pencent
      LMC_0xFA_C_CANFD (ComIPdu):
        ComIPduSignalProcessing = IMMEDIATE
        ComIPduType = NORMAL
        ComIPduDirection = RECEIVE
        ComIPduCallout = ComCallOut_LMC_0xFA_C_CANFD
        ComIPduErrorNotification = ComCbk_RxTimeOut_LMC_0xFA_C_CANFD
        ComFirstTimeout = 2.1
        ComTimeout = 0.1
        ComIPduGroupRef = ComIPduGroup_Rx
        ComPduIdRef = PduCollection/LMC_0xFA_C_CANFD_PduR2Com
        ComIPduSignalRef = LMC_CRC_FA
        ComIPduSignalRef = LMC_RollingCounter_FA
        ComIPduSignalRef = LMC_EngTorqDec_Main
        ComIPduSignalRef = LMC_EngTorqDecActive_Main
        ComIPduSignalRef = LMC_EngTorqInc_Main
        ComIPduSignalRef = LMC_EngTorqIncActive_Main
        ComIPduSignalRef = LMC_EngTorqDec_Sub
        ComIPduSignalRef = LMC_EngTorqDecActive_Sub
        ComIPduSignalRef = LMC_EngTorqInc_Sub
        ComIPduSignalRef = LMC_EngTorqIncActive_Sub
        ComIPduSignalRef = LMC_SysSt
        ComIPduSignalRef = LMC_EAF_ActiveSt
        ComIPduSignalRef = LMC_FTSC_ActiveSt
        ComIPduSignalRef = LMC_HSPC_ActiveSt
        ComIPduSignalRef = LMC_LSFCActiveSt
        ComIPduSignalRef = LMC_NSPC_ActiveSt
        ComIPduSignalRef = LMC_SDRM_ActiveSt
        ComIPduSignalRef = LMC_WBDC_ActiveSt
        ComIPduSignalRef = LMC_SelfCheckSt
        ComIPduSignalRef = LMC_EngTorqDec_Main_R
        ComIPduSignalRef = LMC_EngTorqDecActive_Main_R
        ComIPduSignalRef = LMC_EngTorqInc_Main_R
        ComIPduSignalRef = LMC_EngTorqIncActive_Main_R
        ComIPduSignalRef = LMC_AMM_St
      11 x ComSignal, all with ComSignalInitValue=0, ComSignalEndianness=LITTLE_ENDIAN, ComUpdateBitPosition=-1, ComTransferProperty=TRIGGERED:
        LMC_CRC_FA: ComSignalType=UINT8, ComBitSize=8, ComBitPosition=0, ComNotification=Rte_COMCbk_LMC_CRC_FA, ComSystemTemplateSystemSignalRef=LMC_CRC_FA
        LMC_RollingCounter_FA: ComSignalType=UINT8, ComBitSize=4, ComBitPosition=8, ComNotification=Rte_COMCbk_LMC_RollingCounter_FA, ComSystemTemplateSystemSignalRef=LMC_RollingCounter_FA
        LMC_EngTorqDec_Main: ComSignalType=UINT16, ComBitSize=10, ComBitPosition=16, ComNotification=Rte_COMCbk_LMC_EngTorqDec_Main, ComSystemTemplateSystemSignalRef=LMC_EngTorqDec_Main
        LMC_EngTorqDecActive_Main: ComSignalType=BOOLEAN, ComBitSize=1, ComBitPosition=26, ComNotification=Rte_COMCbk_LMC_EngTorqDecActive_Main, ComSystemTemplateSystemSignalRef=LMC_EngTorqDecActive_Main
        LMC_AMM_St: ComSignalType=UINT8, ComBitSize=2, ComBitPosition=27, ComNotification=Rte_COMCbk_LMC_AMM_St, ComSystemTemplateSystemSignalRef=LMC_AMM_St
        LMC_EngTorqInc_Main: ComSignalType=UINT16, ComBitSize=10, ComBitPosition=32, ComNotification=Rte_COMCbk_LMC_EngTorqInc_Main, ComSystemTemplateSystemSignalRef=LMC_EngTorqInc_Main
        LMC_EngTorqIncActive_Main: ComSignalType=BOOLEAN, ComBitSize=1, ComBitPosition=42, ComNotification=Rte_COMCbk_LMC_EngTorqIncActive_Main, ComSystemTemplateSystemSignalRef=LMC_EngTorqIncActive_Main
        LMC_EngTorqDec_Sub: ComSignalType=UINT16, ComBitSize=10, ComBitPosition=48, ComNotification=Rte_COMCbk_LMC_EngTorqDec_Sub, ComSystemTemplateSystemSignalRef=LMC_EngTorqDec_Sub
        LMC_EngTorqDecActive_Sub: ComSignalType=BOOLEAN, ComBitSize=1, ComBitPosition=58, ComNotification=Rte_COMCbk_LMC_EngTorqDecActive_Sub, ComSystemTemplateSystemSignalRef=LMC_EngTorqDecActive_Sub
        LMC_EngTorqInc_Sub: ComSignalType=UINT16, ComBitSize=10, ComBitPosition=64, ComNotification=Rte_COMCbk_LMC_EngTorqInc_Sub, ComSystemTemplateSystemSignalRef=LMC_EngTorqInc_Sub
        LMC_EngTorqIncActive_Sub: ComSignalType=BOOLEAN, ComBitSize=1, ComBitPosition=74, ComNotification=Rte_COMCbk_LMC_EngTorqIncActive_Sub, ComSystemTemplateSystemSignalRef=LMC_EngTorqIncActive_Sub
      LMC_0x18C_C_CANFD (ComIPdu):
        ComIPduSignalProcessing = IMMEDIATE
        ComIPduType = NORMAL
        ComIPduDirection = RECEIVE
        ComIPduCallout = ComCallOut_LMC_0x18C_C_CANFD
        ComIPduErrorNotification = ComCbk_RxTimeOut_LMC_0x18C_C_CANFD
        ComFirstTimeout = 2.2
        ComTimeout = 0.2
        ComIPduGroupRef = ComIPduGroup_Rx
        ComPduIdRef = PduCollection/LMC_0x18C_C_CANFD_PduR2Com
        ComIPduSignalRef = LMC_CRC_18C
        ComIPduSignalRef = LMC_RollingCounter_18C
        ComIPduSignalRef = LMC_TqTotalBrakeTorque
        ComIPduSignalRef = LMC_TqTotalBrakeTorque_Valid
        ComIPduSignalRef = LMC_CmpUTurnLockwhists
